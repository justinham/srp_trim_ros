VERSION ""

NS_ :

BS_:

BU_: WCM VPM VLM VKM UVM TIM TEST_TOOL_2 TEST_TOOL_1 TCP TCM TCCM3 TCCM STC SRR_SRR SRR_SLR SRR_RR SRR_RF SRR_LR_CR SRR_LF SIB SDM SCL SBZA_R SBZA_L SBM SADS RadioLow RSC RDCM PTM PDR PA NVM MTCM_R MTCM_L MSM_RR MSM_P MSM_LR MSM_D MSB2 MSB1 MRCM_R MRCM_L MFC LRR_HC LRR LIB1 IPC ICS_Info ICCM HVAC_FP_R HVAC_FP_F HUD_CAN HDLM FCM_LC FCM EPS EOCM_HCP2 EOCM_HCP1 EOCM ELM ECP_X1 ECP_MC ECP_E ECM EBCM DMS DEFC DCM CSM CMMb CMMa CGM BSM_MH BSM BCM ARS ARB APA AOS AMP ALC AHS AHL_AFL AGC
VAL_TABLE_ ASS_PhLckdLpLckd 0 "FALSE" 1 "TRUE" ;
VAL_TABLE_ ASS_DSPMd7Prsnt 0 "FALSE" 1 "TRUE" ;
VAL_TABLE_ ASS_DSPMd0Prsnt 0 "FALSE" 1 "TRUE" ;
VAL_TABLE_ ASS_DSPMd5Prsnt 0 "FALSE" 1 "TRUE" ;
VAL_TABLE_ ASS_VehNoisCmpnAvail 0 "FALSE" 1 "TRUE" ;
VAL_TABLE_ ASS_DSPAvail 0 "FALSE" 1 "TRUE" ;
VAL_TABLE_ ASS_DSPMd1Prsnt 0 "FALSE" 1 "TRUE" ;
VAL_TABLE_ ASS_SurndAvail 0 "FALSE" 1 "TRUE" ;
VAL_TABLE_ ASS_DSPMd4Prsnt 0 "FALSE" 1 "TRUE" ;
VAL_TABLE_ ASS_DSPMd2Prsnt 0 "FALSE" 1 "TRUE" ;
VAL_TABLE_ ASS_MtxSnkMutStat 0 "FALSE" 1 "TRUE" ;
VAL_TABLE_ ASS_DSPMd6Prsnt 0 "FALSE" 1 "TRUE" ;
VAL_TABLE_ ASS_DSPMd3Prsnt 0 "FALSE" 1 "TRUE" ;
VAL_TABLE_ FrtPsngrMtxSnkMutSts 0 "FALSE" 1 "TRUE" ;
VAL_TABLE_ CCSI_CrtclChmPrdcrSOH 0 "Unknown" 1 "Healthy" 2 "Faulted" ;
VAL_TABLE_ RRMtxSnkMutSts 0 "FALSE" 1 "TRUE" ;
VAL_TABLE_ LRMtxSnkMutSts 0 "FALSE" 1 "TRUE" ;
VAL_TABLE_ DirAudPrmtRndrngActv 0 "FALSE" 1 "TRUE" ;
VAL_TABLE_ HMIInCarVcCommSts 0 "ICC_Off" 1 "ICC_Idle" 2 "Front_High_Rear_High" 3 "Front_High_Rear_Normal" 4 "Front_High_Rear_Off" 5 "Front_Normal_Rear_High" 6 "Front_Normal_Rear_Normal" 7 "Front_Normal_Rear_Off" ;
VAL_TABLE_ AATP_ActAxlTrqAuth_Inv 0 "FALSE" 1 "TRUE" ;
VAL_TABLE_ AEPP_AccEffcPosAuth_Inv 0 "FALSE" 1 "TRUE" ;
VAL_TABLE_ ASDRP_LnCntrWrnExtdIndReqAuth 0 "No Indication" 1 "Can Not See Lanes" 2 "Tight Curve" 3 "Freeway Ends" 4 "Construction" 5 "Excessive Speed" 6 "Vehicles Proximity" 7 "Unavailable" 8 "Attention Unknown" 9 "Due to Weather" 10 "Take Steering" 11 "Take Vehicle Control" 12 "Service Driver Assist System" 13 "Lane Following Locked Out" 14 "Reserved 1" 15 "Lane Ending" 16 "Exit Lane" 17 "GM Authority" 18 "Vehicle Setting" 19 "Adaptive Cruise" 20 "Controlled Access" 21 "Driver Attention Off Road" 22 "GPS Unavailable" 23 "Driver Action" 24 "Vehicle Center" 25 "Sensor Impaired" 26 "Opening Left" 27 "Opening Right" 28 "Changing Left" 29 "Changing Right" 30 "Complete Left" 31 "Complete Right" 32 "Unable Left" 33 "Unable Right" 34 "Cancelled Left" 35 "Cancelled Right" 36 "Timed Out Left" 37 "Timed Out Right" 38 "Trailer Narrow Lane" 39 "Trailer Dimensions" 40 "Trailer Braking" 41 "Trailer Overloaded" 42 "Trailer Stability" 43 "Subscription Required" ;
VAL_TABLE_ ASDRP_LnCntrCtlIndReqAuth 0 "Indication Off" 1 "White Indicator" 2 "Green Indicator" 3 "Yellow Indicator" 4 "Red Indicator" 5 "Blue Indicator" ;
VAL_TABLE_ ASOCNP_LKATakeStrgIndOnAuth 0 "FALSE" 1 "TRUE" ;
VAL_TABLE_ ASTIP_LnCntrVehStopdAuth 0 "FALSE" 1 "TRUE" ;
VAL_TABLE_ ASSLC_AutoLdnsCmpnAct 0 "FALSE" 1 "TRUE" ;
VAL_TABLE_ ASSLC_VcSrcActOnMtx 0 "FALSE" 1 "TRUE" ;
VAL_TABLE_ AutoLnChgCstAvlFlg5 0 "FALSE" 1 "TRUE" ;
VAL_TABLE_ AutoLnChgCstAvlFlg4 0 "FALSE" 1 "TRUE" ;
VAL_TABLE_ AutoLnChgCstAvlFlg3 0 "FALSE" 1 "TRUE" ;
VAL_TABLE_ AutoLnChgCstAvlFlg2 0 "FALSE" 1 "TRUE" ;
VAL_TABLE_ AutoLnChgCstAvlFlg1 0 "FALSE" 1 "TRUE" ;
VAL_TABLE_ AutoLnChgCstCurrSetVal 0 "Setting Unkown" 1 "Off" 2 "On" 3 "LCOD" 4 "LCOD and ALC" ;
VAL_TABLE_ RIMObjAtchdIndOn 0 "FALSE" 1 "TRUE" ;
VAL_TABLE_ RIMElecPrkBrkRelIndOn 0 "FALSE" 1 "TRUE" ;
VAL_TABLE_ AutoLnChgCstSetAval 0 "FALSE" 1 "TRUE" ;
VAL_TABLE_ AutoLnChgCstAvlFlg7 0 "FALSE" 1 "TRUE" ;
VAL_TABLE_ AutoLnChgCstAvlFlg6 0 "FALSE" 1 "TRUE" ;
VAL_TABLE_ BGI1P_RmtVehStrtReqAuth 0 "FALSE" 1 "TRUE" ;
VAL_TABLE_ BGI1P_RmtStrtStsAuth 0 "Inactive" 1 "Active" ;
VAL_TABLE_ BGI1P_OutsdAmbtLgtLvlStsAuth 0 "Unknown" 1 "Day" 2 "Night" ;
VAL_TABLE_ BGI1P_DrvrDrOpnStsAuth_Inv 0 "FALSE" 1 "TRUE" ;
VAL_TABLE_ BGI1P_DrvrDrOpnStsAuth_DuD 0 "FALSE" 1 "TRUE" ;
VAL_TABLE_ BGI1P_DrvrDrOpnStsAuth 0 "FALSE" 1 "TRUE" ;
VAL_TABLE_ BGI2P_WprFrtHiSwFiltdAuth 0 "FALSE" 1 "TRUE" ;
VAL_TABLE_ BGI2P_ServWprSysDrvIndOnAuth 0 "FALSE" 1 "TRUE" ;
VAL_TABLE_ BGI2P_WshFldLvlIndOnAuth 0 "FALSE" 1 "TRUE" ;
VAL_TABLE_ BGI2P_EnvModPrsntRspdr3Auth 0 "FALSE" 1 "TRUE" ;
VAL_TABLE_ BSPMP_SecRunCrnkCmdActvAuth_Inv 0 "FALSE" 1 "TRUE" ;
VAL_TABLE_ BSPMP_SecRunCrnkCmdActvAuth 0 "FALSE" 1 "TRUE" ;
VAL_TABLE_ BSPMP_SecPwrModePBActvAuth_Inv 0 "FALSE" 1 "TRUE" ;
VAL_TABLE_ BSPMP_SecPwrModePBActvAuth 0 "FALSE" 1 "TRUE" ;
VAL_TABLE_ BSPMP_BkupSysPwrModeAuth_Inv 0 "FALSE" 1 "TRUE" ;
VAL_TABLE_ BSPMP_BkupSysPwrModeAuth 0 "Off" 1 "Accessory" 2 "Run" 3 "Start Request" 4 "Propulsion" ;
VAL_TABLE_ BSPMP_RmtProgmActvAuth 0 "FALSE" 1 "TRUE" ;
VAL_TABLE_ BSDIP_ESCOffVisIndOnAuth 0 "FALSE" 1 "TRUE" ;
VAL_TABLE_ BSDIP_EPBSysWrnIndReqAuth 0 "Off" 1 "On" 2 "0.5_Hz" 3 "1_Hz" 4 "2_Hz" 5 "4_Hz" ;
VAL_TABLE_ BSDIP_EPBSysStsIndReqAuth 0 "Off" 1 "On" 2 "0.5_Hz" 3 "1_Hz" 4 "2_Hz" 5 "4_Hz" ;
VAL_TABLE_ BSDIP_ABSIndOnAuth 0 "FALSE" 1 "TRUE" ;
VAL_TABLE_ BSDIP_TracCtlOffVisIndOnAuth 0 "FALSE" 1 "TRUE" ;
VAL_TABLE_ BSDIP_SrvBrkRdBrkTTShrtChIOAuth 0 "FALSE" 1 "TRUE" ;
VAL_TABLE_ BSDIP_ServBrkRdBrkTTLngChIOAuth 0 "FALSE" 1 "TRUE" ;
VAL_TABLE_ BSDIP_ServBrkBstSrvBrkAssIOAuth 0 "FALSE" 1 "TRUE" ;
VAL_TABLE_ BSDIP_ESCVisIndReqAuth 0 "OFF" 1 "ON" 2 "2_Hz" ;
VAL_TABLE_ ClsnEvntDatRcrdgTrgrd 0 "FALSE" 1 "TRUE" ;
VAL_TABLE_ LLDP_LatAccelAuth_Inv 0 "FALSE" 1 "TRUE" ;
VAL_TABLE_ BGI3P_BrkPedModrTrvlAchAuth_Inv 0 "FALSE" 1 "TRUE" ;
VAL_TABLE_ BGI3P_BrkPedPstnAuth_Inv 0 "FALSE" 1 "TRUE" ;
VAL_TABLE_ LLDP_LongAccelAuth_Inv 0 "FALSE" 1 "TRUE" ;
VAL_TABLE_ BGI3P_BrkPedModrTrvlAchAuth 0 "FALSE" 1 "TRUE" ;
VAL_TABLE_ BGI3P_BrkPedInitTrvlAchAuth_Inv 0 "FALSE" 1 "TRUE" ;
VAL_TABLE_ BGI3P_CruzSpdLmtrSwStsAuth 0 "Indeterminate" 1 "No_Activation" 2 "Resume" 3 "Set" 4 "SL/SW On/Off" 5 "Cruise On/Off" 6 "Cancel" 7 "Short to Ground" 8 "Open/Short to Power" 9 "Between_Ranges" ;
VAL_TABLE_ BGI3P_BrkPedInitTrvlAchAuth 0 "FALSE" 1 "TRUE" ;
VAL_TABLE_ YRP_YawRateAuth_Inv 0 "FALSE" 1 "TRUE" ;
VAL_TABLE_ YRP_YawRateAuth_DuD 0 "FALSE" 1 "TRUE" ;
VAL_TABLE_ CBIP_ACCBrkgStsAuth 0 "Not Active" 1 "Active" 2 "Failed" ;
VAL_TABLE_ FAVP_WhlAngVelRFrtAuth_Inv 0 "FALSE" 1 "TRUE" ;
VAL_TABLE_ FAVP_WhlAngVelLFrtAuth_Inv 0 "FALSE" 1 "TRUE" ;
VAL_TABLE_ RAVP_WhlAngVelRRrAuth_Inv 0 "FALSE" 1 "TRUE" ;
VAL_TABLE_ RAVP_WhlAngVelLRrAuth_Inv 0 "FALSE" 1 "TRUE" ;
VAL_TABLE_ VAP_ActlVehAccelAuth_Inv 0 "FALSE" 1 "TRUE" ;
VAL_TABLE_ WRDSP_RRAuth 0 "Unknown" 1 "Not Supported" 2 "Invalid" 3 "Forward" 4 "Reverse" ;
VAL_TABLE_ WRDSP_LFAuth 0 "Unknown" 1 "Not Supported" 2 "Invalid" 3 "Forward" 4 "Reverse" ;
VAL_TABLE_ ThrPstn_Inv 0 "FALSE" 1 "TRUE" ;
VAL_TABLE_ WRDSP_RFAuth 0 "Unknown" 1 "Not Supported" 2 "Invalid" 3 "Forward" 4 "Reverse" ;
VAL_TABLE_ WRDSP_LRAuth 0 "Unknown" 1 "Not Supported" 2 "Invalid" 3 "Forward" 4 "Reverse" ;
VAL_TABLE_ TrnsTrqCnvCltCmdMd 0 "Unlocked" 1 "Transitioning" 2 "Controlled Slip" 3 "Locked" 4 "Not Supported" ;
VAL_TABLE_ DRCDNDP_DRCAvgDrvnRstOccAuth 0 "FALSE" 1 "TRUE" ;
VAL_TABLE_ DRCDNDP_DRCAvgDrvnAuth_Inv 0 "FALSE" 1 "TRUE" ;
VAL_TABLE_ DRCDNDP_DRCAvgNonDrvnAuth_Inv 0 "FALSE" 1 "TRUE" ;
VAL_TABLE_ DRCDNDP_DRCAvgNonDrvnRstOccAuth 0 "FALSE" 1 "TRUE" ;
VAL_TABLE_ DRCDNDP_DRCAvgDrvnSrcAuth 0 "Transmission Output Speed" 1 "Wheel Speed" ;
VAL_TABLE_ BSIS2P_BrkPdlDrvAppPrsDetcdAuth 0 "FALSE" 1 "TRUE" ;
VAL_TABLE_ BSIS2P_BrkPdlDrvAppPrsDtdAuth_In 0 "FALSE" 1 "TRUE" ;
VAL_TABLE_ BSIS2P_BrkPdlDrvApplPresAuth_Inv 0 "FALSE" 1 "TRUE" ;
VAL_TABLE_ BSIS2P_ABSFldAuth 0 "FALSE" 1 "TRUE" ;
VAL_TABLE_ BSIS2P_ABSAtvAuth 0 "FALSE" 1 "TRUE" ;
VAL_TABLE_ AAASSRP_StrgReqStsAuth 0 "Unknown" 1 "Active" 2 "Inactive" ;
VAL_TABLE_ EPSOP_ElecPwStrgTqOvlyStsAuth 0 "Unknown" 1 "Temporarily Inhibited" 2 "Inactive" 3 "Active" 4 "Temporarily Limited" 5 "Failed" ;
VAL_TABLE_ EngCyldrDctvRqd 0 "FALSE" 1 "TRUE" ;
VAL_TABLE_ EngCylDctvMd 0 "All Cylinders Active" 1 "Deactivation In Progress" 2 "Half of Total Cylinders Active" 3 "Reactivation In Progress" ;
VAL_TABLE_ SWHOP_StrgWhlHndsOffDtnStatAuth 0 "Hands On" 1 "Hands Off" 2 "Unknown" ;
VAL_TABLE_ SSASIP_StrgWhlTrqIntegStsAuth 0 "Unknown" 1 "Redundant ASIL D" 2 "Non Redundant ASIL D" 3 "Failed" ;
VAL_TABLE_ PTOAccelUpnBrkRelIndOn 0 "FALSE" 1 "TRUE" ;
VAL_TABLE_ PTOEngRunTmrCstCurrSetVal 0 "Setting Unknown" 1 "Min 10" 2 "Min 30" 3 "Min 90" 4 "Min 120" 5 "Min 150" 6 "Min 180" 7 "Min 210" 8 "Min 240" 9 "Min 270" 10 "Min 200" 11 "Min 330" 12 "Min 360" 13 "Min 390" 14 "Min 420" 15 "Min 450" ;
VAL_TABLE_ PTOStndbySpdCstSetAval 0 "FALSE" 1 "TRUE" ;
VAL_TABLE_ PTOSetPrkBrkIndOn 0 "FALSE" 1 "TRUE" ;
VAL_TABLE_ PTOSet2SpdCstSetAval 0 "FALSE" 1 "TRUE" ;
VAL_TABLE_ PTOSet1SpdCstSetAval 0 "FALSE" 1 "TRUE" ;
VAL_TABLE_ PTOServIndOn 0 "FALSE" 1 "TRUE" ;
VAL_TABLE_ PTORelBrkPedIndOn 0 "FALSE" 1 "TRUE" ;
VAL_TABLE_ PTORelAccelPedIndOn 0 "FALSE" 1 "TRUE" ;
VAL_TABLE_ PTORdcEngSpdIndOn 0 "FALSE" 1 "TRUE" ;
VAL_TABLE_ PTExPrtclFltrWrn3IndOn 0 "FALSE" 1 "TRUE" ;
VAL_TABLE_ PTExPrtclFltrMnlRgnSts 0 "Cleaning Not Required" 1 "Allowed" 2 "Not Allowed" 3 "In Progress" 4 "Complete" 5 "Pending Driver Input" 6 "Not Available" 7 "Do Not Press Pedals" ;
VAL_TABLE_ ServFuelSysTrnsfrPmpIO 0 "FALSE" 1 "TRUE" ;
VAL_TABLE_ PTOTransInGrIndOn 0 "FALSE" 1 "TRUE" ;
VAL_TABLE_ PTOTpStpSpdCstSetAval 0 "FALSE" 1 "TRUE" ;
VAL_TABLE_ HiVltgChrgrSysSts 0 "Default" 1 "Idle" 2 "Initializing" 3 "Active" 4 "Complete" 5 "Aborted" 6 "Utility Override Active" 7 "Utility Override Reduced Power" 8 "Pause Due to Update" 9 "Connection Unpowered" 10 "Unconnected" ;
VAL_TABLE_ PTOEngUpnBrkRelIndOn 0 "FALSE" 1 "TRUE" ;
VAL_TABLE_ PTODisengCruzCtlIndOn 0 "FALSE" 1 "TRUE" ;
VAL_TABLE_ PTOEngmntStsInd 0 "No Indication" 1 "Continuous Indication" 2 "Slow Flashing Indication" 3 "Fast Flashing Indication" ;
VAL_TABLE_ PTOEngRunTmrCstAvlFlg2 0 "FALSE" 1 "TRUE" ;
VAL_TABLE_ PTOEngRunTmrCstAvlFlg15 0 "FALSE" 1 "TRUE" ;
VAL_TABLE_ PTOEngRunTmrCstAvlFlg14 0 "FALSE" 1 "TRUE" ;
VAL_TABLE_ PTOEngRunTmrCstAvlFlg13 0 "FALSE" 1 "TRUE" ;
VAL_TABLE_ PTOEngRunTmrCstAvlFlg12 0 "FALSE" 1 "TRUE" ;
VAL_TABLE_ EngAftRunIndReq 0 "No Action" 1 "No Indication" 2 "Idle Needed" 3 "Overheated" 4 "Interrupted" ;
VAL_TABLE_ PTOSet2SpdCstAvlFlg4 0 "FALSE" 1 "TRUE" ;
VAL_TABLE_ PTOSet2SpdCstAvlFlg3 0 "FALSE" 1 "TRUE" ;
VAL_TABLE_ PTOSet2SpdCstAvlFlg2 0 "FALSE" 1 "TRUE" ;
VAL_TABLE_ PTOSet2SpdCstAvlFlg15 0 "FALSE" 1 "TRUE" ;
VAL_TABLE_ PTOSet2SpdCstAvlFlg14 0 "FALSE" 1 "TRUE" ;
VAL_TABLE_ PTOSet2SpdCstAvlFlg13 0 "FALSE" 1 "TRUE" ;
VAL_TABLE_ PTOSet2SpdCstAvlFlg12 0 "FALSE" 1 "TRUE" ;
VAL_TABLE_ PTOSet2SpdCstAvlFlg11 0 "FALSE" 1 "TRUE" ;
VAL_TABLE_ PTOStndbySpdCstAvlFlg3 0 "FALSE" 1 "TRUE" ;
VAL_TABLE_ PTOStndbySpdCstAvlFlg2 0 "FALSE" 1 "TRUE" ;
VAL_TABLE_ PTOStndbySpdCstAvlFlg1 0 "FALSE" 1 "TRUE" ;
VAL_TABLE_ PTOSet2SpdCstAvlFlg9 0 "FALSE" 1 "TRUE" ;
VAL_TABLE_ PTOSet2SpdCstAvlFlg8 0 "FALSE" 1 "TRUE" ;
VAL_TABLE_ PTOSet2SpdCstAvlFlg7 0 "FALSE" 1 "TRUE" ;
VAL_TABLE_ PTOSet2SpdCstAvlFlg6 0 "FALSE" 1 "TRUE" ;
VAL_TABLE_ PTOSet2SpdCstAvlFlg5 0 "FALSE" 1 "TRUE" ;
VAL_TABLE_ PTOTpStpSpdCstAvlFlg4 0 "FALSE" 1 "TRUE" ;
VAL_TABLE_ PTOTpStpSpdCstAvlFlg3 0 "FALSE" 1 "TRUE" ;
VAL_TABLE_ PTOTpStpSpdCstAvlFlg2 0 "FALSE" 1 "TRUE" ;
VAL_TABLE_ PTOTpStpSpdCstAvlFlg1 0 "FALSE" 1 "TRUE" ;
VAL_TABLE_ PTOStndbySpdCstAvlFlg7 0 "FALSE" 1 "TRUE" ;
VAL_TABLE_ PTOStndbySpdCstAvlFlg6 0 "FALSE" 1 "TRUE" ;
VAL_TABLE_ PTOStndbySpdCstAvlFlg5 0 "FALSE" 1 "TRUE" ;
VAL_TABLE_ PTOStndbySpdCstAvlFlg4 0 "FALSE" 1 "TRUE" ;
VAL_TABLE_ UpftrSnwPlwIndReq 0 "No Indication" 1 "Active" 2 "Active with Headlamps Disabled" 3 "Not Available" ;
VAL_TABLE_ UpftrRrAprchPrtctnIndReq 0 "No Indication" 1 "Armed" 2 "Deactivated" 3 "Triggered" 4 "Not Available" ;
VAL_TABLE_ PTOTpStpSpdCstAvlFlg7 0 "FALSE" 1 "TRUE" ;
VAL_TABLE_ PTOTpStpSpdCstAvlFlg6 0 "FALSE" 1 "TRUE" ;
VAL_TABLE_ PTOTpStpSpdCstAvlFlg5 0 "FALSE" 1 "TRUE" ;
VAL_TABLE_ IBS12VEstdBatTemp_Inv 0 "FALSE" 1 "TRUE" ;
VAL_TABLE_ UpftrRadioMutReqd 0 "FALSE" 1 "TRUE" ;
VAL_TABLE_ UpftrBkupCamActvnReqd 0 "FALSE" 1 "TRUE" ;
VAL_TABLE_ UpftrVehStrtEnblIndReq 0 "No Indication" 1 "On" 2 "Off" 3 "Not Available" ;
VAL_TABLE_ TransOilFiltChgIndOn 0 "FALSE" 1 "TRUE" ;
VAL_TABLE_ StBltTghtngCstAvlFlg7 0 "FALSE" 1 "TRUE" ;
VAL_TABLE_ StBltTghtngCstAvlFlg6 0 "FALSE" 1 "TRUE" ;
VAL_TABLE_ StBltTghtngCstAvlFlg5 0 "FALSE" 1 "TRUE" ;
VAL_TABLE_ StBltTghtngCstAvlFlg4 0 "FALSE" 1 "TRUE" ;
VAL_TABLE_ StBltTghtngCstAvlFlg3 0 "FALSE" 1 "TRUE" ;
VAL_TABLE_ StBltTghtngCstAvlFlg2 0 "FALSE" 1 "TRUE" ;
VAL_TABLE_ StBltTghtngCstAvlFlg1 0 "FALSE" 1 "TRUE" ;
VAL_TABLE_ RrCrsTrfcAlrtCstAvlFlg7 0 "FALSE" 1 "TRUE" ;
VAL_TABLE_ TrnsOlTmpSnsPrs 0 "FALSE" 1 "TRUE" ;
VAL_TABLE_ TrffcLgtAsstCstAvlFlg7 0 "FALSE" 1 "TRUE" ;
VAL_TABLE_ TrffcLgtAsstCstAvlFlg6 0 "FALSE" 1 "TRUE" ;
VAL_TABLE_ TrffcLgtAsstCstAvlFlg5 0 "FALSE" 1 "TRUE" ;
VAL_TABLE_ TrffcLgtAsstCstAvlFlg4 0 "FALSE" 1 "TRUE" ;
VAL_TABLE_ TrffcLgtAsstCstAvlFlg3 0 "FALSE" 1 "TRUE" ;
VAL_TABLE_ TrffcLgtAsstCstAvlFlg2 0 "FALSE" 1 "TRUE" ;
VAL_TABLE_ TrffcLgtAsstCstAvlFlg1 0 "FALSE" 1 "TRUE" ;
VAL_TABLE_ CustNonUsblSOC_DuD 0 "FALSE" 1 "TRUE" ;
VAL_TABLE_ GoNotfrCstAvlFlg7 0 "FALSE" 1 "TRUE" ;
VAL_TABLE_ GoNotfrCstAvlFlg6 0 "FALSE" 1 "TRUE" ;
VAL_TABLE_ GoNotfrCstAvlFlg5 0 "FALSE" 1 "TRUE" ;
VAL_TABLE_ GoNotfrCstAvlFlg4 0 "FALSE" 1 "TRUE" ;
VAL_TABLE_ GoNotfrCstAvlFlg3 0 "FALSE" 1 "TRUE" ;
VAL_TABLE_ GoNotfrCstAvlFlg2 0 "FALSE" 1 "TRUE" ;
VAL_TABLE_ GoNotfrCstAvlFlg1 0 "FALSE" 1 "TRUE" ;
VAL_TABLE_ GlrFrHgBmRspTypCstAvlFlg7 0 "FALSE" 1 "TRUE" ;
VAL_TABLE_ LtRtHnTrCstAvlFlg1 0 "FALSE" 1 "TRUE" ;
VAL_TABLE_ LnChgAlrtCstAvlFlg7 0 "FALSE" 1 "TRUE" ;
VAL_TABLE_ LnChgAlrtCstAvlFlg6 0 "FALSE" 1 "TRUE" ;
VAL_TABLE_ LnChgAlrtCstAvlFlg5 0 "FALSE" 1 "TRUE" ;
VAL_TABLE_ LnChgAlrtCstAvlFlg4 0 "FALSE" 1 "TRUE" ;
VAL_TABLE_ LnChgAlrtCstAvlFlg3 0 "FALSE" 1 "TRUE" ;
VAL_TABLE_ LnChgAlrtCstAvlFlg2 0 "FALSE" 1 "TRUE" ;
VAL_TABLE_ LnChgAlrtCstAvlFlg1 0 "FALSE" 1 "TRUE" ;
VAL_TABLE_ PrkAsstONOFFCstAvlFlg1 0 "FALSE" 1 "TRUE" ;
VAL_TABLE_ PTHiElecLdReqd 0 "FALSE" 1 "TRUE" ;
VAL_TABLE_ LtRtHnTrCstAvlFlg7 0 "FALSE" 1 "TRUE" ;
VAL_TABLE_ LtRtHnTrCstAvlFlg6 0 "FALSE" 1 "TRUE" ;
VAL_TABLE_ LtRtHnTrCstAvlFlg5 0 "FALSE" 1 "TRUE" ;
VAL_TABLE_ LtRtHnTrCstAvlFlg4 0 "FALSE" 1 "TRUE" ;
VAL_TABLE_ LtRtHnTrCstAvlFlg3 0 "FALSE" 1 "TRUE" ;
VAL_TABLE_ LtRtHnTrCstAvlFlg2 0 "FALSE" 1 "TRUE" ;
VAL_TABLE_ PrkAsstTrHtchPsntCstAvlFlg2 0 "FALSE" 1 "TRUE" ;
VAL_TABLE_ PrkAsstTrHtchPsntCstAvlFlg1 0 "FALSE" 1 "TRUE" ;
VAL_TABLE_ PrkAsstONOFFCstAvlFlg7 0 "FALSE" 1 "TRUE" ;
VAL_TABLE_ PrkAsstONOFFCstAvlFlg6 0 "FALSE" 1 "TRUE" ;
VAL_TABLE_ PrkAsstONOFFCstAvlFlg5 0 "FALSE" 1 "TRUE" ;
VAL_TABLE_ PrkAsstONOFFCstAvlFlg4 0 "FALSE" 1 "TRUE" ;
VAL_TABLE_ PrkAsstONOFFCstAvlFlg3 0 "FALSE" 1 "TRUE" ;
VAL_TABLE_ PrkAsstONOFFCstAvlFlg2 0 "FALSE" 1 "TRUE" ;
VAL_TABLE_ PFASndSeltnCstAvlFlg2 0 "FALSE" 1 "TRUE" ;
VAL_TABLE_ PFASndSeltnCstAvlFlg1 0 "FALSE" 1 "TRUE" ;
VAL_TABLE_ LgslDiagStdCndMet 0 "FALSE" 1 "TRUE" ;
VAL_TABLE_ PrkAsstTrHtchPsntCstAvlFlg7 0 "FALSE" 1 "TRUE" ;
VAL_TABLE_ PrkAsstTrHtchPsntCstAvlFlg6 0 "FALSE" 1 "TRUE" ;
VAL_TABLE_ PrkAsstTrHtchPsntCstAvlFlg5 0 "FALSE" 1 "TRUE" ;
VAL_TABLE_ PrkAsstTrHtchPsntCstAvlFlg4 0 "FALSE" 1 "TRUE" ;
VAL_TABLE_ PrkAsstTrHtchPsntCstAvlFlg3 0 "FALSE" 1 "TRUE" ;
VAL_TABLE_ RnngBrdAutoDplyCstAvlFlg4 0 "FALSE" 1 "TRUE" ;
VAL_TABLE_ RnngBrdAutoDplyCstAvlFlg3 0 "FALSE" 1 "TRUE" ;
VAL_TABLE_ RnngBrdAutoDplyCstAvlFlg2 0 "FALSE" 1 "TRUE" ;
VAL_TABLE_ RnngBrdAutoDplyCstAvlFlg1 0 "FALSE" 1 "TRUE" ;
VAL_TABLE_ PFASndSeltnCstAvlFlg6 0 "FALSE" 1 "TRUE" ;
VAL_TABLE_ PFASndSeltnCstAvlFlg5 0 "FALSE" 1 "TRUE" ;
VAL_TABLE_ PFASndSeltnCstAvlFlg4 0 "FALSE" 1 "TRUE" ;
VAL_TABLE_ PFASndSeltnCstAvlFlg3 0 "FALSE" 1 "TRUE" ;
VAL_TABLE_ RnngBrdManDplyCstAvlFlg5 0 "FALSE" 1 "TRUE" ;
VAL_TABLE_ RnngBrdManDplyCstAvlFlg4 0 "FALSE" 1 "TRUE" ;
VAL_TABLE_ RnngBrdManDplyCstAvlFlg3 0 "FALSE" 1 "TRUE" ;
VAL_TABLE_ RnngBrdManDplyCstAvlFlg2 0 "FALSE" 1 "TRUE" ;
VAL_TABLE_ RnngBrdManDplyCstAvlFlg1 0 "FALSE" 1 "TRUE" ;
VAL_TABLE_ RnngBrdAutoDplyCstAvlFlg7 0 "FALSE" 1 "TRUE" ;
VAL_TABLE_ RnngBrdAutoDplyCstAvlFlg6 0 "FALSE" 1 "TRUE" ;
VAL_TABLE_ RnngBrdAutoDplyCstAvlFlg5 0 "FALSE" 1 "TRUE" ;
VAL_TABLE_ RrCrsTrfcAlrtCstAvlFlg6 0 "FALSE" 1 "TRUE" ;
VAL_TABLE_ RrCrsTrfcAlrtCstAvlFlg5 0 "FALSE" 1 "TRUE" ;
VAL_TABLE_ RrCrsTrfcAlrtCstAvlFlg4 0 "FALSE" 1 "TRUE" ;
VAL_TABLE_ RrCrsTrfcAlrtCstAvlFlg3 0 "FALSE" 1 "TRUE" ;
VAL_TABLE_ RrCrsTrfcAlrtCstAvlFlg2 0 "FALSE" 1 "TRUE" ;
VAL_TABLE_ RrCrsTrfcAlrtCstAvlFlg1 0 "FALSE" 1 "TRUE" ;
VAL_TABLE_ RnngBrdManDplyCstAvlFlg7 0 "FALSE" 1 "TRUE" ;
VAL_TABLE_ RnngBrdManDplyCstAvlFlg6 0 "FALSE" 1 "TRUE" ;
VAL_TABLE_ AutMemRclCstAvlFlg4 0 "FALSE" 1 "TRUE" ;
VAL_TABLE_ AutMemRclCstAvlFlg3 0 "FALSE" 1 "TRUE" ;
VAL_TABLE_ AutMemRclCstAvlFlg2 0 "FALSE" 1 "TRUE" ;
VAL_TABLE_ AutMemRclCstAvlFlg1 0 "FALSE" 1 "TRUE" ;
VAL_TABLE_ AdpLghtRspTypCstAvlFlg7 0 "FALSE" 1 "TRUE" ;
VAL_TABLE_ AdpLghtRspTypCstAvlFlg6 0 "FALSE" 1 "TRUE" ;
VAL_TABLE_ AdpLghtRspTypCstAvlFlg5 0 "FALSE" 1 "TRUE" ;
VAL_TABLE_ AdpLghtRspTypCstAvlFlg4 0 "FALSE" 1 "TRUE" ;
VAL_TABLE_ EsyExtCstAvlFlg4 0 "FALSE" 1 "TRUE" ;
VAL_TABLE_ EsyExtCstAvlFlg3 0 "FALSE" 1 "TRUE" ;
VAL_TABLE_ EsyExtCstAvlFlg2 0 "FALSE" 1 "TRUE" ;
VAL_TABLE_ EsyExtCstAvlFlg1 0 "FALSE" 1 "TRUE" ;
VAL_TABLE_ EngIdlAtv 0 "FALSE" 1 "TRUE" ;
VAL_TABLE_ AutMemRclCstAvlFlg7 0 "FALSE" 1 "TRUE" ;
VAL_TABLE_ AutMemRclCstAvlFlg6 0 "FALSE" 1 "TRUE" ;
VAL_TABLE_ AutMemRclCstAvlFlg5 0 "FALSE" 1 "TRUE" ;
VAL_TABLE_ FrntPCMRspTypCstAvlFlg4 0 "FALSE" 1 "TRUE" ;
VAL_TABLE_ FrntPCMRspTypCstAvlFlg3 0 "FALSE" 1 "TRUE" ;
VAL_TABLE_ FrntPCMRspTypCstAvlFlg2 0 "FALSE" 1 "TRUE" ;
VAL_TABLE_ FrntPCMRspTypCstAvlFlg1 0 "FALSE" 1 "TRUE" ;
VAL_TABLE_ FlToPsSwAtv 0 "FALSE" 1 "TRUE" ;
VAL_TABLE_ EsyExtCstAvlFlg7 0 "FALSE" 1 "TRUE" ;
VAL_TABLE_ EsyExtCstAvlFlg6 0 "FALSE" 1 "TRUE" ;
VAL_TABLE_ EsyExtCstAvlFlg5 0 "FALSE" 1 "TRUE" ;
VAL_TABLE_ FrwdImpMtgnOpSlctCstAvlFlg5 0 "FALSE" 1 "TRUE" ;
VAL_TABLE_ FrwdImpMtgnOpSlctCstAvlFlg4 0 "FALSE" 1 "TRUE" ;
VAL_TABLE_ FrwdImpMtgnOpSlctCstAvlFlg3 0 "FALSE" 1 "TRUE" ;
VAL_TABLE_ FrwdImpMtgnOpSlctCstAvlFlg2 0 "FALSE" 1 "TRUE" ;
VAL_TABLE_ FrwdImpMtgnOpSlctCstAvlFlg1 0 "FALSE" 1 "TRUE" ;
VAL_TABLE_ FrntPCMRspTypCstAvlFlg7 0 "FALSE" 1 "TRUE" ;
VAL_TABLE_ FrntPCMRspTypCstAvlFlg6 0 "FALSE" 1 "TRUE" ;
VAL_TABLE_ FrntPCMRspTypCstAvlFlg5 0 "FALSE" 1 "TRUE" ;
VAL_TABLE_ GlrFrHgBmRspTypCstAvlFlg6 0 "FALSE" 1 "TRUE" ;
VAL_TABLE_ GlrFrHgBmRspTypCstAvlFlg5 0 "FALSE" 1 "TRUE" ;
VAL_TABLE_ GlrFrHgBmRspTypCstAvlFlg4 0 "FALSE" 1 "TRUE" ;
VAL_TABLE_ GlrFrHgBmRspTypCstAvlFlg3 0 "FALSE" 1 "TRUE" ;
VAL_TABLE_ GlrFrHgBmRspTypCstAvlFlg2 0 "FALSE" 1 "TRUE" ;
VAL_TABLE_ GlrFrHgBmRspTypCstAvlFlg1 0 "FALSE" 1 "TRUE" ;
VAL_TABLE_ FrwdImpMtgnOpSlctCstAvlFlg7 0 "FALSE" 1 "TRUE" ;
VAL_TABLE_ FrwdImpMtgnOpSlctCstAvlFlg6 0 "FALSE" 1 "TRUE" ;
VAL_TABLE_ BarPrsAbs_Inv 0 "FALSE" 1 "TRUE" ;
VAL_TABLE_ BatVlt_Inv 0 "FALSE" 1 "TRUE" ;
VAL_TABLE_ DslExhFldLvlPct_Inv 0 "FALSE" 1 "TRUE" ;
VAL_TABLE_ EngOilTmp_Inv 0 "FALSE" 1 "TRUE" ;
VAL_TABLE_ RVC12VBatSOC_Inv 0 "FALSE" 1 "TRUE" ;
VAL_TABLE_ SprTireSt 0 "Undetermined" 1 "No Spare Detected" 2 "Spare Detected" ;
VAL_TABLE_ HiVltgBatMaxTemp_Inv 0 "FALSE" 1 "TRUE" ;
VAL_TABLE_ OATP_OtsAirTmpCrValAuth_Inv 0 "FALSE" 1 "TRUE" ;
VAL_TABLE_ PwrRrClsrCstAvlFlg4 0 "FALSE" 1 "TRUE" ;
VAL_TABLE_ PwrRrClsrCstAvlFlg3 0 "FALSE" 1 "TRUE" ;
VAL_TABLE_ PwrRrClsrCstAvlFlg2 0 "FALSE" 1 "TRUE" ;
VAL_TABLE_ PwrRrClsrCstAvlFlg1 0 "FALSE" 1 "TRUE" ;
VAL_TABLE_ PFASndSeltnCstSetAval 0 "FALSE" 1 "TRUE" ;
VAL_TABLE_ PFASndSeltnCstAvlFlg7 0 "FALSE" 1 "TRUE" ;
VAL_TABLE_ PwrRrClsrCstAvlFlg5 0 "FALSE" 1 "TRUE" ;
VAL_TABLE_ ACRfHiSdFldPrs_Inv 0 "FALSE" 1 "TRUE" ;
VAL_TABLE_ AdpLghtRspTypCstAvlFlg3 0 "FALSE" 1 "TRUE" ;
VAL_TABLE_ AdpLghtRspTypCstAvlFlg2 0 "FALSE" 1 "TRUE" ;
VAL_TABLE_ AdpLghtRspTypCstAvlFlg1 0 "FALSE" 1 "TRUE" ;
VAL_TABLE_ ABSPr 0 "FALSE" 1 "TRUE" ;
VAL_TABLE_ PMMiRAPStatus 0 "FALSE" 1 "TRUE" ;
VAL_TABLE_ RrPCMRspTypCstStAvl 0 "FALSE" 1 "TRUE" ;
VAL_TABLE_ RrPCMRspTypCstAvlFlg7 0 "FALSE" 1 "TRUE" ;
VAL_TABLE_ RrPCMRspTypCstAvlFlg6 0 "FALSE" 1 "TRUE" ;
VAL_TABLE_ RrPCMRspTypCstAvlFlg5 0 "FALSE" 1 "TRUE" ;
VAL_TABLE_ RrPCMRspTypCstAvlFlg4 0 "FALSE" 1 "TRUE" ;
VAL_TABLE_ RrPCMRspTypCstAvlFlg3 0 "FALSE" 1 "TRUE" ;
VAL_TABLE_ RrPCMRspTypCstAvlFlg2 0 "FALSE" 1 "TRUE" ;
VAL_TABLE_ RrPCMRspTypCstAvlFlg1 0 "FALSE" 1 "TRUE" ;
VAL_TABLE_ PAMutSts 0 "No Action" 1 "Show Mute" 2 "Show Unmute" ;
VAL_TABLE_ LDWCtrlAudAttnReqd 0 "FALSE" 1 "TRUE" ;
VAL_TABLE_ LDWCtrlHndOff3ChmEvntStat 0 "NO_ACTION" 1 "ACTIVE" 2 "CANCEL_CHIME" ;
VAL_TABLE_ StBltRmndrChmTyp2EvntStat 0 "No_Action" 1 "Active" 2 "Cancel_Chime" ;
VAL_TABLE_ TrnLmpRtIO 0 "FALSE" 1 "TRUE" ;
VAL_TABLE_ TrnLmpLftIO 0 "FALSE" 1 "TRUE" ;
VAL_TABLE_ RetainedACCpwrStatus 0 "FALSE" 1 "TRUE" ;
VAL_TABLE_ PrkAsstRrLftSdZn1ChEvntSt 0 "NO_ACTION" 1 "ACTIVE" 2 "CANCEL_CHIME" ;
VAL_TABLE_ PrkAsstRrFrstRprtChEvntSt 0 "NO_ACTION" 1 "ACTIVE" 2 "CANCEL_CHIME" ;
VAL_TABLE_ PrkAsstFrRgrChEvntSt 0 "NO_ACTION" 1 "ACTIVE" 2 "CANCEL_CHIME" ;
VAL_TABLE_ PrkAsstFrRghtSdZn6ChEvntSt 0 "NO_ACTION" 1 "ACTIVE" 2 "CANCEL_CHIME" ;
VAL_TABLE_ PrkAsstRrLftSdZn5ChEvntSt 0 "NO_ACTION" 1 "ACTIVE" 2 "CANCEL_CHIME" ;
VAL_TABLE_ PrkAsstRrLftSdZn4ChEvntSt 0 "NO_ACTION" 1 "ACTIVE" 2 "CANCEL_CHIME" ;
VAL_TABLE_ PrkAsstRrLftSdZn3ChEvntSt 0 "NO_ACTION" 1 "ACTIVE" 2 "CANCEL_CHIME" ;
VAL_TABLE_ PrkAsstRrLftSdZn2ChEvntSt 0 "NO_ACTION" 1 "ACTIVE" 2 "CANCEL_CHIME" ;
VAL_TABLE_ PrkAsstRrRghtSdZn3ChEvntSt 0 "NO_ACTION" 1 "ACTIVE" 2 "CANCEL_CHIME" ;
VAL_TABLE_ PrkAsstRrRghtSdZn2ChEvntSt 0 "NO_ACTION" 1 "ACTIVE" 2 "CANCEL_CHIME" ;
VAL_TABLE_ PrkAsstRrRghtSdZn1ChEvntSt 0 "NO_ACTION" 1 "ACTIVE" 2 "CANCEL_CHIME" ;
VAL_TABLE_ PrkAsstRrLftSdZn6ChEvntSt 0 "NO_ACTION" 1 "ACTIVE" 2 "CANCEL_CHIME" ;
VAL_TABLE_ PrkAsstRrRgrChEvntSt 0 "NO_ACTION" 1 "ACTIVE" 2 "CANCEL_CHIME" ;
VAL_TABLE_ PrkAsstRrRghtSdZn6ChEvntSt 0 "NO_ACTION" 1 "ACTIVE" 2 "CANCEL_CHIME" ;
VAL_TABLE_ PrkAsstRrRghtSdZn5ChEvntSt 0 "NO_ACTION" 1 "ACTIVE" 2 "CANCEL_CHIME" ;
VAL_TABLE_ PrkAsstRrRghtSdZn4ChEvntSt 0 "NO_ACTION" 1 "ACTIVE" 2 "CANCEL_CHIME" ;
VAL_TABLE_ RrCrsTrfcAlrtLftIndCtrl 0 "ON" 1 "OFF" 2 "FLASH" ;
VAL_TABLE_ RlOvrDsblStsChgChmEvntStat 0 "No_Action" 1 "Active" 2 "Cancel_Chime" ;
VAL_TABLE_ RIMIntCllnChmEvStat 0 "NO_ACTION" 1 "ACTIVE" 2 "CANCEL_CHIM" ;
VAL_TABLE_ RIMBrkPlsChEvStat 0 "NO_ACTION" 1 "ACTIVE" 2 "CANCEL_CHIM" ;
VAL_TABLE_ RrPCMChmEvntSt 0 "NO_ACTION" 1 "ACTIVE" 2 "CANCEL_CHIME" ;
VAL_TABLE_ RrCrsTrfcAlrtRtSdChmEvntStat 0 "NO_ACTION" 1 "ACTIVE" 2 "CANCEL_CHIME" ;
VAL_TABLE_ RrCrsTrfcAlrtRgIndCtrl 0 "ON" 1 "OFF" 2 "FLASH" ;
VAL_TABLE_ RrCrsTrfcAlrtLtSdChmEvntStat 0 "NO_ACTION" 1 "ACTIVE" 2 "CANCEL_CHIME" ;
VAL_TABLE_ DrHndlLRAuthReqd 0 "FALSE" 1 "TRUE" ;
VAL_TABLE_ DrHndlLFAuthReqd 0 "FALSE" 1 "TRUE" ;
VAL_TABLE_ FrtPedtrnClsnMtgnAudAttnReqd 0 "FALSE" 1 "TRUE" ;
VAL_TABLE_ ACCGoNtfrChmEvntSt 0 "NO_ACTION" 1 "ACTIVE" ;
VAL_TABLE_ TrffcLgtAsstWrnChmEvntStat 0 "NO_ACTION" 1 "ACTIVE" 2 "CANCEL_CHIME" 3 "RESERVED_1" ;
VAL_TABLE_ StBltRmndrChmEvntStat 0 "NO_ACTION" 1 "ACTIVE" 2 "CANCEL_CHIME" ;
VAL_TABLE_ HVACUsrCtlIntrctnDispReqd 0 "FALSE" 1 "TRUE" ;
VAL_TABLE_ AirDflctrIndReq 0 "Off" 1 "Service" 2 "Stuck" ;
VAL_TABLE_ RrClsrRelAuthReqd 0 "FALSE" 1 "TRUE" ;
VAL_TABLE_ LnKpAsstTkStrIndOn 0 "FALSE" 1 "TRUE" ;
VAL_TABLE_ FrtClsrRelAuthReqd 0 "FALSE" 1 "TRUE" ;
VAL_TABLE_ DrHndlRRAuthReqd 0 "FALSE" 1 "TRUE" ;
VAL_TABLE_ DrHndlRFAuthReqd 0 "FALSE" 1 "TRUE" ;
VAL_TABLE_ MemStrTrplBeepChmEvStCoDrv 0 "No Action" 1 "Active" 2 "Cancel Chime" ;
VAL_TABLE_ MemStrSnglBeepChmEvStRR 0 "No Action" 1 "Active" 2 "Cancel Chime" ;
VAL_TABLE_ MemStrSnglBeepChmEvStLR 0 "No Action" 1 "Active" 2 "Cancel Chime" ;
VAL_TABLE_ MemStrSnglBeepChmEvStDrv 0 "No Action" 1 "Active" 2 "Cancel Chime" ;
VAL_TABLE_ PrkAsstFlChEvntSt 0 "NO_ACTION" 1 "ACTIVE" 2 "CANCEL_CHIME" ;
VAL_TABLE_ MemStrTrplBeepChmEvStRR 0 "No Action" 1 "Active" 2 "Cancel Chime" ;
VAL_TABLE_ MemStrTrplBeepChmEvStLR 0 "No Action" 1 "Active" 2 "Cancel Chime" ;
VAL_TABLE_ MemStrTrplBeepChmEvStDrv 0 "No Action" 1 "Active" 2 "Cancel Chime" ;
VAL_TABLE_ PrkAsstFllFrZn4ChEvntSt 0 "NO_ACTION" 1 "ACTIVE" 2 "CANCEL_CHIME" ;
VAL_TABLE_ PrkAsstFllFrZn3ChEvntSt 0 "NO_ACTION" 1 "ACTIVE" 2 "CANCEL_CHIME" ;
VAL_TABLE_ PrkAsstFllFrZn2ChEvntSt 0 "NO_ACTION" 1 "ACTIVE" 2 "CANCEL_CHIME" ;
VAL_TABLE_ PrkAsstFllFrZn1ChEvntSt 0 "NO_ACTION" 1 "ACTIVE" 2 "CANCEL_CHIME" ;
VAL_TABLE_ PrkAsstFllRrZn2ChEvntSt 0 "NO_ACTION" 1 "ACTIVE" 2 "CANCEL_CHIME" ;
VAL_TABLE_ PrkAsstFllRrZn1ChEvntSt 0 "NO_ACTION" 1 "ACTIVE" 2 "CANCEL_CHIME" ;
VAL_TABLE_ PrkAsstFllFrZn6ChEvntSt 0 "NO_ACTION" 1 "ACTIVE" 2 "CANCEL_CHIME" ;
VAL_TABLE_ PrkAsstFllFrZn5ChEvntSt 0 "NO_ACTION" 1 "ACTIVE" 2 "CANCEL_CHIME" ;
VAL_TABLE_ PrkAsstFllRrZn6ChEvntSt 0 "NO_ACTION" 1 "ACTIVE" 2 "CANCEL_CHIME" ;
VAL_TABLE_ PrkAsstFllRrZn5ChEvntSt 0 "NO_ACTION" 1 "ACTIVE" 2 "CANCEL_CHIME" ;
VAL_TABLE_ PrkAsstFllRrZn4ChEvntSt 0 "NO_ACTION" 1 "ACTIVE" 2 "CANCEL_CHIME" ;
VAL_TABLE_ PrkAsstFllRrZn3ChEvntSt 0 "NO_ACTION" 1 "ACTIVE" 2 "CANCEL_CHIME" ;
VAL_TABLE_ PrkAsstFrLftSdZn3ChEvntSt 0 "NO_ACTION" 1 "ACTIVE" 2 "CANCEL_CHIME" ;
VAL_TABLE_ PrkAsstFrLftSdZn2ChEvntSt 0 "NO_ACTION" 1 "ACTIVE" 2 "CANCEL_CHIME" ;
VAL_TABLE_ PrkAsstFrLftSdZn1ChEvntSt 0 "NO_ACTION" 1 "ACTIVE" 2 "CANCEL_CHIME" ;
VAL_TABLE_ PrkAsstFrFrstRprtChEvntSt 0 "NO_ACTION" 1 "ACTIVE" 2 "CANCEL_CHIME" ;
VAL_TABLE_ PrkAsstFrRghtSdZn1ChEvntSt 0 "NO_ACTION" 1 "ACTIVE" 2 "CANCEL_CHIME" ;
VAL_TABLE_ PrkAsstFrLftSdZn6ChEvntSt 0 "NO_ACTION" 1 "ACTIVE" 2 "CANCEL_CHIME" ;
VAL_TABLE_ PrkAsstFrLftSdZn5ChEvntSt 0 "NO_ACTION" 1 "ACTIVE" 2 "CANCEL_CHIME" ;
VAL_TABLE_ PrkAsstFrLftSdZn4ChEvntSt 0 "NO_ACTION" 1 "ACTIVE" 2 "CANCEL_CHIME" ;
VAL_TABLE_ PrkAsstFrRghtSdZn5ChEvntSt 0 "NO_ACTION" 1 "ACTIVE" 2 "CANCEL_CHIME" ;
VAL_TABLE_ PrkAsstFrRghtSdZn4ChEvntSt 0 "NO_ACTION" 1 "ACTIVE" 2 "CANCEL_CHIME" ;
VAL_TABLE_ PrkAsstFrRghtSdZn3ChEvntSt 0 "NO_ACTION" 1 "ACTIVE" 2 "CANCEL_CHIME" ;
VAL_TABLE_ PrkAsstFrRghtSdZn2ChEvntSt 0 "NO_ACTION" 1 "ACTIVE" 2 "CANCEL_CHIME" ;
VAL_TABLE_ FrwdClsnAlrtImntAlrtAudAttnReqd 0 "FALSE" 1 "TRUE" ;
VAL_TABLE_ LKALnMrkgIndLt 0 "Off" 1 "White" 2 "Green" 3 "Amber" 4 "Amber Flashing" ;
VAL_TABLE_ LKALnMrkgIndRt 0 "Off" 1 "White" 2 "Green" 3 "Amber" 4 "Amber Flashing" ;
VAL_TABLE_ FrntPsSeatbeltStat 0 "Unknown" 1 "Unfastened" 2 "Fastened" ;
VAL_TABLE_ FrntPsSeatbeltStat_Inv 0 "FALSE" 1 "TRUE" ;
VAL_TABLE_ EPBSP_ElecPrkBrkApplStsAuth 0 "Unknown" 1 "Applied" 2 "Released" 3 "Dynamic Apply" 4 "In-Progress" ;
VAL_TABLE_ RrPCMRspTypCstCrStVal 0 "SETTING_UNKNOWN" 1 "OFF" 2 "ALERT" 3 "ALERT_AND_BRAKE" 4 "RESERVED_4 RESERVED_5" 5 "RESERVED_6" 6 "RESERVED_7" ;
VAL_TABLE_ ORIP_DrvrStBltStsAuth_Inv 0 "FALSE" 1 "TRUE" ;
VAL_TABLE_ ORIP_DrvrStBltStsAuth 0 "Unknown" 1 "UnFastened" 2 "Fastened" ;
VAL_TABLE_ LnDtWrnCntrlVsAlrtCmdGnc 0 "OFF" 1 "NOT READY TO ASSIST" 2 "READY TO ASSIST" 3 "ALERT" 4 "INTERVENTION" ;
VAL_TABLE_ ElecPrkBrkCtnChiEveStat 0 "NO_ACTION" 1 "ACTIVE" 2 "CANCEL_CHIME" ;
VAL_TABLE_ LDWCtrlHndOff1ChmEvntStat 0 "NO_ACTION" 1 "ACTIVE" 2 "CANCEL_CHIME" ;
VAL_TABLE_ FrwdCllsnAlrtImAlrtDrIntAlrtChmE 0 "NO_ACTION" 1 "ACTIVE" 2 "CANCEL_CHIME" ;
VAL_TABLE_ FrntPCMChmEvntStat 0 "NO_ACTION" 1 "ACTIVE" 2 "CANCEL_CHIME" ;
VAL_TABLE_ ElecPrkBrkFixDurChiEveStat 0 "NO_ACTION" 1 "ACTIVE" 2 "CANCEL_CHIME" ;
VAL_TABLE_ MemStrDblBeepChmEvStCoDrv 0 "No Action" 1 "Active" 2 "Cancel Chime" ;
VAL_TABLE_ LDWCtrlRtHndSdChmEvntStat 0 "NO_ACTION" 1 "ACTIVE" 2 "CANCEL_CHIME" ;
VAL_TABLE_ LDWCtrlLtHndSdChmEvntStat 0 "NO_ACTION" 1 "ACTIVE" 2 "CANCEL_CHIME" ;
VAL_TABLE_ LDWCtrlHndOff2ChmEvntStat 0 "NO_ACTION" 1 "ACTIVE" 2 "CANCEL_CHIME" ;
VAL_TABLE_ MemStrSnglBeepChmEvStCoDrv 0 "No Action" 1 "Active" 2 "Cancel Chime" ;
VAL_TABLE_ MemStrDblBeepChmEvStRR 0 "No Action" 1 "Active" 2 "Cancel Chime" ;
VAL_TABLE_ MemStrDblBeepChmEvStLR 0 "No Action" 1 "Active" 2 "Cancel Chime" ;
VAL_TABLE_ MemStrDblBeepChmEvStDrv 0 "No Action" 1 "Active" 2 "Cancel Chime" ;
VAL_TABLE_ ELWWIP_WprFrtFtrReqAuth 0 "Wiper Front Stop" 1 "Wiper Front Crank Suspend" 2 "Wiper Front Depressed Park" 3 "Wiper Front Park" 4 "Wiper Front Winter Park" 5 "Wiper Front Service Park" 6 "Wiper Front Intermittent 5" 7 "Wiper Front Intermittent 4" 8 "Wiper Front Intermittent 3" 9 "Wiper Front Intermittent 2" 10 "Wiper Front Intermittent 1" 11 "Wiper Front Low Wipe" 12 "Wiper Front High Wipe" ;
VAL_TABLE_ ELWWIP_RvrsLmpCmdAuth 0 "Off" 1 "On" 2 "Flashing" ;
VAL_TABLE_ ELWWIP_TrlrRvrsLmpsCmdAuth 0 "Off" 1 "On" 2 "Flashing" ;
VAL_TABLE_ ELWWIP_CHMSLCmdAuth 0 "No_Action" 1 "Off" 2 "On" 3 "Emergency_Brake_Flashing" ;
VAL_TABLE_ ELWWIP_BrkLmpRtCmdAuth 0 "No_Action" 1 "Off" 2 "On" 3 "Emergency_Brake_Flashing" 4 "Police_Flashing" ;
VAL_TABLE_ ELWWIP_BrkLmpLtCmdAuth 0 "No_Action" 1 "Off" 2 "On" 3 "Emergency_Brake_Flashing" 4 "Police_Flashing" ;
VAL_TABLE_ APACR_FaildChmEvntStat 0 "NO_ACTION" 1 "ACTIVE" 2 "CANCEL_CHIME" ;
VAL_TABLE_ APACR_StopChmEvntStat 0 "NO_ACTION" 1 "ACTIVE" 2 "CANCEL_CHIME" ;
VAL_TABLE_ APACR_CmpltChmEvntStat 0 "NO_ACTION" 1 "ACTIVE" 2 "CANCEL_CHIME" ;
VAL_TABLE_ APACR_CncldChmEvntStat 0 "NO_ACTION" 1 "ACTIVE" 2 "CANCEL_CHIME" ;
VAL_TABLE_ APACR_SptFndChmEvntStat 0 "NO_ACTION" 1 "ACTIVE" 2 "CANCEL_CHIME" ;
VAL_TABLE_ LnCntrWrnIndRqst 0 "No Indication" 1 "Can not See Lanes" 2 "Tight Curve" 3 "Freeway Ends" 4 "Construction" 5 "Excessive Speed" 6 "Vehicles Too Close" 7 "Canceled Take Steering" 8 "Can not See Eyes" 9 "Due to Weather" 10 "Take Steering" 11 "Take Vehicle Control" 12 "Service Driver Assist System" 13 "Lane Following Locked Out" 14 "TJA Max Speed Reached" 15 "TJA Available" 16 "TJA Active" ;
VAL_TABLE_ UpftrRrAprchPrtctnChmEvntStat 0 "No Action" 1 "Active" 2 "Cancel Chime" ;
VAL_TABLE_ TrlLfTrInLtFld 0 "FALSE" 1 "TRUE" ;
VAL_TABLE_ TnDrvRIMOFFUnvIndOn 0 "FALSE" 1 "TRUE" ;
VAL_TABLE_ StNtLtchdIO 0 "FALSE" 1 "TRUE" ;
VAL_TABLE_ SrvPedtrnProtSysIO 0 "FALSE" 1 "TRUE" ;
VAL_TABLE_ SftTpVltLwIO 0 "FALSE" 1 "TRUE" ;
VAL_TABLE_ SftTpVehOvSpdIO 0 "FALSE" 1 "TRUE" ;
VAL_TABLE_ SftTpTmpLwIO 0 "FALSE" 1 "TRUE" ;
VAL_TABLE_ SftTpStrIO 0 "FALSE" 1 "TRUE" ;
VAL_TABLE_ TrlrTlLtFld 0 "FALSE" 1 "TRUE" ;
VAL_TABLE_ RrVirtBmpAutoBrkRelIndOn 0 "FALSE" 1 "TRUE" ;
VAL_TABLE_ TrlrRvrsLmpOtgIndOn 0 "FALSE" 1 "TRUE" ;
VAL_TABLE_ TrlrRtTrInLtFld 0 "FALSE" 1 "TRUE" ;
VAL_TABLE_ TrlrFgLtFld 0 "FALSE" 1 "TRUE" ;
VAL_TABLE_ TrlrDisconndIndOn 0 "FALSE" 1 "TRUE" ;
VAL_TABLE_ TrlrBrkLtFld 0 "FALSE" 1 "TRUE" ;
VAL_TABLE_ TrnsNEmsRltMlfActv 0 "FALSE" 1 "TRUE" ;
VAL_TABLE_ TrnsEmsRltMlfAtv 0 "FALSE" 1 "TRUE" ;
VAL_TABLE_ DM2Denied 0 "FALSE" 1 "TRUE" ;
VAL_TABLE_ TrnLmpRrRtOtgIndOn 0 "FALSE" 1 "TRUE" ;
VAL_TABLE_ TrnLmpRrLtOtgIndOn 0 "FALSE" 1 "TRUE" ;
VAL_TABLE_ DM1Denied 0 "FALSE" 1 "TRUE" ;
VAL_TABLE_ TrnLmpFrtRtOtgIndOn 0 "FALSE" 1 "TRUE" ;
VAL_TABLE_ TrnLmpFrtLtOtgIndOn 0 "FALSE" 1 "TRUE" ;
VAL_TABLE_ RdHgtStatIndReq 0 "Nominal Trim" 1 "Raised 2" 2 "Raised 1" 3 "Lowered 1" 4 "Lowered 2" 5 "Cargo/Trailer" 6 "Entry/Exit" 7 "Alignment Mode" 8 "Service Mode" 9 "Entry/Exit Pending" 10 "Safety Lowered" ;
VAL_TABLE_ SftTpFlrIO 0 "FALSE" 1 "TRUE" ;
VAL_TABLE_ ACCSysSlctdMd 0 "Cruise Control Mode Switching Not Supported" 1 "Adaptive Cruise Control" 2 "Enhanced Cruise Control" ;
VAL_TABLE_ BkupPwrMdStrtStpIgntSwtchPrsdRpt 0 "FALSE" 1 "TRUE" ;
VAL_TABLE_ VltSwAtvIO 0 "FALSE" 1 "TRUE" ;
VAL_TABLE_ ValetModeActive 0 "FALSE" 1 "TRUE" ;
VAL_TABLE_ TrnsOilChngIO 0 "FALSE" 1 "TRUE" ;
VAL_TABLE_ RdHgtWrn2IndReq 0 "No Indication" 1 "Auto Lowering" 2 "Suspension Low-Wait" 3 "Suspension Low-Caution" 4 "Suspension High" 5 "Safety Lowered" 6 "Raised 2 Inhibit 4WD" 7 "Raised 2 Inhibit Speed" 8 "Raised Inhibit Speed" 9 "Cargo Inhibit Speed" 10 "Entry Exit Pending Speed" 11 "Raised 2 Inhibit Crawl" 12 "Object Detected" 13 "SuspensionOverloaded" 14 "Lowered Inhibit DMC" ;
VAL_TABLE_ LnchCtlWhlSlSts 0 "No Action" 1 "Five Percent" 2 "Five And A Half Percent" 3 "Six Percent" 4 "Six And A Half Percent" 5 "Seven Percent" 6 "Seven And A Half Percent" 7 "Eight Percent" 8 "Eight And A Half Percent" 9 "Nine Percent" 10 "Nine And A Half Percent" 11 "Ten Percent" 12 "Ten And A Half Percent" 13 "Eleven Percent" 14 "Eleven And a Half Percent" 15 "Twelve Percent" 16 "Twelve And A Half Percent" 17 "Thirteen Percent" 18 "Thirteen And A Half Percent" 19 "Fourteen Percent" 20 "Fourteen And A Half Percent" 21 "Fifteen Percent" ;
VAL_TABLE_ LnchCtlEngRPMSts 0 "No Action" 1 "800" 2 "900" 3 "1000" 4 "1100" 5 "1200" 6 "1300" 7 "1400" 8 "1500" 9 "1600" 10 "1700" 11 "1800" 12 "1900" 13 "2000" 14 "2100" 15 "2200" 16 "2300" 17 "2400" 18 "2500" 19 "2600" 20 "2700" 21 "2800" 22 "2900" 23 "3000" 24 "3100" 25 "3200" 26 "3300" 27 "3400" 28 "3500" 29 "3600" 30 "3700" 31 "3800" 32 "3900" 33 "4000" 34 "FlexibleRPM 1" 35 "FlexibleRPM 2" 36 "FlexibleRPM 3" 37 "FlexibleRPM 4" 38 "FlexibleRPM 5" ;
VAL_TABLE_ LogisticModeStatus 0 "Off" 1 "Plant" 2 "Transport Mode" 3 "Storage Mode" ;
VAL_TABLE_ LnCntrEsclnSts 0 "None" 1 "Driver Not Looking to Roadway" 2 "Limited Condition" 3 "System Faulted" ;
VAL_TABLE_ InvsblTrlrOprtlSts 0 "Available" 1 "Degraded" 2 "Unavailable" 3 "Unknown" ;
VAL_TABLE_ GlrFrHiBmSts 0 "OFF" 1 "AHBA" 2 "GFHB" ;
VAL_TABLE_ CkBrkLmpsIndOn 0 "FALSE" 1 "TRUE" ;
VAL_TABLE_ CIBAutoBrkRelIndOn 0 "FALSE" 1 "TRUE" ;
VAL_TABLE_ BrkLtsAtv 0 "FALSE" 1 "TRUE" ;
VAL_TABLE_ AutoHgBmCtrlIO 0 "FALSE" 1 "TRUE" ;
VAL_TABLE_ PAVisObjIndStatReq 0 "No Action" 1 "Driver Tube Front" 2 "Driver Tube Rear" 3 "Full Active" ;
VAL_TABLE_ ClsTrnkLidIO 0 "FALSE" 1 "TRUE" ;
VAL_TABLE_ CkSoftTpIO 0 "FALSE" 1 "TRUE" ;
VAL_TABLE_ CkRrPrkLmpIndOn 0 "FALSE" 1 "TRUE" ;
VAL_TABLE_ CkLoBmsIndOn 0 "FALSE" 1 "TRUE" ;
VAL_TABLE_ CkFrtPrkLmpsIndOn 0 "FALSE" 1 "TRUE" ;
VAL_TABLE_ CkFgLmpsIndOn 0 "FALSE" 1 "TRUE" ;
VAL_TABLE_ CkDyTmRnngLmpsIndOn 0 "FALSE" 1 "TRUE" ;
VAL_TABLE_ CkCrnrLmpsIndOn 0 "FALSE" 1 "TRUE" ;
VAL_TABLE_ FrntPsMtzdStBltFldIndOn 0 "FALSE" 1 "TRUE" ;
VAL_TABLE_ ESCLTrntheStrWheelWhlStrtgIO 0 "FALSE" 1 "TRUE" ;
VAL_TABLE_ DrvStBltRmIndOn 0 "FALSE" 1 "TRUE" ;
VAL_TABLE_ DrvShftCntrlReqDndIO 0 "FALSE" 1 "TRUE" ;
VAL_TABLE_ DrMtzdStBltUnIndOn 0 "FALSE" 1 "TRUE" ;
VAL_TABLE_ DrMtzdStBltFldIndOn 0 "FALSE" 1 "TRUE" ;
VAL_TABLE_ DRLAct 0 "FALSE" 1 "TRUE" ;
VAL_TABLE_ CrsCntAtv 0 "FALSE" 1 "TRUE" ;
VAL_TABLE_ LicLpOtIO 0 "FALSE" 1 "TRUE" ;
VAL_TABLE_ LSCMBAutoBrkRlsIndOn 0 "FALSE" 1 "TRUE" ;
VAL_TABLE_ HiBmOtgIndOn 0 "FALSE" 1 "TRUE" ;
VAL_TABLE_ GrdBrkgAct 0 "FALSE" 1 "TRUE" ;
VAL_TABLE_ FrwdVhHdwyAlrtIndOn 0 "FALSE" 1 "TRUE" ;
VAL_TABLE_ EngFuelInjnSysFltIndOn 0 "FALSE" 1 "TRUE" ;
VAL_TABLE_ FrntPsStbltRmIndOn 0 "FALSE" 1 "TRUE" ;
VAL_TABLE_ FrntPsMtzdStBltUnIndOn 0 "FALSE" 1 "TRUE" ;
VAL_TABLE_ RIMOFFIndOn 0 "FALSE" 1 "TRUE" ;
VAL_TABLE_ PrkBrkSwAtv 0 "FALSE" 1 "TRUE" ;
VAL_TABLE_ PedtrnProtSysDpl 0 "FALSE" 1 "TRUE" ;
VAL_TABLE_ NoSDCrdPrIndOn 0 "FALSE" 1 "TRUE" ;
VAL_TABLE_ MovblTpServRqrdIO 0 "FALSE" 1 "TRUE" ;
VAL_TABLE_ MovblTpNormzRqrdIO 0 "FALSE" 1 "TRUE" ;
VAL_TABLE_ LnCntrMisuseCond 0 "FALSE" 1 "TRUE" ;
VAL_TABLE_ LnCntrDrvAwrIndOn 0 "FALSE" 1 "TRUE" ;
VAL_TABLE_ RvLpOtIO 0 "FALSE" 1 "TRUE" ;
VAL_TABLE_ RstrntDplyIndOn 0 "FALSE" 1 "TRUE" ;
VAL_TABLE_ RrFgLpOtIO 0 "FALSE" 1 "TRUE" ;
VAL_TABLE_ RrCrsTrfcAlrtOffIndOn 0 "FALSE" 1 "TRUE" ;
VAL_TABLE_ BrkOvrhtdIndOn 0 "FALSE" 1 "TRUE" ;
VAL_TABLE_ RearPsStbltVisIndMd 0 "FALSE" 1 "TRUE" ;
VAL_TABLE_ RIMUnIndOn 0 "FALSE" 1 "TRUE" ;
VAL_TABLE_ RIMONIndOn 0 "FALSE" 1 "TRUE" ;
VAL_TABLE_ SftTpPlsDnWrngIO 0 "FALSE" 1 "TRUE" ;
VAL_TABLE_ SftTpPlsDnSrtdIO 0 "FALSE" 1 "TRUE" ;
VAL_TABLE_ SftTpMchnOvhtIO 0 "FALSE" 1 "TRUE" ;
VAL_TABLE_ SftTpLtcIO 0 "FALSE" 1 "TRUE" ;
VAL_TABLE_ ServHdlmpsIndOn 0 "FALSE" 1 "TRUE" ;
VAL_TABLE_ SerRideSysIO 0 "FALSE" 1 "TRUE" ;
VAL_TABLE_ SDCrdFllIndOn 0 "FALSE" 1 "TRUE" ;
VAL_TABLE_ SDCrdErrIndOn 0 "FALSE" 1 "TRUE" ;
VAL_TABLE_ LnchCtlModeSts 0 "Disable" 1 "General" 2 "General Custom" 3 "High Traction" 4 "High Traction Custom" 5 "Line Lock" 6 "Line lock Press Brake" 7 "Line Lock Release Brake" ;
VAL_TABLE_ RdHgtMvmtIndReq 0 "No Movement" 1 "Raising to 2" 2 "Raising" 3 "Lowering" 4 "Cargo Loading" ;
VAL_TABLE_ RdHgtAtLocIndReq 0 "No Indication" 1 "Stored" 2 "Cleared" 3 "All Cleared" 4 "Not Saved" 5 "Unknown" ;
VAL_TABLE_ TrlrMirVidEnblCstCurrSetVal 0 "Setting_Unknown" 1 "Off" 2 "On" 3 "Reserved_3" 4 "Reserved_4" 5 "Reserved_5" 6 "Reserved_6" 7 "Reserved_7" ;
VAL_TABLE_ PARgn 0 "Europe" 1 "North America" ;
VAL_TABLE_ RdHgtWrn1IndReq 0 "No indication" 1 "Front Lift Inhibited" 2 "Leveling Inhibited" 3 "Front Lift Unavailable" 4 "Leveling Unavailable" 5 "Front Lift Faulted" 6 "Leveling Faulted" ;
VAL_TABLE_ WndPstnStsLF 0 "Denormalized" 1 "Fully Closed" 2 "Less Than Position A" 3 "Position A" 4 "Greater Than A but less than Position C" 5 "Position C" 6 "Greater than Position C but less than Fully open" 7 "Fully Open" ;
VAL_TABLE_ TrnsSftMdSt 0 "No Override Mode" 1 "Performance Mode" 2 "Lift-Foot Cornering Mode" 3 "Automatic Grade Braking Mode" ;
VAL_TABLE_ WndPstnStsRR 0 "Denormalized" 1 "Fully Closed" 2 "Less Than Position A" 3 "Position A" 4 "Greater Than A but less than Position C" 5 "Position C" 6 "Greater than Position C but less than Fully open" 7 "Fully Open" ;
VAL_TABLE_ WndPstnStsRF 0 "Denormalized" 1 "Fully Closed" 2 "Less Than Position A" 3 "Position A" 4 "Greater Than A but less than Position C" 5 "Position C" 6 "Greater than Position C but less than Fully open" 7 "Fully Open" ;
VAL_TABLE_ WndPstnStsLR 0 "Denormalized" 1 "Fully Closed" 2 "Less Than Position A" 3 "Position A" 4 "Greater Than A but less than Position C" 5 "Position C" 6 "Greater than Position C but less than Fully open" 7 "Fully Open" ;
VAL_TABLE_ CltTpTrvAchv_Inv 0 "FALSE" 1 "TRUE" ;
VAL_TABLE_ BrkPadLifeFrtDistWrnIndReq 0 "No Action" 1 "Low" 2 "Display Distance" ;
VAL_TABLE_ AdvdFrtLgtSysIndReq 0 "NO INDICATION" 1 "FAILURE INDICATION" 2 "TOURIST MODE SETTING CHANGED" 3 "TOURIST MODE REMINDER" ;
VAL_TABLE_ ACCAutoStSpStat 0 "No_Set_Speed_Change" 1 "Proposed_Speed_Limit_Change" 2 "Accepted_Speed_Limit_Change" 3 "Declined_Speed_Limit_Change" ;
VAL_TABLE_ CmdThrdRwCtStbtVisInd 0 "No Indication" 1 "Unbuckled Indication" 2 "Buckled Indication" 3 "Unbuckled Flashing Indication" ;
VAL_TABLE_ CmdSndRwRtStbtVisInd 0 "No Indication" 1 "Unbuckled Indication" 2 "Buckled Indication" 3 "Unbuckled Flashing Indication" ;
VAL_TABLE_ CmdSndRwLtStbtVisInd 0 "No Indication" 1 "Unbuckled Indication" 2 "Buckled Indication" 3 "Unbuckled Flashing Indication" ;
VAL_TABLE_ CmdSndRwCtStbtVisInd 0 "No Indication" 1 "Unbuckled Indication" 2 "Buckled Indication" 3 "Unbuckled Flashing Indication" ;
VAL_TABLE_ CltTpTrvAchv 0 "FALSE" 1 "TRUE" ;
VAL_TABLE_ DrLckStsLR 0 "Unknown" 1 "Locked" 2 "Unlocked" ;
VAL_TABLE_ DrLckStsLF 0 "Unknown" 1 "Locked" 2 "Unlocked" ;
VAL_TABLE_ CmdThrdRwRtStbtVisInd 0 "No Indication" 1 "Unbuckled Indication" 2 "Buckled Indication" 3 "Unbuckled Flashing Indication" ;
VAL_TABLE_ CmdThrdRwLtStbtVisInd 0 "No Indication" 1 "Unbuckled Indication" 2 "Buckled Indication" 3 "Unbuckled Flashing Indication" ;
VAL_TABLE_ AutoBmSlctAllwd 0 "FALSE" 1 "TRUE" ;
VAL_TABLE_ DrSlctdSpdLmtAutMdSpdLmtStat 0 "No Set Speed Change" 1 "Proposed Speed Limit Change" 2 "Accepted Speed Limit Change" 3 "Declined Speed Limit Change" ;
VAL_TABLE_ DrLckStsRR 0 "Unknown" 1 "Locked" 2 "Unlocked" ;
VAL_TABLE_ DrLckStsRF 0 "Unknown" 1 "Locked" 2 "Unlocked" ;
VAL_TABLE_ PAIM_FaildIndOn 0 "FALSE" 1 "TRUE" ;
VAL_TABLE_ PAIM_RrOffIndOn 0 "FALSE" 1 "TRUE" ;
VAL_TABLE_ PAIM_DsbldIndOn 0 "FALSE" 1 "TRUE" ;
VAL_TABLE_ PAIM_TeenDrvrPAOffUnvIndOn 0 "FALSE" 1 "TRUE" ;
VAL_TABLE_ PAIM_FrtOffIndOn 0 "FALSE" 1 "TRUE" ;
VAL_TABLE_ PAIM_SnsrDstbdIndOn 0 "FALSE" 1 "TRUE" ;
VAL_TABLE_ PAIM_SnsrBlckdIndOn 0 "FALSE" 1 "TRUE" ;
VAL_TABLE_ PAIM_SnsrClnIndOn 0 "FALSE" 1 "TRUE" ;
VAL_TABLE_ eLSDActrTrqPctg_Inv 0 "FALSE" 1 "TRUE" ;
VAL_TABLE_ PAIM_OffIndOn 0 "FALSE" 1 "TRUE" ;
VAL_TABLE_ FourWhlDrvWrnIndReq 0 "No Action" 1 "No Indication" 2 "For 4WD Low Shift Transmission To Neutral" 3 "To Exit 4WD Low Shift Transmission to Neutral" 4 "For 4WD Low Reduce Speed" 5 "To Exit 4WD Low Reduce Speed" 6 "Reminder Vehicle Still In 4WD Low" 7 "4WD Shift in Progress" 8 "4WD Shift Not Allowed Engine Warming Up" 9 "4WD Shift Not Allowed Mismatched Tire" 10 "4WD Shift Not Allowed In Park" 11 "Apply Brake For 4WD Shift" 12 "No 4WD Shifts Allowed" 13 "Reduce Speed For 4WD Shift" 14 "Turn off Engine for 4WD Shift" 15 "For 4WD Shift Transmission Neutral" ;
VAL_TABLE_ EnrgMgtLdShdRq 0 "No Load Shedding" 1 "Load Shed Level 1" 2 "Load Shed Level 2" 3 "Load Shed Level 3" 4 "Load Shed Level 4" ;
VAL_TABLE_ BrkSysHillStrtAsstStat 0 "Inactive" 1 "Brake Pressure Hold" 2 "Normal Pressure Decay" 3 "Drive-off Pressure Decay" 4 "Reserved_4" 5 "Reserved_5" 6 "Reserved_6" 7 "Reserved_7" ;
VAL_TABLE_ FrntPsStbltRmIndReq 0 "OFF" 1 "ON" 2 "0.5_Hz" 3 "1_Hz" 4 "2_Hz" 5 "4_Hz" 6 "RESERVED_1" 7 "RESERVED_2" ;
VAL_TABLE_ CrgBedVwAutoLgtCstCurrSetVal 0 "Setting_Unknown" 1 "Off" 2 "On" 3 "Reserved_3" 4 "Reserved_4" 5 "Reserved_5" 6 "Reserved_6" 7 "Reserved_7" ;
VAL_TABLE_ CnvtBkWndPstnSts 0 "Denormalized" 1 "Fully Closed" 2 "Less Than Position A" 3 "Position A" 4 "Greater Than A but less than Position C" 5 "Position C" 6 "Greater than Position C but less than Fully open" 7 "Fully Open" ;
VAL_TABLE_ CTDStat 0 "OFF" 1 "ARMED" 2 "DISARMED" 3 "ALARM ACTIVE" 4 "ARMING DELAY" 5 "POST ALARM DELAY" ;
VAL_TABLE_ FrntPsStBltRmOccStat 0 "UNKNOWN" 1 "EMPTY" 2 "OCCUPIED" ;
VAL_TABLE_ FrntPsStBltRmOccStat_Inv 0 "FALSE" 1 "TRUE" ;
VAL_TABLE_ EngAirFiltMonSts 0 "OK" 1 "Replace Air Filter Soon" 2 "Replace Air Filter Now" 3 "Fault Present" 4 "Disabled" 5 "No Action" ;
VAL_TABLE_ LnDtWrnCntrlFtrSt 0 "OFF" 1 "STANDBY" 2 "READY TO ASSIST" 3 "FAILED" 4 "ALERT AND CONTROL" ;
VAL_TABLE_ FrwdVhImAlrtIndRqst 0 "OFF" 1 "ON" 2 "0.5_Hz" 3 "1_Hz" 4 "2_Hz" 5 "4_Hz" 6 "RESERVED_1" 7 "RESERVED_2" ;
VAL_TABLE_ AirbgStIndOn 0 "FALSE" 1 "TRUE" ;
VAL_TABLE_ PrkAsstStat 0 "OFF" 1 "STANDBY" 2 "DISABLED" 3 "FAILED" 4 "FRONT_REAR_ACTIVE" 5 "REAR_ACTIVE" 6 "FRONT_ACTIVE" 7 "UNKNOWN" ;
VAL_TABLE_ NghtVsnSysStat 0 "UNKNOWN" 1 "INITIALIZING" 2 "INACTIVE" 3 "ACTIVE" 4 "NEEDS SERVICE" 5 "NOT DARK" 6 "TEMPORARILY UNAVAILABLE" 7 "NEEDS HEADLIGHTS" ;
VAL_TABLE_ FPARS_RtCntr 0 "OFF" 1 "FAILED" 2 "BLOCKED" 3 "ATTACHED_OBJECT" 4 "NO_OBJECT" 5 "ZONE_1" 6 "ZONE_2" 7 "ZONE_3" 8 "ZONE_4" 9 "ZONE_5" 10 "ZONE_6" 11 "OFF_NO_FAULT" 12 "RESERVED_1" 13 "RESERVED_2" 14 "RESERVED_3" ;
VAL_TABLE_ FPARS_Lt 0 "OFF" 1 "FAILED" 2 "BLOCKED" 3 "ATTACHED_OBJECT" 4 "NO_OBJECT" 5 "ZONE_1" 6 "ZONE_2" 7 "ZONE_3" 8 "ZONE_4" 9 "ZONE_5" 10 "ZONE_6" 11 "OFF_NO_FAULT" 12 "RESERVED_1" 13 "RESERVED_2" 14 "RESERVED_3" ;
VAL_TABLE_ FPARS_Rt 0 "OFF" 1 "FAILED" 2 "BLOCKED" 3 "ATTACHED_OBJECT" 4 "NO_OBJECT" 5 "ZONE_1" 6 "ZONE_2" 7 "ZONE_3" 8 "ZONE_4" 9 "ZONE_5" 10 "ZONE_6" 11 "OFF_NO_FAULT" 12 "RESERVED_1" 13 "RESERVED_2" 14 "RESERVED_3" ;
VAL_TABLE_ FPARS_LtCntr 0 "OFF" 1 "FAILED" 2 "BLOCKED" 3 "ATTACHED_OBJECT" 4 "NO_OBJECT" 5 "ZONE_1" 6 "ZONE_2" 7 "ZONE_3" 8 "ZONE_4" 9 "ZONE_5" 10 "ZONE_6" 11 "OFF_NO_FAULT" 12 "RESERVED_1" 13 "RESERVED_2" 14 "RESERVED_3" ;
VAL_TABLE_ FPLTLI_PrkLmpLtCmd 0 "No Action" 1 "Off" 2 "On" 3 "Ramp On" 4 "Ramp Off" ;
VAL_TABLE_ FPLTLI_AuxPrkLmpLtCmd 0 "No Action" 1 "Off" 2 "On" 3 "Ramp On" 4 "Ramp Off" ;
VAL_TABLE_ FPLTLI_PrkLmpRtCmd 0 "No Action" 1 "Off" 2 "On" 3 "Ramp On" 4 "Ramp Off" ;
VAL_TABLE_ FPLTLI_AuxPrkLmpRtCmd 0 "No Action" 1 "Off" 2 "On" 3 "Ramp On" 4 "Ramp Off" ;
VAL_TABLE_ CrwlModeDndRsnIndReq 0 "No Indication" 1 "Unavailable" 2 "Brakes Overtemp" 3 "Shift to 4 High" 4 "Reduce Speed" ;
VAL_TABLE_ BSISP_ETRSHydrlcBrkgStsAuth 0 "Not Active" 1 "Active" 2 "Failed" ;
VAL_TABLE_ BSISP_ESCActvAuth 0 "FALSE" 1 "TRUE" ;
VAL_TABLE_ BSISP_TCSFaildAuth 0 "FALSE" 1 "TRUE" ;
VAL_TABLE_ MaxChrgSts 0 "Not Active" 1 "Active" 2 "Not Available" ;
VAL_TABLE_ ArtcldRnngBrdSt 0 "No Action" 1 "Resume Normal Operation" 2 "Running Boards Deployed" 3 "Running Boards Stowed" 4 "Running Boards Cargo Access" 5 "Running Boards Inhibited" 6 "Running Boards Could Not Extend" ;
VAL_TABLE_ BSISP_ESCSysStsAuth 0 "Normal Operation" 1 "Failed" 2 "Initializing" 3 "Enhanced Operation" 4 "Driver Disable" ;
VAL_TABLE_ BSISP_TCSActvAuth 0 "FALSE" 1 "TRUE" ;
VAL_TABLE_ BSISP_TCSDrvrIntntAuth 0 "Disabled" 1 "Enabled" ;
VAL_TABLE_ BVSCRP_CPSAxlTrqCmdLimStsAuth 0 "Request Not Limited" 1 "Request Value Limited to Minimum" 2 "Request Value Limited to Maximum" 3 "Request Rate Limited" ;
VAL_TABLE_ BVSCRP_ACCAxlTrqCmdReqStsAuth 0 "No Request" 1 "Request Honored" 2 "Lost Arbitration" 3 "Request Denied" 4 "Request Suspended Till Driver Input" ;
VAL_TABLE_ BVSCRP_ACCAxlTrqCmdLimStsAuth 0 "Request Not Limited" 1 "Request Value Limited Minimum" 2 "Request Value Limited Maximum" 3 "Request Rate Limited" ;
VAL_TABLE_ BVSCRP_CruzCtlEnbldAuth 0 "FALSE" 1 "TRUE" ;
VAL_TABLE_ BVSCRP_CPSAxlTrqCmdReqStsAuth 0 "No Request" 1 "Request Honored" 2 "Lost Arbitration" 3 "Serial Data Failure Temporary" 4 "Serial Data Failure Permanent" 5 "Control System Failure Temporary" 6 "Control System Failure Permanent" ;
VAL_TABLE_ BVSCRP_CltchPdlActPosAuth_Inv 0 "FALSE" 1 "TRUE" ;
VAL_TABLE_ TCTPIR_DrvrNtfn 0 "No Action" 1 "No Indication" 2 "Warm" 3 "Increase Speed or Apply Brake" 4 "Ready for Drive Away" 5 "Please Wait" 6 "Apply and Hold Brake" 7 "Cool Down" 8 "Creep Disabled" ;
VAL_TABLE_ RTPP_TirePrsRRAuth_Inv 0 "FALSE" 1 "TRUE" ;
VAL_TABLE_ RTPP_TirePrsLRAuth_Inv 0 "FALSE" 1 "TRUE" ;
VAL_TABLE_ AdptCrsCntrlEngd 0 "FALSE" 1 "TRUE" ;
VAL_TABLE_ SGI_ServStSysIndOn 0 "FALSE" 1 "TRUE" ;
VAL_TABLE_ DrvStBltRmIndReq 0 "OFF" 1 "ON" 2 "0.5_Hz" 3 "1_Hz" 4 "2_Hz" 5 "4_Hz" 6 "RESERVED_1" 7 "RESERVED_2" ;
VAL_TABLE_ AirbgStsIndReq 0 "OFF" 1 "ON" 2 "0.5_Hz" 3 "1_Hz" 4 "2_Hz" 5 "4_Hz" 6 "RESERVED_1" 7 "RESERVED_2" ;
VAL_TABLE_ AutoEmrgBrkgDsbldIndOn 0 "FALSE" 1 "TRUE" ;
VAL_TABLE_ PTCrnkAct 0 "FALSE" 1 "TRUE" ;
VAL_TABLE_ DrvShftCntrlTrgtGr 0 "Unknown" 1 "First Gear" 2 "Second Gear" 3 "Third Gear" 4 "Fourth Gear" 5 "Fifth Gear" 6 "Sixth Gear" 7 "Seventh Gear" 8 "Eighth Gear" 9 "Ninth Gear" 10 "Tenth Gear" ;
VAL_TABLE_ DrvrAlrtTypCstAvlFlg3 0 "FALSE" 1 "TRUE" ;
VAL_TABLE_ DrvrAlrtTypCstAvlFlg2 0 "FALSE" 1 "TRUE" ;
VAL_TABLE_ DrvrAlrtTypCstAvlFlg1 0 "FALSE" 1 "TRUE" ;
VAL_TABLE_ CrgBedVwAutoLgtCstSetAval 0 "FALSE" 1 "TRUE" ;
VAL_TABLE_ RrClsrAjrStat 0 "FALSE" 1 "TRUE" ;
VAL_TABLE_ RrClsrAjrStat_Inv 0 "FALSE" 1 "TRUE" ;
VAL_TABLE_ RRDrAjrStat 0 "FALSE" 1 "TRUE" ;
VAL_TABLE_ RRDrAjrStat_Inv 0 "FALSE" 1 "TRUE" ;
VAL_TABLE_ EsyExtCstStAvl 0 "FALSE" 1 "TRUE" ;
VAL_TABLE_ DsplyTrgVdOn 0 "FALSE" 1 "TRUE" ;
VAL_TABLE_ DspFrnt360CmrON 0 "FALSE" 1 "TRUE" ;
VAL_TABLE_ DrvrAlrtTypCstStAvl 0 "FALSE" 1 "TRUE" ;
VAL_TABLE_ DrvrAlrtTypCstAvlFlg7 0 "FALSE" 1 "TRUE" ;
VAL_TABLE_ DrvrAlrtTypCstAvlFlg6 0 "FALSE" 1 "TRUE" ;
VAL_TABLE_ DrvrAlrtTypCstAvlFlg5 0 "FALSE" 1 "TRUE" ;
VAL_TABLE_ DrvrAlrtTypCstAvlFlg4 0 "FALSE" 1 "TRUE" ;
VAL_TABLE_ LnChgAlrtLmtdTrlrIndOn 0 "FALSE" 1 "TRUE" ;
VAL_TABLE_ LnChgAlrtCstStAvl 0 "FALSE" 1 "TRUE" ;
VAL_TABLE_ JckKnfDtnCstSetAval 0 "FALSE" 1 "TRUE" ;
VAL_TABLE_ HptcStFldIndOn 0 "FALSE" 1 "TRUE" ;
VAL_TABLE_ GoNotfrCstStAvl 0 "FALSE" 1 "TRUE" ;
VAL_TABLE_ GlrFrHgBmRspTypCstStAvl 0 "FALSE" 1 "TRUE" ;
VAL_TABLE_ FrwdImpMtgnOpSlctCstStAvl 0 "FALSE" 1 "TRUE" ;
VAL_TABLE_ FrntPCMRspTypCstStAvl 0 "FALSE" 1 "TRUE" ;
VAL_TABLE_ RnngBrdManDplyCstSetSelbl 0 "FALSE" 1 "TRUE" ;
VAL_TABLE_ RnngBrdManDplyCstSetAval 0 "FALSE" 1 "TRUE" ;
VAL_TABLE_ RnngBrdAutoDplyCstSetAval 0 "FALSE" 1 "TRUE" ;
VAL_TABLE_ PrkAsstTrHtchPsntCstStAvl 0 "FALSE" 1 "TRUE" ;
VAL_TABLE_ PrkAsstONOFFCstStAvl 0 "FALSE" 1 "TRUE" ;
VAL_TABLE_ LtRtHnTrCstStAvl 0 "FALSE" 1 "TRUE" ;
VAL_TABLE_ LnChgAlrtSysOffIndOn 0 "FALSE" 1 "TRUE" ;
VAL_TABLE_ SBZAlrtCstAvlFlg6 0 "FALSE" 1 "TRUE" ;
VAL_TABLE_ SBZAlrtCstAvlFlg5 0 "FALSE" 1 "TRUE" ;
VAL_TABLE_ SBZAlrtCstAvlFlg4 0 "FALSE" 1 "TRUE" ;
VAL_TABLE_ SBZAlrtCstAvlFlg3 0 "FALSE" 1 "TRUE" ;
VAL_TABLE_ SBZAlrtCstAvlFlg2 0 "FALSE" 1 "TRUE" ;
VAL_TABLE_ SBZAlrtCstAvlFlg1 0 "FALSE" 1 "TRUE" ;
VAL_TABLE_ RrVwPrkAstSymCsStAvl 0 "FALSE" 1 "TRUE" ;
VAL_TABLE_ RrCrsTrfcAlrtCstStAvl 0 "FALSE" 1 "TRUE" ;
VAL_TABLE_ TargaTopAjrStat 0 "FALSE" 1 "TRUE" ;
VAL_TABLE_ StBltTghtngCstStAv 0 "FALSE" 1 "TRUE" ;
VAL_TABLE_ SrrndVwLghtCsStAvl 0 "FALSE" 1 "TRUE" ;
VAL_TABLE_ ServSdDtcSysIndOn 0 "FALSE" 1 "TRUE" ;
VAL_TABLE_ SdDtcTempUnvIndOn 0 "FALSE" 1 "TRUE" ;
VAL_TABLE_ SBZAlrtOffIndOn 0 "FALSE" 1 "TRUE" ;
VAL_TABLE_ SBZAlrtCstStAvl 0 "FALSE" 1 "TRUE" ;
VAL_TABLE_ SBZAlrtCstAvlFlg7 0 "FALSE" 1 "TRUE" ;
VAL_TABLE_ TrnSigSwRtActv 0 "FALSE" 1 "TRUE" ;
VAL_TABLE_ TrnSigSwLtActv 0 "FALSE" 1 "TRUE" ;
VAL_TABLE_ TrlrMirVidGdlnsCstSetAval 0 "FALSE" 1 "TRUE" ;
VAL_TABLE_ TrlrMirVidEnblCstSetAval 0 "FALSE" 1 "TRUE" ;
VAL_TABLE_ TrlrConnStat 0 "Not Connected" 1 "Connected" ;
VAL_TABLE_ TrffcLgtAsstCstSetAval 0 "FALSE" 1 "TRUE" ;
VAL_TABLE_ PwrRrClsrCstCurrSetVal 0 "Setting_Unknown" 1 "Off" 2 "On" 3 "On_Custom_Height" 4 "RESERVED_4" 5 "RESERVED_5" 6 "RESERVED_6" 7 "RESERVED_7" ;
VAL_TABLE_ GlrFrHgBmRspTypCstCurSetVal 0 "SETTING_UNKNOWN" 1 "AUTOMATIC_HIGH_BEAM" 2 "GLARE_FREE_HIGH_BEAM" 3 "RESERVED_3" 4 "\?? RESERVED_4" 5 "RESERVED_5" 6 "RESERVED_6" 7 "RESERVED_7" ;
VAL_TABLE_ FrwdImpMtgnOpSlctCstCrStVal 0 "SETTING_UNKNOWN" 1 "OFF" 2 "ALERT" 3 "ALERT_BRAKE" 4 "ALERT_BRAKE_STEER" 5 "RESERVED_5" 6 "RESERVED_6" 7 "RESERVED_7" ;
VAL_TABLE_ FrntPCMRspTypCstCrStVal 0 "SETTING_UNKNOWN" 1 "OFF" 2 "ALERT" 3 "ALERT_AND_BRAKE" 4 "ALERT_AND_BRAKE_AND_STEER" 5 "RESERVED_5" 6 "RESERVED_6" 7 "RESERVED_7" ;
VAL_TABLE_ LnChgAlrtCstCrStVal 0 "SETTING_UNKNOWN" 1 "OFF" 2 "ON" 3 "RESERVED_3" 4 "RESERVED_4" 5 "RESERVED_5" 6 "RESERVED_6" 7 "RESERVED_7" ;
VAL_TABLE_ JckKnfDtnCstCurrSetVal 0 "Setting_Unknown" 1 "Off" 2 "On" 3 "Reserved_3" 4 "Reserved_4" 5 "Reserved_5" 6 "Reserved_6" 7 "Reserved_7" ;
VAL_TABLE_ GoNotfrCstCrStVal 0 "SETTING_UNKNOWN" 1 "OFF" 2 "ON" 3 "RESERVED_3" 4 "RESERVED_4" 5 "RESERVED_5" 6 "RESERVED_6" 7 "RESERVED_7" ;
VAL_TABLE_ PrkAsstONOFFCstCrStVal 0 "SETTING_UNKNOWN" 1 "OFF" 2 "ALERT" 3 "ALERT_BRAKE" 4 "RESERVED_4" 5 "RESERVED_5" 6 "RESERVED_6" 7 "RESERVED_7" ;
VAL_TABLE_ LtRtHnTrCstCurSetVal 0 "SETTING_UNKNOWN" 1 "LEFT_HAND_DRIVE" 2 "RIGHT_HAND_DRIVE" 3 "AUTOMATIC_WITH_GPS" 4 "RESERVED_4" 5 "RESERVED_5" 6 "RESERVED_6" 7 "RESERVED_7" ;
VAL_TABLE_ RnngBrdAutoDplyCstCurrSetVal 0 "Setting_Unknown" 1 "Off" 2 "Door" 3 "Door_Park" 4 "Reserved_5" 5 "Reserved_6" 6 "Reserved_7" ;
VAL_TABLE_ PFASndSeltnCstCurrSetVal 0 "Setting_Unknown" 1 "Pedestrian Alert Sound 1" 2 "Pedestrian Alert Sound 2" 3 "Pedestrian Alert Sound 3" 4 "RESERVED_4" 5 "RESERVED_5" 6 "RESERVED_6" 7 "RESERVED_7" ;
VAL_TABLE_ PrkAsstTrHtchPsntCstCrStVal 0 "SETTING_UNKNOWN" 1 "OFF_NOT_ATTACHED" 2 "ON_ATTACHED" 3 "RESERVED_3" 4 "RESERVED_4" 5 "RESERVED_5" 6 "RESERVED_6" 7 "RESERVED_7" ;
VAL_TABLE_ RrVwPrkAstSymCsCrStVal 0 "SETTING_UNKNOWN" 1 "OFF" 2 "ON" 3 "RESERVED_3" 4 "RESERVED_4" 5 "RESERVED_5" 6 "RESERVED_6" 7 "RESERVED_7" ;
VAL_TABLE_ RrCrsTrfcAlrtCstCrStVal 0 "SETTING_UNKNOWN" 1 "OFF" 2 "ALERT" 3 "ALERT and BRAKE" 4 "RESERVED_4" 5 "RESERVED_5" 6 "RESERVED_6" 7 "RESERVED_7" ;
VAL_TABLE_ RnngBrdManDplyCstCurrSetVal 0 "Setting_Unknown" 1 "Off" 2 "Extend to Door" 3 "Extend to Bed" 4 "Reserved_4" 5 "Reserved_5" 6 "Reserved_6" 7 "Reserved_7" ;
VAL_TABLE_ SrrndVwLghtCsCrStVal 0 "SETTING_UNKNOWN" 1 "OFF" 2 "ON" 3 "RESERVED_3" 4 "RESERVED_4" 5 "RESERVED_5" 6 "RESERVED_6" 7 "RESERVED_7" ;
VAL_TABLE_ SBZAlrtCstCrStVal 0 "SETTING_UNKNOWN" 1 "OFF" 2 "ON" 3 "RESERVED_3" 4 "RESERVED_4" 5 "RESERVED_5" 6 "RESERVED_6" 7 "RESERVED_7" ;
VAL_TABLE_ TrlrMirVidGdlnsCstCurrSetVal 0 "Setting_Unknown" 1 "Off" 2 "On" 3 "Reserved_3" 4 "Reserved_4" 5 "Reserved_5" 6 "Reserved_6" 7 "Reserved_7" ;
VAL_TABLE_ TrffcLgtAsstCstCurrSetVal 0 "SETTING_UNKNOWN" 1 "OFF" 2 "ALERT" 3 "RESERVED_3" 4 "RESERVED_4" 5 "RESERVED_5" 6 "RESERVED_6" 7 "RESERVED_7" ;
VAL_TABLE_ StBltTghtngCstCrStVal 0 "SETTING_UNKNOWN" 1 "OFF" 2 "ON" 3 "RESERVED_3" 4 "RESERVED_4" 5 "RESERVED_5" 6 "RESERVED_6" 7 "RESERVED_7" ;
VAL_TABLE_ CnvtblTopTneuAjrStat 0 "FALSE" 1 "TRUE" ;
VAL_TABLE_ LftglsAjrStat 0 "FALSE" 1 "TRUE" ;
VAL_TABLE_ LftglsAjrStat_Inv 0 "FALSE" 1 "TRUE" ;
VAL_TABLE_ LRDrAjrStat 0 "FALSE" 1 "TRUE" ;
VAL_TABLE_ LRDrAjrStat_Inv 0 "FALSE" 1 "TRUE" ;
VAL_TABLE_ ElvtdIdlCstCrStVal 0 "No Action" 1 "Off" 2 "On" ;
VAL_TABLE_ RRSCDS_Massg 0 "Not Selected" 1 "Selected Massage Off" 2 "Selected Massage On" ;
VAL_TABLE_ RRSCDS_LmbrUDnFdRr 0 "Not Selected" 1 "Selected-No Movement" 2 "Up" 3 "Down" 4 "Forward" 5 "Rearward" ;
VAL_TABLE_ RRSCDS_MassgTyp 0 "Massage Off" 1 "Massage Type 1" 2 "Massage Type 2" 3 "Massage Type 3" 4 "Massage Type 4" 5 "Massage Type 5" 6 "Massage Type 6" 7 "Massage Type 7" 8 "Massage Type 8" 9 "Massage Type 9" 10 "Massage Type 10" 11 "Massage Type 11" 12 "Massage Type 12" 13 "Massage Type 13" 14 "Massage Type 14" 15 "Massage Type 15" ;
VAL_TABLE_ RRSCDS_BkCshBlstInOt 0 "Not Selected" 1 "Selected-No Movement" 2 "Back Bolster In" 3 "Back Bolster Out" 4 "Cushion Bolster In" 5 "Cushion Bolster Out" ;
VAL_TABLE_ RRSCDS_HdrstFwdRrwd 0 "Not Selected" 1 "Selected-No Movement" 2 "Forward" 3 "Rearward" ;
VAL_TABLE_ RRSCDS_LmbrFwdRr 0 "Not Selected" 1 "Selected-No Movement" 2 "Forward" 3 "Rearward" ;
VAL_TABLE_ RRSCDS_HdrstFdRrUDn 0 "Not Selected" 1 "Selected-No Movement" 2 "Up" 3 "Down" 4 "Forward" 5 "Rearward" ;
VAL_TABLE_ RRSCDS_UprShldrFdRr 0 "Not Selected" 1 "Selected-No Movement" 2 "Forward" 3 "Rearward" ;
VAL_TABLE_ RRSCDS_CshBlstrInOut 0 "Not Selected" 1 "Selected-No Movement" 2 "In" 3 "Out" ;
VAL_TABLE_ RRSCDS_HdrstWngInOt 0 "Not Selected" 1 "Selected-No Movement" 2 "In" 3 "Out" ;
VAL_TABLE_ RRSCDS_HdrstUpDn 0 "Not Selected" 1 "Selected-No Movement" 2 "Up" 3 "Down" ;
VAL_TABLE_ RRSCDS_LmbrUpDwn 0 "Not Selected" 1 "Selected-No Movement" 2 "Up" 3 "Down" ;
VAL_TABLE_ RRSCDS_MassgIntsty 0 "Massage Off" 1 "Massage Intensity 1" 2 "Massage Intensity 2" 3 "Massage Intensity 3" 4 "Massage Intensity 4" 5 "Massage Intensity 5" 6 "Massage Intensity 6" 7 "Massage Intensity 7" ;
VAL_TABLE_ EDADS_ShftIndSt 0 "Shift Down" 1 "Shift Up" 2 "No Shift" ;
VAL_TABLE_ RRSCDS_CshLgAdjFdRr 0 "Not Selected" 1 "Selected-No Movement" 2 "Forward" 3 "Rearward" ;
VAL_TABLE_ RRSCDS_HdrstTltFwdRr 0 "Not Selected" 1 "Selected-No Movement" 2 "Forward" 3 "Rearward" ;
VAL_TABLE_ RRSCDS_BkBlstrInOut 0 "Not Selected" 1 "Selected-No Movement" 2 "In" 3 "Out" ;
VAL_TABLE_ RRSCDS_DispReq 0 "FALSE" 1 "TRUE" ;
VAL_TABLE_ EDADS_RcmndtFwdGr 0 "None" 1 "First Gear" 2 "Second Gear" 3 "Third Gear" 4 "Fourth Gear" 5 "Fifth Gear" 6 "Sixth Gear" 7 "Seventh Gear" 8 "Eighth Gear" 9 "Ninth Gear" 10 "Tenth Gear" 11 "Unused" 12 "Unused" 13 "Unused" 14 "Unused" 15 "Unused" ;
VAL_TABLE_ EDADS_CrntFwdMsdGr 0 "None" 1 "First Gear" 2 "Second Gear" 3 "Third Gear" 4 "Fourth Gear" 5 "Fifth Gear" 6 "Sixth Gear" 7 "Seventh Gear" 8 "Eighth Gear" 9 "Ninth Gear" 10 "Tenth Gear" 11 "Unused" 12 "Unused" 13 "Unused" 14 "Unused" 15 "Unused" ;
VAL_TABLE_ CnvtblTpWndMtnReq 0 "NO_ACTION" 1 "OPEN" 2 "CLOSE" 3 "COMFORT_OPEN" 4 "COMFORT_CLOSE" ;
VAL_TABLE_ CnvtblTpStat 0 "INDETERMINATE" 1 "FULLY CLOSED" 2 "FULLY OPEN" 3 "CLOSING" 4 "OPENING" 5 "HALTED" ;
VAL_TABLE_ EDADS_EcoDrvShftIO 0 "FALSE" 1 "TRUE" ;
VAL_TABLE_ DrvDrAjrStat 0 "FALSE" 1 "TRUE" ;
VAL_TABLE_ DrvDrAjrStat_Inv 0 "FALSE" 1 "TRUE" ;
VAL_TABLE_ FCAACCGapSeltn 0 "Far" 1 "Medium" 2 "Near" 3 "Off" 4 "Unknown" ;
VAL_TABLE_ EsyExtCstCurSetVal 0 "SETTING_UNKNOWN" 1 "OFF" 2 "ON" 3 "RESERVED_3" 4 "RESERVED_4" 5 "RESERVED_5" 6 "RESERVED_6" 7 "RESERVED_7" ;
VAL_TABLE_ RFSCDS_LmbrUDnFdRr 0 "Not Selected" 1 "Selected-No Movement" 2 "Up" 3 "Down" 4 "Forward" 5 "Rearward" ;
VAL_TABLE_ RFSCDS_UprShldrFdRr 0 "Not Selected" 1 "Selected-No Movement" 2 "Forward" 3 "Rearward" ;
VAL_TABLE_ RFSCDS_MassgTyp 0 "Massage Off" 1 "Massage Type 1" 2 "Massage Type 2" 3 "Massage Type 3" 4 "Massage Type 4" 5 "Massage Type 5" 6 "Massage Type 6" 7 "Massage Type 7" 8 "Massage Type 8" 9 "Massage Type 9" 10 "Massage Type 10" 11 "Massage Type 11" 12 "Massage Type 12" 13 "Massage Type 13" 14 "Massage Type 14" 15 "Massage Type 15" ;
VAL_TABLE_ RFSCDS_HdrstWngInOt 0 "Not Selected" 1 "Selected-No Movement" 2 "In" 3 "Out" ;
VAL_TABLE_ RFSCDS_DispReq 0 "FALSE" 1 "TRUE" ;
VAL_TABLE_ RFSCDS_BkBlstrInOut 0 "Not Selected" 1 "Selected-No Movement" 2 "In" 3 "Out" ;
VAL_TABLE_ RFSCDS_HdrstFwdRrwd 0 "Not Selected" 1 "Selected-No Movement" 2 "Forward" 3 "Rearward" ;
VAL_TABLE_ RFSCDS_LmbrFwdRr 0 "Not Selected" 1 "Selected-No Movement" 2 "Forward" 3 "Rearward" ;
VAL_TABLE_ RFSCDS_HdrstTltFwdRr 0 "Not Selected" 1 "Selected-No Movement" 2 "Forward" 3 "Rearward" ;
VAL_TABLE_ RFSCDS_HdrstUpDn 0 "Not Selected" 1 "Selected-No Movement" 2 "Up" 3 "Down" ;
VAL_TABLE_ RFSCDS_Massg 0 "Not Selected" 1 "Selected Massage Off" 2 "Selected Massage On" ;
VAL_TABLE_ RFSCDS_MassgIntsty 0 "Massage Off" 1 "Massage Intensity 1" 2 "Massage Intensity 2" 3 "Massage Intensity 3" 4 "Massage Intensity 4" 5 "Massage Intensity 5" 6 "Massage Intensity 6" 7 "Massage Intensity 7" ;
VAL_TABLE_ RFSCDS_CshLgAdjFdRr 0 "Not Selected" 1 "Selected-No Movement" 2 "Forward" 3 "Rearward" ;
VAL_TABLE_ RFSCDS_BkCshBlstInOt 0 "Not Selected" 1 "Selected-No Movement" 2 "Back Bolster In" 3 "Back Bolster Out" 4 "Cushion Bolster In" 5 "Cushion Bolster Out" ;
VAL_TABLE_ RPARS_LtCntr 0 "OFF" 1 "FAILED" 2 "BLOCKED" 3 "ATTACHED_OBJECT" 4 "NO_OBJECT" 5 "ZONE_1" 6 "ZONE_2" 7 "ZONE_3" 8 "ZONE_4" 9 "ZONE_5" 10 "ZONE_6" 11 "OFF_NO_FAULT" 12 "RESERVED_1" 13 "RESERVED_2" 14 "RESERVED_3" ;
VAL_TABLE_ RFSCDS_LmbrUpDwn 0 "Not Selected" 1 "Selected-No Movement" 2 "Up" 3 "Down" ;
VAL_TABLE_ RFSCDS_HdrstFdRrUDn 0 "Not Selected" 1 "Selected-No Movement" 2 "Up" 3 "Down" 4 "Forward" 5 "Rearward" ;
VAL_TABLE_ RFSCDS_CshBlstrInOut 0 "Not Selected" 1 "Selected-No Movement" 2 "In" 3 "Out" ;
VAL_TABLE_ RPARS_RtCntr 0 "OFF" 1 "FAILED" 2 "BLOCKED" 3 "ATTACHED_OBJECT" 4 "NO_OBJECT" 5 "ZONE_1" 6 "ZONE_2" 7 "ZONE_3" 8 "ZONE_4" 9 "ZONE_5" 10 "ZONE_6" 11 "OFF_NO_FAULT" 12 "RESERVED_1" 13 "RESERVED_2" 14 "RESERVED_3" ;
VAL_TABLE_ RPARS_Rt 0 "OFF" 1 "FAILED" 2 "BLOCKED" 3 "ATTACHED_OBJECT" 4 "NO_OBJECT" 5 "ZONE_1" 6 "ZONE_2" 7 "ZONE_3" 8 "ZONE_4" 9 "ZONE_5" 10 "ZONE_6" 11 "OFF_NO_FAULT" 12 "RESERVED_1" 13 "RESERVED_2" 14 "RESERVED_3" ;
VAL_TABLE_ MemCmd 0 "No Operation Required" 1 "Store Mem 1 (Button Mem 1)" 2 "Store Mem 2(Button Mem 2)" 3 "Store Mem 3 (Button Mem 3)" 4 "Store Mem EXIT (Button Mem Exit)" 5 "Recall Mem 1 (Button Mem 1)" 6 "Recall Mem 2 (Button Mem 2)" 7 "Recall Mem 3 (Button Mem 3)" 8 "Recall Mem EXIT (Button Mem Exit)" 9 "Stop All Movement" 10 "RESERVED_10" 11 "RESERVED_11" 12 "RESERVED_12" 13 "RESERVED_13" 14 "RESERVED_14" 15 "RESERVED_15" ;
VAL_TABLE_ RPARS_Lt 0 "OFF" 1 "FAILED" 2 "BLOCKED" 3 "ATTACHED_OBJECT" 4 "NO_OBJECT" 5 "ZONE_1" 6 "ZONE_2" 7 "ZONE_3" 8 "ZONE_4" 9 "ZONE_5" 10 "ZONE_6" 11 "OFF_NO_FAULT" 12 "RESERVED_1" 13 "RESERVED_2" 14 "RESERVED_3" ;
VAL_TABLE_ CoDrvDrAjrStat 0 "FALSE" 1 "TRUE" ;
VAL_TABLE_ CoDrvDrAjrStat_Inv 0 "FALSE" 1 "TRUE" ;
VAL_TABLE_ AutMemRclCstCurSetVal 0 "SETTING_UNKNOWN" 1 "OFF" 2 "ON" 3 "AUTO_MEMORY_RECALL" 4 "EASY_EXIT" 5 "AUTO_MEMORY_AND EASY_EXIT_RECALLS" 6 "RESERVED_7" ;
VAL_TABLE_ LRSCDS_BkBlstrInOut 0 "Not Selected" 1 "Selected-No Movement" 2 "In" 3 "Out" ;
VAL_TABLE_ LRSCDS_UprShldrFdRr 0 "Not Selected" 1 "Selected-No Movement" 2 "Forward" 3 "Rearward" ;
VAL_TABLE_ LRSCDS_CshBlstrInOut 0 "Not Selected" 1 "Selected-No Movement" 2 "In" 3 "Out" ;
VAL_TABLE_ LRSCDS_HdrstFdRrUDn 0 "Not Selected" 1 "Selected-No Movement" 2 "Up" 3 "Down" 4 "Forward" 5 "Rearward" ;
VAL_TABLE_ LRSCDS_HdrstTltFwdRr 0 "Not Selected" 1 "Selected-No Movement" 2 "Forward" 3 "Rearward" ;
VAL_TABLE_ LRSCDS_HdrstUpDn 0 "Not Selected" 1 "Selected-No Movement" 2 "Up" 3 "Down" ;
VAL_TABLE_ LRSCDS_LmbrUpDwn 0 "Not Selected" 1 "Selected-No Movement" 2 "Up" 3 "Down" ;
VAL_TABLE_ LRSCDS_DispReq 0 "FALSE" 1 "TRUE" ;
VAL_TABLE_ LRSCDS_MassgIntsty 0 "Massage Off" 1 "Massage Intensity 1" 2 "Massage Intensity 2" 3 "Massage Intensity 3" 4 "Massage Intensity 4" 5 "Massage Intensity 5" 6 "Massage Intensity 6" 7 "Massage Intensity 7" ;
VAL_TABLE_ LRSCDS_HdrstWngInOt 0 "Not Selected" 1 "Selected-No Movement" 2 "In" 3 "Out" ;
VAL_TABLE_ LRSCDS_LmbrUDnFdRr 0 "Not Selected" 1 "Selected-No Movement" 2 "Up" 3 "Down" 4 "Forward" 5 "Rearward" ;
VAL_TABLE_ LRSCDS_CshLgAdjFdRr 0 "Not Selected" 1 "Selected-No Movement" 2 "Forward" 3 "Rearward" ;
VAL_TABLE_ LRSCDS_HdrstFwdRrwd 0 "Not Selected" 1 "Selected-No Movement" 2 "Forward" 3 "Rearward" ;
VAL_TABLE_ LRSCDS_LmbrFwdRr 0 "Not Selected" 1 "Selected-No Movement" 2 "Forward" 3 "Rearward" ;
VAL_TABLE_ LRSCDS_Massg 0 "Not Selected" 1 "Selected Massage Off" 2 "Selected Massage On" ;
VAL_TABLE_ SAP_SecAxlOpMdAuth 0 "2WD High" 1 "4WD High Rigid Coupling" 2 "4WD Low Rigid Coupling" 3 "AWD Active Single Clutch" 4 "4WD High Active Clutch" 5 "4WD Low Active Clutch" 6 "AWD Active Twin Clutch" 7 "2WD Low" 8 "Unknown" 9 "Neutral" ;
VAL_TABLE_ LRSCDS_BkCshBlstInOt 0 "Not Selected" 1 "Selected-No Movement" 2 "Back Bolster In" 3 "Back Bolster Out" 4 "Cushion Bolster In" 5 "Cushion Bolster Out" ;
VAL_TABLE_ LRSCDS_MassgTyp 0 "Massage Off" 1 "Massage Type 1" 2 "Massage Type 2" 3 "Massage Type 3" 4 "Massage Type 4" 5 "Massage Type 5" 6 "Massage Type 6" 7 "Massage Type 7" 8 "Massage Type 8" 9 "Massage Type 9" 10 "Massage Type 10" 11 "Massage Type 11" 12 "Massage Type 12" 13 "Massage Type 13" 14 "Massage Type 14" 15 "Massage Type 15" ;
VAL_TABLE_ SAP_SecAxl4WDAWDStatAuth 0 "Normal" 1 "Temporary_Limited" 2 "Temporary_Inhibit" 3 "Permanently_Failed" ;
VAL_TABLE_ SAP_SecAxlOpMdAuth_Inv 0 "FALSE" 1 "TRUE" ;
VAL_TABLE_ SAP_SecAxl4WDAWDEstTrqAuth_Inv 0 "FALSE" 1 "TRUE" ;
VAL_TABLE_ AdpLghtRspTypCstCurSetVal 0 "SETTING_UNKNOWN" 1 "OFF" 2 "CORNER_AND_CURVE_LIGHTING" 3 "INTELLIGENT_LIGHT_DISTRIBUTION" 4 "INTELLIGENT_LIGHT_DISTRIBUTION_GPS_ASSISTANCE" 5 "RESERVED_5" 6 "RESERVED_6" 7 "RESERVED_7" ;
VAL_TABLE_ HSP_HptcStPrsntAuth 0 "FALSE" 1 "TRUE" ;
VAL_TABLE_ HSP_DrvAlrtTypCstCurrSetValAuth 0 "SETTING_UNKNOWN" 1 "CHIME" 2 "SEAT" ;
VAL_TABLE_ LFSCDS_LmbrUDnFdRr 0 "Not Selected" 1 "Selected-No Movement" 2 "Up" 3 "Down" 4 "Forward" 5 "Rearward" ;
VAL_TABLE_ LFSCDS_DispReq 0 "FALSE" 1 "TRUE" ;
VAL_TABLE_ LFSCDS_UprShldrFdRr 0 "Not Selected" 1 "Selected-No Movement" 2 "Forward" 3 "Rearward" ;
VAL_TABLE_ LFSCDS_LmbrUpDwn 0 "Not Selected" 1 "Selected-No Movement" 2 "Up" 3 "Down" ;
VAL_TABLE_ LFSCDS_Massg 0 "Not Selected" 1 "Selected Massage Off" 2 "Selected Massage On" ;
VAL_TABLE_ LFSCDS_BkBlstrInOut 0 "Not Selected" 1 "Selected-No Movement" 2 "In" 3 "Out" ;
VAL_TABLE_ LFSCDS_HdrstTltFwdRr 0 "Not Selected" 1 "Selected-No Movement" 2 "Forward" 3 "Rearward" ;
VAL_TABLE_ LFSCDS_LmbrFwdRr 0 "Not Selected" 1 "Selected-No Movement" 2 "Forward" 3 "Rearward" ;
VAL_TABLE_ LFSCDS_MassgTyp 0 "Massage Off" 1 "Massage Type 1" 2 "Massage Type 2" 3 "Massage Type 3" 4 "Massage Type 4" 5 "Massage Type 5" 6 "Massage Type 6" 7 "Massage Type 7" 8 "Massage Type 8" 9 "Massage Type 9" 10 "Massage Type 10" 11 "Massage Type 11" 12 "Massage Type 12" 13 "Massage Type 13" 14 "Massage Type 14" 15 "Massage Type 15" ;
VAL_TABLE_ LFSCDS_HdrstFdRrUDn 0 "Not Selected" 1 "Selected-No Movement" 2 "Up" 3 "Down" 4 "Forward" 5 "Rearward" ;
VAL_TABLE_ LFSCDS_CshBlstrInOut 0 "Not Selected" 1 "Selected-No Movement" 2 "In" 3 "Out" ;
VAL_TABLE_ LFSCDS_HdrstUpDn 0 "Not Selected" 1 "Selected-No Movement" 2 "Up" 3 "Down" ;
VAL_TABLE_ LFSCDS_HdrstWngInOt 0 "Not Selected" 1 "Selected-No Movement" 2 "In" 3 "Out" ;
VAL_TABLE_ LFSCDS_BkCshBlstInOt 0 "Not Selected" 1 "Selected-No Movement" 2 "Back Bolster In" 3 "Back Bolster Out" 4 "Cushion Bolster In" 5 "Cushion Bolster Out" ;
VAL_TABLE_ SDGPARS_CntrLtSd 0 "OFF" 1 "FAILED" 2 "BLOCKED" 3 "ATTACHED_OBJECT" 4 "NO_OBJECT" 5 "ZONE_1" 6 "ZONE_2" 7 "ZONE_3" 8 "ZONE_4" 9 "ZONE_5" 10 "ZONE_6" 11 "OFF_NO_FAULT" 12 "RESERVED_1" 13 "RESERVED_2" 14 "RESERVED_3" ;
VAL_TABLE_ LFSCDS_MassgIntsty 0 "Massage Off" 1 "Massage Intensity 1" 2 "Massage Intensity 2" 3 "Massage Intensity 3" 4 "Massage Intensity 4" 5 "Massage Intensity 5" 6 "Massage Intensity 6" 7 "Massage Intensity 7" ;
VAL_TABLE_ LFSCDS_CshLgAdjFdRr 0 "Not Selected" 1 "Selected-No Movement" 2 "Forward" 3 "Rearward" ;
VAL_TABLE_ LFSCDS_HdrstFwdRrwd 0 "Not Selected" 1 "Selected-No Movement" 2 "Forward" 3 "Rearward" ;
VAL_TABLE_ SDGPARS_FrtLtSd 0 "OFF" 1 "FAILED" 2 "BLOCKED" 3 "ATTACHED_OBJECT" 4 "NO_OBJECT" 5 "ZONE_1" 6 "ZONE_2" 7 "ZONE_3" 8 "ZONE_4" 9 "ZONE_5" 10 "ZONE_6" 11 "OFF_NO_FAULT" 12 "RESERVED_1" 13 "RESERVED_2" 14 "RESERVED_3" ;
VAL_TABLE_ SDGPARS_RrRtSd 0 "OFF" 1 "FAILED" 2 "BLOCKED" 3 "ATTACHED_OBJECT" 4 "NO_OBJECT" 5 "ZONE_1" 6 "ZONE_2" 7 "ZONE_3" 8 "ZONE_4" 9 "ZONE_5" 10 "ZONE_6" 11 "OFF_NO_FAULT" 12 "RESERVED_1" 13 "RESERVED_2" 14 "RESERVED_3" ;
VAL_TABLE_ SDGPARS_RrLtSd 0 "OFF" 1 "FAILED" 2 "BLOCKED" 3 "ATTACHED_OBJECT" 4 "NO_OBJECT" 5 "ZONE_1" 6 "ZONE_2" 7 "ZONE_3" 8 "ZONE_4" 9 "ZONE_5" 10 "ZONE_6" 11 "OFF_NO_FAULT" 12 "RESERVED_1" 13 "RESERVED_2" 14 "RESERVED_3" ;
VAL_TABLE_ SDGPARS_CntrRtSd 0 "OFF" 1 "FAILED" 2 "BLOCKED" 3 "ATTACHED_OBJECT" 4 "NO_OBJECT" 5 "ZONE_1" 6 "ZONE_2" 7 "ZONE_3" 8 "ZONE_4" 9 "ZONE_5" 10 "ZONE_6" 11 "OFF_NO_FAULT" 12 "RESERVED_1" 13 "RESERVED_2" 14 "RESERVED_3" ;
VAL_TABLE_ AutoHldEnbld 0 "FALSE" 1 "TRUE" ;
VAL_TABLE_ SDGPARS_FrtRtSd 0 "OFF" 1 "FAILED" 2 "BLOCKED" 3 "ATTACHED_OBJECT" 4 "NO_OBJECT" 5 "ZONE_1" 6 "ZONE_2" 7 "ZONE_3" 8 "ZONE_4" 9 "ZONE_5" 10 "ZONE_6" 11 "OFF_NO_FAULT" 12 "RESERVED_1" 13 "RESERVED_2" 14 "RESERVED_3" ;
VAL_TABLE_ PCOSN_NtfnSecRowCntrStBltSts 0 "Unknown" 1 "UnFastened" 2 "Fastened" 3 "Data Not Available" ;
VAL_TABLE_ PCOSN_NtfnSecRowLtStBltSts 0 "Unknown" 1 "UnFastened" 2 "Fastened" 3 "Data Not Available" ;
VAL_TABLE_ PCOSN_NtfnThrdRowCntrStBltSts 0 "Unknown" 1 "UnFastened" 2 "Fastened" 3 "Data Not Available" ;
VAL_TABLE_ PCOSN_NtfnImpDeltVelTxSts 0 "Not Available" 1 "Pending" 2 "Complete" ;
VAL_TABLE_ PCOSN_NtfnSecRowCntrStOccpSts 0 "Unknown" 1 "Empty" 2 "Occupied" 3 "Data Not Available" ;
VAL_TABLE_ PCOSN_NtfnSecRowLtStOccpSts 0 "Unknown" 1 "Empty" 2 "Occupied" 3 "Data Not Available" ;
VAL_TABLE_ PCOSN_NtfnSecRowRtStBltSts 0 "Unknown" 1 "UnFastened" 2 "Fastened" 3 "Data Not Available" ;
VAL_TABLE_ PCOSN_NtfnThrdRowCntrStOccpSts 0 "Unknown" 1 "Empty" 2 "Occupied" 3 "Data Not Available" ;
VAL_TABLE_ PCOSN_NtfnThrdRowRtStOccpSts 0 "Unknown" 1 "Empty" 2 "Occupied" 3 "Data Not Available" ;
VAL_TABLE_ PCOSN_NtfnFrstPsngrStBltSts 0 "Unknown" 1 "UnFastened" 2 "Fastened" 3 "Data Not Available" ;
VAL_TABLE_ PCOSN_NtfnFrstPsngrStOccpSts 0 "UNKNOWN" 1 "EMPTY" 2 "OCCUPIED" 3 "DATA NOT AVAILABLE" ;
VAL_TABLE_ PCOSN_NtfnSecRowRtStOccpSts 0 "Unknown" 1 "Empty" 2 "Occupied" 3 "Data Not Available" ;
VAL_TABLE_ PCOSN_NtfnThrdRowLtStOccpSts 0 "Unknown" 1 "Empty" 2 "Occupied" 3 "Data Not Available" ;
VAL_TABLE_ PCOSN_NtfnThrdRowRtStBltSts 0 "Unknown" 1 "UnFastened" 2 "Fastened" 3 "Data Not Available" ;
VAL_TABLE_ PCOSN_NtfnDrvrStBltSts 0 "Unknown" 1 "UnFastened" 2 "Fastened" 3 "Data Not Available" ;
VAL_TABLE_ PCOSN_NtfnThrdRowLtStBltSts 0 "Unknown" 1 "UnFastened" 2 "Fastened" 3 "Data Not Available" ;
VAL_TABLE_ TDAP_DrvrStMemIdfrAuth 0 "Memory 1" 1 "Memory 2" 2 "Memory 3" 3 "Memory 4" 4 "Memory 5" 5 "Memory 6" 6 "Memory 7" 7 "Unknown" ;
VAL_TABLE_ TDAP_DrvrIdfrAuth 0 "Driver 1" 1 "Driver 2" 2 "Driver 3" 3 "Driver 4" 4 "Driver 5" 5 "Driver 6" 6 "Driver 7" 7 "Unknown" ;
VAL_TABLE_ TDAP_TeenDrvrActvAuth 0 "FALSE" 1 "TRUE" ;
VAL_TABLE_ AutoHgBmActReq 0 "FALSE" 1 "TRUE" ;
VAL_TABLE_ AutMemRclCstStAvl 0 "FALSE" 1 "TRUE" ;
VAL_TABLE_ AdpLghtRspTypCstStAvl 0 "FALSE" 1 "TRUE" ;
VAL_TABLE_ ACCBRP_ACCActvAuth 0 "FALSE" 1 "TRUE" ;
VAL_TABLE_ VMI1P_VehTopSpdLimModeActvAuth 0 "FALSE" 1 "TRUE" ;
VAL_TABLE_ VMI1P_AccelActlPstnAuth_Inv 0 "FALSE" 1 "TRUE" ;
VAL_TABLE_ VMI1P_AccelPedOvrrdActvAuth 0 "FALSE" 1 "TRUE" ;
VAL_TABLE_ RdWhlAng_Inv 0 "FALSE" 1 "TRUE" ;
VAL_TABLE_ VehPtchAng_Inv 0 "FALSE" 1 "TRUE" ;
VAL_TABLE_ VehRollAng_Inv 0 "FALSE" 1 "TRUE" ;
VAL_TABLE_ CnvtTopModSpdLimIndOn 0 "FALSE" 1 "TRUE" ;
VAL_TABLE_ TEGP_TrnsShftLvrPstnAuth 0 "Between Ranges" 1 "Park Range" 2 "Reverse Range" 3 "Neutral Range" 4 "Forward Range A" 5 "Forward Range B" 6 "Forward Range C" 7 "Forward Range D" 8 "Forward Range E" 9 "Forward Range F" 10 "Forward Range G" 11 "Forward Range H" 12 "Forward Range I" 13 "Forward Range J" 14 "Lever Position Unknown" ;
VAL_TABLE_ TrnsRngInhbtSt 0 "No Range Inhibit Active" 1 "Transmission Inhibit Active" 2 "Transmission Range Re-Selection Req" 3 "Driveline Not Engaged" 4 "Diagnostic Inhibit Active" ;
VAL_TABLE_ IntAmbtBrghtnsCtrlStVal 0 "No Action" 1 "BrightnessLevel 1" 2 "BrightnessLevel 2" 3 "BrightnessLevel 3" 4 "BrightnessLevel 4" 5 "ReservedLevel 5" 6 "ReservedLevel 6" 7 "ReservedLevel 7" ;
VAL_TABLE_ TEGP_TrnsShftLvrPstnAuth_Inv 0 "FALSE" 1 "TRUE" ;
VAL_TABLE_ TEGP_TransCmndGrAuth 0 "Not Supported" 1 "First Gear" 2 "Second Gear" 3 "Third Gear" 4 "Fourth Gear" 5 "Fifth Gear" 6 "Sixth Gear" 7 "Seventh Gear" 8 "Eighth Gear" 9 "Ninth Gear" 10 "Tenth Gear" 11 "Unused and Reserved" 12 "CVT Forward Gear" 13 "Neutral Gear" 14 "Reverse Gear" 15 "Park Gear" ;
VAL_TABLE_ IntAmbtBrghtnsCtrlStAvl 0 "FALSE" 1 "TRUE" ;
VAL_TABLE_ BkUpPwrMdRnCrnkOutSt 0 "FALSE" 1 "TRUE" ;
VAL_TABLE_ TrnsTUTDMdSt 0 "No Activation" 1 "Driver Shift Control Active" 2 "Electronic Range Select Active" ;
VAL_TABLE_ EASSI_StrtStpSt 0 "Engine Off" 1 "Engine Running" 2 "Engine Starting" 3 "Engine Stopping" ;
VAL_TABLE_ TEGP_TrnsEstGrAuth 0 "Not Supported" 1 "First Gear" 2 "Second Gear" 3 "Third Gear" 4 "Fourth Gear" 5 "Fifth Gear" 6 "Sixth Gear" 7 "Seventh Gear" 8 "Eighth Gear" 9 "Ninth Gear" 10 "Tenth Gear" 11 "Unused and Reserved" 12 "CVT Forward Gear" 13 "Neutral Gear" 14 "Reverse Gear" 15 "Park Gear" ;
VAL_TABLE_ TEGP_TrnsEngdStAuth_Inv 0 "FALSE" 1 "TRUE" ;
VAL_TABLE_ TEGP_TrnsEngdStAuth 0 "Transmission Not Engaged" 1 "Transmission Engaged in Forward" 2 "Transmission Engaged in Reverse" 3 "Operating State Not Reached" ;
VAL_TABLE_ TEGP_TrnsEstGrAuth_Inv 0 "FALSE" 1 "TRUE" ;
VAL_TABLE_ FWDECP_RFAuth_Inv 0 "FALSE" 1 "TRUE" ;
VAL_TABLE_ FWDECP_RstOccAuth 0 "FALSE" 1 "TRUE" ;
VAL_TABLE_ FWDECP_LFAuth_Inv 0 "FALSE" 1 "TRUE" ;
VAL_TABLE_ RWDECP_RRAuth_Inv 0 "FALSE" 1 "TRUE" ;
VAL_TABLE_ RWDECP_RstOccAuth 0 "FALSE" 1 "TRUE" ;
VAL_TABLE_ RWDECP_LRAuth_Inv 0 "FALSE" 1 "TRUE" ;
VAL_TABLE_ ASPATR_ClsnImntBrkgAxlTrqRqActv 0 "FALSE" 1 "TRUE" ;
VAL_TABLE_ CIBAutoBrkReqActv 0 "FALSE" 1 "TRUE" ;
VAL_TABLE_ DMSIP_DrvrAttnStatAuth_Inv 0 "FALSE" 1 "TRUE" ;
VAL_TABLE_ DMSIP_DrvrAttnStatAuth 0 "Unknown" 1 "Attention is On Road" 2 "Attention is Off Road" 3 "Attention is Driver's Lap" 4 "Attention is Center Console" 5 "Driver\???s Eyes Fully Closed" 6 "Reserved" ;
VAL_TABLE_ ACCBRP_ReqActvAuth 0 "FALSE" 1 "TRUE" ;
VAL_TABLE_ ACCATRIP_TrqActvAuth 0 "FALSE" 1 "TRUE" ;
VAL_TABLE_ LCCPIP_LnCntrCtlAclPedLimRqAuth 0 "FALSE" 1 "TRUE" ;
VAL_TABLE_ EngOilPrs_Inv 0 "FALSE" 1 "TRUE" ;
VAL_TABLE_ StrgWhlTchSnsHndsOnStat 0 "Hands Off" 1 "Hands On" ;
VAL_TABLE_ HstVehLngVel_Inv 0 "FALSE" 1 "TRUE" ;
VAL_TABLE_ HstVehYawRate_Inv 0 "FALSE" 1 "TRUE" ;
VAL_TABLE_ HstVehLatVel_Inv 0 "FALSE" 1 "TRUE" ;
VAL_TABLE_ ESP_EngSpdStAuth 0 "Normal_Operation" 1 "Degraded_Operation" 2 "Invalid" ;
VAL_TABLE_ TrlrTirePresProfXferSts 0 "Not Active" 1 "Completed" 2 "In Progress" 3 "Failed" ;
VAL_TABLE_ FrwdVehAhdIndReq 0 "OFF" 1 "ON" 2 "0.5_Hz" 3 "1_Hz" 4 "2_Hz" 5 "4_Hz" ;
VAL_TABLE_ ServPedtrnFrndlyAlrtIndOn 0 "FALSE" 1 "TRUE" ;
VAL_TABLE_ RrAxlTmpInhIO 0 "FALSE" 1 "TRUE" ;
VAL_TABLE_ RrAxlMlfIO 0 "FALSE" 1 "TRUE" ;
VAL_TABLE_ RegVltgCtlEngyRcvryActv 0 "FALSE" 1 "TRUE" ;
VAL_TABLE_ HillDscntCtlDispActvIndOn 0 "FALSE" 1 "TRUE" ;
VAL_TABLE_ Deg360VidFtrPrsnt 0 "FALSE" 1 "TRUE" ;
VAL_TABLE_ BrkgSysVehTopSpdLimIndOn 0 "FALSE" 1 "TRUE" ;
VAL_TABLE_ TrgrdVidRcrdrFtrPrsnt 0 "FALSE" 1 "TRUE" ;
VAL_TABLE_ TireRRLoTracIndOn 0 "FALSE" 1 "TRUE" ;
VAL_TABLE_ TireRFLoTracIndOn 0 "FALSE" 1 "TRUE" ;
VAL_TABLE_ TireLRLoTracIndOn 0 "FALSE" 1 "TRUE" ;
VAL_TABLE_ TireLFLoTracIndOn 0 "FALSE" 1 "TRUE" ;
VAL_TABLE_ MemIdfrIgnOnIndReq 0 "No Action" 1 "Driver 1" 2 "Driver 2" 3 "Driver 3" 4 "Driver 4" 5 "Driver 5" 6 "Driver 6" 7 "Driver 7" 8 "Driver 8" ;
VAL_TABLE_ HybStatElecVehModeOvrrd 0 "Undetermined" 1 "No Override" 2 "Too Cold" 3 "Battery Low" 4 "Speed too High" 5 "Generic Override" 6 "Grade too High" 7 "Accelerator Pedal Threshold Exceeded" ;
VAL_TABLE_ ROSP_FrntPsRestOcpStatAuth 0 "Unknown" 1 "Empty" 2 "Empty or Occupied_Non-Adult" 3 "Occupied_Adult" ;
VAL_TABLE_ HiVltgBatAvgTemp_Inv 0 "FALSE" 1 "TRUE" ;
VAL_TABLE_ SLVFSP_SpdLimVsnFsdSpdUntAuth 0 "km/h" 1 "mph" ;
VAL_TABLE_ CustUsblSOC_DuD 0 "FALSE" 1 "TRUE" ;
VAL_TABLE_ HiVltgBatMinTemp_Inv 0 "FALSE" 1 "TRUE" ;
VAL_TABLE_ TnDrvStBltShfIntlkCstAvlFlg4 0 "FALSE" 1 "TRUE" ;
VAL_TABLE_ TnDrvStBltShfIntlkCstAvlFlg3 0 "FALSE" 1 "TRUE" ;
VAL_TABLE_ TnDrvStBltShfIntlkCstAvlFlg2 0 "FALSE" 1 "TRUE" ;
VAL_TABLE_ TnDrvStBltShfIntlkCstAvlFlg1 0 "FALSE" 1 "TRUE" ;
VAL_TABLE_ PwrRrClsrCstSetAval 0 "FALSE" 1 "TRUE" ;
VAL_TABLE_ PwrRrClsrCstAvlFlg7 0 "FALSE" 1 "TRUE" ;
VAL_TABLE_ PwrRrClsrCstAvlFlg6 0 "FALSE" 1 "TRUE" ;
VAL_TABLE_ MemIdfrMemStorIndReq 0 "No Action" 1 "Driver 1" 2 "Driver 2" 3 "Driver 3" 4 "Driver 4" 5 "Driver 5" 6 "Driver 6" 7 "Driver 7" 8 "Driver 8" ;
VAL_TABLE_ ServHiVltgBatIndReq 0 "No Indication" 1 "Shut Down Soon" 2 "No Restart" ;
VAL_TABLE_ HtdStrgWhlInd_HVAC_FP_F 0 "Off" 1 "Low" 2 "Med" 3 "High" ;
VAL_TABLE_ HiVltgBatLmtnDueToTempInd 0 "Normal" 1 "Cold" 2 "Hot" ;
VAL_TABLE_ ServHybSysIndOn 0 "FALSE" 1 "TRUE" ;
VAL_TABLE_ ReqFrtPsgrRstntOccFltInd 0 "FALSE" 1 "TRUE" ;
VAL_TABLE_ RegenPwrLimdIndOn 0 "FALSE" 1 "TRUE" ;
VAL_TABLE_ RegenPwrLimdDispPctVsbl 0 "FALSE" 1 "TRUE" ;
VAL_TABLE_ PrplDispTotPwrUntDisp 0 "kilowatt" 1 "Horsepower" ;
VAL_TABLE_ LossOfPrplIndOn 0 "FALSE" 1 "TRUE" ;
VAL_TABLE_ HybShfToPrkIndOn 0 "FALSE" 1 "TRUE" ;
VAL_TABLE_ EngRnngDueToVehSpdIndOn 0 "FALSE" 1 "TRUE" ;
VAL_TABLE_ InstnsFuelEconHybOvrrdReq 0 "No Action" 1 "Min Fuel Economy" 2 "Max Fuel Economy" 3 "Auto Stop" 4 "EV" ;
VAL_TABLE_ HybStatShtlModeOvrrd 0 "Undetermined" 1 "No Override" 2 "Too Cold" 3 "Battery Low" 4 "Speed too High" 5 "Generic Override" 6 "Grade too High" 7 "Accelerator Pedal Threshold Exceeded" ;
VAL_TABLE_ DM6Denied 0 "FALSE" 1 "TRUE" ;
VAL_TABLE_ DM5Denied 0 "FALSE" 1 "TRUE" ;
VAL_TABLE_ DM4Denied 0 "FALSE" 1 "TRUE" ;
VAL_TABLE_ DM3Denied 0 "FALSE" 1 "TRUE" ;
VAL_TABLE_ JmpStrtSts 0 "Inactive" 1 "In Progress" 2 "Complete" 3 "Power Mode" 4 "Disabled" ;
VAL_TABLE_ TSP_TmpDrvrShfCtlActvAuth 0 "FALSE" 1 "TRUE" ;
VAL_TABLE_ TSP_ElecRngSeltnInDrvActvAuth 0 "FALSE" 1 "TRUE" ;
VAL_TABLE_ VCBA_FrtJnctnActv 0 "FALSE" 1 "TRUE" ;
VAL_TABLE_ VCBA_DynGdlnsActv 0 "FALSE" 1 "TRUE" ;
VAL_TABLE_ VCBA_CurbVwGdlnsActv 0 "FALSE" 1 "TRUE" ;
VAL_TABLE_ VCBA_CurbOvrhdActv 0 "FALSE" 1 "TRUE" ;
VAL_TABLE_ VCBA_CurbActv 0 "FALSE" 1 "TRUE" ;
VAL_TABLE_ VCBA_CrgBedActv 0 "FALSE" 1 "TRUE" ;
VAL_TABLE_ VCBA_BowlActv 0 "FALSE" 1 "TRUE" ;
VAL_TABLE_ VCBA_BedHtchActv 0 "FALSE" 1 "TRUE" ;
VAL_TABLE_ VCBA_RrOvrhdActv 0 "FALSE" 1 "TRUE" ;
VAL_TABLE_ VCBA_RrJnctnActv 0 "FALSE" 1 "TRUE" ;
VAL_TABLE_ VCBA_RrHtchActv 0 "FALSE" 1 "TRUE" ;
VAL_TABLE_ VCBA_LRTrlrTowMirActv 0 "FALSE" 1 "TRUE" ;
VAL_TABLE_ VCBA_JPActv 0 "FALSE" 1 "TRUE" ;
VAL_TABLE_ VCBA_InvsblTrlrActv 0 "FALSE" 1 "TRUE" ;
VAL_TABLE_ VCBA_FrtPrspctvActv 0 "FALSE" 1 "TRUE" ;
VAL_TABLE_ VCBA_FrtOvrhdActv 0 "FALSE" 1 "TRUE" ;
VAL_TABLE_ VCBA_TrlrTowMirActv 0 "FALSE" 1 "TRUE" ;
VAL_TABLE_ VCBA_TrlrGdlnsActv 0 "FALSE" 1 "TRUE" ;
VAL_TABLE_ VCBA_TrlrAux2Actv 0 "FALSE" 1 "TRUE" ;
VAL_TABLE_ VCBA_TrlrAux1CmbdActv 0 "FALSE" 1 "TRUE" ;
VAL_TABLE_ VCBA_TrlrAux1Actv 0 "FALSE" 1 "TRUE" ;
VAL_TABLE_ VCBA_SdRrwdActv 0 "FALSE" 1 "TRUE" ;
VAL_TABLE_ VCBA_SdFrwdActv 0 "FALSE" 1 "TRUE" ;
VAL_TABLE_ VCBA_RrPrspctvActv 0 "FALSE" 1 "TRUE" ;
VAL_TABLE_ VCBA_ZmdBowlActv 0 "FALSE" 1 "TRUE" ;
VAL_TABLE_ SrrndVsnRcrdrDelFileReqSts 0 "Unknown" 1 "File_1 Deleted" 2 "File_2 Deleted" 3 "File_3 Deleted" 4 "File_4 Deleted" 5 "File_5 Deleted" 6 "No Selection" 7 "Delete Failed" ;
VAL_TABLE_ SrrndVsnRcrdrVwprtSts 0 "Unknown" 1 "Playback Mosaic" 2 "Playback Zoom1" 3 "Playback Zoom2" 4 "Playback Zoom3" 5 "Playback Zoom4" 6 "List Recent" 7 "List Saved" ;
VAL_TABLE_ SrrndVsnRcrdrVwprtReq 0 "Unknown" 1 "Playback Mosaic" 2 "Playback Zoom1" 3 "Playback Zoom2" 4 "Playback Zoom3" 5 "Playback Zoom4" 6 "List Recent" 7 "List Saved" ;
VAL_TABLE_ SrrndVsnRcrdrPlybkSts 0 "Unknown" 1 "Play" 2 "Pause" 3 "Rewind" 4 "Fast Forward" 5 "No Selection" ;
VAL_TABLE_ SrrndVsnRcrdrRcrdSts 0 "Unknown" 1 "Enabled" 2 "Disabled" ;
VAL_TABLE_ SrrndVsnRcrdrListPgSts 0 "Unknown" 1 "Page Up" 2 "Page Down" 3 "No Selection" ;
VAL_TABLE_ VGVS_TrlrActv 0 "FALSE" 1 "TRUE" ;
VAL_TABLE_ VGVS_DynActv 0 "FALSE" 1 "TRUE" ;
VAL_TABLE_ VGVS_CurbVwActv 0 "FALSE" 1 "TRUE" ;
VAL_TABLE_ VCBA_TrnspHdActv 0 "FALSE" 1 "TRUE" ;
VAL_TABLE_ SrrndVsnRcrdrRcrdgActv 0 "FALSE" 1 "TRUE" ;
VAL_TABLE_ SVRCBA_PgUpActv 0 "FALSE" 1 "TRUE" ;
VAL_TABLE_ SVRCBA_PgDnActv 0 "FALSE" 1 "TRUE" ;
VAL_TABLE_ RmtRflshDispActvnReq 0 "FALSE" 1 "TRUE" ;
VAL_TABLE_ RmtRflshCmpgnAval 0 "FALSE" 1 "TRUE" ;
VAL_TABLE_ RdcBrkgToAvoidOvrhtgIndOn 0 "FALSE" 1 "TRUE" ;
VAL_TABLE_ HiVltgSysDsbld 0 "FALSE" 1 "TRUE" ;
VAL_TABLE_ FuelFiltChgNowIndOn 0 "FALSE" 1 "TRUE" ;
VAL_TABLE_ ElecAllWhlDrvIndOn 0 "FALSE" 1 "TRUE" ;
VAL_TABLE_ DM8Denied 0 "FALSE" 1 "TRUE" ;
VAL_TABLE_ DM7Denied 0 "FALSE" 1 "TRUE" ;
VAL_TABLE_ TrnspModeInactiveIndOn 0 "FALSE" 1 "TRUE" ;
VAL_TABLE_ TrnspModeActvIndOn 0 "FALSE" 1 "TRUE" ;
VAL_TABLE_ BrkTempStsIndReq 0 "No Action" 1 "Normal" 2 "Warm" 3 "Hot" 4 "Overheated" ;
VAL_TABLE_ VwgVwprtSts 0 "Unknown" 1 "Front Perspective" 2 "Front Junction" 3 "Front Overhead" 4 "Side Forward" 5 "Rear Perspective" 6 "Rear Junction" 7 "Rear Overhead" 8 "Side Rearward" 9 "Bowl" 10 "Zoomed Bowl" 11 "Japan" 12 "Rear Hitch" 13 "Bed Hitch" 14 "Trailer Aux1" 15 "Trailer Towing Mirror" 16 "L R Trailer Towing Mirror" 17 "Trailer Aux1 Combined" 18 "Trailer Aux2" 19 "Invisible Trailer" 20 "Cargo Bed" 21 "Curb Overhead" 22 "Curb" 23 "No Request" 24 "Transparent Hood" ;
VAL_TABLE_ VwgVwprtReq 0 "Unknown" 1 "Front Perspective" 2 "Front Junction" 3 "Front Overhead" 4 "Side Forward" 5 "Rear Perspective" 6 "Rear Junction" 7 "Rear Overhead" 8 "Side Rearward" 9 "Bowl" 10 "Zoomed Bowl" 11 "Japan" 12 "Rear Hitch" 13 "Bed Hitch" 14 "Trailer Aux1" 15 "Trailer Towing Mirror" 16 "L R Trailer Towing Mirror" 17 "Trailer Aux1 Combined" 18 "Trailer Aux2" 19 "Invisible Trailer" 20 "Cargo Bed" 21 "Curb Overhead" 22 "Curb" 23 "No Request" 24 "Transparent Hood" ;
VAL_TABLE_ StBltShfIntlkCstCurrSetVal 0 "SETTING_UNKNOWN" 1 "OFF" 2 "ON" 3 "RESERVED_3" 4 "RESERVED_4" 5 "RESERVED_5" 6 "RESERVED_6" 7 "RESERVED_7" ;
VAL_TABLE_ TnDrvStBltShfIntlkCstSetAval 0 "FALSE" 1 "TRUE" ;
VAL_TABLE_ TnDrvStBltShfIntlkCstCurrSetVal 0 "SETTING_UNKNOWN" 1 "OFF" 2 "ON" 3 "RESERVED_3" 4 "RESERVED_4" 5 "RESERVED_5" 6 "RESERVED_6" 7 "RESERVED_7" ;
VAL_TABLE_ LvlgSysEntEgrsMdCstCurrSetVal 0 "SETTING_UNKNOWN" 1 "OFF" 2 "ON" 3 "RESERVED_3" 4 "RESERVED_4" 5 "RESERVED_5" 6 "RESERVED_6" 7 "RESERVED_7" ;
VAL_TABLE_ LvlgSysAlgnMdCstCurrSetVal 0 "SETTING_UNKNOWN" 1 "OFF" 2 "ON" 3 "RESERVED_3" 4 "RESERVED_4" 5 "RESERVED_5" 6 "RESERVED_6" 7 "RESERVED_7" ;
VAL_TABLE_ StBltShfIntlkCstSetAval 0 "FALSE" 1 "TRUE" ;
VAL_TABLE_ RideHghtSeltn2Name 0 "No Action" 1 "Auto" 2 "Raised 2" 3 "Raised" 4 "Normal" 5 "Entry/Exit" 6 "Cargo Loading" 7 "Lowered" ;
VAL_TABLE_ RideHghtSeltn1Name 0 "No Action" 1 "Auto" 2 "Raised 2" 3 "Raised" 4 "Normal" 5 "Entry/Exit" 6 "Cargo Loading" 7 "Lowered" ;
VAL_TABLE_ LvlgSysServMdCstCurrSetVal 0 "SETTING_UNKNOWN" 1 "OFF" 2 "ON" 3 "RESERVED_3" 4 "RESERVED_4" 5 "RESERVED_5" 6 "RESERVED_6" 7 "RESERVED_7" ;
VAL_TABLE_ LvlgSysAlgnMdCstSetAval 0 "FALSE" 1 "TRUE" ;
VAL_TABLE_ RideHghtSeltn4Name 0 "No Action" 1 "Auto" 2 "Raised 2" 3 "Raised" 4 "Normal" 5 "Entry/Exit" 6 "Cargo Loading" 7 "Lowered" ;
VAL_TABLE_ RideHghtSeltn3Name 0 "No Action" 1 "Auto" 2 "Raised 2" 3 "Raised" 4 "Normal" 5 "Entry/Exit" 6 "Cargo Loading" 7 "Lowered" ;
VAL_TABLE_ StBltShfIntlkCstAvlFlg3 0 "FALSE" 1 "TRUE" ;
VAL_TABLE_ StBltShfIntlkCstAvlFlg2 0 "FALSE" 1 "TRUE" ;
VAL_TABLE_ StBltShfIntlkCstAvlFlg1 0 "FALSE" 1 "TRUE" ;
VAL_TABLE_ TnDrvStBltShfIntlkCstAvlFlg7 0 "FALSE" 1 "TRUE" ;
VAL_TABLE_ TnDrvStBltShfIntlkCstAvlFlg6 0 "FALSE" 1 "TRUE" ;
VAL_TABLE_ TnDrvStBltShfIntlkCstAvlFlg5 0 "FALSE" 1 "TRUE" ;
VAL_TABLE_ HybModeDisp 0 "No Action" 1 "Battery Power" 2 "Engine Power" 3 "Hybrid Power" 4 "Charging with Engine Off" 5 "Charging with Engine On" 6 "Neutral Engine On" 7 "Neutral Engine Off" 8 "Engine Charging" 9 "Engine Power Rear with Battery Front" 10 "Engine Power Rear with Front Wheel Regen" 11 "Undetermined" 12 "Default and Accessory" 13 "Engine Idle" 14 "Reserved 1" 15 "Reserved 2" 16 "Reserved 3" ;
VAL_TABLE_ RrClsrLckSts 0 "Unknown" 1 "Unlocked" 2 "Locked" ;
VAL_TABLE_ RdHgtActvnIndReq 0 "No Indication" 1 "Raising" 2 "Lowering" 3 "Location Raising" 4 "Location Lowering" 5 "Raising Without Remember" ;
VAL_TABLE_ HybModeDispVehCfg 0 "No Action" 1 "Not in Motion" 2 "FWD" 3 "RWD" 4 "4WD" ;
VAL_TABLE_ WhlSlpSt 0 "No Slip Detected" 1 "Negative Slip Detected" 2 "Positive Slip Detected" 3 "Slip Detection Fault" ;
VAL_TABLE_ SBZALCAVisIndStatRt 0 "FLASHING" 1 "SOLID" 2 "OFF" ;
VAL_TABLE_ SBZALCAVisIndStatLt 0 "FLASHING" 1 "SOLID" 2 "OFF" ;
VAL_TABLE_ FrFgLmpIO 0 "FALSE" 1 "TRUE" ;
VAL_TABLE_ ShftrUnlckdBrktoShfIndOn 0 "FALSE" 1 "TRUE" ;
VAL_TABLE_ ShftrLckdBcklPsngrStBltIndOn 0 "FALSE" 1 "TRUE" ;
VAL_TABLE_ ShftrLckdBcklDrvrStBltIndOn 0 "FALSE" 1 "TRUE" ;
VAL_TABLE_ FuelSysNEmsRltMlfActv 0 "FALSE" 1 "TRUE" ;
VAL_TABLE_ DCCnvStblznErrIndOn 0 "FALSE" 1 "TRUE" ;
VAL_TABLE_ NtVsnVidBrghtnsSts 0 "No Action" 1 "Min" 2 "Default-2" 3 "Default-1" 4 "Default" 5 "Default+1" 6 "Default+2" 7 "Max" ;
VAL_TABLE_ AnmlWrnIndReq 0 "Off" 1 "Animal Advisory" 2 "Animal Alert" ;
VAL_TABLE_ RrFgLmpIO 0 "FALSE" 1 "TRUE" ;
VAL_TABLE_ IdlRecmndToClEngIO 0 "FALSE" 1 "TRUE" ;
VAL_TABLE_ ACCSpdLimSgnUnt 0 "km/h" 1 "mph" ;
VAL_TABLE_ StBltShfIntlkCstAvlFlg7 0 "FALSE" 1 "TRUE" ;
VAL_TABLE_ StBltShfIntlkCstAvlFlg6 0 "FALSE" 1 "TRUE" ;
VAL_TABLE_ StBltShfIntlkCstAvlFlg5 0 "FALSE" 1 "TRUE" ;
VAL_TABLE_ StBltShfIntlkCstAvlFlg4 0 "FALSE" 1 "TRUE" ;
VAL_TABLE_ ElecMtrARotrTemp_Inv 0 "FALSE" 1 "TRUE" ;
VAL_TABLE_ ElecMtrASttrTemp_Inv 0 "FALSE" 1 "TRUE" ;
VAL_TABLE_ LvlgSysAlgnMdCstAvlFlg5 0 "FALSE" 1 "TRUE" ;
VAL_TABLE_ LvlgSysAlgnMdCstAvlFlg4 0 "FALSE" 1 "TRUE" ;
VAL_TABLE_ LvlgSysAlgnMdCstAvlFlg3 0 "FALSE" 1 "TRUE" ;
VAL_TABLE_ LvlgSysAlgnMdCstAvlFlg2 0 "FALSE" 1 "TRUE" ;
VAL_TABLE_ LvlgSysAlgnMdCstAvlFlg1 0 "FALSE" 1 "TRUE" ;
VAL_TABLE_ SecAxlTransStatAchvd_Inv 0 "FALSE" 1 "TRUE" ;
VAL_TABLE_ NtVsnVidCntrstSts 0 "No Action" 1 "Min" 2 "Default-2" 3 "Default-1" 4 "Default" 5 "Default+1" 6 "Default+2" 7 "Max" ;
VAL_TABLE_ NtVsnFncSts 0 "Normal" 1 "Limited" 2 "Unavailable" 3 "Invalid" ;
VAL_TABLE_ HzrdReqActv 0 "FALSE" 1 "TRUE" ;
VAL_TABLE_ AllWhlDrvRcmndIndOn 0 "FALSE" 1 "TRUE" ;
VAL_TABLE_ ElecShfLckdBcklPsngrStBltIndOn 0 "FALSE" 1 "TRUE" ;
VAL_TABLE_ ElecShfLckdBcklDrvrStBltIndOn 0 "FALSE" 1 "TRUE" ;
VAL_TABLE_ TrlrBrkgSysProfSts 0 "Default Profile" 1 "Profile 1" 2 "Profile 2" 3 "Profile 3" 4 "Profile 4" 5 "Profile 5" ;
VAL_TABLE_ TrlrBrkCnctdIndOn 0 "FALSE" 1 "TRUE" ;
VAL_TABLE_ SecAxlTransStatAchvd 0 "Unknown" 1 "Neutral" 2 "Mode 1" ;
VAL_TABLE_ RmtPRNDLDispFltIndOn 0 "FALSE" 1 "TRUE" ;
VAL_TABLE_ NoKeyFndTryAgnIndOn 0 "FALSE" 1 "TRUE" ;
VAL_TABLE_ NoKeyDtdElecShfDndIndOn 0 "FALSE" 1 "TRUE" ;
VAL_TABLE_ KeyMisgCkForKeyIndOn 0 "FALSE" 1 "TRUE" ;
VAL_TABLE_ PrtctdIdlUnvIndOn 0 "FALSE" 1 "TRUE" ;
VAL_TABLE_ PrtctdIdlIndOn 0 "FALSE" 1 "TRUE" ;
VAL_TABLE_ NoKeyDtdMechShfDndIndOn 0 "FALSE" 1 "TRUE" ;
VAL_TABLE_ ElecShfUnlckdBrkToShfIndOn 0 "FALSE" 1 "TRUE" ;
VAL_TABLE_ SpdLmtrSpdLimSgnUnt 0 "km/h" 1 "mph" ;
VAL_TABLE_ KMORAI_IndOn 0 "FALSE" 1 "TRUE" ;
VAL_TABLE_ EngRcmndDwnsftIndOn 0 "FALSE" 1 "TRUE" ;
VAL_TABLE_ ElecShfVehInPrkNeutGrMisusdIO 0 "FALSE" 1 "TRUE" ;
VAL_TABLE_ ElecShfShfgToPrkNeutGrMisusdIO 0 "FALSE" 1 "TRUE" ;
VAL_TABLE_ ElecShfSelNeutAgnForCarWshMdIO 0 "FALSE" 1 "TRUE" ;
VAL_TABLE_ ElecShfPrssNeutAgnForNeutIndOn 0 "FALSE" 1 "TRUE" ;
VAL_TABLE_ ElecShfCarWshModeOnDoNTowIndOn 0 "FALSE" 1 "TRUE" ;
VAL_TABLE_ SGI2P_AirSpnsnRdHghtActlStsAuth 0 "Faulted" 1 "Entry/Exit" 2 "Lowered 3(Stability)" 3 "Lowered 2 (Sport)" 4 "Lowered 1 (Aero)" 5 "Showroom" 6 "Normal" 7 "Raised 1" 8 "Raised 2" 9 "Raised 3" ;
VAL_TABLE_ InvsblTrlrAux2CamConctSts 0 "Unknown" 1 "Not Connected" 2 "Connected" ;
VAL_TABLE_ InvsblTrlrAux1CamConctSts 0 "Unknown" 1 "Not Connected" 2 "Connected" ;
VAL_TABLE_ ESCSpdLtdIndReq 0 "No Indication" 1 "Countdown" 2 "Limited" ;
VAL_TABLE_ RideHghtSeltn7Name 0 "No Action" 1 "Auto" 2 "Raised 2" 3 "Raised" 4 "Normal" 5 "Entry/Exit" 6 "Cargo Loading" 7 "Lowered" ;
VAL_TABLE_ RideHghtSeltn6Name 0 "No Action" 1 "Auto" 2 "Raised 2" 3 "Raised" 4 "Normal" 5 "Entry/Exit" 6 "Cargo Loading" 7 "Lowered" ;
VAL_TABLE_ RideHghtSeltn5Name 0 "No Action" 1 "Auto" 2 "Raised 2" 3 "Raised" 4 "Normal" 5 "Entry/Exit" 6 "Cargo Loading" 7 "Lowered" ;
VAL_TABLE_ LvlgSysServMdCstSetSelable 0 "FALSE" 1 "TRUE" ;
VAL_TABLE_ LvlgSysServMdCstSetAval 0 "FALSE" 1 "TRUE" ;
VAL_TABLE_ LvlgSysEntEgrsMdCstSetAval 0 "FALSE" 1 "TRUE" ;
VAL_TABLE_ LvlgSysAlgnMdCstSetSelable 0 "FALSE" 1 "TRUE" ;
VAL_TABLE_ RideHghtSeltn8Name 0 "No Action" 1 "Auto" 2 "Raised 2" 3 "Raised" 4 "Normal" 5 "Entry/Exit" 6 "Cargo Loading" 7 "Lowered" ;
VAL_TABLE_ RideHghtSeltn4Unv 0 "FALSE" 1 "TRUE" ;
VAL_TABLE_ RideHghtSeltn4Pndg 0 "FALSE" 1 "TRUE" ;
VAL_TABLE_ RideHghtSeltn3Unv 0 "FALSE" 1 "TRUE" ;
VAL_TABLE_ RideHghtSeltn3Pndg 0 "FALSE" 1 "TRUE" ;
VAL_TABLE_ RideHghtSeltn2Unv 0 "FALSE" 1 "TRUE" ;
VAL_TABLE_ RideHghtSeltn2Pndg 0 "FALSE" 1 "TRUE" ;
VAL_TABLE_ RideHghtSeltn1Unv 0 "FALSE" 1 "TRUE" ;
VAL_TABLE_ RideHghtSeltn1Pndg 0 "FALSE" 1 "TRUE" ;
VAL_TABLE_ RideHghtSeltn8Unv 0 "FALSE" 1 "TRUE" ;
VAL_TABLE_ RideHghtSeltn8Pndg 0 "FALSE" 1 "TRUE" ;
VAL_TABLE_ RideHghtSeltn7Unv 0 "FALSE" 1 "TRUE" ;
VAL_TABLE_ RideHghtSeltn7Pndg 0 "FALSE" 1 "TRUE" ;
VAL_TABLE_ RideHghtSeltn6Unv 0 "FALSE" 1 "TRUE" ;
VAL_TABLE_ RideHghtSeltn6Pndg 0 "FALSE" 1 "TRUE" ;
VAL_TABLE_ RideHghtSeltn5Unv 0 "FALSE" 1 "TRUE" ;
VAL_TABLE_ RideHghtSeltn5Pndg 0 "FALSE" 1 "TRUE" ;
VAL_TABLE_ IHVSLR_HtdCushBckLvl2 0 "FALSE" 1 "TRUE" ;
VAL_TABLE_ IHVSLR_HtdCushBckLvl1 0 "FALSE" 1 "TRUE" ;
VAL_TABLE_ IHVSLR_HtdCushBckAuto 0 "FALSE" 1 "TRUE" ;
VAL_TABLE_ IHVSLR_HtdBckMd 0 "FALSE" 1 "TRUE" ;
VAL_TABLE_ IHVSLR_HtdBckLvl3 0 "FALSE" 1 "TRUE" ;
VAL_TABLE_ IHVSLR_HtdBckLvl2 0 "FALSE" 1 "TRUE" ;
VAL_TABLE_ IHVSLR_HtdBckLvl1 0 "FALSE" 1 "TRUE" ;
VAL_TABLE_ IHVSLR_HtdBckAuto 0 "FALSE" 1 "TRUE" ;
VAL_TABLE_ DispSmrtTowVidOn 0 "FALSE" 1 "TRUE" ;
VAL_TABLE_ IHVSLR_VntMd 0 "FALSE" 1 "TRUE" ;
VAL_TABLE_ IHVSLR_VntLvl3 0 "FALSE" 1 "TRUE" ;
VAL_TABLE_ IHVSLR_VntLvl2 0 "FALSE" 1 "TRUE" ;
VAL_TABLE_ IHVSLR_VntLvl1 0 "FALSE" 1 "TRUE" ;
VAL_TABLE_ IHVSLR_VntAuto 0 "FALSE" 1 "TRUE" ;
VAL_TABLE_ IHVSLR_HtdCushBckMd 0 "FALSE" 1 "TRUE" ;
VAL_TABLE_ IHVSLR_HtdCushBckLvl3 0 "FALSE" 1 "TRUE" ;
VAL_TABLE_ LvlgSysEntEgrsMdCstAvlFlg6 0 "FALSE" 1 "TRUE" ;
VAL_TABLE_ LvlgSysEntEgrsMdCstAvlFlg5 0 "FALSE" 1 "TRUE" ;
VAL_TABLE_ LvlgSysEntEgrsMdCstAvlFlg4 0 "FALSE" 1 "TRUE" ;
VAL_TABLE_ LvlgSysEntEgrsMdCstAvlFlg3 0 "FALSE" 1 "TRUE" ;
VAL_TABLE_ LvlgSysEntEgrsMdCstAvlFlg2 0 "FALSE" 1 "TRUE" ;
VAL_TABLE_ LvlgSysEntEgrsMdCstAvlFlg1 0 "FALSE" 1 "TRUE" ;
VAL_TABLE_ LvlgSysAlgnMdCstAvlFlg7 0 "FALSE" 1 "TRUE" ;
VAL_TABLE_ LvlgSysAlgnMdCstAvlFlg6 0 "FALSE" 1 "TRUE" ;
VAL_TABLE_ LvlgSysServMdCstAvlFlg7 0 "FALSE" 1 "TRUE" ;
VAL_TABLE_ LvlgSysServMdCstAvlFlg6 0 "FALSE" 1 "TRUE" ;
VAL_TABLE_ LvlgSysServMdCstAvlFlg5 0 "FALSE" 1 "TRUE" ;
VAL_TABLE_ LvlgSysServMdCstAvlFlg4 0 "FALSE" 1 "TRUE" ;
VAL_TABLE_ LvlgSysServMdCstAvlFlg3 0 "FALSE" 1 "TRUE" ;
VAL_TABLE_ LvlgSysServMdCstAvlFlg2 0 "FALSE" 1 "TRUE" ;
VAL_TABLE_ LvlgSysServMdCstAvlFlg1 0 "FALSE" 1 "TRUE" ;
VAL_TABLE_ LvlgSysEntEgrsMdCstAvlFlg7 0 "FALSE" 1 "TRUE" ;
VAL_TABLE_ VehMassEstSts 0 "Undetermined" 1 "Degraded" 2 "Normal" ;
VAL_TABLE_ TmngBltChgIndOn 0 "FALSE" 1 "TRUE" ;
VAL_TABLE_ FuelConsmpHvyIndReq 0 "No Indication" 1 "Range" 2 "Low Fuel and Range" ;
VAL_TABLE_ IHVSRR_HtdCushBckLvl2 0 "FALSE" 1 "TRUE" ;
VAL_TABLE_ IHVSRR_HtdCushBckLvl1 0 "FALSE" 1 "TRUE" ;
VAL_TABLE_ IHVSRR_HtdCushBckAuto 0 "FALSE" 1 "TRUE" ;
VAL_TABLE_ IHVSRR_HtdBckMd 0 "FALSE" 1 "TRUE" ;
VAL_TABLE_ IHVSRR_HtdBckLvl3 0 "FALSE" 1 "TRUE" ;
VAL_TABLE_ IHVSRR_HtdBckLvl2 0 "FALSE" 1 "TRUE" ;
VAL_TABLE_ IHVSRR_HtdBckLvl1 0 "FALSE" 1 "TRUE" ;
VAL_TABLE_ IHVSRR_HtdBckAuto 0 "FALSE" 1 "TRUE" ;
VAL_TABLE_ IHVSRR_VntMd 0 "FALSE" 1 "TRUE" ;
VAL_TABLE_ IHVSRR_VntLvl3 0 "FALSE" 1 "TRUE" ;
VAL_TABLE_ IHVSRR_VntLvl2 0 "FALSE" 1 "TRUE" ;
VAL_TABLE_ IHVSRR_VntLvl1 0 "FALSE" 1 "TRUE" ;
VAL_TABLE_ IHVSRR_VntAuto 0 "FALSE" 1 "TRUE" ;
VAL_TABLE_ IHVSRR_HtdCushBckMd 0 "FALSE" 1 "TRUE" ;
VAL_TABLE_ IHVSRR_HtdCushBckLvl3 0 "FALSE" 1 "TRUE" ;
VAL_TABLE_ MemStorCmpltdIndReq 0 "No Indication" 1 "Memory Button 1" 2 "Memory Button 2" 3 "Memory Button 3" 4 "Memory Button Exit" ;
VAL_TABLE_ MemRclHldUntilCmpltIndReq 0 "No Indication" 1 "Memory Button 1" 2 "Memory Button 2" 3 "Memory Button 3" 4 "Memory Button Exit" ;
VAL_TABLE_ TrlrArtclnAngCalSts 0 "Unknown" 1 "Available" 2 "Degraded" 3 "Unavailable" ;
VAL_TABLE_ PrkAsstActIndCmnd 0 "FALSE" 1 "TRUE" ;
VAL_TABLE_ InrTlgtOpnIndOn 0 "FALSE" 1 "TRUE" ;
VAL_TABLE_ PPVehRadioMutReq 0 "Unknown" 1 "Mute Requested" 2 "Mute Not Requested" ;
VAL_TABLE_ RrStrgFlrIndOn 0 "FALSE" 1 "TRUE" ;
VAL_TABLE_ MemStorTmdOutIndOn 0 "FALSE" 1 "TRUE" ;
VAL_TABLE_ MemStorPrssSetFrstIndOn 0 "FALSE" 1 "TRUE" ;
VAL_TABLE_ MemSeeAutoRclSetsIndOn 0 "FALSE" 1 "TRUE" ;
VAL_TABLE_ OffRdMdDrvlnVisDispVal 0 "Setting_Unknown" 1 "Custom_Mode_1" 2 "Custom_Mode_2" 3 "Custom_Mode_3" 4 "Custom_Mode_4" 5 "Custom_Mode_5" 6 "Custom_Mode_6" 7 "Custom_Mode_7" ;
VAL_TABLE_ OffRdMdBrkPedVisDispVal 0 "Setting_Unknown" 1 "Custom_Mode_1" 2 "Custom_Mode_2" 3 "Custom_Mode_3" 4 "Custom_Mode_4" 5 "Custom_Mode_5" 6 "Custom_Mode_6" 7 "Custom_Mode_7" ;
VAL_TABLE_ OffRdMdActvAerodynsVisDispVal 0 "Setting_Unknown" 1 "Custom_Mode_1" 2 "Custom_Mode_2" 3 "Custom_Mode_3" 4 "Custom_Mode_4" 5 "Custom_Mode_5" 6 "Custom_Mode_6" 7 "Custom_Mode_7" ;
VAL_TABLE_ OffRdMdSpnsnVisDispVal 0 "Setting_Unknown" 1 "Custom_Mode_1" 2 "Custom_Mode_2" 3 "Custom_Mode_3" 4 "Custom_Mode_4" 5 "Custom_Mode_5" 6 "Custom_Mode_6" 7 "Custom_Mode_7" ;
VAL_TABLE_ OffRdMdPwrtrnVisDispVal 0 "Setting_Unknown" 1 "Custom_Mode_1" 2 "Custom_Mode_2" 3 "Custom_Mode_3" 4 "Custom_Mode_4" 5 "Custom_Mode_5" 6 "Custom_Mode_6" 7 "Custom_Mode_7" ;
VAL_TABLE_ OffRdMdESCVisDispVal 0 "Setting_Unknown" 1 "Custom_Mode_1" 2 "Custom_Mode_2" 3 "Custom_Mode_3" 4 "Custom_Mode_4" 5 "Custom_Mode_5" 6 "Custom_Mode_6" 7 "Custom_Mode_7" ;
VAL_TABLE_ OffRdMdRideHghtVisDispVal 0 "Setting_Unknown" 1 "Custom_Mode_1" 2 "Custom_Mode_2" 3 "Custom_Mode_3" 4 "Custom_Mode_4" 5 "Custom_Mode_5" 6 "Custom_Mode_6" 7 "Custom_Mode_7" ;
VAL_TABLE_ OffRdMdStrgVisDispVal 0 "Setting_Unknown" 1 "Custom_Mode_1" 2 "Custom_Mode_2" 3 "Custom_Mode_3" 4 "Custom_Mode_4" 5 "Custom_Mode_5" 6 "Custom_Mode_6" 7 "Custom_Mode_7" ;
VAL_TABLE_ PTOEngRunTmrCstAvlFlg11 0 "FALSE" 1 "TRUE" ;
VAL_TABLE_ PTOEngRunTmrCstAvlFlg10 0 "FALSE" 1 "TRUE" ;
VAL_TABLE_ BrkSysTwoFtdDrvDtdIndOn 0 "FALSE" 1 "TRUE" ;
VAL_TABLE_ RrCrsTrfcAutoBrkgOffIndOn 0 "FALSE" 1 "TRUE" ;
VAL_TABLE_ ACCTrlrGapSetIndOn 0 "FALSE" 1 "TRUE" ;
VAL_TABLE_ OffRdMdSndVisDispVal 0 "Setting_Unknown" 1 "Custom_Mode_1" 2 "Custom_Mode_2" 3 "Custom_Mode_3" 4 "Custom_Mode_4" 5 "Custom_Mode_5" 6 "Custom_Mode_6" 7 "Custom_Mode_7" ;
VAL_TABLE_ TowHaulMdPwrtrnVisDispVal 0 "Setting_Unknown" 1 "Custom_Mode_1" 2 "Custom_Mode_2" 3 "Custom_Mode_3" 4 "Custom_Mode_4" 5 "Custom_Mode_5" 6 "Custom_Mode_6" 7 "Custom_Mode_7" ;
VAL_TABLE_ TowHaulMdESCVisDispVal 0 "Setting_Unknown" 1 "Custom_Mode_1" 2 "Custom_Mode_2" 3 "Custom_Mode_3" 4 "Custom_Mode_4" 5 "Custom_Mode_5" 6 "Custom_Mode_6" 7 "Custom_Mode_7" ;
VAL_TABLE_ TowHaulMdBrkPedVisDispVal 0 "Setting_Unknown" 1 "Custom_Mode_1" 2 "Custom_Mode_2" 3 "Custom_Mode_3" 4 "Custom_Mode_4" 5 "Custom_Mode_5" 6 "Custom_Mode_6" 7 "Custom_Mode_7" ;
VAL_TABLE_ TowHaulMdActvAerodynsVisDispVal 0 "Setting_Unknown" 1 "Custom_Mode_1" 2 "Custom_Mode_2" 3 "Custom_Mode_3" 4 "Custom_Mode_4" 5 "Custom_Mode_5" 6 "Custom_Mode_6" 7 "Custom_Mode_7" ;
VAL_TABLE_ TowHaulMdStrgVisDispVal 0 "Setting_Unknown" 1 "Custom_Mode_1" 2 "Custom_Mode_2" 3 "Custom_Mode_3" 4 "Custom_Mode_4" 5 "Custom_Mode_5" 6 "Custom_Mode_6" 7 "Custom_Mode_7" ;
VAL_TABLE_ TowHaulMdSpnsnVisDispVal 0 "Setting_Unknown" 1 "Custom_Mode_1" 2 "Custom_Mode_2" 3 "Custom_Mode_3" 4 "Custom_Mode_4" 5 "Custom_Mode_5" 6 "Custom_Mode_6" 7 "Custom_Mode_7" ;
VAL_TABLE_ TowHaulMdSndVisDispVal 0 "Setting_Unknown" 1 "Custom_Mode_1" 2 "Custom_Mode_2" 3 "Custom_Mode_3" 4 "Custom_Mode_4" 5 "Custom_Mode_5" 6 "Custom_Mode_6" 7 "Custom_Mode_7" ;
VAL_TABLE_ TowHaulMdDrvlnVisDispVal 0 "Setting_Unknown" 1 "Custom_Mode_1" 2 "Custom_Mode_2" 3 "Custom_Mode_3" 4 "Custom_Mode_4" 5 "Custom_Mode_5" 6 "Custom_Mode_6" 7 "Custom_Mode_7" ;
VAL_TABLE_ RrAxlLckIO 0 "FALSE" 1 "TRUE" ;
VAL_TABLE_ FrntAxlLckIO 0 "FALSE" 1 "TRUE" ;
VAL_TABLE_ AxlLckUnavailIndReq 0 "No Action" 1 "Rear Axle Not Locked" 2 "Not in 4WD Low" 3 "Speed Too High" 4 "Not During Hill Decent" 5 "Generic Unavailable" ;
VAL_TABLE_ TowHaulMdRideHghtVisDispVal 0 "Setting_Unknown" 1 "Custom_Mode_1" 2 "Custom_Mode_2" 3 "Custom_Mode_3" 4 "Custom_Mode_4" 5 "Custom_Mode_5" 6 "Custom_Mode_6" 7 "Custom_Mode_7" ;
VAL_TABLE_ TirePrsLRInr_Inv 0 "FALSE" 1 "TRUE" ;
VAL_TABLE_ AutoTrnspHdActvnCstAvlFlg1 0 "FALSE" 1 "TRUE" ;
VAL_TABLE_ TirePrsStatLRInr 0 "Unknown" 1 "Nominal" 2 "Low - Service Now" 3 "Low" 4 "Low - Extended Mobility" 5 "High" ;
VAL_TABLE_ AutoTrnspHdActvnCstCurrSetVal 0 "Setting Unknown" 1 "Active" 2 "Inactive" ;
VAL_TABLE_ TirePrsRRInr_Inv 0 "FALSE" 1 "TRUE" ;
VAL_TABLE_ AutoTrnspHdActvnCstAvlFlg5 0 "FALSE" 1 "TRUE" ;
VAL_TABLE_ AutoTrnspHdActvnCstAvlFlg4 0 "FALSE" 1 "TRUE" ;
VAL_TABLE_ AutoTrnspHdActvnCstAvlFlg3 0 "FALSE" 1 "TRUE" ;
VAL_TABLE_ AutoTrnspHdActvnCstAvlFlg2 0 "FALSE" 1 "TRUE" ;
VAL_TABLE_ TirePrsStatRRInr 0 "Unknown" 1 "Nominal" 2 "Low - Service Now" 3 "Low" 4 "Low - Extended Mobility" 5 "High" ;
VAL_TABLE_ PTOEngRunTmrCstAvlFlg6 0 "FALSE" 1 "TRUE" ;
VAL_TABLE_ PTOEngRunTmrCstAvlFlg5 0 "FALSE" 1 "TRUE" ;
VAL_TABLE_ PTOEngRunTmrCstAvlFlg4 0 "FALSE" 1 "TRUE" ;
VAL_TABLE_ PTOEngRunTmrCstAvlFlg3 0 "FALSE" 1 "TRUE" ;
VAL_TABLE_ AxlLcksServIO 0 "FALSE" 1 "TRUE" ;
VAL_TABLE_ AutoTrnspHdActvnCstSetAval 0 "FALSE" 1 "TRUE" ;
VAL_TABLE_ AutoTrnspHdActvnCstAvlFlg7 0 "FALSE" 1 "TRUE" ;
VAL_TABLE_ AutoTrnspHdActvnCstAvlFlg6 0 "FALSE" 1 "TRUE" ;
VAL_TABLE_ PTOSet1SpdCstAvlFlg1 0 "FALSE" 1 "TRUE" ;
VAL_TABLE_ PTOModeCstAvlFlg2 0 "FALSE" 1 "TRUE" ;
VAL_TABLE_ PTOModeCstAvlFlg1 0 "FALSE" 1 "TRUE" ;
VAL_TABLE_ PTOEngSpdTypCstAvlFlg2 0 "FALSE" 1 "TRUE" ;
VAL_TABLE_ PTOEngSpdTypCstAvlFlg1 0 "FALSE" 1 "TRUE" ;
VAL_TABLE_ PTOEngRunTmrCstAvlFlg9 0 "FALSE" 1 "TRUE" ;
VAL_TABLE_ PTOEngRunTmrCstAvlFlg8 0 "FALSE" 1 "TRUE" ;
VAL_TABLE_ PTOEngRunTmrCstAvlFlg7 0 "FALSE" 1 "TRUE" ;
VAL_TABLE_ PTOSet1SpdCstAvlFlg3 0 "FALSE" 1 "TRUE" ;
VAL_TABLE_ PTOSet1SpdCstAvlFlg2 0 "FALSE" 1 "TRUE" ;
VAL_TABLE_ PTOSet1SpdCstAvlFlg15 0 "FALSE" 1 "TRUE" ;
VAL_TABLE_ PTOSet1SpdCstAvlFlg14 0 "FALSE" 1 "TRUE" ;
VAL_TABLE_ PTOSet1SpdCstAvlFlg13 0 "FALSE" 1 "TRUE" ;
VAL_TABLE_ PTOSet1SpdCstAvlFlg12 0 "FALSE" 1 "TRUE" ;
VAL_TABLE_ PTOSet1SpdCstAvlFlg11 0 "FALSE" 1 "TRUE" ;
VAL_TABLE_ PTOSet1SpdCstAvlFlg10 0 "FALSE" 1 "TRUE" ;
VAL_TABLE_ PTOSet2SpdCstAvlFlg10 0 "FALSE" 1 "TRUE" ;
VAL_TABLE_ PTOSet2SpdCstAvlFlg1 0 "FALSE" 1 "TRUE" ;
VAL_TABLE_ PTOSet1SpdCstAvlFlg9 0 "FALSE" 1 "TRUE" ;
VAL_TABLE_ PTOSet1SpdCstAvlFlg8 0 "FALSE" 1 "TRUE" ;
VAL_TABLE_ PTOSet1SpdCstAvlFlg7 0 "FALSE" 1 "TRUE" ;
VAL_TABLE_ PTOSet1SpdCstAvlFlg6 0 "FALSE" 1 "TRUE" ;
VAL_TABLE_ PTOSet1SpdCstAvlFlg5 0 "FALSE" 1 "TRUE" ;
VAL_TABLE_ PTOSet1SpdCstAvlFlg4 0 "FALSE" 1 "TRUE" ;
VAL_TABLE_ PTOPrssAndRelBrkPedIndOn 0 "FALSE" 1 "TRUE" ;
VAL_TABLE_ PTOModeCstSetAval 0 "FALSE" 1 "TRUE" ;
VAL_TABLE_ PTOMblModeTransInGrIndOn 0 "FALSE" 1 "TRUE" ;
VAL_TABLE_ PTOEngSpdTypCstSetAval 0 "FALSE" 1 "TRUE" ;
VAL_TABLE_ PTOEngRunTmrCstSetAval 0 "FALSE" 1 "TRUE" ;
VAL_TABLE_ PTOModeCstCurrSetVal 0 "Setting Unknown" 1 "Standard" 2 "Remote" ;
VAL_TABLE_ PTOSet2SpdCstCurrSetVal 0 "Setting Unknown" 1 "RPM 1900" 2 "RPM 2000" 3 "RPM 2100" 4 "RPM 2200" 5 "RPM 2300" 6 "RPM 2400" 7 "RPM 2500" 8 "RPM 2600" 9 "RPM 2700" 10 "RPM 2800" 11 "RPM 2900" 12 "RPM 3000" 13 "RPM 3100" 14 "RPM 3200" 15 "RPM 3300" ;
VAL_TABLE_ PTOSet1SpdCstCurrSetVal 0 "Setting Unknown" 1 "RPM 1100" 2 "RPM 1200" 3 "RPM 1300" 4 "RPM 1400" 5 "RPM 1500" 6 "RPM 1600" 7 "RPM 1700" 8 "RPM 1800" 9 "RPM 1900" 10 "RPM 2000" 11 "RPM 2100" 12 "RPM 2200" 13 "RPM 2300" 14 "RPM 2400" 15 "RPM 2500" ;
VAL_TABLE_ PTOStndbySpdCstCurrSetVal 0 "Setting Unknown" 1 "RPM 900" 2 "RPM 1000" 3 "RPM 1100" 4 "RPM 1200" 5 "RPM 1300" 6 "RPM 1400" 7 "RPM 1500" ;
VAL_TABLE_ PTOEngRunTmrCstAvlFlg1 0 "FALSE" 1 "TRUE" ;
VAL_TABLE_ PTOEngSpdTypCstCurrSetVal 0 "Setting Unknown" 1 "Preset" 2 "Variable" ;
VAL_TABLE_ PTOTpStpSpdCstCurrSetVal 0 "Setting Unknown" 1 "RPM 5" 2 "RPM 10" 3 "RPM 25" 4 "RPM 50" 5 "RPM 100" 6 "RPM 250" 7 "RPM 500" ;
VAL_TABLE_ TrlrProfDrvrReqdSeltn 0 "No Action" 1 "Default Profile" 2 "Profile1" 3 "Profile2" 4 "Profile3" 5 "Profile4" 6 "Profile5" 7 "Profile6" 8 "Profile7" 9 "Profile8" 10 "Profile9" 11 "Profile10" 12 "Profile11" 13 "Profile12" 14 "Profile13" 15 "Profile14" 16 "Profile15" 17 "Profile16" 18 "Profile17" 19 "Profile18" 20 "Profile19" 21 "Profile20" ;
VAL_TABLE_ TrlrProfDeltn 0 "No Profile Deleted" 1 "Profile1 Deleted" 2 "Profile2 Deleted" 3 "Profile3 Deleted" 4 "Profile4 Deleted" 5 "Profile5 Deleted" 6 "Profile6 Deleted" 7 "Profile7 Deleted" 8 "Profile8 Deleted" 9 "Profile9 Deleted" 10 "Profile10 Deleted" 11 "Profile11 Deleted" 12 "Profile12 Deleted" 13 "Profile13 Deleted" 14 "Profile14 Deleted" 15 "Profile15 Deleted" 16 "Profile16 Deleted" 17 "Profile17 Deleted" 18 "Profile18 Deleted" 19 "Profile19 Deleted" 20 "Profile20 Deleted" ;
VAL_TABLE_ NumofAxls 0 "Unknown" 1 "1" 2 "2" 3 "3" ;
VAL_TABLE_ ASTC_ChimSnkSpkrPos 0 "NO_ACTION" 1 "FULL_FRONT" 2 "FULL_REAR" 3 "FULL_LEFT" 4 "FULL_RIGHT" 5 "RIGHT_FRONT" 6 "RIGHT_REAR" 7 "LEFT_FRONT" 8 "LEFT_REAR" 9 "RESERVED_1" 10 "RESERVED_2" 11 "RESERVED_3" 12 "RESERVED_4" 13 "RESERVED_5" 14 "RESERVED_6" 15 "RESERVED_7" ;
VAL_TABLE_ ASTC_MtxSnkMut 0 "FALSE" 1 "TRUE" ;
VAL_TABLE_ ASTC_DSPMd 0 "NO_ACTION" 1 "DSP_MODE_0" 2 "DSP_MODE_1" 3 "DSP_MODE_2" 4 "DSP_MODE_3" 5 "DSP_MODE_4" 6 "DSP_MODE_5" 7 "DSP_MODE_6" 8 "DSP_MODE_7" 9 "RESERVED_1" 10 "RESERVED_2" 11 "RESERVED_3" 12 "RESERVED_4" 13 "RESERVED_5" 14 "RESERVED_6" 15 "RESERVED_7" ;
VAL_TABLE_ ASTC_AmpLwPwrSt 0 "FALSE" 1 "TRUE" ;
VAL_TABLE_ ASTC_VehNoisCmpnAct 0 "FALSE" 1 "TRUE" ;
VAL_TABLE_ FrtCntrStckHptcFdbkReq 0 "NO_ACTION" 1 "TAP" 2 "LONG_PRESS" 3 "PRESS_&_HOLD_SCROLL" 4 "PRESS_&_HOLD_END" 5 "RESERVED_05" 6 "RESERVED_06" 7 "RESERVED_07" 8 "RESERVED_08" 9 "RESERVED_09" 10 "RESERVED_10" 11 "RESERVED_11" 12 "RESERVED_12" 13 "RESERVED_13" 14 "RESERVED_14" 15 "RESERVED_15" ;
VAL_TABLE_ ASTC_GblAudSnkMut 0 "FALSE" 1 "TRUE" ;
VAL_TABLE_ ZALC_LRMtxSnkMut 0 "FALSE" 1 "TRUE" ;
VAL_TABLE_ ZALC_PsngrFrtMtxSnkMut 0 "FALSE" 1 "TRUE" ;
VAL_TABLE_ ZALC_MltZnMixPrmtAudRR 0 "FALSE" 1 "TRUE" ;
VAL_TABLE_ ZALC_RRMtxSnkMut 0 "FALSE" 1 "TRUE" ;
VAL_TABLE_ ZALC_MltZnAudFtrStat 0 "Unknown" 1 "Single Zone Audio" 2 "Dual Zone Audio" 3 "Quad Zone Audio" ;
VAL_TABLE_ ZALC_VcSrcActvOnRRMtx 0 "FALSE" 1 "TRUE" ;
VAL_TABLE_ ZALC_MltZnMixPrmtAudDrvrFrt 0 "FALSE" 1 "TRUE" ;
VAL_TABLE_ ZALC_VcSrcActvOnPsngrFrtMtx 0 "FALSE" 1 "TRUE" ;
VAL_TABLE_ FrtCntrStckOptDskDrvDckStat 0 "DS_EMPTY" 1 "DS_LOADING" 2 "DS_READY" 3 "DS_EJECT" 4 "DS_READ_FORMAT_ERROR" 5 "DS_STAT_5" 6 "DS_STAT_6" 7 "DS_STAT_7" ;
VAL_TABLE_ ZALC_MltZnMixPrmtAudLR 0 "FALSE" 1 "TRUE" ;
VAL_TABLE_ ZALC_MltZnMixPrmtAudPsngrFrt 0 "FALSE" 1 "TRUE" ;
VAL_TABLE_ ZALC_VcSrcActvOnLRMtx 0 "FALSE" 1 "TRUE" ;
VAL_TABLE_ TrlrTirePresSnsrIDLrnReqd 0 "FALSE" 1 "TRUE" ;
VAL_TABLE_ TrlrThftAlrtEnbld 0 "FALSE" 1 "TRUE" ;
VAL_TABLE_ TrlrLghtAlrtEnbld 0 "FALSE" 1 "TRUE" ;
VAL_TABLE_ DAPR_CtlDir 0 "None" 1 "Left" 2 "Right" 3 "Center" 4 "Custom1" 5 "Custom 2" 6 "Custom 3" 7 "Custom 4" ;
VAL_TABLE_ TrlrTirePresProfXferd 0 "FALSE" 1 "TRUE" ;
VAL_TABLE_ DAPR_CurrPrmt 0 "FALSE" 1 "TRUE" ;
VAL_TABLE_ DAPR_CtlZn 0 "None" 1 "Zone 1" 2 "Zone 2" 3 "Zone 3" 4 "Zone 4" 5 "Zone 5" 6 "Zone 6" 7 "Zone 7" 8 "Zone 8" 9 "Zone 9" 10 "Zone 10" 11 "Zone 11" 12 "Zone 12" 13 "Zone 13" 14 "Custom 1" 15 "Custom 2" ;
VAL_TABLE_ LVMAVC_RmtSpchRcgnID 0 "NO_ACTION" 1 "LVM_NAV" 2 "LVM_DMB" 3 "LVM_PDR" ;
VAL_TABLE_ LVMAVC_PrmtAudResp 0 "NO_ACTION" 1 "ACTIVE" ;
VAL_TABLE_ LVMAVC_RmtSpchRcgnActn 0 "NO_ACTION" 1 "ACTIVATE_LVM_SR" 2 "PTT_BUTTON_PRESS" 3 "END_BUTTON_PRESS" ;
VAL_TABLE_ LVMAVC_ApplID 0 "NO_ACTION" 1 "LVM_NAV" 2 "LVM_DMB" 3 "LVM_PERFORMANCE_COMPUTER" 4 "LVM_COMPLEX_MODE" ;
VAL_TABLE_ LVMAVC_StreoAudResp 0 "NO_ACTION" 1 "ACTIVE" ;
VAL_TABLE_ LVMAVC_RmtEnbl 0 "NO_ACTION" 1 "REMOTE_ENABLE_ON" 2 "REMOTE_ENABLE_ACTIVE" ;
VAL_TABLE_ LVMAVC_SpchRcgnAval 0 "NO_ACTION" 1 "LVM_SPEECH_REC_AVAILABLE" ;
VAL_TABLE_ TrlrStatTowHaulModeOvrrd 0 "No Override" 1 "Override to Not Tow Haul" 2 "Unused and Reserved 1" 3 "Unused and Reserved 2" ;
VAL_TABLE_ TrlrLtngSeqReq 0 "No Action" 1 "Off" 2 "On" ;
VAL_TABLE_ TrlrHtchTyp 0 "Unknown" 1 "Conventional" 2 "5th Wheel" 3 "Gooseneck" ;
VAL_TABLE_ FrtCntrStckVidInSel 0 "Primary Video Input" 1 "Reserved" 2 "LVM Video Input" ;
VAL_TABLE_ TrlrAppInvsblTrlrPrvwReqd 0 "FALSE" 1 "TRUE" ;
VAL_TABLE_ TrlrAppAux2CamPrvwReqd 0 "FALSE" 1 "TRUE" ;
VAL_TABLE_ TrlrAppAux1CamPrvwReqd 0 "FALSE" 1 "TRUE" ;
VAL_TABLE_ TrlRvsLghtFldEnbld 0 "FALSE" 1 "TRUE" ;
VAL_TABLE_ FrtCntrStckTchCtlrRstCmd 0 "FALSE" 1 "TRUE" ;
VAL_TABLE_ Frt360CamSwAct 0 "FALSE" 1 "TRUE" ;
VAL_TABLE_ TrlrTyp 0 "Unknown" 1 "Box" 2 "Not-Box" ;
VAL_TABLE_ TrgdVidRecSwAct 0 "FALSE" 1 "TRUE" ;
VAL_TABLE_ SrrndVsnRcrdrListFcs 0 "Unknown" 1 "File_1" 2 "File_2" 3 "File_3" 4 "File_4" 5 "File_5" 6 "Delete_1" 7 "Delete_2" 8 "Delete_3" 9 "Delete_4" 10 "Delete_5" 11 "No Focus" ;
VAL_TABLE_ VwgVwprtSeltn 0 "Unknown" 1 "Front Perspective" 2 "Front Junction" 3 "Front Overhead" 4 "Side Forward" 5 "Rear Perspective" 6 "Rear Junction" 7 "Rear Overhead" 8 "Side Rearward" 9 "Bowl" 10 "Zoomed Bowl" 11 "Japan" 12 "Rear Hitch" 13 "Bed Hitch" 14 "Trailer Aux1" 15 "Trailer Towing Mirror" 16 "L R Trailer Towing Mirror" 17 "Trailer Aux1 Combined" 18 "Trailer Aux2" 19 "Invisible Trailer" 20 "Cargo Bed" 21 "Curb Overhead" 22 "Curb" 23 "No Request" 24 "Transparent Hood" ;
VAL_TABLE_ PFASndSeltnCstChgSetReq 0 "No Action" 1 "Pedestrian Alert Sound 1" 2 "Pedestrian Alert Sound 2" 3 "Pedestrian Alert Sound 3" 4 "RESERVED_4" 5 "RESERVED_5" 6 "RESERVED_6" 7 "RESERVED_7" ;
VAL_TABLE_ SrrndVsnRcrdrVwprtSeltn 0 "Unknown" 1 "Playback Mosaic" 2 "Playback Zoom1" 3 "Playback Zoom2" 4 "Playback Zoom3" 5 "Playback Zoom4" 6 "List Recent" 7 "List Saved" 8 "No Request" ;
VAL_TABLE_ SrrndVsnRcrdrFileSeltn 0 "Unknown" 1 "File_1" 2 "File_2" 3 "File_3" 4 "File_4" 5 "File_5" 6 "No Selection" ;
VAL_TABLE_ SrrndVsnRcrdrFileDeltn 0 "Unknown" 1 "File_1" 2 "File_2" 3 "File_3" 4 "File_4" 5 "File_5" 6 "No Selection" ;
VAL_TABLE_ VGS_DynActv 0 "FALSE" 1 "TRUE" ;
VAL_TABLE_ VGS_CurbVwActv 0 "FALSE" 1 "TRUE" ;
VAL_TABLE_ SrrndVsnRcrdrPlybkSeltn 0 "Unknown" 1 "Play" 2 "Pause" 3 "Rewind" 4 "Fast Forward" 5 "No Selection" ;
VAL_TABLE_ SrrndVsnRcrdrPlybkFcs 0 "Unknown" 1 "View_1" 2 "View_2" 3 "View_3" 4 "View_4" 5 "Zoomed" 6 "No Focus" ;
VAL_TABLE_ SrrndVsnRcrdrSaveFile 0 "Unknown" 1 "Save" 2 "Not Pressed" ;
VAL_TABLE_ SrrndVsnRcrdrRcrdSeltn 0 "Unknown" 1 "Enabled" 2 "Disabled" ;
VAL_TABLE_ SrrndVsnRcrdrListPgSeltn 0 "Unknown" 1 "Page Up" 2 "Page Down" 3 "No Selection" ;
VAL_TABLE_ VGS_TrlrActv 0 "FALSE" 1 "TRUE" ;
VAL_TABLE_ HMIInCarVcCommCtl 0 "ICC_Off" 1 "Front_High_Rear_High" 2 "Front_High_Rear_Normal" 3 "Front_High_Rear_Off" 4 "Front_Normal_Rear_High" 5 "Front_Normal_Rear_Normal" 6 "Front_Normal_Rear_Off" ;
VAL_TABLE_ AutoLnChgCstChgSetReq 0 "No Action" 1 "Off" 2 "On" 3 "LCOD" 4 "LCOD and ALC" ;
VAL_TABLE_ DrvrSeltdTrlrPrsnt 0 "Trailer Present" 1 "No Trailer" ;
VAL_TABLE_ VcRcgnSesnActv 0 "FALSE" 1 "TRUE" ;
VAL_TABLE_ HndsFrVcCallActv 0 "FALSE" 1 "TRUE" ;
VAL_TABLE_ FrtZnAudVolSyncCtlOn 0 "FALSE" 1 "TRUE" ;
VAL_TABLE_ DirAudPrmtRndrngEnbld 0 "FALSE" 1 "TRUE" ;
VAL_TABLE_ PASftBtnSeltdStatRw 0 "Not_Pressed" 1 "Pressed" 2 "Unknown" 3 "Failed" ;
VAL_TABLE_ APASftBtnSeltdStatRw 0 "Not_Pressed" 1 "Pressed" 2 "Unknown" 3 "Failed" ;
VAL_TABLE_ WCM_LCMDataMsgStat 0 "No Action" 1 "Acknowledge" ;
VAL_TABLE_ WCM_LCMFileTrans 0 "No Action" 1 "Begin Transfer" 2 "Successful Block Transfer" 3 "Cancel Transfer" 4 "Retry Last Block" ;
VAL_TABLE_ PwrRrClsrCstChgSetReq 0 "No_Action" 1 "Off" 2 "On" 3 "On_Custom_Height" 4 "RESERVED_4" 5 "RESERVED_5" 6 "RESERVED_6" 7 "RESERVED_7" ;
VAL_TABLE_ OATDispdVal_DuD 0 "FALSE" 1 "TRUE" ;
VAL_TABLE_ PTOSet1SpdCstSetReq 0 "No Action" 1 "RPM 1100" 2 "RPM 1200" 3 "RPM 1300" 4 "RPM 1400" 5 "RPM 1500" 6 "RPM 1600" 7 "RPM 1700" 8 "RPM 1800" 9 "RPM 1900" 10 "RPM 2000" 11 "RPM 2100" 12 "RPM 2200" 13 "RPM 2300" 14 "RPM 2400" 15 "RPM 2500" ;
VAL_TABLE_ PTOEngRunTmrCstSetReq 0 "No Action" 1 "Min 10" 2 "Min 30" 3 "Min 90" 4 "Min 120" 5 "Min 150" 6 "Min 180" 7 "Min 210" 8 "Min 240" 9 "Min 270" 10 "Min 200" 11 "Min 330" 12 "Min 360" 13 "Min 390" 14 "Min 420" 15 "Min 450" ;
VAL_TABLE_ PTOStndbySpdCstSetReq 0 "No Action" 1 "RPM 900" 2 "RPM 1000" 3 "RPM 1100" 4 "RPM 1200" 5 "RPM 1300" 6 "RPM 1400" 7 "RPM 1500" ;
VAL_TABLE_ PTOSet2SpdCstSetReq 0 "No Action" 1 "RPM 1900" 2 "RPM 2000" 3 "RPM 2100" 4 "RPM 2200" 5 "RPM 2300" 6 "RPM 2400" 7 "RPM 2500" 8 "RPM 2600" 9 "RPM 2700" 10 "RPM 2800" 11 "RPM 2900" 12 "RPM 3000" 13 "RPM 3100" 14 "RPM 3200" 15 "RPM 3300" ;
VAL_TABLE_ PTOModeCstSetReq 0 "No Action" 1 "Standard" 2 "Remote" ;
VAL_TABLE_ PTOEngSpdTypCstSetReq 0 "No Action" 1 "Preset" 2 "Variable" ;
VAL_TABLE_ PTOTpStpSpdCstSetReq 0 "No Action" 1 "RPM 5" 2 "RPM 10" 3 "RPM 25" 4 "RPM 50" 5 "RPM 100" 6 "RPM 250" 7 "RPM 500" ;
VAL_TABLE_ AutoTrnspHdActvnCstChgSetReq 0 "No Action" 1 "Active" 2 "Inactive" ;
VAL_TABLE_ DTCI_AGC_CnfrmdDTC 0 "FALSE" 1 "TRUE" ;
VAL_TABLE_ DTCI_AGC_DTCFaultType 0 "Not Supported" 1 "Type A" 2 "Type B" 3 "Type C" ;
VAL_TABLE_ DTCI_AGC_TstNCmpltdOpCyc 0 "FALSE" 1 "TRUE" ;
VAL_TABLE_ DTCI_AGC_TstNCmpltdLstClr 0 "FALSE" 1 "TRUE" ;
VAL_TABLE_ DTCI_AGC_TstFldOpCyc 0 "FALSE" 1 "TRUE" ;
VAL_TABLE_ DTCI_AGC_TstFldLstClr 0 "FALSE" 1 "TRUE" ;
VAL_TABLE_ DTCI_AGC_TstFld 0 "FALSE" 1 "TRUE" ;
VAL_TABLE_ DTCI_AGC_PndngDTC 0 "FALSE" 1 "TRUE" ;
VAL_TABLE_ DTCI_AGC_DTCTriggered 0 "FALSE" 1 "TRUE" ;
VAL_TABLE_ DTCI_AGC_WrnIndTrggrd 0 "FALSE" 1 "TRUE" ;
VAL_TABLE_ DTCI_AGC_WrnIndRqd 0 "FALSE" 1 "TRUE" ;
VAL_TABLE_ DTCI_AHL_AFL_CnfrmdDTC 0 "FALSE" 1 "TRUE" ;
VAL_TABLE_ DTCI_AHL_AFL_DTCFaultType 0 "Not Supported" 1 "Type A" 2 "Type B" 3 "Type C" ;
VAL_TABLE_ DTCI_AHL_AFL_TstNCmpltdOpCyc 0 "FALSE" 1 "TRUE" ;
VAL_TABLE_ DTCI_AHL_AFL_TstNCmpltdLstClr 0 "FALSE" 1 "TRUE" ;
VAL_TABLE_ DTCI_AHL_AFL_TstFldOpCyc 0 "FALSE" 1 "TRUE" ;
VAL_TABLE_ DTCI_AHL_AFL_TstFldLstClr 0 "FALSE" 1 "TRUE" ;
VAL_TABLE_ DTCI_AHL_AFL_TstFld 0 "FALSE" 1 "TRUE" ;
VAL_TABLE_ DTCI_AHL_AFL_PndngDTC 0 "FALSE" 1 "TRUE" ;
VAL_TABLE_ DTCI_AHL_AFL_DTCTriggered 0 "FALSE" 1 "TRUE" ;
VAL_TABLE_ DTCI_AHL_AFL_WrnIndTrggrd 0 "FALSE" 1 "TRUE" ;
VAL_TABLE_ DTCI_AHL_AFL_WrnIndRqd 0 "FALSE" 1 "TRUE" ;
VAL_TABLE_ DTCI_AHS_CnfrmdDTC 0 "FALSE" 1 "TRUE" ;
VAL_TABLE_ DTCI_AHS_DTCFaultType 0 "Not Supported" 1 "Type A" 2 "Type B" 3 "Type C" ;
VAL_TABLE_ DTCI_AHS_TstNCmpltdOpCyc 0 "FALSE" 1 "TRUE" ;
VAL_TABLE_ DTCI_AHS_TstNCmpltdLstClr 0 "FALSE" 1 "TRUE" ;
VAL_TABLE_ DTCI_AHS_TstFldOpCyc 0 "FALSE" 1 "TRUE" ;
VAL_TABLE_ DTCI_AHS_TstFldLstClr 0 "FALSE" 1 "TRUE" ;
VAL_TABLE_ DTCI_AHS_TstFld 0 "FALSE" 1 "TRUE" ;
VAL_TABLE_ DTCI_AHS_PndngDTC 0 "FALSE" 1 "TRUE" ;
VAL_TABLE_ DTCI_AHS_DTCTriggered 0 "FALSE" 1 "TRUE" ;
VAL_TABLE_ DTCI_AHS_WrnIndTrggrd 0 "FALSE" 1 "TRUE" ;
VAL_TABLE_ DTCI_AHS_WrnIndRqd 0 "FALSE" 1 "TRUE" ;
VAL_TABLE_ DTCI_ALC_CnfrmdDTC 0 "FALSE" 1 "TRUE" ;
VAL_TABLE_ DTCI_ALC_DTCFaultType 0 "Not Supported" 1 "Type A" 2 "Type B" 3 "Type C" ;
VAL_TABLE_ DTCI_ALC_TstNCmpltdOpCyc 0 "FALSE" 1 "TRUE" ;
VAL_TABLE_ DTCI_ALC_TstNCmpltdLstClr 0 "FALSE" 1 "TRUE" ;
VAL_TABLE_ DTCI_ALC_TstFldOpCyc 0 "FALSE" 1 "TRUE" ;
VAL_TABLE_ DTCI_ALC_TstFldLstClr 0 "FALSE" 1 "TRUE" ;
VAL_TABLE_ DTCI_ALC_TstFld 0 "FALSE" 1 "TRUE" ;
VAL_TABLE_ DTCI_ALC_PndngDTC 0 "FALSE" 1 "TRUE" ;
VAL_TABLE_ DTCI_ALC_DTCTriggered 0 "FALSE" 1 "TRUE" ;
VAL_TABLE_ DTCI_ALC_WrnIndTrggrd 0 "FALSE" 1 "TRUE" ;
VAL_TABLE_ DTCI_ALC_WrnIndRqd 0 "FALSE" 1 "TRUE" ;
VAL_TABLE_ DTCI_AMP_CnfrmdDTC 0 "FALSE" 1 "TRUE" ;
VAL_TABLE_ DTCI_AMP_DTCFaultType 0 "Not Supported" 1 "Type A" 2 "Type B" 3 "Type C" ;
VAL_TABLE_ DTCI_AMP_TstNCmpltdOpCyc 0 "FALSE" 1 "TRUE" ;
VAL_TABLE_ DTCI_AMP_TstNCmpltdLstClr 0 "FALSE" 1 "TRUE" ;
VAL_TABLE_ DTCI_AMP_TstFldOpCyc 0 "FALSE" 1 "TRUE" ;
VAL_TABLE_ DTCI_AMP_TstFldLstClr 0 "FALSE" 1 "TRUE" ;
VAL_TABLE_ DTCI_AMP_TstFld 0 "FALSE" 1 "TRUE" ;
VAL_TABLE_ DTCI_AMP_PndngDTC 0 "FALSE" 1 "TRUE" ;
VAL_TABLE_ DTCI_AMP_DTCTriggered 0 "FALSE" 1 "TRUE" ;
VAL_TABLE_ DTCI_AMP_WrnIndTrggrd 0 "FALSE" 1 "TRUE" ;
VAL_TABLE_ DTCI_AMP_WrnIndRqd 0 "FALSE" 1 "TRUE" ;
VAL_TABLE_ DTCI_AOS_CnfrmdDTC 0 "FALSE" 1 "TRUE" ;
VAL_TABLE_ DTCI_AOS_DTCFaultType 0 "Not Supported" 1 "Type A" 2 "Type B" 3 "Type C" ;
VAL_TABLE_ DTCI_AOS_TstNCmpltdOpCyc 0 "FALSE" 1 "TRUE" ;
VAL_TABLE_ DTCI_AOS_TstNCmpltdLstClr 0 "FALSE" 1 "TRUE" ;
VAL_TABLE_ DTCI_AOS_TstFldOpCyc 0 "FALSE" 1 "TRUE" ;
VAL_TABLE_ DTCI_AOS_TstFldLstClr 0 "FALSE" 1 "TRUE" ;
VAL_TABLE_ DTCI_AOS_TstFld 0 "FALSE" 1 "TRUE" ;
VAL_TABLE_ DTCI_AOS_PndngDTC 0 "FALSE" 1 "TRUE" ;
VAL_TABLE_ DTCI_AOS_DTCTriggered 0 "FALSE" 1 "TRUE" ;
VAL_TABLE_ DTCI_AOS_WrnIndTrggrd 0 "FALSE" 1 "TRUE" ;
VAL_TABLE_ DTCI_AOS_WrnIndRqd 0 "FALSE" 1 "TRUE" ;
VAL_TABLE_ DTCI_APA_CnfrmdDTC 0 "FALSE" 1 "TRUE" ;
VAL_TABLE_ DTCI_APA_DTCFaultType 0 "Not Supported" 1 "Type A" 2 "Type B" 3 "Type C" ;
VAL_TABLE_ DTCI_APA_TstNCmpltdOpCyc 0 "FALSE" 1 "TRUE" ;
VAL_TABLE_ DTCI_APA_TstNCmpltdLstClr 0 "FALSE" 1 "TRUE" ;
VAL_TABLE_ DTCI_APA_TstFldOpCyc 0 "FALSE" 1 "TRUE" ;
VAL_TABLE_ DTCI_APA_TstFldLstClr 0 "FALSE" 1 "TRUE" ;
VAL_TABLE_ DTCI_APA_TstFld 0 "FALSE" 1 "TRUE" ;
VAL_TABLE_ DTCI_APA_PndngDTC 0 "FALSE" 1 "TRUE" ;
VAL_TABLE_ DTCI_APA_DTCTriggered 0 "FALSE" 1 "TRUE" ;
VAL_TABLE_ DTCI_APA_WrnIndTrggrd 0 "FALSE" 1 "TRUE" ;
VAL_TABLE_ DTCI_APA_WrnIndRqd 0 "FALSE" 1 "TRUE" ;
VAL_TABLE_ DTCI_ARB_CnfrmdDTC 0 "FALSE" 1 "TRUE" ;
VAL_TABLE_ DTCI_ARB_DTCFaultType 0 "Not Supported" 1 "Type A" 2 "Type B" 3 "Type C" ;
VAL_TABLE_ DTCI_ARB_TstNCmpltdOpCyc 0 "FALSE" 1 "TRUE" ;
VAL_TABLE_ DTCI_ARB_TstNCmpltdLstClr 0 "FALSE" 1 "TRUE" ;
VAL_TABLE_ DTCI_ARB_TstFldOpCyc 0 "FALSE" 1 "TRUE" ;
VAL_TABLE_ DTCI_ARB_TstFldLstClr 0 "FALSE" 1 "TRUE" ;
VAL_TABLE_ DTCI_ARB_TstFld 0 "FALSE" 1 "TRUE" ;
VAL_TABLE_ DTCI_ARB_PndngDTC 0 "FALSE" 1 "TRUE" ;
VAL_TABLE_ DTCI_ARB_DTCTriggered 0 "FALSE" 1 "TRUE" ;
VAL_TABLE_ DTCI_ARB_WrnIndTrggrd 0 "FALSE" 1 "TRUE" ;
VAL_TABLE_ DTCI_ARB_WrnIndRqd 0 "FALSE" 1 "TRUE" ;
VAL_TABLE_ DTCI_ARS_CnfrmdDTC 0 "FALSE" 1 "TRUE" ;
VAL_TABLE_ DTCI_ARS_DTCFaultType 0 "Not Supported" 1 "Type A" 2 "Type B" 3 "Type C" ;
VAL_TABLE_ DTCI_ARS_TstNCmpltdOpCyc 0 "FALSE" 1 "TRUE" ;
VAL_TABLE_ DTCI_ARS_TstNCmpltdLstClr 0 "FALSE" 1 "TRUE" ;
VAL_TABLE_ DTCI_ARS_TstFldOpCyc 0 "FALSE" 1 "TRUE" ;
VAL_TABLE_ DTCI_ARS_TstFldLstClr 0 "FALSE" 1 "TRUE" ;
VAL_TABLE_ DTCI_ARS_TstFld 0 "FALSE" 1 "TRUE" ;
VAL_TABLE_ DTCI_ARS_PndngDTC 0 "FALSE" 1 "TRUE" ;
VAL_TABLE_ DTCI_ARS_DTCTriggered 0 "FALSE" 1 "TRUE" ;
VAL_TABLE_ DTCI_ARS_WrnIndTrggrd 0 "FALSE" 1 "TRUE" ;
VAL_TABLE_ DTCI_ARS_WrnIndRqd 0 "FALSE" 1 "TRUE" ;
VAL_TABLE_ DTCI_BCM_CnfrmdDTC 0 "FALSE" 1 "TRUE" ;
VAL_TABLE_ DTCI_BCM_DTCFaultType 0 "Not Supported" 1 "Type A" 2 "Type B" 3 "Type C" ;
VAL_TABLE_ DTCI_BCM_TstNCmpltdOpCyc 0 "FALSE" 1 "TRUE" ;
VAL_TABLE_ DTCI_BCM_TstNCmpltdLstClr 0 "FALSE" 1 "TRUE" ;
VAL_TABLE_ DTCI_BCM_TstFldOpCyc 0 "FALSE" 1 "TRUE" ;
VAL_TABLE_ DTCI_BCM_TstFldLstClr 0 "FALSE" 1 "TRUE" ;
VAL_TABLE_ DTCI_BCM_TstFld 0 "FALSE" 1 "TRUE" ;
VAL_TABLE_ DTCI_BCM_PndngDTC 0 "FALSE" 1 "TRUE" ;
VAL_TABLE_ DTCI_BCM_DTCTriggered 0 "FALSE" 1 "TRUE" ;
VAL_TABLE_ DTCI_BCM_WrnIndTrggrd 0 "FALSE" 1 "TRUE" ;
VAL_TABLE_ DTCI_BCM_WrnIndRqd 0 "FALSE" 1 "TRUE" ;
VAL_TABLE_ DTCI_BSM_MH_CnfrmdDTC 0 "FALSE" 1 "TRUE" ;
VAL_TABLE_ DTCI_BSM_MH_DTCFaultType 0 "Not Supported" 1 "Type A" 2 "Type B" 3 "Type C" ;
VAL_TABLE_ DTCI_BSM_MH_TstNCmpltdOpCyc 0 "FALSE" 1 "TRUE" ;
VAL_TABLE_ DTCI_BSM_MH_TstNCmpltdLstClr 0 "FALSE" 1 "TRUE" ;
VAL_TABLE_ DTCI_BSM_MH_TstFldOpCyc 0 "FALSE" 1 "TRUE" ;
VAL_TABLE_ DTCI_BSM_MH_TstFldLstClr 0 "FALSE" 1 "TRUE" ;
VAL_TABLE_ DTCI_BSM_MH_TstFld 0 "FALSE" 1 "TRUE" ;
VAL_TABLE_ DTCI_BSM_MH_PndngDTC 0 "FALSE" 1 "TRUE" ;
VAL_TABLE_ DTCI_BSM_MH_DTCTriggered 0 "FALSE" 1 "TRUE" ;
VAL_TABLE_ DTCI_BSM_MH_WrnIndTrggrd 0 "FALSE" 1 "TRUE" ;
VAL_TABLE_ DTCI_BSM_MH_WrnIndRqd 0 "FALSE" 1 "TRUE" ;
VAL_TABLE_ DTCI_BSM_CnfrmdDTC 0 "FALSE" 1 "TRUE" ;
VAL_TABLE_ DTCI_BSM_DTCFaultType 0 "Not Supported" 1 "Type A" 2 "Type B" 3 "Type C" ;
VAL_TABLE_ DTCI_BSM_TstNCmpltdOpCyc 0 "FALSE" 1 "TRUE" ;
VAL_TABLE_ DTCI_BSM_TstNCmpltdLstClr 0 "FALSE" 1 "TRUE" ;
VAL_TABLE_ DTCI_BSM_TstFldOpCyc 0 "FALSE" 1 "TRUE" ;
VAL_TABLE_ DTCI_BSM_TstFldLstClr 0 "FALSE" 1 "TRUE" ;
VAL_TABLE_ DTCI_BSM_TstFld 0 "FALSE" 1 "TRUE" ;
VAL_TABLE_ DTCI_BSM_PndngDTC 0 "FALSE" 1 "TRUE" ;
VAL_TABLE_ DTCI_BSM_DTCTriggered 0 "FALSE" 1 "TRUE" ;
VAL_TABLE_ DTCI_BSM_WrnIndTrggrd 0 "FALSE" 1 "TRUE" ;
VAL_TABLE_ DTCI_BSM_WrnIndRqd 0 "FALSE" 1 "TRUE" ;
VAL_TABLE_ DTCI_CGM_CnfrmdDTC 0 "FALSE" 1 "TRUE" ;
VAL_TABLE_ DTCI_CGM_DTCFaultType 0 "Not Supported" 1 "Type A" 2 "Type B" 3 "Type C" ;
VAL_TABLE_ DTCI_CGM_TstNCmpltdOpCyc 0 "FALSE" 1 "TRUE" ;
VAL_TABLE_ DTCI_CGM_TstNCmpltdLstClr 0 "FALSE" 1 "TRUE" ;
VAL_TABLE_ DTCI_CGM_TstFldOpCyc 0 "FALSE" 1 "TRUE" ;
VAL_TABLE_ DTCI_CGM_TstFldLstClr 0 "FALSE" 1 "TRUE" ;
VAL_TABLE_ DTCI_CGM_TstFld 0 "FALSE" 1 "TRUE" ;
VAL_TABLE_ DTCI_CGM_PndngDTC 0 "FALSE" 1 "TRUE" ;
VAL_TABLE_ DTCI_CGM_DTCTriggered 0 "FALSE" 1 "TRUE" ;
VAL_TABLE_ DTCI_CGM_WrnIndTrggrd 0 "FALSE" 1 "TRUE" ;
VAL_TABLE_ DTCI_CGM_WrnIndRqd 0 "FALSE" 1 "TRUE" ;
VAL_TABLE_ DTCI_CMMa_CnfrmdDTC 0 "FALSE" 1 "TRUE" ;
VAL_TABLE_ DTCI_CMMa_DTCFaultType 0 "Not Supported" 1 "Type A" 2 "Type B" 3 "Type C" ;
VAL_TABLE_ DTCI_CMMa_TstNCmpltdOpCyc 0 "FALSE" 1 "TRUE" ;
VAL_TABLE_ DTCI_CMMa_TstNCmpltdLstClr 0 "FALSE" 1 "TRUE" ;
VAL_TABLE_ DTCI_CMMa_TstFldOpCyc 0 "FALSE" 1 "TRUE" ;
VAL_TABLE_ DTCI_CMMa_TstFldLstClr 0 "FALSE" 1 "TRUE" ;
VAL_TABLE_ DTCI_CMMa_TstFld 0 "FALSE" 1 "TRUE" ;
VAL_TABLE_ DTCI_CMMa_PndngDTC 0 "FALSE" 1 "TRUE" ;
VAL_TABLE_ DTCI_CMMa_DTCTriggered 0 "FALSE" 1 "TRUE" ;
VAL_TABLE_ DTCI_CMMa_WrnIndTrggrd 0 "FALSE" 1 "TRUE" ;
VAL_TABLE_ DTCI_CMMa_WrnIndRqd 0 "FALSE" 1 "TRUE" ;
VAL_TABLE_ DTCI_CMMb_CnfrmdDTC 0 "FALSE" 1 "TRUE" ;
VAL_TABLE_ DTCI_CMMb_DTCFaultType 0 "Not Supported" 1 "Type A" 2 "Type B" 3 "Type C" ;
VAL_TABLE_ DTCI_CMMb_TstNCmpltdOpCyc 0 "FALSE" 1 "TRUE" ;
VAL_TABLE_ DTCI_CMMb_TstNCmpltdLstClr 0 "FALSE" 1 "TRUE" ;
VAL_TABLE_ DTCI_CMMb_TstFldOpCyc 0 "FALSE" 1 "TRUE" ;
VAL_TABLE_ DTCI_CMMb_TstFldLstClr 0 "FALSE" 1 "TRUE" ;
VAL_TABLE_ DTCI_CMMb_TstFld 0 "FALSE" 1 "TRUE" ;
VAL_TABLE_ DTCI_CMMb_PndngDTC 0 "FALSE" 1 "TRUE" ;
VAL_TABLE_ DTCI_CMMb_DTCTriggered 0 "FALSE" 1 "TRUE" ;
VAL_TABLE_ DTCI_CMMb_WrnIndTrggrd 0 "FALSE" 1 "TRUE" ;
VAL_TABLE_ DTCI_CMMb_WrnIndRqd 0 "FALSE" 1 "TRUE" ;
VAL_TABLE_ DTCI_CSM_CnfrmdDTC 0 "FALSE" 1 "TRUE" ;
VAL_TABLE_ DTCI_CSM_DTCFaultType 0 "Not Supported" 1 "Type A" 2 "Type B" 3 "Type C" ;
VAL_TABLE_ DTCI_CSM_TstNCmpltdOpCyc 0 "FALSE" 1 "TRUE" ;
VAL_TABLE_ DTCI_CSM_TstNCmpltdLstClr 0 "FALSE" 1 "TRUE" ;
VAL_TABLE_ DTCI_CSM_TstFldOpCyc 0 "FALSE" 1 "TRUE" ;
VAL_TABLE_ DTCI_CSM_TstFldLstClr 0 "FALSE" 1 "TRUE" ;
VAL_TABLE_ DTCI_CSM_TstFld 0 "FALSE" 1 "TRUE" ;
VAL_TABLE_ DTCI_CSM_PndngDTC 0 "FALSE" 1 "TRUE" ;
VAL_TABLE_ DTCI_CSM_DTCTriggered 0 "FALSE" 1 "TRUE" ;
VAL_TABLE_ DTCI_CSM_WrnIndTrggrd 0 "FALSE" 1 "TRUE" ;
VAL_TABLE_ DTCI_CSM_WrnIndRqd 0 "FALSE" 1 "TRUE" ;
VAL_TABLE_ DTCI_DCM_CnfrmdDTC 0 "FALSE" 1 "TRUE" ;
VAL_TABLE_ DTCI_DCM_DTCFaultType 0 "Not Supported" 1 "Type A" 2 "Type B" 3 "Type C" ;
VAL_TABLE_ DTCI_DCM_TstNCmpltdOpCyc 0 "FALSE" 1 "TRUE" ;
VAL_TABLE_ DTCI_DCM_TstNCmpltdLstClr 0 "FALSE" 1 "TRUE" ;
VAL_TABLE_ DTCI_DCM_TstFldOpCyc 0 "FALSE" 1 "TRUE" ;
VAL_TABLE_ DTCI_DCM_TstFldLstClr 0 "FALSE" 1 "TRUE" ;
VAL_TABLE_ DTCI_DCM_TstFld 0 "FALSE" 1 "TRUE" ;
VAL_TABLE_ DTCI_DCM_PndngDTC 0 "FALSE" 1 "TRUE" ;
VAL_TABLE_ DTCI_DCM_DTCTriggered 0 "FALSE" 1 "TRUE" ;
VAL_TABLE_ DTCI_DCM_WrnIndTrggrd 0 "FALSE" 1 "TRUE" ;
VAL_TABLE_ DTCI_DCM_WrnIndRqd 0 "FALSE" 1 "TRUE" ;
VAL_TABLE_ DTCI_DMS_CnfrmdDTC 0 "FALSE" 1 "TRUE" ;
VAL_TABLE_ DTCI_DMS_DTCFaultType 0 "Not Supported" 1 "Type A" 2 "Type B" 3 "Type C" ;
VAL_TABLE_ DTCI_DMS_TstNCmpltdOpCyc 0 "FALSE" 1 "TRUE" ;
VAL_TABLE_ DTCI_DMS_TstNCmpltdLstClr 0 "FALSE" 1 "TRUE" ;
VAL_TABLE_ DTCI_DMS_TstFldOpCyc 0 "FALSE" 1 "TRUE" ;
VAL_TABLE_ DTCI_DMS_TstFldLstClr 0 "FALSE" 1 "TRUE" ;
VAL_TABLE_ DTCI_DMS_TstFld 0 "FALSE" 1 "TRUE" ;
VAL_TABLE_ DTCI_DMS_PndngDTC 0 "FALSE" 1 "TRUE" ;
VAL_TABLE_ DTCI_DMS_DTCTriggered 0 "FALSE" 1 "TRUE" ;
VAL_TABLE_ DTCI_DMS_WrnIndTrggrd 0 "FALSE" 1 "TRUE" ;
VAL_TABLE_ DTCI_DMS_WrnIndRqd 0 "FALSE" 1 "TRUE" ;
VAL_TABLE_ DTCI_EBCM_CnfrmdDTC 0 "FALSE" 1 "TRUE" ;
VAL_TABLE_ DTCI_EBCM_DTCFaultType 0 "Not Supported" 1 "Type A" 2 "Type B" 3 "Type C" ;
VAL_TABLE_ DTCI_EBCM_TstNCmpltdOpCyc 0 "FALSE" 1 "TRUE" ;
VAL_TABLE_ DTCI_EBCM_TstNCmpltdLstClr 0 "FALSE" 1 "TRUE" ;
VAL_TABLE_ DTCI_EBCM_TstFldOpCyc 0 "FALSE" 1 "TRUE" ;
VAL_TABLE_ DTCI_EBCM_TstFldLstClr 0 "FALSE" 1 "TRUE" ;
VAL_TABLE_ DTCI_EBCM_TstFld 0 "FALSE" 1 "TRUE" ;
VAL_TABLE_ DTCI_EBCM_PndngDTC 0 "FALSE" 1 "TRUE" ;
VAL_TABLE_ DTCI_EBCM_DTCTriggered 0 "FALSE" 1 "TRUE" ;
VAL_TABLE_ DTCI_EBCM_WrnIndTrggrd 0 "FALSE" 1 "TRUE" ;
VAL_TABLE_ DTCI_EBCM_WrnIndRqd 0 "FALSE" 1 "TRUE" ;
VAL_TABLE_ DTCI_ECM_CnfrmdDTC 0 "FALSE" 1 "TRUE" ;
VAL_TABLE_ DTCI_ECM_DTCFaultType 0 "Not Supported" 1 "Type A" 2 "Type B" 3 "Type C" ;
VAL_TABLE_ DTCI_ECM_TstNCmpltdOpCyc 0 "FALSE" 1 "TRUE" ;
VAL_TABLE_ DTCI_ECM_TstNCmpltdLstClr 0 "FALSE" 1 "TRUE" ;
VAL_TABLE_ DTCI_ECM_TstFldOpCyc 0 "FALSE" 1 "TRUE" ;
VAL_TABLE_ DTCI_ECM_TstFldLstClr 0 "FALSE" 1 "TRUE" ;
VAL_TABLE_ DTCI_ECM_TstFld 0 "FALSE" 1 "TRUE" ;
VAL_TABLE_ DTCI_ECM_PndngDTC 0 "FALSE" 1 "TRUE" ;
VAL_TABLE_ DTCI_ECM_DTCTriggered 0 "FALSE" 1 "TRUE" ;
VAL_TABLE_ DTCI_ECM_WrnIndTrggrd 0 "FALSE" 1 "TRUE" ;
VAL_TABLE_ DTCI_ECM_WrnIndRqd 0 "FALSE" 1 "TRUE" ;
VAL_TABLE_ DTCI_ECP_E_CnfrmdDTC 0 "FALSE" 1 "TRUE" ;
VAL_TABLE_ DTCI_ECP_E_DTCFaultType 0 "Not Supported" 1 "Type A" 2 "Type B" 3 "Type C" ;
VAL_TABLE_ DTCI_ECP_E_TstNCmpltdOpCyc 0 "FALSE" 1 "TRUE" ;
VAL_TABLE_ DTCI_ECP_E_TstNCmpltdLstClr 0 "FALSE" 1 "TRUE" ;
VAL_TABLE_ DTCI_ECP_E_TstFldOpCyc 0 "FALSE" 1 "TRUE" ;
VAL_TABLE_ DTCI_ECP_E_TstFldLstClr 0 "FALSE" 1 "TRUE" ;
VAL_TABLE_ DTCI_ECP_E_TstFld 0 "FALSE" 1 "TRUE" ;
VAL_TABLE_ DTCI_ECP_E_PndngDTC 0 "FALSE" 1 "TRUE" ;
VAL_TABLE_ DTCI_ECP_E_DTCTriggered 0 "FALSE" 1 "TRUE" ;
VAL_TABLE_ DTCI_ECP_E_WrnIndTrggrd 0 "FALSE" 1 "TRUE" ;
VAL_TABLE_ DTCI_ECP_E_WrnIndRqd 0 "FALSE" 1 "TRUE" ;
VAL_TABLE_ DTCI_ECP_MC_CnfrmdDTC 0 "FALSE" 1 "TRUE" ;
VAL_TABLE_ DTCI_ECP_MC_DTCFaultType 0 "Not Supported" 1 "Type A" 2 "Type B" 3 "Type C" ;
VAL_TABLE_ DTCI_ECP_MC_TstNCmpltdOpCyc 0 "FALSE" 1 "TRUE" ;
VAL_TABLE_ DTCI_ECP_MC_TstNCmpltdLstClr 0 "FALSE" 1 "TRUE" ;
VAL_TABLE_ DTCI_ECP_MC_TstFldOpCyc 0 "FALSE" 1 "TRUE" ;
VAL_TABLE_ DTCI_ECP_MC_TstFldLstClr 0 "FALSE" 1 "TRUE" ;
VAL_TABLE_ DTCI_ECP_MC_TstFld 0 "FALSE" 1 "TRUE" ;
VAL_TABLE_ DTCI_ECP_MC_PndngDTC 0 "FALSE" 1 "TRUE" ;
VAL_TABLE_ DTCI_ECP_MC_DTCTriggered 0 "FALSE" 1 "TRUE" ;
VAL_TABLE_ DTCI_ECP_MC_WrnIndTrggrd 0 "FALSE" 1 "TRUE" ;
VAL_TABLE_ DTCI_ECP_MC_WrnIndRqd 0 "FALSE" 1 "TRUE" ;
VAL_TABLE_ DTCI_ECP_X1_CnfrmdDTC 0 "FALSE" 1 "TRUE" ;
VAL_TABLE_ DTCI_ECP_X1_DTCFaultType 0 "Not Supported" 1 "Type A" 2 "Type B" 3 "Type C" ;
VAL_TABLE_ DTCI_ECP_X1_TstNCmpltdOpCyc 0 "FALSE" 1 "TRUE" ;
VAL_TABLE_ DTCI_ECP_X1_TstNCmpltdLstClr 0 "FALSE" 1 "TRUE" ;
VAL_TABLE_ DTCI_ECP_X1_TstFldOpCyc 0 "FALSE" 1 "TRUE" ;
VAL_TABLE_ DTCI_ECP_X1_TstFldLstClr 0 "FALSE" 1 "TRUE" ;
VAL_TABLE_ DTCI_ECP_X1_TstFld 0 "FALSE" 1 "TRUE" ;
VAL_TABLE_ DTCI_ECP_X1_PndngDTC 0 "FALSE" 1 "TRUE" ;
VAL_TABLE_ DTCI_ECP_X1_DTCTriggered 0 "FALSE" 1 "TRUE" ;
VAL_TABLE_ DTCI_ECP_X1_WrnIndTrggrd 0 "FALSE" 1 "TRUE" ;
VAL_TABLE_ DTCI_ECP_X1_WrnIndRqd 0 "FALSE" 1 "TRUE" ;
VAL_TABLE_ DTCI_ELM_CnfrmdDTC 0 "FALSE" 1 "TRUE" ;
VAL_TABLE_ DTCI_ELM_DTCFaultType 0 "Not Supported" 1 "Type A" 2 "Type B" 3 "Type C" ;
VAL_TABLE_ DTCI_ELM_TstNCmpltdOpCyc 0 "FALSE" 1 "TRUE" ;
VAL_TABLE_ DTCI_ELM_TstNCmpltdLstClr 0 "FALSE" 1 "TRUE" ;
VAL_TABLE_ DTCI_ELM_TstFldOpCyc 0 "FALSE" 1 "TRUE" ;
VAL_TABLE_ DTCI_ELM_TstFldLstClr 0 "FALSE" 1 "TRUE" ;
VAL_TABLE_ DTCI_ELM_TstFld 0 "FALSE" 1 "TRUE" ;
VAL_TABLE_ DTCI_ELM_PndngDTC 0 "FALSE" 1 "TRUE" ;
VAL_TABLE_ DTCI_ELM_DTCTriggered 0 "FALSE" 1 "TRUE" ;
VAL_TABLE_ DTCI_ELM_WrnIndTrggrd 0 "FALSE" 1 "TRUE" ;
VAL_TABLE_ DTCI_ELM_WrnIndRqd 0 "FALSE" 1 "TRUE" ;
VAL_TABLE_ DTCI_EOCM_HCP1_CnfrmdDTC 0 "FALSE" 1 "TRUE" ;
VAL_TABLE_ DTCI_EOCM_HCP1_DTCFaultType 0 "Not Supported" 1 "Type A" 2 "Type B" 3 "Type C" ;
VAL_TABLE_ DTCI_EOCM_HCP1_TstNCmpltdOpCyc 0 "FALSE" 1 "TRUE" ;
VAL_TABLE_ DTCI_EOCM_HCP1_TstNCmpltdLstClr 0 "FALSE" 1 "TRUE" ;
VAL_TABLE_ DTCI_EOCM_HCP1_TstFldOpCyc 0 "FALSE" 1 "TRUE" ;
VAL_TABLE_ DTCI_EOCM_HCP1_TstFldLstClr 0 "FALSE" 1 "TRUE" ;
VAL_TABLE_ DTCI_EOCM_HCP1_TstFld 0 "FALSE" 1 "TRUE" ;
VAL_TABLE_ DTCI_EOCM_HCP1_PndngDTC 0 "FALSE" 1 "TRUE" ;
VAL_TABLE_ DTCI_EOCM_HCP1_DTCTriggered 0 "FALSE" 1 "TRUE" ;
VAL_TABLE_ DTCI_EOCM_HCP1_WrnIndTrggrd 0 "FALSE" 1 "TRUE" ;
VAL_TABLE_ DTCI_EOCM_HCP1_WrnIndRqd 0 "FALSE" 1 "TRUE" ;
VAL_TABLE_ DTCI_EOCM_HCP2_CnfrmdDTC 0 "FALSE" 1 "TRUE" ;
VAL_TABLE_ DTCI_EOCM_HCP2_DTCFaultType 0 "Not Supported" 1 "Type A" 2 "Type B" 3 "Type C" ;
VAL_TABLE_ DTCI_EOCM_HCP2_TstNCmpltdOpCyc 0 "FALSE" 1 "TRUE" ;
VAL_TABLE_ DTCI_EOCM_HCP2_TstNCmpltdLstClr 0 "FALSE" 1 "TRUE" ;
VAL_TABLE_ DTCI_EOCM_HCP2_TstFldOpCyc 0 "FALSE" 1 "TRUE" ;
VAL_TABLE_ DTCI_EOCM_HCP2_TstFldLstClr 0 "FALSE" 1 "TRUE" ;
VAL_TABLE_ DTCI_EOCM_HCP2_TstFld 0 "FALSE" 1 "TRUE" ;
VAL_TABLE_ DTCI_EOCM_HCP2_PndngDTC 0 "FALSE" 1 "TRUE" ;
VAL_TABLE_ DTCI_EOCM_HCP2_DTCTriggered 0 "FALSE" 1 "TRUE" ;
VAL_TABLE_ DTCI_EOCM_HCP2_WrnIndTrggrd 0 "FALSE" 1 "TRUE" ;
VAL_TABLE_ DTCI_EOCM_HCP2_WrnIndRqd 0 "FALSE" 1 "TRUE" ;
VAL_TABLE_ DTCI_EOCM_CnfrmdDTC 0 "FALSE" 1 "TRUE" ;
VAL_TABLE_ DTCI_EOCM_DTCFaultType 0 "Not Supported" 1 "Type A" 2 "Type B" 3 "Type C" ;
VAL_TABLE_ DTCI_EOCM_TstNCmpltdOpCyc 0 "FALSE" 1 "TRUE" ;
VAL_TABLE_ DTCI_EOCM_TstNCmpltdLstClr 0 "FALSE" 1 "TRUE" ;
VAL_TABLE_ DTCI_EOCM_TstFldOpCyc 0 "FALSE" 1 "TRUE" ;
VAL_TABLE_ DTCI_EOCM_TstFldLstClr 0 "FALSE" 1 "TRUE" ;
VAL_TABLE_ DTCI_EOCM_TstFld 0 "FALSE" 1 "TRUE" ;
VAL_TABLE_ DTCI_EOCM_PndngDTC 0 "FALSE" 1 "TRUE" ;
VAL_TABLE_ DTCI_EOCM_DTCTriggered 0 "FALSE" 1 "TRUE" ;
VAL_TABLE_ DTCI_EOCM_WrnIndTrggrd 0 "FALSE" 1 "TRUE" ;
VAL_TABLE_ DTCI_EOCM_WrnIndRqd 0 "FALSE" 1 "TRUE" ;
VAL_TABLE_ DTCI_EPS_CnfrmdDTC 0 "FALSE" 1 "TRUE" ;
VAL_TABLE_ DTCI_EPS_DTCFaultType 0 "Not Supported" 1 "Type A" 2 "Type B" 3 "Type C" ;
VAL_TABLE_ DTCI_EPS_TstNCmpltdOpCyc 0 "FALSE" 1 "TRUE" ;
VAL_TABLE_ DTCI_EPS_TstNCmpltdLstClr 0 "FALSE" 1 "TRUE" ;
VAL_TABLE_ DTCI_EPS_TstFldOpCyc 0 "FALSE" 1 "TRUE" ;
VAL_TABLE_ DTCI_EPS_TstFldLstClr 0 "FALSE" 1 "TRUE" ;
VAL_TABLE_ DTCI_EPS_TstFld 0 "FALSE" 1 "TRUE" ;
VAL_TABLE_ DTCI_EPS_PndngDTC 0 "FALSE" 1 "TRUE" ;
VAL_TABLE_ DTCI_EPS_DTCTriggered 0 "FALSE" 1 "TRUE" ;
VAL_TABLE_ DTCI_EPS_WrnIndTrggrd 0 "FALSE" 1 "TRUE" ;
VAL_TABLE_ DTCI_EPS_WrnIndRqd 0 "FALSE" 1 "TRUE" ;
VAL_TABLE_ DTCI_FCM_LC_CnfrmdDTC 0 "FALSE" 1 "TRUE" ;
VAL_TABLE_ DTCI_FCM_LC_DTCFaultType 0 "Not Supported" 1 "Type A" 2 "Type B" 3 "Type C" ;
VAL_TABLE_ DTCI_FCM_LC_TstNCmpltdOpCyc 0 "FALSE" 1 "TRUE" ;
VAL_TABLE_ DTCI_FCM_LC_TstNCmpltdLstClr 0 "FALSE" 1 "TRUE" ;
VAL_TABLE_ DTCI_FCM_LC_TstFldOpCyc 0 "FALSE" 1 "TRUE" ;
VAL_TABLE_ DTCI_FCM_LC_TstFldLstClr 0 "FALSE" 1 "TRUE" ;
VAL_TABLE_ DTCI_FCM_LC_TstFld 0 "FALSE" 1 "TRUE" ;
VAL_TABLE_ DTCI_FCM_LC_PndngDTC 0 "FALSE" 1 "TRUE" ;
VAL_TABLE_ DTCI_FCM_LC_DTCTriggered 0 "FALSE" 1 "TRUE" ;
VAL_TABLE_ DTCI_FCM_LC_WrnIndTrggrd 0 "FALSE" 1 "TRUE" ;
VAL_TABLE_ DTCI_FCM_LC_WrnIndRqd 0 "FALSE" 1 "TRUE" ;
VAL_TABLE_ DTCI_FCM_CnfrmdDTC 0 "FALSE" 1 "TRUE" ;
VAL_TABLE_ DTCI_FCM_DTCFaultType 0 "Not Supported" 1 "Type A" 2 "Type B" 3 "Type C" ;
VAL_TABLE_ DTCI_FCM_TstNCmpltdOpCyc 0 "FALSE" 1 "TRUE" ;
VAL_TABLE_ DTCI_FCM_TstNCmpltdLstClr 0 "FALSE" 1 "TRUE" ;
VAL_TABLE_ DTCI_FCM_TstFldOpCyc 0 "FALSE" 1 "TRUE" ;
VAL_TABLE_ DTCI_FCM_TstFldLstClr 0 "FALSE" 1 "TRUE" ;
VAL_TABLE_ DTCI_FCM_TstFld 0 "FALSE" 1 "TRUE" ;
VAL_TABLE_ DTCI_FCM_PndngDTC 0 "FALSE" 1 "TRUE" ;
VAL_TABLE_ DTCI_FCM_DTCTriggered 0 "FALSE" 1 "TRUE" ;
VAL_TABLE_ DTCI_FCM_WrnIndTrggrd 0 "FALSE" 1 "TRUE" ;
VAL_TABLE_ DTCI_FCM_WrnIndRqd 0 "FALSE" 1 "TRUE" ;
VAL_TABLE_ DTCI_HDLM_CnfrmdDTC 0 "FALSE" 1 "TRUE" ;
VAL_TABLE_ DTCI_HDLM_DTCFaultType 0 "Not Supported" 1 "Type A" 2 "Type B" 3 "Type C" ;
VAL_TABLE_ DTCI_HDLM_TstNCmpltdOpCyc 0 "FALSE" 1 "TRUE" ;
VAL_TABLE_ DTCI_HDLM_TstNCmpltdLstClr 0 "FALSE" 1 "TRUE" ;
VAL_TABLE_ DTCI_HDLM_TstFldOpCyc 0 "FALSE" 1 "TRUE" ;
VAL_TABLE_ DTCI_HDLM_TstFldLstClr 0 "FALSE" 1 "TRUE" ;
VAL_TABLE_ DTCI_HDLM_TstFld 0 "FALSE" 1 "TRUE" ;
VAL_TABLE_ DTCI_HDLM_PndngDTC 0 "FALSE" 1 "TRUE" ;
VAL_TABLE_ DTCI_HDLM_DTCTriggered 0 "FALSE" 1 "TRUE" ;
VAL_TABLE_ DTCI_HDLM_WrnIndTrggrd 0 "FALSE" 1 "TRUE" ;
VAL_TABLE_ DTCI_HDLM_WrnIndRqd 0 "FALSE" 1 "TRUE" ;
VAL_TABLE_ DTCI_HUD_CAN_CnfrmdDTC 0 "FALSE" 1 "TRUE" ;
VAL_TABLE_ DTCI_HUD_CAN_DTCFaultType 0 "Not Supported" 1 "Type A" 2 "Type B" 3 "Type C" ;
VAL_TABLE_ DTCI_HUD_CAN_TstNCmpltdOpCyc 0 "FALSE" 1 "TRUE" ;
VAL_TABLE_ DTCI_HUD_CAN_TstNCmpltdLstClr 0 "FALSE" 1 "TRUE" ;
VAL_TABLE_ DTCI_HUD_CAN_TstFldOpCyc 0 "FALSE" 1 "TRUE" ;
VAL_TABLE_ DTCI_HUD_CAN_TstFldLstClr 0 "FALSE" 1 "TRUE" ;
VAL_TABLE_ DTCI_HUD_CAN_TstFld 0 "FALSE" 1 "TRUE" ;
VAL_TABLE_ DTCI_HUD_CAN_PndngDTC 0 "FALSE" 1 "TRUE" ;
VAL_TABLE_ DTCI_HUD_CAN_DTCTriggered 0 "FALSE" 1 "TRUE" ;
VAL_TABLE_ DTCI_HUD_CAN_WrnIndTrggrd 0 "FALSE" 1 "TRUE" ;
VAL_TABLE_ DTCI_HUD_CAN_WrnIndRqd 0 "FALSE" 1 "TRUE" ;
VAL_TABLE_ DTCI_HVAC_FP_F_CnfrmdDTC 0 "FALSE" 1 "TRUE" ;
VAL_TABLE_ DTCI_HVAC_FP_F_DTCFaultType 0 "Not Supported" 1 "Type A" 2 "Type B" 3 "Type C" ;
VAL_TABLE_ DTCI_HVAC_FP_F_TstNCmpltdOpCyc 0 "FALSE" 1 "TRUE" ;
VAL_TABLE_ DTCI_HVAC_FP_F_TstNCmpltdLstClr 0 "FALSE" 1 "TRUE" ;
VAL_TABLE_ DTCI_HVAC_FP_F_TstFldOpCyc 0 "FALSE" 1 "TRUE" ;
VAL_TABLE_ DTCI_HVAC_FP_F_TstFldLstClr 0 "FALSE" 1 "TRUE" ;
VAL_TABLE_ DTCI_HVAC_FP_F_TstFld 0 "FALSE" 1 "TRUE" ;
VAL_TABLE_ DTCI_HVAC_FP_F_PndngDTC 0 "FALSE" 1 "TRUE" ;
VAL_TABLE_ DTCI_HVAC_FP_F_DTCTriggered 0 "FALSE" 1 "TRUE" ;
VAL_TABLE_ DTCI_HVAC_FP_F_WrnIndTrggrd 0 "FALSE" 1 "TRUE" ;
VAL_TABLE_ DTCI_HVAC_FP_F_WrnIndRqd 0 "FALSE" 1 "TRUE" ;
VAL_TABLE_ DTCI_HVAC_FP_R_CnfrmdDTC 0 "FALSE" 1 "TRUE" ;
VAL_TABLE_ DTCI_HVAC_FP_R_DTCFaultType 0 "Not Supported" 1 "Type A" 2 "Type B" 3 "Type C" ;
VAL_TABLE_ DTCI_HVAC_FP_R_TstNCmpltdOpCyc 0 "FALSE" 1 "TRUE" ;
VAL_TABLE_ DTCI_HVAC_FP_R_TstNCmpltdLstClr 0 "FALSE" 1 "TRUE" ;
VAL_TABLE_ DTCI_HVAC_FP_R_TstFldOpCyc 0 "FALSE" 1 "TRUE" ;
VAL_TABLE_ DTCI_HVAC_FP_R_TstFldLstClr 0 "FALSE" 1 "TRUE" ;
VAL_TABLE_ DTCI_HVAC_FP_R_TstFld 0 "FALSE" 1 "TRUE" ;
VAL_TABLE_ DTCI_HVAC_FP_R_PndngDTC 0 "FALSE" 1 "TRUE" ;
VAL_TABLE_ DTCI_HVAC_FP_R_DTCTriggered 0 "FALSE" 1 "TRUE" ;
VAL_TABLE_ DTCI_HVAC_FP_R_WrnIndTrggrd 0 "FALSE" 1 "TRUE" ;
VAL_TABLE_ DTCI_HVAC_FP_R_WrnIndRqd 0 "FALSE" 1 "TRUE" ;
VAL_TABLE_ DTCI_ICCM_CnfrmdDTC 0 "FALSE" 1 "TRUE" ;
VAL_TABLE_ DTCI_ICCM_DTCFaultType 0 "Not Supported" 1 "Type A" 2 "Type B" 3 "Type C" ;
VAL_TABLE_ DTCI_ICCM_TstNCmpltdOpCyc 0 "FALSE" 1 "TRUE" ;
VAL_TABLE_ DTCI_ICCM_TstNCmpltdLstClr 0 "FALSE" 1 "TRUE" ;
VAL_TABLE_ DTCI_ICCM_TstFldOpCyc 0 "FALSE" 1 "TRUE" ;
VAL_TABLE_ DTCI_ICCM_TstFldLstClr 0 "FALSE" 1 "TRUE" ;
VAL_TABLE_ DTCI_ICCM_TstFld 0 "FALSE" 1 "TRUE" ;
VAL_TABLE_ DTCI_ICCM_PndngDTC 0 "FALSE" 1 "TRUE" ;
VAL_TABLE_ DTCI_ICCM_DTCTriggered 0 "FALSE" 1 "TRUE" ;
VAL_TABLE_ DTCI_ICCM_WrnIndTrggrd 0 "FALSE" 1 "TRUE" ;
VAL_TABLE_ DTCI_ICCM_WrnIndRqd 0 "FALSE" 1 "TRUE" ;
VAL_TABLE_ DTCI_ICS_Info_CnfrmdDTC 0 "FALSE" 1 "TRUE" ;
VAL_TABLE_ DTCI_ICS_Info_DTCFaultType 0 "Not Supported" 1 "Type A" 2 "Type B" 3 "Type C" ;
VAL_TABLE_ DTCI_ICS_Info_TstNCmpltdOpCyc 0 "FALSE" 1 "TRUE" ;
VAL_TABLE_ DTCI_ICS_Info_TstNCmpltdLstClr 0 "FALSE" 1 "TRUE" ;
VAL_TABLE_ DTCI_ICS_Info_TstFldOpCyc 0 "FALSE" 1 "TRUE" ;
VAL_TABLE_ DTCI_ICS_Info_TstFldLstClr 0 "FALSE" 1 "TRUE" ;
VAL_TABLE_ DTCI_ICS_Info_TstFld 0 "FALSE" 1 "TRUE" ;
VAL_TABLE_ DTCI_ICS_Info_PndngDTC 0 "FALSE" 1 "TRUE" ;
VAL_TABLE_ DTCI_ICS_Info_DTCTriggered 0 "FALSE" 1 "TRUE" ;
VAL_TABLE_ DTCI_ICS_Info_WrnIndTrggrd 0 "FALSE" 1 "TRUE" ;
VAL_TABLE_ DTCI_ICS_Info_WrnIndRqd 0 "FALSE" 1 "TRUE" ;
VAL_TABLE_ DTCI_IPC_CnfrmdDTC 0 "FALSE" 1 "TRUE" ;
VAL_TABLE_ DTCI_IPC_DTCFaultType 0 "Not Supported" 1 "Type A" 2 "Type B" 3 "Type C" ;
VAL_TABLE_ DTCI_IPC_TstNCmpltdOpCyc 0 "FALSE" 1 "TRUE" ;
VAL_TABLE_ DTCI_IPC_TstNCmpltdLstClr 0 "FALSE" 1 "TRUE" ;
VAL_TABLE_ DTCI_IPC_TstFldOpCyc 0 "FALSE" 1 "TRUE" ;
VAL_TABLE_ DTCI_IPC_TstFldLstClr 0 "FALSE" 1 "TRUE" ;
VAL_TABLE_ DTCI_IPC_TstFld 0 "FALSE" 1 "TRUE" ;
VAL_TABLE_ DTCI_IPC_PndngDTC 0 "FALSE" 1 "TRUE" ;
VAL_TABLE_ DTCI_IPC_DTCTriggered 0 "FALSE" 1 "TRUE" ;
VAL_TABLE_ DTCI_IPC_WrnIndTrggrd 0 "FALSE" 1 "TRUE" ;
VAL_TABLE_ DTCI_IPC_WrnIndRqd 0 "FALSE" 1 "TRUE" ;
VAL_TABLE_ DTCI_LIB1_CnfrmdDTC 0 "FALSE" 1 "TRUE" ;
VAL_TABLE_ DTCI_LIB1_DTCFaultType 0 "Not Supported" 1 "Type A" 2 "Type B" 3 "Type C" ;
VAL_TABLE_ DTCI_LIB1_TstNCmpltdOpCyc 0 "FALSE" 1 "TRUE" ;
VAL_TABLE_ DTCI_LIB1_TstNCmpltdLstClr 0 "FALSE" 1 "TRUE" ;
VAL_TABLE_ DTCI_LIB1_TstFldOpCyc 0 "FALSE" 1 "TRUE" ;
VAL_TABLE_ DTCI_LIB1_TstFldLstClr 0 "FALSE" 1 "TRUE" ;
VAL_TABLE_ DTCI_LIB1_TstFld 0 "FALSE" 1 "TRUE" ;
VAL_TABLE_ DTCI_LIB1_PndngDTC 0 "FALSE" 1 "TRUE" ;
VAL_TABLE_ DTCI_LIB1_DTCTriggered 0 "FALSE" 1 "TRUE" ;
VAL_TABLE_ DTCI_LIB1_WrnIndTrggrd 0 "FALSE" 1 "TRUE" ;
VAL_TABLE_ DTCI_LIB1_WrnIndRqd 0 "FALSE" 1 "TRUE" ;
VAL_TABLE_ DTCI_LRR_HC_CnfrmdDTC 0 "FALSE" 1 "TRUE" ;
VAL_TABLE_ DTCI_LRR_HC_DTCFaultType 0 "Not Supported" 1 "Type A" 2 "Type B" 3 "Type C" ;
VAL_TABLE_ DTCI_LRR_HC_TstNCmpltdOpCyc 0 "FALSE" 1 "TRUE" ;
VAL_TABLE_ DTCI_LRR_HC_TstNCmpltdLstClr 0 "FALSE" 1 "TRUE" ;
VAL_TABLE_ DTCI_LRR_HC_TstFldOpCyc 0 "FALSE" 1 "TRUE" ;
VAL_TABLE_ DTCI_LRR_HC_TstFldLstClr 0 "FALSE" 1 "TRUE" ;
VAL_TABLE_ DTCI_LRR_HC_TstFld 0 "FALSE" 1 "TRUE" ;
VAL_TABLE_ DTCI_LRR_HC_PndngDTC 0 "FALSE" 1 "TRUE" ;
VAL_TABLE_ DTCI_LRR_HC_DTCTriggered 0 "FALSE" 1 "TRUE" ;
VAL_TABLE_ DTCI_LRR_HC_WrnIndTrggrd 0 "FALSE" 1 "TRUE" ;
VAL_TABLE_ DTCI_LRR_HC_WrnIndRqd 0 "FALSE" 1 "TRUE" ;
VAL_TABLE_ DTCI_LRR_CnfrmdDTC 0 "FALSE" 1 "TRUE" ;
VAL_TABLE_ DTCI_LRR_DTCFaultType 0 "Not Supported" 1 "Type A" 2 "Type B" 3 "Type C" ;
VAL_TABLE_ DTCI_LRR_TstNCmpltdOpCyc 0 "FALSE" 1 "TRUE" ;
VAL_TABLE_ DTCI_LRR_TstNCmpltdLstClr 0 "FALSE" 1 "TRUE" ;
VAL_TABLE_ DTCI_LRR_TstFldOpCyc 0 "FALSE" 1 "TRUE" ;
VAL_TABLE_ DTCI_LRR_TstFldLstClr 0 "FALSE" 1 "TRUE" ;
VAL_TABLE_ DTCI_LRR_TstFld 0 "FALSE" 1 "TRUE" ;
VAL_TABLE_ DTCI_LRR_PndngDTC 0 "FALSE" 1 "TRUE" ;
VAL_TABLE_ DTCI_LRR_DTCTriggered 0 "FALSE" 1 "TRUE" ;
VAL_TABLE_ DTCI_LRR_WrnIndTrggrd 0 "FALSE" 1 "TRUE" ;
VAL_TABLE_ DTCI_LRR_WrnIndRqd 0 "FALSE" 1 "TRUE" ;
VAL_TABLE_ DTCI_MFC_CnfrmdDTC 0 "FALSE" 1 "TRUE" ;
VAL_TABLE_ DTCI_MFC_DTCFaultType 0 "Not Supported" 1 "Type A" 2 "Type B" 3 "Type C" ;
VAL_TABLE_ DTCI_MFC_TstNCmpltdOpCyc 0 "FALSE" 1 "TRUE" ;
VAL_TABLE_ DTCI_MFC_TstNCmpltdLstClr 0 "FALSE" 1 "TRUE" ;
VAL_TABLE_ DTCI_MFC_TstFldOpCyc 0 "FALSE" 1 "TRUE" ;
VAL_TABLE_ DTCI_MFC_TstFldLstClr 0 "FALSE" 1 "TRUE" ;
VAL_TABLE_ DTCI_MFC_TstFld 0 "FALSE" 1 "TRUE" ;
VAL_TABLE_ DTCI_MFC_PndngDTC 0 "FALSE" 1 "TRUE" ;
VAL_TABLE_ DTCI_MFC_DTCTriggered 0 "FALSE" 1 "TRUE" ;
VAL_TABLE_ DTCI_MFC_WrnIndTrggrd 0 "FALSE" 1 "TRUE" ;
VAL_TABLE_ DTCI_MFC_WrnIndRqd 0 "FALSE" 1 "TRUE" ;
VAL_TABLE_ DTCI_MRCM_L_CnfrmdDTC 0 "FALSE" 1 "TRUE" ;
VAL_TABLE_ DTCI_MRCM_L_DTCFaultType 0 "Not Supported" 1 "Type A" 2 "Type B" 3 "Type C" ;
VAL_TABLE_ DTCI_MRCM_L_TstNCmpltdOpCyc 0 "FALSE" 1 "TRUE" ;
VAL_TABLE_ DTCI_MRCM_L_TstNCmpltdLstClr 0 "FALSE" 1 "TRUE" ;
VAL_TABLE_ DTCI_MRCM_L_TstFldOpCyc 0 "FALSE" 1 "TRUE" ;
VAL_TABLE_ DTCI_MRCM_L_TstFldLstClr 0 "FALSE" 1 "TRUE" ;
VAL_TABLE_ DTCI_MRCM_L_TstFld 0 "FALSE" 1 "TRUE" ;
VAL_TABLE_ DTCI_MRCM_L_PndngDTC 0 "FALSE" 1 "TRUE" ;
VAL_TABLE_ DTCI_MRCM_L_DTCTriggered 0 "FALSE" 1 "TRUE" ;
VAL_TABLE_ DTCI_MRCM_L_WrnIndTrggrd 0 "FALSE" 1 "TRUE" ;
VAL_TABLE_ DTCI_MRCM_L_WrnIndRqd 0 "FALSE" 1 "TRUE" ;
VAL_TABLE_ DTCI_MRCM_R_CnfrmdDTC 0 "FALSE" 1 "TRUE" ;
VAL_TABLE_ DTCI_MRCM_R_DTCFaultType 0 "Not Supported" 1 "Type A" 2 "Type B" 3 "Type C" ;
VAL_TABLE_ DTCI_MRCM_R_TstNCmpltdOpCyc 0 "FALSE" 1 "TRUE" ;
VAL_TABLE_ DTCI_MRCM_R_TstNCmpltdLstClr 0 "FALSE" 1 "TRUE" ;
VAL_TABLE_ DTCI_MRCM_R_TstFldOpCyc 0 "FALSE" 1 "TRUE" ;
VAL_TABLE_ DTCI_MRCM_R_TstFldLstClr 0 "FALSE" 1 "TRUE" ;
VAL_TABLE_ DTCI_MRCM_R_TstFld 0 "FALSE" 1 "TRUE" ;
VAL_TABLE_ DTCI_MRCM_R_PndngDTC 0 "FALSE" 1 "TRUE" ;
VAL_TABLE_ DTCI_MRCM_R_DTCTriggered 0 "FALSE" 1 "TRUE" ;
VAL_TABLE_ DTCI_MRCM_R_WrnIndTrggrd 0 "FALSE" 1 "TRUE" ;
VAL_TABLE_ DTCI_MRCM_R_WrnIndRqd 0 "FALSE" 1 "TRUE" ;
VAL_TABLE_ DTCI_MSB1_CnfrmdDTC 0 "FALSE" 1 "TRUE" ;
VAL_TABLE_ DTCI_MSB1_DTCFaultType 0 "Not Supported" 1 "Type A" 2 "Type B" 3 "Type C" ;
VAL_TABLE_ DTCI_MSB1_TstNCmpltdOpCyc 0 "FALSE" 1 "TRUE" ;
VAL_TABLE_ DTCI_MSB1_TstNCmpltdLstClr 0 "FALSE" 1 "TRUE" ;
VAL_TABLE_ DTCI_MSB1_TstFldOpCyc 0 "FALSE" 1 "TRUE" ;
VAL_TABLE_ DTCI_MSB1_TstFldLstClr 0 "FALSE" 1 "TRUE" ;
VAL_TABLE_ DTCI_MSB1_TstFld 0 "FALSE" 1 "TRUE" ;
VAL_TABLE_ DTCI_MSB1_PndngDTC 0 "FALSE" 1 "TRUE" ;
VAL_TABLE_ DTCI_MSB1_DTCTriggered 0 "FALSE" 1 "TRUE" ;
VAL_TABLE_ DTCI_MSB1_WrnIndTrggrd 0 "FALSE" 1 "TRUE" ;
VAL_TABLE_ DTCI_MSB1_WrnIndRqd 0 "FALSE" 1 "TRUE" ;
VAL_TABLE_ DTCI_MSB2_CnfrmdDTC 0 "FALSE" 1 "TRUE" ;
VAL_TABLE_ DTCI_MSB2_DTCFaultType 0 "Not Supported" 1 "Type A" 2 "Type B" 3 "Type C" ;
VAL_TABLE_ DTCI_MSB2_TstNCmpltdOpCyc 0 "FALSE" 1 "TRUE" ;
VAL_TABLE_ DTCI_MSB2_TstNCmpltdLstClr 0 "FALSE" 1 "TRUE" ;
VAL_TABLE_ DTCI_MSB2_TstFldOpCyc 0 "FALSE" 1 "TRUE" ;
VAL_TABLE_ DTCI_MSB2_TstFldLstClr 0 "FALSE" 1 "TRUE" ;
VAL_TABLE_ DTCI_MSB2_TstFld 0 "FALSE" 1 "TRUE" ;
VAL_TABLE_ DTCI_MSB2_PndngDTC 0 "FALSE" 1 "TRUE" ;
VAL_TABLE_ DTCI_MSB2_DTCTriggered 0 "FALSE" 1 "TRUE" ;
VAL_TABLE_ DTCI_MSB2_WrnIndTrggrd 0 "FALSE" 1 "TRUE" ;
VAL_TABLE_ DTCI_MSB2_WrnIndRqd 0 "FALSE" 1 "TRUE" ;
VAL_TABLE_ DTCI_MSM_D_CnfrmdDTC 0 "FALSE" 1 "TRUE" ;
VAL_TABLE_ DTCI_MSM_D_DTCFaultType 0 "Not Supported" 1 "Type A" 2 "Type B" 3 "Type C" ;
VAL_TABLE_ DTCI_MSM_D_TstNCmpltdOpCyc 0 "FALSE" 1 "TRUE" ;
VAL_TABLE_ DTCI_MSM_D_TstNCmpltdLstClr 0 "FALSE" 1 "TRUE" ;
VAL_TABLE_ DTCI_MSM_D_TstFldOpCyc 0 "FALSE" 1 "TRUE" ;
VAL_TABLE_ DTCI_MSM_D_TstFldLstClr 0 "FALSE" 1 "TRUE" ;
VAL_TABLE_ DTCI_MSM_D_TstFld 0 "FALSE" 1 "TRUE" ;
VAL_TABLE_ DTCI_MSM_D_PndngDTC 0 "FALSE" 1 "TRUE" ;
VAL_TABLE_ DTCI_MSM_D_DTCTriggered 0 "FALSE" 1 "TRUE" ;
VAL_TABLE_ DTCI_MSM_D_WrnIndTrggrd 0 "FALSE" 1 "TRUE" ;
VAL_TABLE_ DTCI_MSM_D_WrnIndRqd 0 "FALSE" 1 "TRUE" ;
VAL_TABLE_ DTCI_MSM_LR_CnfrmdDTC 0 "FALSE" 1 "TRUE" ;
VAL_TABLE_ DTCI_MSM_LR_DTCFaultType 0 "Not Supported" 1 "Type A" 2 "Type B" 3 "Type C" ;
VAL_TABLE_ DTCI_MSM_LR_TstNCmpltdOpCyc 0 "FALSE" 1 "TRUE" ;
VAL_TABLE_ DTCI_MSM_LR_TstNCmpltdLstClr 0 "FALSE" 1 "TRUE" ;
VAL_TABLE_ DTCI_MSM_LR_TstFldOpCyc 0 "FALSE" 1 "TRUE" ;
VAL_TABLE_ DTCI_MSM_LR_TstFldLstClr 0 "FALSE" 1 "TRUE" ;
VAL_TABLE_ DTCI_MSM_LR_TstFld 0 "FALSE" 1 "TRUE" ;
VAL_TABLE_ DTCI_MSM_LR_PndngDTC 0 "FALSE" 1 "TRUE" ;
VAL_TABLE_ DTCI_MSM_LR_DTCTriggered 0 "FALSE" 1 "TRUE" ;
VAL_TABLE_ DTCI_MSM_LR_WrnIndTrggrd 0 "FALSE" 1 "TRUE" ;
VAL_TABLE_ DTCI_MSM_LR_WrnIndRqd 0 "FALSE" 1 "TRUE" ;
VAL_TABLE_ DTCI_MSM_P_CnfrmdDTC 0 "FALSE" 1 "TRUE" ;
VAL_TABLE_ DTCI_MSM_P_DTCFaultType 0 "Not Supported" 1 "Type A" 2 "Type B" 3 "Type C" ;
VAL_TABLE_ DTCI_MSM_P_TstNCmpltdOpCyc 0 "FALSE" 1 "TRUE" ;
VAL_TABLE_ DTCI_MSM_P_TstNCmpltdLstClr 0 "FALSE" 1 "TRUE" ;
VAL_TABLE_ DTCI_MSM_P_TstFldOpCyc 0 "FALSE" 1 "TRUE" ;
VAL_TABLE_ DTCI_MSM_P_TstFldLstClr 0 "FALSE" 1 "TRUE" ;
VAL_TABLE_ DTCI_MSM_P_TstFld 0 "FALSE" 1 "TRUE" ;
VAL_TABLE_ DTCI_MSM_P_PndngDTC 0 "FALSE" 1 "TRUE" ;
VAL_TABLE_ DTCI_MSM_P_DTCTriggered 0 "FALSE" 1 "TRUE" ;
VAL_TABLE_ DTCI_MSM_P_WrnIndTrggrd 0 "FALSE" 1 "TRUE" ;
VAL_TABLE_ DTCI_MSM_P_WrnIndRqd 0 "FALSE" 1 "TRUE" ;
VAL_TABLE_ DTCI_MSM_RR_CnfrmdDTC 0 "FALSE" 1 "TRUE" ;
VAL_TABLE_ DTCI_MSM_RR_DTCFaultType 0 "Not Supported" 1 "Type A" 2 "Type B" 3 "Type C" ;
VAL_TABLE_ DTCI_MSM_RR_TstNCmpltdOpCyc 0 "FALSE" 1 "TRUE" ;
VAL_TABLE_ DTCI_MSM_RR_TstNCmpltdLstClr 0 "FALSE" 1 "TRUE" ;
VAL_TABLE_ DTCI_MSM_RR_TstFldOpCyc 0 "FALSE" 1 "TRUE" ;
VAL_TABLE_ DTCI_MSM_RR_TstFldLstClr 0 "FALSE" 1 "TRUE" ;
VAL_TABLE_ DTCI_MSM_RR_TstFld 0 "FALSE" 1 "TRUE" ;
VAL_TABLE_ DTCI_MSM_RR_PndngDTC 0 "FALSE" 1 "TRUE" ;
VAL_TABLE_ DTCI_MSM_RR_DTCTriggered 0 "FALSE" 1 "TRUE" ;
VAL_TABLE_ DTCI_MSM_RR_WrnIndTrggrd 0 "FALSE" 1 "TRUE" ;
VAL_TABLE_ DTCI_MSM_RR_WrnIndRqd 0 "FALSE" 1 "TRUE" ;
VAL_TABLE_ DTCI_MTCM_L_CnfrmdDTC 0 "FALSE" 1 "TRUE" ;
VAL_TABLE_ DTCI_MTCM_L_DTCFaultType 0 "Not Supported" 1 "Type A" 2 "Type B" 3 "Type C" ;
VAL_TABLE_ DTCI_MTCM_L_TstNCmpltdOpCyc 0 "FALSE" 1 "TRUE" ;
VAL_TABLE_ DTCI_MTCM_L_TstNCmpltdLstClr 0 "FALSE" 1 "TRUE" ;
VAL_TABLE_ DTCI_MTCM_L_TstFldOpCyc 0 "FALSE" 1 "TRUE" ;
VAL_TABLE_ DTCI_MTCM_L_TstFldLstClr 0 "FALSE" 1 "TRUE" ;
VAL_TABLE_ DTCI_MTCM_L_TstFld 0 "FALSE" 1 "TRUE" ;
VAL_TABLE_ DTCI_MTCM_L_PndngDTC 0 "FALSE" 1 "TRUE" ;
VAL_TABLE_ DTCI_MTCM_L_DTCTriggered 0 "FALSE" 1 "TRUE" ;
VAL_TABLE_ DTCI_MTCM_L_WrnIndTrggrd 0 "FALSE" 1 "TRUE" ;
VAL_TABLE_ DTCI_MTCM_L_WrnIndRqd 0 "FALSE" 1 "TRUE" ;
VAL_TABLE_ DTCI_MTCM_R_CnfrmdDTC 0 "FALSE" 1 "TRUE" ;
VAL_TABLE_ DTCI_MTCM_R_DTCFaultType 0 "Not Supported" 1 "Type A" 2 "Type B" 3 "Type C" ;
VAL_TABLE_ DTCI_MTCM_R_TstNCmpltdOpCyc 0 "FALSE" 1 "TRUE" ;
VAL_TABLE_ DTCI_MTCM_R_TstNCmpltdLstClr 0 "FALSE" 1 "TRUE" ;
VAL_TABLE_ DTCI_MTCM_R_TstFldOpCyc 0 "FALSE" 1 "TRUE" ;
VAL_TABLE_ DTCI_MTCM_R_TstFldLstClr 0 "FALSE" 1 "TRUE" ;
VAL_TABLE_ DTCI_MTCM_R_TstFld 0 "FALSE" 1 "TRUE" ;
VAL_TABLE_ DTCI_MTCM_R_PndngDTC 0 "FALSE" 1 "TRUE" ;
VAL_TABLE_ DTCI_MTCM_R_DTCTriggered 0 "FALSE" 1 "TRUE" ;
VAL_TABLE_ DTCI_MTCM_R_WrnIndTrggrd 0 "FALSE" 1 "TRUE" ;
VAL_TABLE_ DTCI_MTCM_R_WrnIndRqd 0 "FALSE" 1 "TRUE" ;
VAL_TABLE_ DTCI_NVM_CnfrmdDTC 0 "FALSE" 1 "TRUE" ;
VAL_TABLE_ DTCI_NVM_DTCFaultType 0 "Not Supported" 1 "Type A" 2 "Type B" 3 "Type C" ;
VAL_TABLE_ DTCI_NVM_TstNCmpltdOpCyc 0 "FALSE" 1 "TRUE" ;
VAL_TABLE_ DTCI_NVM_TstNCmpltdLstClr 0 "FALSE" 1 "TRUE" ;
VAL_TABLE_ DTCI_NVM_TstFldOpCyc 0 "FALSE" 1 "TRUE" ;
VAL_TABLE_ DTCI_NVM_TstFldLstClr 0 "FALSE" 1 "TRUE" ;
VAL_TABLE_ DTCI_NVM_TstFld 0 "FALSE" 1 "TRUE" ;
VAL_TABLE_ DTCI_NVM_PndngDTC 0 "FALSE" 1 "TRUE" ;
VAL_TABLE_ DTCI_NVM_DTCTriggered 0 "FALSE" 1 "TRUE" ;
VAL_TABLE_ DTCI_NVM_WrnIndTrggrd 0 "FALSE" 1 "TRUE" ;
VAL_TABLE_ DTCI_NVM_WrnIndRqd 0 "FALSE" 1 "TRUE" ;
VAL_TABLE_ DTCI_PA_CnfrmdDTC 0 "FALSE" 1 "TRUE" ;
VAL_TABLE_ DTCI_PA_DTCFaultType 0 "Not Supported" 1 "Type A" 2 "Type B" 3 "Type C" ;
VAL_TABLE_ DTCI_PA_TstNCmpltdOpCyc 0 "FALSE" 1 "TRUE" ;
VAL_TABLE_ DTCI_PA_TstNCmpltdLstClr 0 "FALSE" 1 "TRUE" ;
VAL_TABLE_ DTCI_PA_TstFldOpCyc 0 "FALSE" 1 "TRUE" ;
VAL_TABLE_ DTCI_PA_TstFldLstClr 0 "FALSE" 1 "TRUE" ;
VAL_TABLE_ DTCI_PA_TstFld 0 "FALSE" 1 "TRUE" ;
VAL_TABLE_ DTCI_PA_PndngDTC 0 "FALSE" 1 "TRUE" ;
VAL_TABLE_ DTCI_PA_DTCTriggered 0 "FALSE" 1 "TRUE" ;
VAL_TABLE_ DTCI_PA_WrnIndTrggrd 0 "FALSE" 1 "TRUE" ;
VAL_TABLE_ DTCI_PA_WrnIndRqd 0 "FALSE" 1 "TRUE" ;
VAL_TABLE_ DTCI_PDR_CnfrmdDTC 0 "FALSE" 1 "TRUE" ;
VAL_TABLE_ DTCI_PDR_DTCFaultType 0 "Not Supported" 1 "Type A" 2 "Type B" 3 "Type C" ;
VAL_TABLE_ DTCI_PDR_TstNCmpltdOpCyc 0 "FALSE" 1 "TRUE" ;
VAL_TABLE_ DTCI_PDR_TstNCmpltdLstClr 0 "FALSE" 1 "TRUE" ;
VAL_TABLE_ DTCI_PDR_TstFldOpCyc 0 "FALSE" 1 "TRUE" ;
VAL_TABLE_ DTCI_PDR_TstFldLstClr 0 "FALSE" 1 "TRUE" ;
VAL_TABLE_ DTCI_PDR_TstFld 0 "FALSE" 1 "TRUE" ;
VAL_TABLE_ DTCI_PDR_PndngDTC 0 "FALSE" 1 "TRUE" ;
VAL_TABLE_ DTCI_PDR_DTCTriggered 0 "FALSE" 1 "TRUE" ;
VAL_TABLE_ DTCI_PDR_WrnIndTrggrd 0 "FALSE" 1 "TRUE" ;
VAL_TABLE_ DTCI_PDR_WrnIndRqd 0 "FALSE" 1 "TRUE" ;
VAL_TABLE_ DTCI_PTM_CnfrmdDTC 0 "FALSE" 1 "TRUE" ;
VAL_TABLE_ DTCI_PTM_DTCFaultType 0 "Not Supported" 1 "Type A" 2 "Type B" 3 "Type C" ;
VAL_TABLE_ DTCI_PTM_TstNCmpltdOpCyc 0 "FALSE" 1 "TRUE" ;
VAL_TABLE_ DTCI_PTM_TstNCmpltdLstClr 0 "FALSE" 1 "TRUE" ;
VAL_TABLE_ DTCI_PTM_TstFldOpCyc 0 "FALSE" 1 "TRUE" ;
VAL_TABLE_ DTCI_PTM_TstFldLstClr 0 "FALSE" 1 "TRUE" ;
VAL_TABLE_ DTCI_PTM_TstFld 0 "FALSE" 1 "TRUE" ;
VAL_TABLE_ DTCI_PTM_PndngDTC 0 "FALSE" 1 "TRUE" ;
VAL_TABLE_ DTCI_PTM_DTCTriggered 0 "FALSE" 1 "TRUE" ;
VAL_TABLE_ DTCI_PTM_WrnIndTrggrd 0 "FALSE" 1 "TRUE" ;
VAL_TABLE_ DTCI_PTM_WrnIndRqd 0 "FALSE" 1 "TRUE" ;
VAL_TABLE_ DTCI_RDCM_CnfrmdDTC 0 "FALSE" 1 "TRUE" ;
VAL_TABLE_ DTCI_RDCM_DTCFaultType 0 "Not Supported" 1 "Type A" 2 "Type B" 3 "Type C" ;
VAL_TABLE_ DTCI_RDCM_TstNCmpltdOpCyc 0 "FALSE" 1 "TRUE" ;
VAL_TABLE_ DTCI_RDCM_TstNCmpltdLstClr 0 "FALSE" 1 "TRUE" ;
VAL_TABLE_ DTCI_RDCM_TstFldOpCyc 0 "FALSE" 1 "TRUE" ;
VAL_TABLE_ DTCI_RDCM_TstFldLstClr 0 "FALSE" 1 "TRUE" ;
VAL_TABLE_ DTCI_RDCM_TstFld 0 "FALSE" 1 "TRUE" ;
VAL_TABLE_ DTCI_RDCM_PndngDTC 0 "FALSE" 1 "TRUE" ;
VAL_TABLE_ DTCI_RDCM_DTCTriggered 0 "FALSE" 1 "TRUE" ;
VAL_TABLE_ DTCI_RDCM_WrnIndTrggrd 0 "FALSE" 1 "TRUE" ;
VAL_TABLE_ DTCI_RDCM_WrnIndRqd 0 "FALSE" 1 "TRUE" ;
VAL_TABLE_ DTCI_RSC_CnfrmdDTC 0 "FALSE" 1 "TRUE" ;
VAL_TABLE_ DTCI_RSC_DTCFaultType 0 "Not Supported" 1 "Type A" 2 "Type B" 3 "Type C" ;
VAL_TABLE_ DTCI_RSC_TstNCmpltdOpCyc 0 "FALSE" 1 "TRUE" ;
VAL_TABLE_ DTCI_RSC_TstNCmpltdLstClr 0 "FALSE" 1 "TRUE" ;
VAL_TABLE_ DTCI_RSC_TstFldOpCyc 0 "FALSE" 1 "TRUE" ;
VAL_TABLE_ DTCI_RSC_TstFldLstClr 0 "FALSE" 1 "TRUE" ;
VAL_TABLE_ DTCI_RSC_TstFld 0 "FALSE" 1 "TRUE" ;
VAL_TABLE_ DTCI_RSC_PndngDTC 0 "FALSE" 1 "TRUE" ;
VAL_TABLE_ DTCI_RSC_DTCTriggered 0 "FALSE" 1 "TRUE" ;
VAL_TABLE_ DTCI_RSC_WrnIndTrggrd 0 "FALSE" 1 "TRUE" ;
VAL_TABLE_ DTCI_RSC_WrnIndRqd 0 "FALSE" 1 "TRUE" ;
VAL_TABLE_ DTCI_RadioLow_CnfrmdDTC 0 "FALSE" 1 "TRUE" ;
VAL_TABLE_ DTCI_RadioLow_DTCFaultType 0 "Not Supported" 1 "Type A" 2 "Type B" 3 "Type C" ;
VAL_TABLE_ DTCI_RadioLow_TstNCmpltdOpCyc 0 "FALSE" 1 "TRUE" ;
VAL_TABLE_ DTCI_RadioLow_TstNCmpltdLstClr 0 "FALSE" 1 "TRUE" ;
VAL_TABLE_ DTCI_RadioLow_TstFldOpCyc 0 "FALSE" 1 "TRUE" ;
VAL_TABLE_ DTCI_RadioLow_TstFldLstClr 0 "FALSE" 1 "TRUE" ;
VAL_TABLE_ DTCI_RadioLow_TstFld 0 "FALSE" 1 "TRUE" ;
VAL_TABLE_ DTCI_RadioLow_PndngDTC 0 "FALSE" 1 "TRUE" ;
VAL_TABLE_ DTCI_RadioLow_DTCTriggered 0 "FALSE" 1 "TRUE" ;
VAL_TABLE_ DTCI_RadioLow_WrnIndTrggrd 0 "FALSE" 1 "TRUE" ;
VAL_TABLE_ DTCI_RadioLow_WrnIndRqd 0 "FALSE" 1 "TRUE" ;
VAL_TABLE_ DTCI_SADS_CnfrmdDTC 0 "FALSE" 1 "TRUE" ;
VAL_TABLE_ DTCI_SADS_DTCFaultType 0 "Not Supported" 1 "Type A" 2 "Type B" 3 "Type C" ;
VAL_TABLE_ DTCI_SADS_TstNCmpltdOpCyc 0 "FALSE" 1 "TRUE" ;
VAL_TABLE_ DTCI_SADS_TstNCmpltdLstClr 0 "FALSE" 1 "TRUE" ;
VAL_TABLE_ DTCI_SADS_TstFldOpCyc 0 "FALSE" 1 "TRUE" ;
VAL_TABLE_ DTCI_SADS_TstFldLstClr 0 "FALSE" 1 "TRUE" ;
VAL_TABLE_ DTCI_SADS_TstFld 0 "FALSE" 1 "TRUE" ;
VAL_TABLE_ DTCI_SADS_PndngDTC 0 "FALSE" 1 "TRUE" ;
VAL_TABLE_ DTCI_SADS_DTCTriggered 0 "FALSE" 1 "TRUE" ;
VAL_TABLE_ DTCI_SADS_WrnIndTrggrd 0 "FALSE" 1 "TRUE" ;
VAL_TABLE_ DTCI_SADS_WrnIndRqd 0 "FALSE" 1 "TRUE" ;
VAL_TABLE_ DTCI_SBM_CnfrmdDTC 0 "FALSE" 1 "TRUE" ;
VAL_TABLE_ DTCI_SBM_DTCFaultType 0 "Not Supported" 1 "Type A" 2 "Type B" 3 "Type C" ;
VAL_TABLE_ DTCI_SBM_TstNCmpltdOpCyc 0 "FALSE" 1 "TRUE" ;
VAL_TABLE_ DTCI_SBM_TstNCmpltdLstClr 0 "FALSE" 1 "TRUE" ;
VAL_TABLE_ DTCI_SBM_TstFldOpCyc 0 "FALSE" 1 "TRUE" ;
VAL_TABLE_ DTCI_SBM_TstFldLstClr 0 "FALSE" 1 "TRUE" ;
VAL_TABLE_ DTCI_SBM_TstFld 0 "FALSE" 1 "TRUE" ;
VAL_TABLE_ DTCI_SBM_PndngDTC 0 "FALSE" 1 "TRUE" ;
VAL_TABLE_ DTCI_SBM_DTCTriggered 0 "FALSE" 1 "TRUE" ;
VAL_TABLE_ DTCI_SBM_WrnIndTrggrd 0 "FALSE" 1 "TRUE" ;
VAL_TABLE_ DTCI_SBM_WrnIndRqd 0 "FALSE" 1 "TRUE" ;
VAL_TABLE_ DTCI_SBZA_L_CnfrmdDTC 0 "FALSE" 1 "TRUE" ;
VAL_TABLE_ DTCI_SBZA_L_DTCFaultType 0 "Not Supported" 1 "Type A" 2 "Type B" 3 "Type C" ;
VAL_TABLE_ DTCI_SBZA_L_TstNCmpltdOpCyc 0 "FALSE" 1 "TRUE" ;
VAL_TABLE_ DTCI_SBZA_L_TstNCmpltdLstClr 0 "FALSE" 1 "TRUE" ;
VAL_TABLE_ DTCI_SBZA_L_TstFldOpCyc 0 "FALSE" 1 "TRUE" ;
VAL_TABLE_ DTCI_SBZA_L_TstFldLstClr 0 "FALSE" 1 "TRUE" ;
VAL_TABLE_ DTCI_SBZA_L_TstFld 0 "FALSE" 1 "TRUE" ;
VAL_TABLE_ DTCI_SBZA_L_PndngDTC 0 "FALSE" 1 "TRUE" ;
VAL_TABLE_ DTCI_SBZA_L_DTCTriggered 0 "FALSE" 1 "TRUE" ;
VAL_TABLE_ DTCI_SBZA_L_WrnIndTrggrd 0 "FALSE" 1 "TRUE" ;
VAL_TABLE_ DTCI_SBZA_L_WrnIndRqd 0 "FALSE" 1 "TRUE" ;
VAL_TABLE_ DTCI_SBZA_R_CnfrmdDTC 0 "FALSE" 1 "TRUE" ;
VAL_TABLE_ DTCI_SBZA_R_DTCFaultType 0 "Not Supported" 1 "Type A" 2 "Type B" 3 "Type C" ;
VAL_TABLE_ DTCI_SBZA_R_TstNCmpltdOpCyc 0 "FALSE" 1 "TRUE" ;
VAL_TABLE_ DTCI_SBZA_R_TstNCmpltdLstClr 0 "FALSE" 1 "TRUE" ;
VAL_TABLE_ DTCI_SBZA_R_TstFldOpCyc 0 "FALSE" 1 "TRUE" ;
VAL_TABLE_ DTCI_SBZA_R_TstFldLstClr 0 "FALSE" 1 "TRUE" ;
VAL_TABLE_ DTCI_SBZA_R_TstFld 0 "FALSE" 1 "TRUE" ;
VAL_TABLE_ DTCI_SBZA_R_PndngDTC 0 "FALSE" 1 "TRUE" ;
VAL_TABLE_ DTCI_SBZA_R_DTCTriggered 0 "FALSE" 1 "TRUE" ;
VAL_TABLE_ DTCI_SBZA_R_WrnIndTrggrd 0 "FALSE" 1 "TRUE" ;
VAL_TABLE_ DTCI_SBZA_R_WrnIndRqd 0 "FALSE" 1 "TRUE" ;
VAL_TABLE_ DTCI_SCL_CnfrmdDTC 0 "FALSE" 1 "TRUE" ;
VAL_TABLE_ DTCI_SCL_DTCFaultType 0 "Not Supported" 1 "Type A" 2 "Type B" 3 "Type C" ;
VAL_TABLE_ DTCI_SCL_TstNCmpltdOpCyc 0 "FALSE" 1 "TRUE" ;
VAL_TABLE_ DTCI_SCL_TstNCmpltdLstClr 0 "FALSE" 1 "TRUE" ;
VAL_TABLE_ DTCI_SCL_TstFldOpCyc 0 "FALSE" 1 "TRUE" ;
VAL_TABLE_ DTCI_SCL_TstFldLstClr 0 "FALSE" 1 "TRUE" ;
VAL_TABLE_ DTCI_SCL_TstFld 0 "FALSE" 1 "TRUE" ;
VAL_TABLE_ DTCI_SCL_PndngDTC 0 "FALSE" 1 "TRUE" ;
VAL_TABLE_ DTCI_SCL_DTCTriggered 0 "FALSE" 1 "TRUE" ;
VAL_TABLE_ DTCI_SCL_WrnIndTrggrd 0 "FALSE" 1 "TRUE" ;
VAL_TABLE_ DTCI_SCL_WrnIndRqd 0 "FALSE" 1 "TRUE" ;
VAL_TABLE_ DTCI_SDM_CnfrmdDTC 0 "FALSE" 1 "TRUE" ;
VAL_TABLE_ DTCI_SDM_DTCFaultType 0 "Not Supported" 1 "Type A" 2 "Type B" 3 "Type C" ;
VAL_TABLE_ DTCI_SDM_TstNCmpltdOpCyc 0 "FALSE" 1 "TRUE" ;
VAL_TABLE_ DTCI_SDM_TstNCmpltdLstClr 0 "FALSE" 1 "TRUE" ;
VAL_TABLE_ DTCI_SDM_TstFldOpCyc 0 "FALSE" 1 "TRUE" ;
VAL_TABLE_ DTCI_SDM_TstFldLstClr 0 "FALSE" 1 "TRUE" ;
VAL_TABLE_ DTCI_SDM_TstFld 0 "FALSE" 1 "TRUE" ;
VAL_TABLE_ DTCI_SDM_PndngDTC 0 "FALSE" 1 "TRUE" ;
VAL_TABLE_ DTCI_SDM_DTCTriggered 0 "FALSE" 1 "TRUE" ;
VAL_TABLE_ DTCI_SDM_WrnIndTrggrd 0 "FALSE" 1 "TRUE" ;
VAL_TABLE_ DTCI_SDM_WrnIndRqd 0 "FALSE" 1 "TRUE" ;
VAL_TABLE_ DTCI_SIB_CnfrmdDTC 0 "FALSE" 1 "TRUE" ;
VAL_TABLE_ DTCI_SIB_DTCFaultType 0 "Not Supported" 1 "Type A" 2 "Type B" 3 "Type C" ;
VAL_TABLE_ DTCI_SIB_TstNCmpltdOpCyc 0 "FALSE" 1 "TRUE" ;
VAL_TABLE_ DTCI_SIB_TstNCmpltdLstClr 0 "FALSE" 1 "TRUE" ;
VAL_TABLE_ DTCI_SIB_TstFldOpCyc 0 "FALSE" 1 "TRUE" ;
VAL_TABLE_ DTCI_SIB_TstFldLstClr 0 "FALSE" 1 "TRUE" ;
VAL_TABLE_ DTCI_SIB_TstFld 0 "FALSE" 1 "TRUE" ;
VAL_TABLE_ DTCI_SIB_PndngDTC 0 "FALSE" 1 "TRUE" ;
VAL_TABLE_ DTCI_SIB_DTCTriggered 0 "FALSE" 1 "TRUE" ;
VAL_TABLE_ DTCI_SIB_WrnIndTrggrd 0 "FALSE" 1 "TRUE" ;
VAL_TABLE_ DTCI_SIB_WrnIndRqd 0 "FALSE" 1 "TRUE" ;
VAL_TABLE_ DTCI_SRR_LF_CnfrmdDTC 0 "FALSE" 1 "TRUE" ;
VAL_TABLE_ DTCI_SRR_LF_DTCFaultType 0 "Not Supported" 1 "Type A" 2 "Type B" 3 "Type C" ;
VAL_TABLE_ DTCI_SRR_LF_TstNCmpltdOpCyc 0 "FALSE" 1 "TRUE" ;
VAL_TABLE_ DTCI_SRR_LF_TstNCmpltdLstClr 0 "FALSE" 1 "TRUE" ;
VAL_TABLE_ DTCI_SRR_LF_TstFldOpCyc 0 "FALSE" 1 "TRUE" ;
VAL_TABLE_ DTCI_SRR_LF_TstFldLstClr 0 "FALSE" 1 "TRUE" ;
VAL_TABLE_ DTCI_SRR_LF_TstFld 0 "FALSE" 1 "TRUE" ;
VAL_TABLE_ DTCI_SRR_LF_PndngDTC 0 "FALSE" 1 "TRUE" ;
VAL_TABLE_ DTCI_SRR_LF_DTCTriggered 0 "FALSE" 1 "TRUE" ;
VAL_TABLE_ DTCI_SRR_LF_WrnIndTrggrd 0 "FALSE" 1 "TRUE" ;
VAL_TABLE_ DTCI_SRR_LF_WrnIndRqd 0 "FALSE" 1 "TRUE" ;
VAL_TABLE_ DTCI_SRR_LR_CR_CnfrmdDTC 0 "FALSE" 1 "TRUE" ;
VAL_TABLE_ DTCI_SRR_LR_CR_DTCFaultType 0 "Not Supported" 1 "Type A" 2 "Type B" 3 "Type C" ;
VAL_TABLE_ DTCI_SRR_LR_CR_TstNCmpltdOpCyc 0 "FALSE" 1 "TRUE" ;
VAL_TABLE_ DTCI_SRR_LR_CR_TstNCmpltdLstClr 0 "FALSE" 1 "TRUE" ;
VAL_TABLE_ DTCI_SRR_LR_CR_TstFldOpCyc 0 "FALSE" 1 "TRUE" ;
VAL_TABLE_ DTCI_SRR_LR_CR_TstFldLstClr 0 "FALSE" 1 "TRUE" ;
VAL_TABLE_ DTCI_SRR_LR_CR_TstFld 0 "FALSE" 1 "TRUE" ;
VAL_TABLE_ DTCI_SRR_LR_CR_PndngDTC 0 "FALSE" 1 "TRUE" ;
VAL_TABLE_ DTCI_SRR_LR_CR_DTCTriggered 0 "FALSE" 1 "TRUE" ;
VAL_TABLE_ DTCI_SRR_LR_CR_WrnIndTrggrd 0 "FALSE" 1 "TRUE" ;
VAL_TABLE_ DTCI_SRR_LR_CR_WrnIndRqd 0 "FALSE" 1 "TRUE" ;
VAL_TABLE_ DTCI_SRR_RF_CnfrmdDTC 0 "FALSE" 1 "TRUE" ;
VAL_TABLE_ DTCI_SRR_RF_DTCFaultType 0 "Not Supported" 1 "Type A" 2 "Type B" 3 "Type C" ;
VAL_TABLE_ DTCI_SRR_RF_TstNCmpltdOpCyc 0 "FALSE" 1 "TRUE" ;
VAL_TABLE_ DTCI_SRR_RF_TstNCmpltdLstClr 0 "FALSE" 1 "TRUE" ;
VAL_TABLE_ DTCI_SRR_RF_TstFldOpCyc 0 "FALSE" 1 "TRUE" ;
VAL_TABLE_ DTCI_SRR_RF_TstFldLstClr 0 "FALSE" 1 "TRUE" ;
VAL_TABLE_ DTCI_SRR_RF_TstFld 0 "FALSE" 1 "TRUE" ;
VAL_TABLE_ DTCI_SRR_RF_PndngDTC 0 "FALSE" 1 "TRUE" ;
VAL_TABLE_ DTCI_SRR_RF_DTCTriggered 0 "FALSE" 1 "TRUE" ;
VAL_TABLE_ DTCI_SRR_RF_WrnIndTrggrd 0 "FALSE" 1 "TRUE" ;
VAL_TABLE_ DTCI_SRR_RF_WrnIndRqd 0 "FALSE" 1 "TRUE" ;
VAL_TABLE_ DTCI_SRR_RR_CnfrmdDTC 0 "FALSE" 1 "TRUE" ;
VAL_TABLE_ DTCI_SRR_RR_DTCFaultType 0 "Not Supported" 1 "Type A" 2 "Type B" 3 "Type C" ;
VAL_TABLE_ DTCI_SRR_RR_TstNCmpltdOpCyc 0 "FALSE" 1 "TRUE" ;
VAL_TABLE_ DTCI_SRR_RR_TstNCmpltdLstClr 0 "FALSE" 1 "TRUE" ;
VAL_TABLE_ DTCI_SRR_RR_TstFldOpCyc 0 "FALSE" 1 "TRUE" ;
VAL_TABLE_ DTCI_SRR_RR_TstFldLstClr 0 "FALSE" 1 "TRUE" ;
VAL_TABLE_ DTCI_SRR_RR_TstFld 0 "FALSE" 1 "TRUE" ;
VAL_TABLE_ DTCI_SRR_RR_PndngDTC 0 "FALSE" 1 "TRUE" ;
VAL_TABLE_ DTCI_SRR_RR_DTCTriggered 0 "FALSE" 1 "TRUE" ;
VAL_TABLE_ DTCI_SRR_RR_WrnIndTrggrd 0 "FALSE" 1 "TRUE" ;
VAL_TABLE_ DTCI_SRR_RR_WrnIndRqd 0 "FALSE" 1 "TRUE" ;
VAL_TABLE_ DTCI_SRR_SLR_CnfrmdDTC 0 "FALSE" 1 "TRUE" ;
VAL_TABLE_ DTCI_SRR_SLR_DTCFaultType 0 "Not Supported" 1 "Type A" 2 "Type B" 3 "Type C" ;
VAL_TABLE_ DTCI_SRR_SLR_TstNCmpltdOpCyc 0 "FALSE" 1 "TRUE" ;
VAL_TABLE_ DTCI_SRR_SLR_TstNCmpltdLstClr 0 "FALSE" 1 "TRUE" ;
VAL_TABLE_ DTCI_SRR_SLR_TstFldOpCyc 0 "FALSE" 1 "TRUE" ;
VAL_TABLE_ DTCI_SRR_SLR_TstFldLstClr 0 "FALSE" 1 "TRUE" ;
VAL_TABLE_ DTCI_SRR_SLR_TstFld 0 "FALSE" 1 "TRUE" ;
VAL_TABLE_ DTCI_SRR_SLR_PndngDTC 0 "FALSE" 1 "TRUE" ;
VAL_TABLE_ DTCI_SRR_SLR_DTCTriggered 0 "FALSE" 1 "TRUE" ;
VAL_TABLE_ DTCI_SRR_SLR_WrnIndTrggrd 0 "FALSE" 1 "TRUE" ;
VAL_TABLE_ DTCI_SRR_SLR_WrnIndRqd 0 "FALSE" 1 "TRUE" ;
VAL_TABLE_ DTCI_SRR_SRR_CnfrmdDTC 0 "FALSE" 1 "TRUE" ;
VAL_TABLE_ DTCI_SRR_SRR_DTCFaultType 0 "Not Supported" 1 "Type A" 2 "Type B" 3 "Type C" ;
VAL_TABLE_ DTCI_SRR_SRR_TstNCmpltdOpCyc 0 "FALSE" 1 "TRUE" ;
VAL_TABLE_ DTCI_SRR_SRR_TstNCmpltdLstClr 0 "FALSE" 1 "TRUE" ;
VAL_TABLE_ DTCI_SRR_SRR_TstFldOpCyc 0 "FALSE" 1 "TRUE" ;
VAL_TABLE_ DTCI_SRR_SRR_TstFldLstClr 0 "FALSE" 1 "TRUE" ;
VAL_TABLE_ DTCI_SRR_SRR_TstFld 0 "FALSE" 1 "TRUE" ;
VAL_TABLE_ DTCI_SRR_SRR_PndngDTC 0 "FALSE" 1 "TRUE" ;
VAL_TABLE_ DTCI_SRR_SRR_DTCTriggered 0 "FALSE" 1 "TRUE" ;
VAL_TABLE_ DTCI_SRR_SRR_WrnIndTrggrd 0 "FALSE" 1 "TRUE" ;
VAL_TABLE_ DTCI_SRR_SRR_WrnIndRqd 0 "FALSE" 1 "TRUE" ;
VAL_TABLE_ DTCI_STC_CnfrmdDTC 0 "FALSE" 1 "TRUE" ;
VAL_TABLE_ DTCI_STC_DTCFaultType 0 "Not Supported" 1 "Type A" 2 "Type B" 3 "Type C" ;
VAL_TABLE_ DTCI_STC_TstNCmpltdOpCyc 0 "FALSE" 1 "TRUE" ;
VAL_TABLE_ DTCI_STC_TstNCmpltdLstClr 0 "FALSE" 1 "TRUE" ;
VAL_TABLE_ DTCI_STC_TstFldOpCyc 0 "FALSE" 1 "TRUE" ;
VAL_TABLE_ DTCI_STC_TstFldLstClr 0 "FALSE" 1 "TRUE" ;
VAL_TABLE_ DTCI_STC_TstFld 0 "FALSE" 1 "TRUE" ;
VAL_TABLE_ DTCI_STC_PndngDTC 0 "FALSE" 1 "TRUE" ;
VAL_TABLE_ DTCI_STC_DTCTriggered 0 "FALSE" 1 "TRUE" ;
VAL_TABLE_ DTCI_STC_WrnIndTrggrd 0 "FALSE" 1 "TRUE" ;
VAL_TABLE_ DTCI_STC_WrnIndRqd 0 "FALSE" 1 "TRUE" ;
VAL_TABLE_ DTCI_TCCM3_CnfrmdDTC 0 "FALSE" 1 "TRUE" ;
VAL_TABLE_ DTCI_TCCM3_DTCFaultType 0 "Not Supported" 1 "Type A" 2 "Type B" 3 "Type C" ;
VAL_TABLE_ DTCI_TCCM3_TstNCmpltdOpCyc 0 "FALSE" 1 "TRUE" ;
VAL_TABLE_ DTCI_TCCM3_TstNCmpltdLstClr 0 "FALSE" 1 "TRUE" ;
VAL_TABLE_ DTCI_TCCM3_TstFldOpCyc 0 "FALSE" 1 "TRUE" ;
VAL_TABLE_ DTCI_TCCM3_TstFldLstClr 0 "FALSE" 1 "TRUE" ;
VAL_TABLE_ DTCI_TCCM3_TstFld 0 "FALSE" 1 "TRUE" ;
VAL_TABLE_ DTCI_TCCM3_PndngDTC 0 "FALSE" 1 "TRUE" ;
VAL_TABLE_ DTCI_TCCM3_DTCTriggered 0 "FALSE" 1 "TRUE" ;
VAL_TABLE_ DTCI_TCCM3_WrnIndTrggrd 0 "FALSE" 1 "TRUE" ;
VAL_TABLE_ DTCI_TCCM3_WrnIndRqd 0 "FALSE" 1 "TRUE" ;
VAL_TABLE_ DTCI_TCCM_CnfrmdDTC 0 "FALSE" 1 "TRUE" ;
VAL_TABLE_ DTCI_TCCM_DTCFaultType 0 "Not Supported" 1 "Type A" 2 "Type B" 3 "Type C" ;
VAL_TABLE_ DTCI_TCCM_TstNCmpltdOpCyc 0 "FALSE" 1 "TRUE" ;
VAL_TABLE_ DTCI_TCCM_TstNCmpltdLstClr 0 "FALSE" 1 "TRUE" ;
VAL_TABLE_ DTCI_TCCM_TstFldOpCyc 0 "FALSE" 1 "TRUE" ;
VAL_TABLE_ DTCI_TCCM_TstFldLstClr 0 "FALSE" 1 "TRUE" ;
VAL_TABLE_ DTCI_TCCM_TstFld 0 "FALSE" 1 "TRUE" ;
VAL_TABLE_ DTCI_TCCM_PndngDTC 0 "FALSE" 1 "TRUE" ;
VAL_TABLE_ DTCI_TCCM_DTCTriggered 0 "FALSE" 1 "TRUE" ;
VAL_TABLE_ DTCI_TCCM_WrnIndTrggrd 0 "FALSE" 1 "TRUE" ;
VAL_TABLE_ DTCI_TCCM_WrnIndRqd 0 "FALSE" 1 "TRUE" ;
VAL_TABLE_ DTCI_TCM_CnfrmdDTC 0 "FALSE" 1 "TRUE" ;
VAL_TABLE_ DTCI_TCM_DTCFaultType 0 "Not Supported" 1 "Type A" 2 "Type B" 3 "Type C" ;
VAL_TABLE_ DTCI_TCM_TstNCmpltdOpCyc 0 "FALSE" 1 "TRUE" ;
VAL_TABLE_ DTCI_TCM_TstNCmpltdLstClr 0 "FALSE" 1 "TRUE" ;
VAL_TABLE_ DTCI_TCM_TstFldOpCyc 0 "FALSE" 1 "TRUE" ;
VAL_TABLE_ DTCI_TCM_TstFldLstClr 0 "FALSE" 1 "TRUE" ;
VAL_TABLE_ DTCI_TCM_TstFld 0 "FALSE" 1 "TRUE" ;
VAL_TABLE_ DTCI_TCM_PndngDTC 0 "FALSE" 1 "TRUE" ;
VAL_TABLE_ DTCI_TCM_DTCTriggered 0 "FALSE" 1 "TRUE" ;
VAL_TABLE_ DTCI_TCM_WrnIndTrggrd 0 "FALSE" 1 "TRUE" ;
VAL_TABLE_ DTCI_TCM_WrnIndRqd 0 "FALSE" 1 "TRUE" ;
VAL_TABLE_ DTCI_TCP_CnfrmdDTC 0 "FALSE" 1 "TRUE" ;
VAL_TABLE_ DTCI_TCP_DTCFaultType 0 "Not Supported" 1 "Type A" 2 "Type B" 3 "Type C" ;
VAL_TABLE_ DTCI_TCP_TstNCmpltdOpCyc 0 "FALSE" 1 "TRUE" ;
VAL_TABLE_ DTCI_TCP_TstNCmpltdLstClr 0 "FALSE" 1 "TRUE" ;
VAL_TABLE_ DTCI_TCP_TstFldOpCyc 0 "FALSE" 1 "TRUE" ;
VAL_TABLE_ DTCI_TCP_TstFldLstClr 0 "FALSE" 1 "TRUE" ;
VAL_TABLE_ DTCI_TCP_TstFld 0 "FALSE" 1 "TRUE" ;
VAL_TABLE_ DTCI_TCP_PndngDTC 0 "FALSE" 1 "TRUE" ;
VAL_TABLE_ DTCI_TCP_DTCTriggered 0 "FALSE" 1 "TRUE" ;
VAL_TABLE_ DTCI_TCP_WrnIndTrggrd 0 "FALSE" 1 "TRUE" ;
VAL_TABLE_ DTCI_TCP_WrnIndRqd 0 "FALSE" 1 "TRUE" ;
VAL_TABLE_ DTCI_TIM_CnfrmdDTC 0 "FALSE" 1 "TRUE" ;
VAL_TABLE_ DTCI_TIM_DTCFaultType 0 "Not Supported" 1 "Type A" 2 "Type B" 3 "Type C" ;
VAL_TABLE_ DTCI_TIM_TstNCmpltdOpCyc 0 "FALSE" 1 "TRUE" ;
VAL_TABLE_ DTCI_TIM_TstNCmpltdLstClr 0 "FALSE" 1 "TRUE" ;
VAL_TABLE_ DTCI_TIM_TstFldOpCyc 0 "FALSE" 1 "TRUE" ;
VAL_TABLE_ DTCI_TIM_TstFldLstClr 0 "FALSE" 1 "TRUE" ;
VAL_TABLE_ DTCI_TIM_TstFld 0 "FALSE" 1 "TRUE" ;
VAL_TABLE_ DTCI_TIM_PndngDTC 0 "FALSE" 1 "TRUE" ;
VAL_TABLE_ DTCI_TIM_DTCTriggered 0 "FALSE" 1 "TRUE" ;
VAL_TABLE_ DTCI_TIM_WrnIndTrggrd 0 "FALSE" 1 "TRUE" ;
VAL_TABLE_ DTCI_TIM_WrnIndRqd 0 "FALSE" 1 "TRUE" ;
VAL_TABLE_ DTCI_UVM_CnfrmdDTC 0 "FALSE" 1 "TRUE" ;
VAL_TABLE_ DTCI_UVM_DTCFaultType 0 "Not Supported" 1 "Type A" 2 "Type B" 3 "Type C" ;
VAL_TABLE_ DTCI_UVM_TstNCmpltdOpCyc 0 "FALSE" 1 "TRUE" ;
VAL_TABLE_ DTCI_UVM_TstNCmpltdLstClr 0 "FALSE" 1 "TRUE" ;
VAL_TABLE_ DTCI_UVM_TstFldOpCyc 0 "FALSE" 1 "TRUE" ;
VAL_TABLE_ DTCI_UVM_TstFldLstClr 0 "FALSE" 1 "TRUE" ;
VAL_TABLE_ DTCI_UVM_TstFld 0 "FALSE" 1 "TRUE" ;
VAL_TABLE_ DTCI_UVM_PndngDTC 0 "FALSE" 1 "TRUE" ;
VAL_TABLE_ DTCI_UVM_DTCTriggered 0 "FALSE" 1 "TRUE" ;
VAL_TABLE_ DTCI_UVM_WrnIndTrggrd 0 "FALSE" 1 "TRUE" ;
VAL_TABLE_ DTCI_UVM_WrnIndRqd 0 "FALSE" 1 "TRUE" ;
VAL_TABLE_ DTCI_VKM_CnfrmdDTC 0 "FALSE" 1 "TRUE" ;
VAL_TABLE_ DTCI_VKM_DTCFaultType 0 "Not Supported" 1 "Type A" 2 "Type B" 3 "Type C" ;
VAL_TABLE_ DTCI_VKM_TstNCmpltdOpCyc 0 "FALSE" 1 "TRUE" ;
VAL_TABLE_ DTCI_VKM_TstNCmpltdLstClr 0 "FALSE" 1 "TRUE" ;
VAL_TABLE_ DTCI_VKM_TstFldOpCyc 0 "FALSE" 1 "TRUE" ;
VAL_TABLE_ DTCI_VKM_TstFldLstClr 0 "FALSE" 1 "TRUE" ;
VAL_TABLE_ DTCI_VKM_TstFld 0 "FALSE" 1 "TRUE" ;
VAL_TABLE_ DTCI_VKM_PndngDTC 0 "FALSE" 1 "TRUE" ;
VAL_TABLE_ DTCI_VKM_DTCTriggered 0 "FALSE" 1 "TRUE" ;
VAL_TABLE_ DTCI_VKM_WrnIndTrggrd 0 "FALSE" 1 "TRUE" ;
VAL_TABLE_ DTCI_VKM_WrnIndRqd 0 "FALSE" 1 "TRUE" ;
VAL_TABLE_ DTCI_VLM_CnfrmdDTC 0 "FALSE" 1 "TRUE" ;
VAL_TABLE_ DTCI_VLM_DTCFaultType 0 "Not Supported" 1 "Type A" 2 "Type B" 3 "Type C" ;
VAL_TABLE_ DTCI_VLM_TstNCmpltdOpCyc 0 "FALSE" 1 "TRUE" ;
VAL_TABLE_ DTCI_VLM_TstNCmpltdLstClr 0 "FALSE" 1 "TRUE" ;
VAL_TABLE_ DTCI_VLM_TstFldOpCyc 0 "FALSE" 1 "TRUE" ;
VAL_TABLE_ DTCI_VLM_TstFldLstClr 0 "FALSE" 1 "TRUE" ;
VAL_TABLE_ DTCI_VLM_TstFld 0 "FALSE" 1 "TRUE" ;
VAL_TABLE_ DTCI_VLM_PndngDTC 0 "FALSE" 1 "TRUE" ;
VAL_TABLE_ DTCI_VLM_DTCTriggered 0 "FALSE" 1 "TRUE" ;
VAL_TABLE_ DTCI_VLM_WrnIndTrggrd 0 "FALSE" 1 "TRUE" ;
VAL_TABLE_ DTCI_VLM_WrnIndRqd 0 "FALSE" 1 "TRUE" ;
VAL_TABLE_ DTCI_VPM_CnfrmdDTC 0 "FALSE" 1 "TRUE" ;
VAL_TABLE_ DTCI_VPM_DTCFaultType 0 "Not Supported" 1 "Type A" 2 "Type B" 3 "Type C" ;
VAL_TABLE_ DTCI_VPM_TstNCmpltdOpCyc 0 "FALSE" 1 "TRUE" ;
VAL_TABLE_ DTCI_VPM_TstNCmpltdLstClr 0 "FALSE" 1 "TRUE" ;
VAL_TABLE_ DTCI_VPM_TstFldOpCyc 0 "FALSE" 1 "TRUE" ;
VAL_TABLE_ DTCI_VPM_TstFldLstClr 0 "FALSE" 1 "TRUE" ;
VAL_TABLE_ DTCI_VPM_TstFld 0 "FALSE" 1 "TRUE" ;
VAL_TABLE_ DTCI_VPM_PndngDTC 0 "FALSE" 1 "TRUE" ;
VAL_TABLE_ DTCI_VPM_DTCTriggered 0 "FALSE" 1 "TRUE" ;
VAL_TABLE_ DTCI_VPM_WrnIndTrggrd 0 "FALSE" 1 "TRUE" ;
VAL_TABLE_ DTCI_VPM_WrnIndRqd 0 "FALSE" 1 "TRUE" ;
VAL_TABLE_ DTCI_WCM_CnfrmdDTC 0 "FALSE" 1 "TRUE" ;
VAL_TABLE_ DTCI_WCM_DTCFaultType 0 "Not Supported" 1 "Type A" 2 "Type B" 3 "Type C" ;
VAL_TABLE_ DTCI_WCM_TstNCmpltdOpCyc 0 "FALSE" 1 "TRUE" ;
VAL_TABLE_ DTCI_WCM_TstNCmpltdLstClr 0 "FALSE" 1 "TRUE" ;
VAL_TABLE_ DTCI_WCM_TstFldOpCyc 0 "FALSE" 1 "TRUE" ;
VAL_TABLE_ DTCI_WCM_TstFldLstClr 0 "FALSE" 1 "TRUE" ;
VAL_TABLE_ DTCI_WCM_TstFld 0 "FALSE" 1 "TRUE" ;
VAL_TABLE_ DTCI_WCM_PndngDTC 0 "FALSE" 1 "TRUE" ;
VAL_TABLE_ DTCI_WCM_DTCTriggered 0 "FALSE" 1 "TRUE" ;
VAL_TABLE_ DTCI_WCM_WrnIndTrggrd 0 "FALSE" 1 "TRUE" ;
VAL_TABLE_ DTCI_WCM_WrnIndRqd 0 "FALSE" 1 "TRUE" ;
VAL_TABLE_ DDIP_SecAxl4WDAWDNonEmMlfIOAuth 0 "FALSE" 1 "TRUE" ;
VAL_TABLE_ DDIP_SecAxl4WDAWDTmpInhbIOAuth 0 "FALSE" 1 "TRUE" ;
VAL_TABLE_ DDIP_4AndAllWhlDrvIndReqAuth 0 "No Indication" 1 "Two Wheel Drive High Pending" 2 "Two Wheel Drive High Active" 3 "Four Wheel Drive High Auto Pending" 4 "Four Wheel Drive High Auto Active" 5 "Four Wheel Drive High Lock Pending" 6 "Four Wheel Drive High Lock Active" 7 "Four Wheel Drive Low Lock Pending" 8 "Four Wheel Drive Low Lock Active" 9 "Transfer Case Neutral Pending" 10 "Transfer Case Neutral Active" 11 "Position Undetermined Active" 12 "AWD Connected Mode Pending" 13 "AWD Connected Mode Active" 14 "Front Wheel Drive Mode Pending" 15 "Front Wheel Drive Mode Active" ;
VAL_TABLE_ ElecMtrASpd_Inv 0 "FALSE" 1 "TRUE" ;
VAL_TABLE_ ESRSDP_ElecShftRngSecDispAuth 0 "No Display" 1 "Park Nominal" 2 "Reverse Nominal" 3 "Neutral Nominal" 4 "Drive Nominal" 5 "Low Nominal" 6 "Manual Nominal" 7 "Park Requested And In Progress" 8 "Reverse Requested And In Progress" 9 "Neutral Requested And In Progress" 10 "Drive Requested And In Progress" 11 "Manual Requested And In Progress" 12 "Park Requested And Denied" ;
VAL_TABLE_ ESCLP_StrgColLckdIndOnAuth 0 "FALSE" 1 "TRUE" ;
VAL_TABLE_ ESCLP_ServColLckIndOnAuth 0 "FALSE" 1 "TRUE" ;
VAL_TABLE_ ESCLP_ElecStrgColLckStsAuth 0 "Locked" 1 "Inbetween" 2 "Unlocked" 3 "Unknown" ;
VAL_TABLE_ EngActStdyStTrq_Inv 0 "FALSE" 1 "TRUE" ;
VAL_TABLE_ DslGlwPlgIO 0 "FALSE" 1 "TRUE" ;
VAL_TABLE_ ArbdEngTemp_Inv 0 "FALSE" 1 "TRUE" ;
VAL_TABLE_ ESVTSP_EnhdSrvsVhTpSpLimReqAuth 0 "No Action" 1 "Active" 2 "Inactive" ;
VAL_TABLE_ FTPP_FrtCmptAjrWrnIndOnAuth 0 "FALSE" 1 "TRUE" ;
VAL_TABLE_ FTPP_FrtCmptFaildToOpnIndOnAuth 0 "FALSE" 1 "TRUE" ;
VAL_TABLE_ FTPP_TirePresLoIndOnAuth 0 "FALSE" 1 "TRUE" ;
VAL_TABLE_ FTPP_TirePrsRFAuth_Inv 0 "FALSE" 1 "TRUE" ;
VAL_TABLE_ FTPP_TirePrsLFAuth_Inv 0 "FALSE" 1 "TRUE" ;
VAL_TABLE_ FTPP_ServWprSysCtlIndOnAuth 0 "FALSE" 1 "TRUE" ;
VAL_TABLE_ GPSQM_PPSAbsVelErrEst_Inv 0 "FALSE" 1 "TRUE" ;
VAL_TABLE_ GPSQM_PPSMode 0 "GNSS Standalone" 1 "GNSS and SBAS" 2 "GNSS and RTX" 3 "GNSS and DR" 4 "GNSS and SBAS and DR" 5 "GNSS and RTX and DR" 6 "DR ONLY" 7 "GNSS and RTX and DR and MM" ;
VAL_TABLE_ GPSQM_PPSPstnDilutnPrcsn_Inv 0 "FALSE" 1 "TRUE" ;
VAL_TABLE_ GPSQM_PPS2DAbsPstnErrEst_Inv 0 "FALSE" 1 "TRUE" ;
VAL_TABLE_ GPSQM_PPSMode_Inv 0 "FALSE" 1 "TRUE" ;
VAL_TABLE_ GPSQM_PPS3DAbsPstnErrEst_Inv 0 "FALSE" 1 "TRUE" ;
VAL_TABLE_ GPSC_PPSLat_Inv 0 "FALSE" 1 "TRUE" ;
VAL_TABLE_ GPSC_PPSLong_Inv 0 "FALSE" 1 "TRUE" ;
VAL_TABLE_ GPST_PPSCldrYr_Inv 0 "FALSE" 1 "TRUE" ;
VAL_TABLE_ GPST_PPSCldrDy_Inv 0 "FALSE" 1 "TRUE" ;
VAL_TABLE_ GPST_PPSTmOfDy_Inv 0 "FALSE" 1 "TRUE" ;
VAL_TABLE_ GPSV_PPSElvtn_Inv 0 "FALSE" 1 "TRUE" ;
VAL_TABLE_ GPSV_PPSCalcdSpd_Inv 0 "FALSE" 1 "TRUE" ;
VAL_TABLE_ GPSV_PPSHdg_Inv 0 "FALSE" 1 "TRUE" ;
VAL_TABLE_ FrtRdHgtGPSCstAvlbltyFlg7 0 "FALSE" 1 "TRUE" ;
VAL_TABLE_ FrtRdHgtGPSCstAvlbltyFlg6 0 "FALSE" 1 "TRUE" ;
VAL_TABLE_ FrtRdHgtGPSCstAvlbltyFlg5 0 "FALSE" 1 "TRUE" ;
VAL_TABLE_ FrtRdHgtGPSCstAvlbltyFlg4 0 "FALSE" 1 "TRUE" ;
VAL_TABLE_ FrtRdHgtGPSCstAvlbltyFlg3 0 "FALSE" 1 "TRUE" ;
VAL_TABLE_ FrtRdHgtGPSCstAvlbltyFlg2 0 "FALSE" 1 "TRUE" ;
VAL_TABLE_ FrtRdHgtGPSCstAvlbltyFlg1 0 "FALSE" 1 "TRUE" ;
VAL_TABLE_ APAWI_WrnIndReq 0 "OFF" 1 "SEARCHING_PARALLEL_RIGHT" 2 "SEARCHING_PARALLEL_LEFT" 3 "SEARCHING_CROSS_RIGHT" 4 "SEARCHING_CROSS_LEFT" 5 "SPOT_FOUND" 6 "SPOT_FOUND_PARALLEL_LEFT" 7 "SPOT_FOUND_CROSS_LEFT" 8 "SPOT_FOUND_PARALLEL_RIGHT" 9 "SPOT_FOUND_CROSS_RIGHT" 10 "MOVE_AHEAD" 11 "MOVE_AHEAD_PARALLEL_LEFT" 12 "MOVE_AHEAD_CROSS_LEFT" 13 "MOVE_AHEAD_PARALLEL_RIGHT" 14 "MOVE_AHEAD_CROSS_RIGHT" 15 "STOP_AND_R_PARALLEL_LEFT" 16 "STOP_AND_R_CROSS_BACK_LEFT" 17 "STOP_AND_R_CROSS_FRONT_LEFT" 18 "STOP_AND_R_PARALLEL_RIGHT" 19 "STOP_AND_R_CROSS_BACK_RIGHT" 20 "STOP_AND_R_CROSS_FRONT_RIGHT" 21 "SEARCH_SPEED_WARNING" 22 "SEARCH_DEACTIVATED" 23 "EXIT_PARK_TO_LEFT" 24 "EXIT_PARK_TO_RIGHT" 25 "SELECT_DRIVE_GEAR" 26 "AUTO_STEERING_ACTIVE" 27 "AUTO_PARKING_ACTIVE" 28 "DRIVE_BACKWARD" 29 "BACKWARD_MOVE" 30 "DRIVE_FORWARD" 31 "FORWARD_MOVE" 32 "STOP" 33 "SHIFTING" 34 "POSITION_REACHED" 35 "TAKE_CONTROL" 36 "PARKING_COMPLETE" 37 "EXIT_PARK_COMPLETE" 38 "DEACTIVATED" 39 "CANCELED_GENERAL" 40 "CANCELED_MOVES" 41 "CANCELED_SPEED" 42 "CANCELED_INTERFERENCE" 43 "CANCELED_EXIT_PARK" 44 "STOPPING" 45 "AUTO_PARKING_COMPLETE" 46 "RELEASE_BRAKE" 47 "RESERVED_01" 48 "RESERVED_02" 49 "RESERVED_03" 50 "RESERVED_04" 51 "RESERVED_05" 52 "RESERVED_06" 53 "RESERVED_07" 54 "RESERVED_08" 55 "RESERVED_09" ;
VAL_TABLE_ APAWI_AutoStrgIconReq 0 "NO_ICON" 1 "ACTIVE" 2 "DEACTIVATED" ;
VAL_TABLE_ APAWI_FcsReq 0 "NO_REQUEST" 1 "FOCUS_REQUEST_IPC" 2 "FOCUS_REQUEST_CSM" ;
VAL_TABLE_ APALftSftBtnRqst 0 "HIDDEN" 1 "DISABLED" 2 "ENABLED" 3 "HIGHLIGHTED" ;
VAL_TABLE_ APAExtPrkSftBtnRqst 0 "HIDDEN" 1 "DISABLED" 2 "ENABLED" 3 "HIGHLIGHTED" ;
VAL_TABLE_ APACrssFrntInSftBtnRqst 0 "HIDDEN" 1 "DISABLED" 2 "ENABLED" 3 "HIGHLIGHTED" ;
VAL_TABLE_ APACrssBckInSftBtnRqst 0 "HIDDEN" 1 "DISABLED" 2 "ENABLED" 3 "HIGHLIGHTED" ;
VAL_TABLE_ APAVMR_NAvalIndOn 0 "FALSE" 1 "TRUE" ;
VAL_TABLE_ APAVMR_SloDnIndOn 0 "FALSE" 1 "TRUE" ;
VAL_TABLE_ APASrchSftBtnRqst 0 "HIDDEN" 1 "DISABLED" 2 "ENABLED" 3 "HIGHLIGHTED" ;
VAL_TABLE_ APARghtSftBtnRqst 0 "HIDDEN" 1 "DISABLED" 2 "ENABLED" 3 "HIGHLIGHTED" ;
VAL_TABLE_ APAPrllPrkSftBtnRqst 0 "HIDDEN" 1 "DISABLED" 2 "ENABLED" 3 "HIGHLIGHTED" ;
VAL_TABLE_ DM2Name 0 "None" 1 "Tour" 2 "Sport" 3 "Track" 4 "Winter" 5 "Off Road" 6 "Tow/Haul" 7 "Hold" 8 "Mountain" 9 "Personal" 10 "Custom" 11 "AWD" 12 "Economy" 13 "Automatic" 14 "EV" 15 "grade braking" 16 "exhaust brake" 17 "active rev match" 18 "2WD" 19 "Comfort" 20 "start/stop disable" 21 "Crawl" 22 "Charge Plus" 23 "Reserved 1 - Reserved 9" ;
VAL_TABLE_ DM1Name 0 "None" 1 "Tour" 2 "Sport" 3 "Track" 4 "Winter" 5 "Off Road" 6 "Tow/Haul" 7 "Hold" 8 "Mountain" 9 "Personal" 10 "Custom" 11 "AWD" 12 "Economy" 13 "Automatic" 14 "EV" 15 "grade braking" 16 "exhaust brake" 17 "active rev match" 18 "2WD" 19 "Comfort" 20 "start/stop disable" 21 "Crawl" 22 "Charge Plus" 23 "Reserved 1 - Reserved 9" ;
VAL_TABLE_ DM4Name 0 "None" 1 "Tour" 2 "Sport" 3 "Track" 4 "Winter" 5 "Off Road" 6 "Tow/Haul" 7 "Hold" 8 "Mountain" 9 "Personal" 10 "Custom" 11 "AWD" 12 "Economy" 13 "Automatic" 14 "EV" 15 "grade braking" 16 "exhaust brake" 17 "active rev match" 18 "2WD" 19 "Comfort" 20 "start/stop disable" 21 "Crawl" 22 "Charge Plus" 23 "Reserved 1 - Reserved 9" ;
VAL_TABLE_ DM3Name 0 "None" 1 "Tour" 2 "Sport" 3 "Track" 4 "Winter" 5 "Off Road" 6 "Tow/Haul" 7 "Hold" 8 "Mountain" 9 "Personal" 10 "Custom" 11 "AWD" 12 "Economy" 13 "Automatic" 14 "EV" 15 "grade braking" 16 "exhaust brake" 17 "active rev match" 18 "2WD" 19 "Comfort" 20 "start/stop disable" 21 "Crawl" 22 "Charge Plus" 23 "Reserved 1 - Reserved 9" ;
VAL_TABLE_ DM5Name 0 "None" 1 "Tour" 2 "Sport" 3 "Track" 4 "Winter" 5 "Off Road" 6 "Tow/Haul" 7 "Hold" 8 "Mountain" 9 "Personal" 10 "Custom" 11 "AWD" 12 "Economy" 13 "Automatic" 14 "EV" 15 "grade braking" 16 "exhaust brake" 17 "active rev match" 18 "2WD" 19 "Comfort" 20 "start/stop disable" 21 "Crawl" 22 "Charge Plus" 23 "Reserved 1 - Reserved 9" ;
VAL_TABLE_ DM7Name 0 "None" 1 "Tour" 2 "Sport" 3 "Track" 4 "Winter" 5 "Off Road" 6 "Tow/Haul" 7 "Hold" 8 "Mountain" 9 "Personal" 10 "Custom" 11 "AWD" 12 "Economy" 13 "Automatic" 14 "EV" 15 "grade braking" 16 "exhaust brake" 17 "active rev match" 18 "2WD" 19 "Comfort" 20 "start/stop disable" 21 "Crawl" 22 "Charge Plus" 23 "Reserved 1 - Reserved 9" ;
VAL_TABLE_ DM6Name 0 "None" 1 "Tour" 2 "Sport" 3 "Track" 4 "Winter" 5 "Off Road" 6 "Tow/Haul" 7 "Hold" 8 "Mountain" 9 "Personal" 10 "Custom" 11 "AWD" 12 "Economy" 13 "Automatic" 14 "EV" 15 "grade braking" 16 "exhaust brake" 17 "active rev match" 18 "2WD" 19 "Comfort" 20 "start/stop disable" 21 "Crawl" 22 "Charge Plus" 23 "Reserved 1 - Reserved 9" ;
VAL_TABLE_ DM8Name 0 "None" 1 "Tour" 2 "Sport" 3 "Track" 4 "Winter" 5 "Off Road" 6 "Tow/Haul" 7 "Hold" 8 "Mountain" 9 "Personal" 10 "Custom" 11 "AWD" 12 "Economy" 13 "Automatic" 14 "EV" 15 "grade braking" 16 "exhaust brake" 17 "active rev match" 18 "2WD" 19 "Comfort" 20 "start/stop disable" 21 "Crawl" 22 "Charge Plus" 23 "Reserved 1 - Reserved 9" ;
VAL_TABLE_ DM6Status 0 "Inactive" 1 "Active" ;
VAL_TABLE_ DM5Status 0 "Inactive" 1 "Active" ;
VAL_TABLE_ DM4Status 0 "Inactive" 1 "Active" ;
VAL_TABLE_ DM3Status 0 "Inactive" 1 "Active" ;
VAL_TABLE_ DM2Status 0 "Inactive" 1 "Active" ;
VAL_TABLE_ DM1Status 0 "Inactive" 1 "Active" ;
VAL_TABLE_ EngCmptAjr 0 "FALSE" 1 "TRUE" ;
VAL_TABLE_ EngCmptAjr_Inv 0 "FALSE" 1 "TRUE" ;
VAL_TABLE_ FrtStrgeCmptAjr 0 "FALSE" 1 "TRUE" ;
VAL_TABLE_ DM8Status 0 "Inactive" 1 "Active" ;
VAL_TABLE_ DM7Status 0 "Inactive" 1 "Active" ;
VAL_TABLE_ BrkPadLifeFrt_Inv 0 "FALSE" 1 "TRUE" ;
VAL_TABLE_ BrkPadLifeRr_Inv 0 "FALSE" 1 "TRUE" ;
VAL_TABLE_ ElecPrkBrkSysDisIndReq 0 "OFF" 1 "ALERT_1" 2 "ALERT_2" 3 "ALERT_3" 4 "ALERT_4" 5 "ALERT_5" 6 "ALERT_6" 7 "ALERT_7" ;
VAL_TABLE_ EPBStpOnBrkToRelPrkBrkIndReq 0 "OFF" 1 "ON" 2 "0.5_Hz" 3 "1_Hz" 4 "2_Hz" 5 "4_Hz" 6 "RESERVED_1" 7 "RESERVED_2" ;
VAL_TABLE_ BrkPadLifeStsIndReq 0 "No Action" 1 "Not Present" 2 "Ok" 3 "Change Soon" 4 "Change Now" 5 "Disabled" 6 "Service" ;
VAL_TABLE_ AutoHldDsbldDrOpnIndOn 0 "FALSE" 1 "TRUE" ;
VAL_TABLE_ AutoHldAppBrkPedIndOn 0 "FALSE" 1 "TRUE" ;
VAL_TABLE_ AutoHldActv 0 "FALSE" 1 "TRUE" ;
VAL_TABLE_ ABSActvIndOn 0 "FALSE" 1 "TRUE" ;
VAL_TABLE_ PerfMdMainMenuTy 0 "No_Action" 1 "Main Menu Type 1" 2 "Main Menu Type 2" 3 "Main Menu Type 3" 4 "Main Menu Type 4" 5 "Main Menu Type 5" 6 "Main Menu Type 6" 7 "Main Menu Type 7" ;
VAL_TABLE_ ESCOffIO 0 "FALSE" 1 "TRUE" ;
VAL_TABLE_ ESCInitIO 0 "FALSE" 1 "TRUE" ;
VAL_TABLE_ ESCCmptMdIO 0 "FALSE" 1 "TRUE" ;
VAL_TABLE_ BrkPadWrnIO 0 "FALSE" 1 "TRUE" ;
VAL_TABLE_ BrkPadLifeRrRstAval 0 "FALSE" 1 "TRUE" ;
VAL_TABLE_ BrkPadLifeFrtRstAval 0 "FALSE" 1 "TRUE" ;
VAL_TABLE_ AutoHldServIndOn 0 "FALSE" 1 "TRUE" ;
VAL_TABLE_ AutoHldDsbldStBltIndOn 0 "FALSE" 1 "TRUE" ;
VAL_TABLE_ TrlrStbAsstActIO 0 "FALSE" 1 "TRUE" ;
VAL_TABLE_ SrvESCMdIO 0 "FALSE" 1 "TRUE" ;
VAL_TABLE_ ServTracCtlIndOn 0 "FALSE" 1 "TRUE" ;
VAL_TABLE_ HillStrtAstActIO 0 "FALSE" 1 "TRUE" ;
VAL_TABLE_ HillRollCntrlActIO 0 "FALSE" 1 "TRUE" ;
VAL_TABLE_ ESCPrfMdIO 0 "FALSE" 1 "TRUE" ;
VAL_TABLE_ VehStbEnhcmntCustAv 0 "FALSE" 1 "TRUE" ;
VAL_TABLE_ VehStbEnhcmntCurStat 0 "On" 1 "Off" ;
VAL_TABLE_ VehStbCompMdCustAv 0 "FALSE" 1 "TRUE" ;
VAL_TABLE_ VehStbCompMdCurStat 0 "On" 1 "Off" ;
VAL_TABLE_ FllwgTmDsplyMd 0 "NO DISPLAY" 1 "DEFAULT" 2 "NORMAL" 3 "LESS THAN MINIMUM" 4 "GREATER THAN MAXIMUM" ;
VAL_TABLE_ AdpAndCnvntlCruzCtlIndReq 0 "No Action" 1 "Cruise Control and Adaptive Cruise Control Telltale Off" 2 "Cruise Control Unavailable Telltale On" 3 "Cruise Control White Telltale On" 4 "Cruise Control Green Telltale On" 5 "Cruise Control Blue Telltale On" 6 "Adaptive Cruise Control Unavailable Telltale On" 7 "Adaptive Cruise Control White Telltale On" 8 "Adaptive Cruise Control Green Telltale On" 9 "Adaptive Cruise Control Blue Telltale On" ;
VAL_TABLE_ LtAstStsIndRq 0 "No Indication" 1 "Off" 2 "LDW" 3 "LKA" 4 "HoLF" ;
VAL_TABLE_ FCAGpSet 0 "FAR" 1 "MEDIUM" 2 "NEAR" 3 "OFF" 4 "UNKNOWN" 5 "FAULTED" ;
VAL_TABLE_ LAOA_LatAsstLDWOptAval 0 "FALSE" 1 "TRUE" ;
VAL_TABLE_ LAOA_LatAsstHoLFOptAval 0 "FALSE" 1 "TRUE" ;
VAL_TABLE_ LAOA_LatAsstLKAOptAval 0 "FALSE" 1 "TRUE" ;
VAL_TABLE_ LAOA_LatAsstOffOptAval 0 "FALSE" 1 "TRUE" ;
VAL_TABLE_ PdWrnIndRqst 0 "OFF" 1 "PEDESTRIAN ADVISORY" 2 "PEDESTRIAN ALERT" 3 "RESERVED" ;
VAL_TABLE_ FrwdHdwyVisIndCtl 0 "FCA" 1 "ACC" 2 "None" ;
VAL_TABLE_ ACCHdwySttng 0 "FAR" 1 "MEDIUM" 2 "NEAR" ;
VAL_TABLE_ FCA_ACCGapSetIndOn 0 "FALSE" 1 "TRUE" ;
VAL_TABLE_ ACCTmpUnvIndOn 0 "FALSE" 1 "TRUE" ;
VAL_TABLE_ ACCSysSlctdMdDspIndOn 0 "FALSE" 1 "TRUE" ;
VAL_TABLE_ ACCShftToPrkBfrExIndOn 0 "FALSE" 1 "TRUE" ;
VAL_TABLE_ ACCRtSpdAdVsIndOn 0 "FALSE" 1 "TRUE" ;
VAL_TABLE_ ACCHdwySttngIndOn 0 "FALSE" 1 "TRUE" ;
VAL_TABLE_ ACCDsngIndOn 0 "FALSE" 1 "TRUE" ;
VAL_TABLE_ ACCDrSlctdSpdIndOn 0 "FALSE" 1 "TRUE" ;
VAL_TABLE_ LnKpAsstUnAvIndOn 0 "FALSE" 1 "TRUE" ;
VAL_TABLE_ LnDprtrWrngUnAvIndOn 0 "FALSE" 1 "TRUE" ;
VAL_TABLE_ FrwdClsnSysIndOn 0 "FALSE" 1 "TRUE" ;
VAL_TABLE_ FrwdCllsnSysUnIndOn 0 "FALSE" 1 "TRUE" ;
VAL_TABLE_ FrwdCllsnSysRdIndOn 0 "FALSE" 1 "TRUE" ;
VAL_TABLE_ FrwdCllsnSysOffIndOn 0 "FALSE" 1 "TRUE" ;
VAL_TABLE_ FrwdCllsnAlrtOffIndOn 0 "FALSE" 1 "TRUE" ;
VAL_TABLE_ FrtPedtrnBrkgWrnIndOn 0 "FALSE" 1 "TRUE" ;
VAL_TABLE_ TnDrvGapAdjUnvIndOn 0 "FALSE" 1 "TRUE" ;
VAL_TABLE_ TeenDrvrLnDprtrWrnOffUnvIndOn 0 "FALSE" 1 "TRUE" ;
VAL_TABLE_ SrvFrwdCllsnSysIndOn 0 "FALSE" 1 "TRUE" ;
VAL_TABLE_ HVACTCR_RrDfgSet 0 "NoAction" 1 "RearDefogOFF" 2 "RearDefogON" ;
VAL_TABLE_ HVACTCR_RecircSet 0 "NoAction" 1 "FreshAir" 2 "Recirc" ;
VAL_TABLE_ HVACTCR_AirDstLtSet 0 "NoAction" 1 "Auto" 2 "Floor" 3 "FloorAndVent" 4 "Vent" 5 "VentAndWindshield" 6 "Windshield" 7 "FloorAndWindshield" 8 "FloorAndVentAndWindshield" ;
VAL_TABLE_ HVACTCR_CompSet 0 "NoAction" 1 "COMP_OFF" 2 "COMP_ON" 3 "COMP_ECON" ;
VAL_TABLE_ HVACTCR_TempFrtLtLvlActv 0 "FALSE" 1 "TRUE" ;
VAL_TABLE_ HVACTCR_AirDstRtSet 0 "NoAction" 1 "Auto" 2 "Floor" 3 "FloorAndVent" 4 "Vent" 5 "VentAndWindshield" 6 "Windshield" 7 "FloorAndWindshield" 8 "FloorAndVentAndWindshield" ;
VAL_TABLE_ HVACTCR_TempFrtRtLvlActv 0 "FALSE" 1 "TRUE" ;
VAL_TABLE_ HVACTCR_RmtClmCtlReqingSets 0 "Active" 1 "Inactive" ;
VAL_TABLE_ HVACTCR_FrtAutoSetChg 0 "FALSE" 1 "TRUE" ;
VAL_TABLE_ HVACTCR_PwrSet 0 "NoAction" 1 "FrontOFF_RearOFF" 2 "FrontON_RearON" 3 "FrontON_RearOFF" 4 "FrontOFF_RearON" ;
VAL_TABLE_ HVACTCR_SyncSet 0 "NoAction" 1 "SYNC_all" 2 "UnSYNC_all" 3 "SYNC_RearToDriver" 4 "UnSYNC_RearToDriver" ;
VAL_TABLE_ HVACTCR_MaxDefrSet 0 "NoAction" 1 "MaxDefrostOff" 2 "MaxDefrostOn" ;
VAL_TABLE_ RmtTrlrLtngSeqReq 0 "No Action" 1 "Off" 2 "On" ;
VAL_TABLE_ HVACTCR_BlwLvlFrtActv 0 "FALSE" 1 "TRUE" ;
VAL_TABLE_ TeleAlrmVisReq 0 "NO_ACTION" 1 "ACTIVE" 2 "CANCEL_FLASH" ;
VAL_TABLE_ TeleAlrmHrnReq 0 "NO_ACTION" 1 "ACTIVE" 2 "CANCEL_HORN" ;
VAL_TABLE_ LnCntrCntrlIndRqst 0 "Indication Off" 1 "White Indicator" 2 "Green Indicator" 3 "Yellow Indicator" 4 "Red Indicator" 5 "Blue Indicator" ;
VAL_TABLE_ LnCntrCnvMsgIndRqst 0 "No Indication" 1 "Behind Slow Vehicle" 2 "Being Passed on Left" 3 "Being Passed on Right" 4 "Tailgater Detected" 5 "Left Blind Spot Occupied" 6 "Right Blind Spot Occupied" 7 "Heavy Traffic" 8 "Merging Vehicle" 9 "Slow Moving Traffic in Left Lane" 10 "Slow Moving Traffic Ahead" 11 "Slow Moving Traffic in Right Lane" 12 "Major Road Interchange Ahead" 13 "Road Exit Detected Ahead" 14 "Exit Only Lane Ahead" 15 "Lane Ending Ahead" 16 "Road Detour Detected" 17 "Take Time to Look at Road" 18 "Show Fuel Level" 19 "Show Fuel Range Normal" 20 "Show Fuel Range Low" 21 "Take Steering Active With Muting" ;
VAL_TABLE_ SrvDvrAsstSystVslMsgRqstOn 0 "FALSE" 1 "TRUE" ;
VAL_TABLE_ LnCntrArrwBlck5Act 0 "FALSE" 1 "TRUE" ;
VAL_TABLE_ LnCntrArrwBlck4Act 0 "FALSE" 1 "TRUE" ;
VAL_TABLE_ LnCntrArrwBlck3Act 0 "FALSE" 1 "TRUE" ;
VAL_TABLE_ LnCntrArrwBlck2Act 0 "FALSE" 1 "TRUE" ;
VAL_TABLE_ LnCntrArrwBlck1Act 0 "FALSE" 1 "TRUE" ;
VAL_TABLE_ LnCntrSpchPrmtReq 0 "No Prompt" 1 "Take Steering" 2 "Take Vehicle Control" ;
VAL_TABLE_ ReqAirDstRRRr 0 "NoAction" 1 "Auto" 2 "Floor" 3 "FloorAndVent" 4 "Vent" 5 "VentAndRoof" 6 "Roof" 7 "RoofAndFloor" 8 "FloorAndVentAndRoof" ;
VAL_TABLE_ ReqAirDstRLRr 0 "NoAction" 1 "Auto" 2 "Floor" 3 "FloorAndVent" 4 "Vent" 5 "VentAndRoof" 6 "Roof" 7 "RoofAndFloor" 8 "FloorAndVentAndRoof" ;
VAL_TABLE_ ReqAirDstChgNxtRLRr 0 "FALSE" 1 "TRUE" ;
VAL_TABLE_ RrAirHandlingDrActrPwrFdbk 0 "No Action" 1 "Power Off" 2 "Power On" ;
VAL_TABLE_ RrHVACCtrlInitFin 0 "FALSE" 1 "TRUE" ;
VAL_TABLE_ ReqTmpLvlRRAtvRr 0 "FALSE" 1 "TRUE" ;
VAL_TABLE_ ReqTmpLvlRLAtvRr 0 "FALSE" 1 "TRUE" ;
VAL_TABLE_ ReqSYNC_RrChgRr 0 "FALSE" 1 "TRUE" ;
VAL_TABLE_ ReqRrHVAC_PwrChgRr 0 "FALSE" 1 "TRUE" ;
VAL_TABLE_ ReqRrAutoRr 0 "FALSE" 1 "TRUE" ;
VAL_TABLE_ ReqBlwLvlRrAtvRr 0 "FALSE" 1 "TRUE" ;
VAL_TABLE_ ReqAirDstChgNxtRRRr 0 "FALSE" 1 "TRUE" ;
VAL_TABLE_ TSMEurDispSgn2Mn 0 "UnKnown" 1 "No Sign Detected" 2 "End of Speed Limit" 3 "End of All Restrictions" 4 "Begin of Motorway" 5 "End of Motorway" 6 "Begin of Expressway" 7 "End of Expressway" 8 "Begin of Play Street Zone" 9 "End of Play Street Zone" 10 "Begin of Passing Restriction" 11 "End of Passing Restriction" 12 "No Entry" 13 "Begin of City Limits" 14 "End of City Limits" 15 "Speed Limit 5" 16 "Speed Limit 10" 17 "Speed Limit 15" 18 "Speed Limit 20" 19 "Speed Limit 25" 20 "Speed Limit 30" 21 "Speed Limit 35" 22 "Speed Limit 40" 23 "Speed Limit 45" 24 "Speed Limit 50" 25 "Speed Limit 55" 26 "Speed Limit 60" 27 "Speed Limit 65" 28 "Speed Limit 70" 29 "Speed Limit 75" 30 "Speed Limit 80" 31 "Speed Limit 85" 32 "Speed Limit 90" 33 "Speed Limit 95" 34 "Speed Limit 100" 35 "Speed Limit 105" 36 "Speed Limit 110" 37 "Speed Limit 115" 38 "Speed Limit 120" 39 "Speed Limit 125" 40 "Speed Limit 130" 41 "Speed Limit 135" 42 "Speed Limit 140" 43 "Speed Limit 145" 44 "Speed Limit 150" 45 "Speed Limit 155" 46 "Speed Limit 160" 47 "Speed Limit 165" 48 "Speed Limit 170" 49 "Speed Limit 175" 50 "Speed Limit 180" 51 "Speed Limit 185" 52 "Speed Limit 190" 53 "Speed Limit 195" 54 "Speed Limit 200" ;
VAL_TABLE_ TSMEurDispSgn1Mn 0 "UnKnown" 1 "No Sign Detected" 2 "End of Speed Limit" 3 "End of All Restrictions" 4 "Begin of Motorway" 5 "End of Motorway" 6 "Begin of Expressway" 7 "End of Expressway" 8 "Begin of Play Street Zone" 9 "End of Play Street Zone" 10 "Begin of Passing Restriction" 11 "End of Passing Restriction" 12 "No Entry" 13 "Begin of City Limits" 14 "End of City Limits" 15 "Speed Limit 5" 16 "Speed Limit 10" 17 "Speed Limit 15" 18 "Speed Limit 20" 19 "Speed Limit 25" 20 "Speed Limit 30" 21 "Speed Limit 35" 22 "Speed Limit 40" 23 "Speed Limit 45" 24 "Speed Limit 50" 25 "Speed Limit 55" 26 "Speed Limit 60" 27 "Speed Limit 65" 28 "Speed Limit 70" 29 "Speed Limit 75" 30 "Speed Limit 80" 31 "Speed Limit 85" 32 "Speed Limit 90" 33 "Speed Limit 95" 34 "Speed Limit 100" 35 "Speed Limit 105" 36 "Speed Limit 110" 37 "Speed Limit 115" 38 "Speed Limit 120" 39 "Speed Limit 125" 40 "Speed Limit 130" 41 "Speed Limit 135" 42 "Speed Limit 140" 43 "Speed Limit 145" 44 "Speed Limit 150" 45 "Speed Limit 155" 46 "Speed Limit 160" 47 "Speed Limit 165" 48 "Speed Limit 170" 49 "Speed Limit 175" 50 "Speed Limit 180" 51 "Speed Limit 185" 52 "Speed Limit 190" 53 "Speed Limit 195" 54 "Speed Limit 200" ;
VAL_TABLE_ TSMUSAndCADispSgn1Mn 0 "UnKnown" 1 "No Sign Detected" 2 "Begin of Passing Restriction US" 3 "End of Passing Restriction US" 4 "Begin of Passing Restriction Canada" 5 "End of Passing Restriction Canada" 6 "Speed Limit 5" 7 "Speed Limit 10" 8 "Speed Limit 15" 9 "Speed Limit 20" 10 "Speed Limit 25" 11 "Speed Limit 30" 12 "Speed Limit 35" 13 "Speed Limit 40" 14 "Speed Limit 45" 15 "Speed Limit 50" 16 "Speed Limit 55" 17 "Speed Limit 60" 18 "Speed Limit 65" 19 "Speed Limit 70" 20 "Speed Limit 75" 21 "Speed Limit 80" 22 "Speed Limit 85" 23 "Speed Limit 90" 24 "Speed Limit 95" 25 "Speed Limit 100" 26 "Speed Limit 105" 27 "Speed Limit 110" 28 "Speed Limit 115" 29 "Speed Limit 120" 30 "Speed Limit 125" 31 "Speed Limit 130" 32 "Speed Limit 135" 33 "Speed Limit 140" 34 "Speed Limit 145" 35 "Speed Limit 150" 36 "Speed Limit 155" 37 "Speed Limit 160" 38 "Speed Limit 165" 39 "Speed Limit 170" 40 "Speed Limit 175" 41 "Speed Limit 180" 42 "Speed Limit 185" 43 "Speed Limit 190" 44 "Speed Limit 195" 45 "Speed Limit 200" ;
VAL_TABLE_ TSMUSAndCADispSgn2Mn 0 "UnKnown" 1 "No Sign Detected" 2 "Begin of Passing Restriction US" 3 "End of Passing Restriction US" 4 "Begin of Passing Restriction Canada" 5 "End of Passing Restriction Canada" 6 "Speed Limit 5" 7 "Speed Limit 10" 8 "Speed Limit 15" 9 "Speed Limit 20" 10 "Speed Limit 25" 11 "Speed Limit 30" 12 "Speed Limit 35" 13 "Speed Limit 40" 14 "Speed Limit 45" 15 "Speed Limit 50" 16 "Speed Limit 55" 17 "Speed Limit 60" 18 "Speed Limit 65" 19 "Speed Limit 70" 20 "Speed Limit 75" 21 "Speed Limit 80" 22 "Speed Limit 85" 23 "Speed Limit 90" 24 "Speed Limit 95" 25 "Speed Limit 100" 26 "Speed Limit 105" 27 "Speed Limit 110" 28 "Speed Limit 115" 29 "Speed Limit 120" 30 "Speed Limit 125" 31 "Speed Limit 130" 32 "Speed Limit 135" 33 "Speed Limit 140" 34 "Speed Limit 145" 35 "Speed Limit 150" 36 "Speed Limit 155" 37 "Speed Limit 160" 38 "Speed Limit 165" 39 "Speed Limit 170" 40 "Speed Limit 175" 41 "Speed Limit 180" 42 "Speed Limit 185" 43 "Speed Limit 190" 44 "Speed Limit 195" 45 "Speed Limit 200" ;
VAL_TABLE_ TSMEurDispSgn2AddOn 0 "UnKnown" 1 "None" 2 "Supp Sign Generic" 3 "Rain" 4 "Snow" 5 "Snow Rain" 6 "Rain Cloud" 7 "Fog" 8 "Time" 9 "Wet Conditions" 10 "Trailer" 11 "Tractor Passable" 12 "Arrow Left" 13 "Arrow Right" 14 "Distance Arrow" 15 "School" ;
VAL_TABLE_ TSMEurDispSgn1AddOn 0 "UnKnown" 1 "None" 2 "Supp Sign Generic" 3 "Rain" 4 "Snow" 5 "Snow Rain" 6 "Rain Cloud" 7 "Fog" 8 "Time" 9 "Wet Conditions" 10 "Trailer" 11 "Tractor Passable" 12 "Arrow Left" 13 "Arrow Right" 14 "Distance Arrow" 15 "School" ;
VAL_TABLE_ FrwdVsFlDtcnIndOn 0 "FALSE" 1 "TRUE" ;
VAL_TABLE_ FrwdVsAdvWthrIndOn 0 "FALSE" 1 "TRUE" ;
VAL_TABLE_ TSMUSAndCADispSgn2AddOn 0 "None" 1 "Supp Sign Generic" 2 "School" 3 "School When Flashing" 4 "End of Speed Limit" 5 "Where Workers Present" ;
VAL_TABLE_ TSMUSAndCADispSgn1AddOn 0 "None" 1 "Supp Sign Generic" 2 "School" 3 "School When Flashing" 4 "End of Speed Limit" 5 "Where Workers Present" ;
VAL_TABLE_ TrffcLgtAsstHUDWrnIndOn 0 "FALSE" 1 "TRUE" ;
VAL_TABLE_ TrffcLgtAsstClstrWrnIndOn 0 "FALSE" 1 "TRUE" ;
VAL_TABLE_ TSMSgnNtfnIndOn 0 "FALSE" 1 "TRUE" ;
VAL_TABLE_ TSMPDAMnSgnFlshgReq 0 "FALSE" 1 "TRUE" ;
VAL_TABLE_ TSMNoEntryIndOn 0 "FALSE" 1 "TRUE" ;
VAL_TABLE_ TSMIcePsblIndOn 0 "FALSE" 1 "TRUE" ;
VAL_TABLE_ TSMAddTrfSgnAvIndOn 0 "FALSE" 1 "TRUE" ;
VAL_TABLE_ FrwdVsFllBlckIndOn 0 "FALSE" 1 "TRUE" ;
VAL_TABLE_ TrffcLgtAsstRLADWrnIndOn 0 "FALSE" 1 "TRUE" ;
VAL_TABLE_ FrtRdHgtGPSCstCurrSetVal 0 "SETTING_UNKNOWN" 1 "OFF" 2 "ON" 3 "RESERVED_3" 4 "RESERVED_4" 5 "RESERVED_5" 6 "RESERVED_6" 7 "RESERVED_7" ;
VAL_TABLE_ FrtRdHgtGPSCstSetAval 0 "FALSE" 1 "TRUE" ;
VAL_TABLE_ EngIntkArBstPr_Inv 0 "FALSE" 1 "TRUE" ;
VAL_TABLE_ EngBstPrsInd_Inv 0 "FALSE" 1 "TRUE" ;
VAL_TABLE_ FlInjRlCtRstOcc 0 "FALSE" 1 "TRUE" ;
VAL_TABLE_ ADASIS_NAVILINK_DgtlMpEfSpdLm 0 "UNKNOWN" 1 "<= 5 KM/H [MPH]" 2 "7 KM/H [MPH]" 3 "10 KM/H [MPH]" 4 "15 KM/H [MPH]" 5 "20 KM/H [MPH]" 6 "25 KM/H [MPH]" 7 "30 KM/H [MPH]" 8 "35 KM/H [MPH]" 9 "40 KM/H [MPH]" 10 "45 KM/H [MPH]" 11 "50 KM/H [MPH]" 12 "55 KM/H [MPH]" 13 "60 KM/H" 14 "MPH]65 KM/H [MPH]" 15 "70 KM/H [MPH]" 16 "75 KM/H [MPH]" 17 "80 KM/H [MPH]" 18 "85 KM/H [MPH]" 19 "90 KM/H [MPH]" 20 "95 KM/H [MPH]" 21 "100 KM/H [MPH]" 22 "105 KM/H [MPH]" 23 "110 KM/H [MPH]" 24 "115 KM/H [MPH]" 25 "120 KM/H[MPH]" 26 "130 KM/H [MPH]" 27 "140 KM/H [MPH]" 28 "150 KM/H [MPH]" 29 "160 KM/H [MPH]" 30 "UNLIMITED" 31 "NOT AVAILABLE" ;
VAL_TABLE_ ADASIS_NAVILINK_CntryCd 0 "AD" 1 "AT" 2 "BE" 3 "CZ" 4 "DK" 5 "EE" 6 "FR" 7 "DE" 8 "GR" 9 "HU" 10 "IE" 11 "IT" 12 "BY" 13 "BG" 14 "CY" 15 "MT" 16 "HR" 17 "TR" 18 "RS" 19 "ME" 20 "LV" 21 "LT" 22 "LU" 23 "NL" 24 "NO" 25 "PL" 26 "PT" 27 "UK" 28 "SK" 29 "SI" 30 "ES" 31 "SE" 32 "CH" 33 "RO" 34 "RU" 35 "UA" 36 "BA" 37 "AL" 38 "MD" 39 "IS" 40 "MK" 41 "US" 42 "ZA" 43 "AU" 44 "NZ" 45 "KR" 46 "CN" ;
VAL_TABLE_ ADASIS_NAVILINK_DigMpCndlSpdLmt 0 "UNKNOWN" 1 "<= 5 KM/H [MPH]" 2 "7 KM/H [MPH]" 3 "10 KM/H [MPH]" 4 "15 KM/H [MPH]" 5 "20 KM/H [MPH]" 6 "25 KM/H [MPH]" 7 "30 KM/H [MPH]" 8 "35 KM/H [MPH]" 9 "40 KM/H [MPH]" 10 "45 KM/H [MPH]" 11 "50 KM/H [MPH]" 12 "55 KM/H [MPH]" 13 "60 KM/H" 14 "MPH]65 KM/H [MPH]" 15 "70 KM/H [MPH]" 16 "75 KM/H [MPH]" 17 "80 KM/H [MPH]" 18 "85 KM/H [MPH]" 19 "90 KM/H [MPH]" 20 "95 KM/H [MPH]" 21 "100 KM/H [MPH]" 22 "105 KM/H [MPH]" 23 "110 KM/H [MPH]" 24 "115 KM/H [MPH]" 25 "120 KM/H[MPH]" 26 "130 KM/H [MPH]" 27 "140 KM/H [MPH]" 28 "150 KM/H [MPH]" 29 "160 KM/H [MPH]" 30 "UNLIMITED" 31 "NOT AVAILABLE" ;
VAL_TABLE_ ADASIS_NAVILINK_DgtlMpSpdCtgry 0 "> 130 KPH OR > 80 MPH" 1 "101-130 KPH OR 65\???80 MPH" 2 "91-100 KPH OR 55\???64 MPH" 3 "71-90 KPH OR 41\???54 MPH" 4 "51-70 KPH OR 31\???40 MPH" 5 "31-50 KPH OR 21\???30 MPH" 6 "11-30 KPH OR 6 \???20 MPH" 7 "<11 KPH OR < 6 MPH" 8 "UNKNOWN" ;
VAL_TABLE_ ADASIS_NAVILINK_DgtlMpPsngRst 0 "NO PASSING RESTRICTIONS" 1 "GENERAL NO OVERTAKE" 2 "FLUCTUATING (E.G. LED SIGNS)" 3 "CONDITIONAL PASSENGER CAR WITH TRAILER" 4 "CONDITIONAL TRACTORS ARE ALLOWED TO OVERTAKE" 5 "CONDITIONAL WHEN WET" 6 "CONDITIONAL WHEN SNOW" 7 "UNKNOWN CONDITION" ;
VAL_TABLE_ ADASIS_NAVILINK_DigMpEfSpdLmTyp 0 "IMPLICIT" 1 "ON TRAFFIC SIGN" 2 "ONLY BY NIGHT" 3 "ONLY BY DAY" 4 "TIME OF DAY" 5 "ONLY BY RAIN" 6 "ONLY BY SNOW OR FOG" 7 "UNKOWN" ;
VAL_TABLE_ ADASIS_NAVILINK_DgMpCnSpdLmTyp 0 "LANE DEPENDENT" 1 "ONLY BY FOG" 2 "ONLY BY NIGHT" 3 "ONLY BY DAY" 4 "BY TIME OF DAY" 5 "ONLY BY RAIN" 6 "ONLY BY SNOW" 7 "UNKNOWN" ;
VAL_TABLE_ ADASIS_NAVILINK_DigMpPstSpdLmAs 0 "NOT ASSURED" 1 "ASSURED" ;
VAL_TABLE_ ADASIS_NAVILINK_DigMpDrvngSd 0 "DRIVING SIDE LEFT" 1 "DRIVING SIDE RIGHT" ;
VAL_TABLE_ ADASIS_NAVILINK_CntrldAccssRd 0 "ROAD IS NOT CONTROLLED ACCESS ROAD" 1 "ROAD IS CONTROLLED ACCESS ROAD" ;
VAL_TABLE_ ADASIS_NAVILINK_BldUpFlg 0 "NOT VALID" 1 "VALID" ;
VAL_TABLE_ CustMdDrvlCstmCurSetVal 0 "SETTING_UNKNOWN" 1 "CUSTOM_MODE_1" 2 "CUSTOM_MODE_2" 3 "CUSTOM_MODE_3" 4 "CUSTOM_MODE_4" 5 "CUSTOM_MODE_5" 6 "CUSTOM_MODE_6" 7 "CUSTOM_MODE_7" ;
VAL_TABLE_ CustMdBrkPdlCstmCurSetVal 0 "SETTING_UNKNOWN" 1 "CUSTOM_MODE_1" 2 "CUSTOM_MODE_2" 3 "CUSTOM_MODE_3" 4 "CUSTOM_MODE_4" 5 "CUSTOM_MODE_5" 6 "CUSTOM_MODE_6" 7 "CUSTOM_MODE_7" ;
VAL_TABLE_ CustMdActAeroCstmCurSetVal 0 "SETTING_UNKNOWN" 1 "CUSTOM_MODE_1" 2 "CUSTOM_MODE_2" 3 "CUSTOM_MODE_3" 4 "CUSTOM_MODE_4" 5 "CUSTOM_MODE_5" 6 "CUSTOM_MODE_6" 7 "CUSTOM_MODE_7" ;
VAL_TABLE_ CustMdRideHghtCstmCurSetVal 0 "SETTING_UNKNOWN" 1 "CUSTOM_MODE_1" 2 "CUSTOM_MODE_2" 3 "CUSTOM_MODE_3" 4 "CUSTOM_MODE_4" 5 "CUSTOM_MODE_5" 6 "CUSTOM_MODE_6" 7 "CUSTOM_MODE_7" ;
VAL_TABLE_ CustMdPTCstmPndSetVal 0 "SETTING_UNKNOWN" 1 "CUSTOM_MODE_1" 2 "CUSTOM_MODE_2" 3 "CUSTOM_MODE_3" 4 "CUSTOM_MODE_4" 5 "CUSTOM_MODE_5" 6 "CUSTOM_MODE_6" 7 "CUSTOM_MODE_7" ;
VAL_TABLE_ CustMdPTCstmCurSetVal 0 "SETTING_UNKNOWN" 1 "CUSTOM_MODE_1" 2 "CUSTOM_MODE_2" 3 "CUSTOM_MODE_3" 4 "CUSTOM_MODE_4" 5 "CUSTOM_MODE_5" 6 "CUSTOM_MODE_6" 7 "CUSTOM_MODE_7" ;
VAL_TABLE_ CustMdSpnCstmCurSetVal 0 "SETTING_UNKNOWN" 1 "CUSTOM_MODE_1" 2 "CUSTOM_MODE_2" 3 "CUSTOM_MODE_3" 4 "CUSTOM_MODE_4" 5 "CUSTOM_MODE_5" 6 "CUSTOM_MODE_6" 7 "CUSTOM_MODE_7" ;
VAL_TABLE_ CustMdSndCstmCurSetVal 0 "SETTING_UNKNOWN" 1 "CUSTOM_MODE_1" 2 "CUSTOM_MODE_2" 3 "CUSTOM_MODE_3" 4 "CUSTOM_MODE_4" 5 "CUSTOM_MODE_5" 6 "CUSTOM_MODE_6" 7 "CUSTOM_MODE_7" ;
VAL_TABLE_ CustMdBrkPdlCstmSetAv 0 "FALSE" 1 "TRUE" ;
VAL_TABLE_ CustMdActAeroCstmSetAv 0 "FALSE" 1 "TRUE" ;
VAL_TABLE_ CustMdTrcStbCstmCurSetVal 0 "SETTING_UNKNOWN" 1 "CUSTOM_MODE_1" 2 "CUSTOM_MODE_2" 3 "CUSTOM_MODE_3" 4 "CUSTOM_MODE_4" 5 "CUSTOM_MODE_5" 6 "CUSTOM_MODE_6" 7 "CUSTOM_MODE_7" ;
VAL_TABLE_ CustMdStrCstmCurSetVal 0 "SETTING_UNKNOWN" 1 "CUSTOM_MODE_1" 2 "CUSTOM_MODE_2" 3 "CUSTOM_MODE_3" 4 "CUSTOM_MODE_4" 5 "CUSTOM_MODE_5" 6 "CUSTOM_MODE_6" 7 "CUSTOM_MODE_7" ;
VAL_TABLE_ CustMdTrcStbCstmSetAv 0 "FALSE" 1 "TRUE" ;
VAL_TABLE_ CustMdStrCstmSetAv 0 "FALSE" 1 "TRUE" ;
VAL_TABLE_ CustMdSpnCstmSetAv 0 "FALSE" 1 "TRUE" ;
VAL_TABLE_ CustMdSndCstmSetAv 0 "FALSE" 1 "TRUE" ;
VAL_TABLE_ CustMdRideHghtCstmSetAv 0 "FALSE" 1 "TRUE" ;
VAL_TABLE_ CustMdPTCstmSetAv 0 "FALSE" 1 "TRUE" ;
VAL_TABLE_ CustMdDrvlCstmSetAv 0 "FALSE" 1 "TRUE" ;
VAL_TABLE_ PrsnlMdActAeroCstmCurSetVal 0 "SETTING_UNKNOWN" 1 "PERSONAL_MODE_1" 2 "PERSONAL_MODE_2" 3 "PERSONAL_MODE_3" 4 "PERSONAL_MODE_4" 5 "PERSONAL_MODE_5" 6 "PERSONAL_MODE_6" 7 "PERSONAL_MODE_7" ;
VAL_TABLE_ ExtdHillStrtAstCustCurSetVal 0 "SETTING_UNKNOWN" 1 "EXTENDED_HOLD" 2 "STANDARD_HOLD" 3 "RESERVED_3" 4 "RESERVED_4" 5 "RESERVED_5" 6 "RESERVED_6" 7 "RESERVED_7" ;
VAL_TABLE_ DisPrfMdRq 0 "No Action" 1 "Normal" 2 "Tour" 3 "Sport" 4 "Track" 5 "Performance Mode 5" 6 "Performance Mode 6" 7 "Performance Mode 7" ;
VAL_TABLE_ PrsnlMdRideHghtCstmCurSetVal 0 "SETTING_UNKNOWN" 1 "PERSONAL_MODE_1" 2 "PERSONAL_MODE_2" 3 "PERSONAL_MODE_3" 4 "PERSONAL_MODE_4" 5 "PERSONAL_MODE_5" 6 "PERSONAL_MODE_6" 7 "PERSONAL_MODE_7" ;
VAL_TABLE_ PrsnlMdDrvlCstmCurSetVal 0 "SETTING_UNKNOWN" 1 "PERSONAL_MODE_1" 2 "PERSONAL_MODE_2" 3 "PERSONAL_MODE_3" 4 "PERSONAL_MODE_4" 5 "PERSONAL_MODE_5" 6 "PERSONAL_MODE_6" 7 "PERSONAL_MODE_7" ;

BA_DEF_ SG_  "SignalType" STRING ;
BA_DEF_ SG_  "SignalLongName" STRING ;
BA_DEF_ BO_  "GenMsgCycleTime" INT 0 10000;
BA_DEF_ BO_  "GenMsgSendType" ENUM "cyclicX","spontanX","cyclicIfActiveX","spontanWithDelay","cyclicAndSpontanX","cyclicAndSpontanWithDelay","spontanWithRepetition","cyclicIfActiveAndSpontanWD";
BA_DEF_DEF_  "SignalType" "";
BA_DEF_DEF_  "SignalLongName" "";
BA_DEF_DEF_  "GenMsgCycleTime" 0;
BA_DEF_DEF_  "GenMsgSendType" "cyclicX";
