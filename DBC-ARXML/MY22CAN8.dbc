VERSION ""

NS_ :

BS_:

BU_: WCM VPM VLM VKM UVM TIM TEST_TOOL_2 TEST_TOOL_1 TCP TCM TCCM3 TCCM STC SRR_SRR SRR_SLR SRR_RR SRR_RF SRR_LR_CR SRR_LF SIB SDM SCL SBZA_R SBZA_L SBM SADS RadioLow RSC RDCM PTM PDR PA NVM MTCM_R MTCM_L MSM_RR MSM_P MSM_LR MSM_D MSB2 MSB1 MRCM_R MRCM_L MFC LRR_HC LRR LIB1 IPC ICS_Info ICCM HVAC_FP_R HVAC_FP_F HUD_CAN HDLM FCM_LC FCM EPS EOCM_HCP2 EOCM_HCP1 EOCM ELM ECP_X1 ECP_MC ECP_E ECM EBCM DMS DEFC DCM CSM CMMb CMMa CGM BSM_MH BSM BCM ARS ARB APA AOS AMP ALC AHS AHL_AFL AGC
VAL_TABLE_ FrwdVsnBlkgSts 0 "UNKNOWN" 1 "NOT BLOCKED" 2 "FULL BLOCKAGE" 3 "PARTIAL BLOCKAGE" 4 "RESERVED3" 5 "RESERVED4" 6 "RESERVED5" 7 "RESERVED6" ;
VAL_TABLE_ FrwdVsnAdvWthrSts 0 "CLEAR WEATHER" 1 "LIGHT FOG" 2 "MEDIUM FOG" 3 "HEAVY FOG" 4 "LIGHT SNOW" 5 "MEDIUM SNOW" 6 "HEAVY SNOW" 7 "LIGHT RAIN" 8 "MEDIUM RAIN" 9 "HEAVY RAIN" ;
VAL_TABLE_ GlrFrHiBmSts 0 "OFF" 1 "AHBA" 2 "GFHB" ;
VAL_TABLE_ FrwdVsnRdTyp 0 "TOWN" 1 "COUNTRY ROAD" 2 "MOTORWAY" 3 "RESERVED1" 4 "RESERVED2" 5 "RESERVED3" 6 "RESERVED 4" 7 "UNDEFINED" ;
VAL_TABLE_ FrwdVsnEnvIllum 0 "UNKNOWN" 1 "LIT ENVIRONMENT DURING NIGHT" 2 "UNLIT ENVIRONMENT DURING NIGHT" 3 "DAYLIGHT" ;
VAL_TABLE_ AutoHgBmActReq 0 "FALSE" 1 "TRUE" ;
VAL_TABLE_ ALOI1_TypTk1 0 "UNKNOWN" 1 "4 WHEEL VEHICLE" 2 "LARGE VEHICLE" 3 "MOTORCYCLE/BICYCLE" 4 "PEDESTRIAN" 5 "FIXED OVERHEAD OBJECT" 6 "FIXED ROADSIDE OBJECT" 7 "NO OBJECT PRESENT" 8 "PEDESTRIAN STANDING OUTSIDE DANGER ZONE" 9 "PEDESTRIAN MOVING OUT OF DANGER ZONE" 10 "PEDESTRIAN MOVING INTO DANGER ZONE" 11 "CHILD CLOSE TO DANGER ZONE" 12 "CLUSTER OBJECT" ;
VAL_TABLE_ ALOI1_TypTk3 0 "UNKNOWN" 1 "4 WHEEL VEHICLE" 2 "LARGE VEHICLE" 3 "MOTORCYCLE/BICYCLE" 4 "PEDESTRIAN" 5 "FIXED OVERHEAD OBJECT" 6 "FIXED ROADSIDE OBJECT" 7 "NO OBJECT PRESENT" 8 "PEDESTRIAN STANDING OUTSIDE DANGER ZONE" 9 "PEDESTRIAN MOVING OUT OF DANGER ZONE" 10 "PEDESTRIAN MOVING INTO DANGER ZONE" 11 "CHILD CLOSE TO DANGER ZONE" 12 "CLUSTER OBJECT" ;
VAL_TABLE_ ALOI1_TypTk2 0 "UNKNOWN" 1 "4 WHEEL VEHICLE" 2 "LARGE VEHICLE" 3 "MOTORCYCLE/BICYCLE" 4 "PEDESTRIAN" 5 "FIXED OVERHEAD OBJECT" 6 "FIXED ROADSIDE OBJECT" 7 "NO OBJECT PRESENT" 8 "PEDESTRIAN STANDING OUTSIDE DANGER ZONE" 9 "PEDESTRIAN MOVING OUT OF DANGER ZONE" 10 "PEDESTRIAN MOVING INTO DANGER ZONE" 11 "CHILD CLOSE TO DANGER ZONE" 12 "CLUSTER OBJECT" ;
VAL_TABLE_ ALOI1_DirTk1 0 "Following" 1 "Oncoming" 2 "Following Goup" 3 "Oncoming Group" 4 "Unknown" ;
VAL_TABLE_ ALOI1_TypTk4 0 "UNKNOWN" 1 "4 WHEEL VEHICLE" 2 "LARGE VEHICLE" 3 "MOTORCYCLE/BICYCLE" 4 "PEDESTRIAN" 5 "FIXED OVERHEAD OBJECT" 6 "FIXED ROADSIDE OBJECT" 7 "NO OBJECT PRESENT" 8 "PEDESTRIAN STANDING OUTSIDE DANGER ZONE" 9 "PEDESTRIAN MOVING OUT OF DANGER ZONE" 10 "PEDESTRIAN MOVING INTO DANGER ZONE" 11 "CHILD CLOSE TO DANGER ZONE" 12 "CLUSTER OBJECT" ;
VAL_TABLE_ ALOI1_DirTk3 0 "Following" 1 "Oncoming" 2 "Following Goup" 3 "Oncoming Group" 4 "Unknown" ;
VAL_TABLE_ ALOI1_DirTk2 0 "Following" 1 "Oncoming" 2 "Following Goup" 3 "Oncoming Group" 4 "Unknown" ;
VAL_TABLE_ ALOI1_CnfdTk2 0 "Highly Speculative" 1 "Speculative" 2 "Confident" 3 "Highly Confident" ;
VAL_TABLE_ ALOI1_CnfdTk1 0 "Highly Speculative" 1 "Speculative" 2 "Confident" 3 "Highly Confident" ;
VAL_TABLE_ ALOI1_DirTk4 0 "Following" 1 "Oncoming" 2 "Following Goup" 3 "Oncoming Group" 4 "Unknown" ;
VAL_TABLE_ ALOI1_MeasStsTk2 0 "No Object" 1 "New Object" 2 "Latent Track Not Detected This Cycle" 3 "Measured This Cycle" ;
VAL_TABLE_ ALOI1_MeasStsTk1 0 "No Object" 1 "New Object" 2 "Latent Track Not Detected This Cycle" 3 "Measured This Cycle" ;
VAL_TABLE_ ALOI1_CnfdTk4 0 "Highly Speculative" 1 "Speculative" 2 "Confident" 3 "Highly Confident" ;
VAL_TABLE_ ALOI1_CnfdTk3 0 "Highly Speculative" 1 "Speculative" 2 "Confident" 3 "Highly Confident" ;
VAL_TABLE_ ALOI1_RltvLnTk2 0 "Unknown" 1 "Host Lane" 2 "Right Lane" 3 "Left Lane" ;
VAL_TABLE_ ALOI1_RltvLnTk1 0 "Unknown" 1 "Host Lane" 2 "Right Lane" 3 "Left Lane" ;
VAL_TABLE_ ALOI1_MeasStsTk4 0 "No Object" 1 "New Object" 2 "Latent Track Not Detected This Cycle" 3 "Measured This Cycle" ;
VAL_TABLE_ ALOI1_MeasStsTk3 0 "No Object" 1 "New Object" 2 "Latent Track Not Detected This Cycle" 3 "Measured This Cycle" ;
VAL_TABLE_ ALOI1_RngTk2_Inv 0 "FALSE" 1 "TRUE" ;
VAL_TABLE_ ALOI1_RngTk1_Inv 0 "FALSE" 1 "TRUE" ;
VAL_TABLE_ ALOI1_AcqTmStm_Inv 0 "FALSE" 1 "TRUE" ;
VAL_TABLE_ ALOI1_RltvLnTk4 0 "Unknown" 1 "Host Lane" 2 "Right Lane" 3 "Left Lane" ;
VAL_TABLE_ ALOI1_RltvLnTk3 0 "Unknown" 1 "Host Lane" 2 "Right Lane" 3 "Left Lane" ;
VAL_TABLE_ ALOI1_RngTk4_Inv 0 "FALSE" 1 "TRUE" ;
VAL_TABLE_ ALOI1_RngTk3_Inv 0 "FALSE" 1 "TRUE" ;
VAL_TABLE_ ALOI2_TypTk5 0 "UNKNOWN" 1 "4 WHEEL VEHICLE" 2 "LARGE VEHICLE" 3 "MOTORCYCLE/BICYCLE" 4 "PEDESTRIAN" 5 "FIXED OVERHEAD OBJECT" 6 "FIXED ROADSIDE OBJECT" 7 "NO OBJECT PRESENT" 8 "PEDESTRIAN STANDING OUTSIDE DANGER ZONE" 9 "PEDESTRIAN MOVING OUT OF DANGER ZONE" 10 "PEDESTRIAN MOVING INTO DANGER ZONE" 11 "CHILD CLOSE TO DANGER ZONE" 12 "CLUSTER OBJECT" ;
VAL_TABLE_ ALOI2_TypTk7 0 "UNKNOWN" 1 "4 WHEEL VEHICLE" 2 "LARGE VEHICLE" 3 "MOTORCYCLE/BICYCLE" 4 "PEDESTRIAN" 5 "FIXED OVERHEAD OBJECT" 6 "FIXED ROADSIDE OBJECT" 7 "NO OBJECT PRESENT" 8 "PEDESTRIAN STANDING OUTSIDE DANGER ZONE" 9 "PEDESTRIAN MOVING OUT OF DANGER ZONE" 10 "PEDESTRIAN MOVING INTO DANGER ZONE" 11 "CHILD CLOSE TO DANGER ZONE" 12 "CLUSTER OBJECT" ;
VAL_TABLE_ ALOI2_TypTk6 0 "UNKNOWN" 1 "4 WHEEL VEHICLE" 2 "LARGE VEHICLE" 3 "MOTORCYCLE/BICYCLE" 4 "PEDESTRIAN" 5 "FIXED OVERHEAD OBJECT" 6 "FIXED ROADSIDE OBJECT" 7 "NO OBJECT PRESENT" 8 "PEDESTRIAN STANDING OUTSIDE DANGER ZONE" 9 "PEDESTRIAN MOVING OUT OF DANGER ZONE" 10 "PEDESTRIAN MOVING INTO DANGER ZONE" 11 "CHILD CLOSE TO DANGER ZONE" 12 "CLUSTER OBJECT" ;
VAL_TABLE_ ALOI2_DirTk5 0 "Following" 1 "Oncoming" 2 "Following Goup" 3 "Oncoming Group" 4 "Unknown" ;
VAL_TABLE_ ALOI2_TypTk8 0 "UNKNOWN" 1 "4 WHEEL VEHICLE" 2 "LARGE VEHICLE" 3 "MOTORCYCLE/BICYCLE" 4 "PEDESTRIAN" 5 "FIXED OVERHEAD OBJECT" 6 "FIXED ROADSIDE OBJECT" 7 "NO OBJECT PRESENT" 8 "PEDESTRIAN STANDING OUTSIDE DANGER ZONE" 9 "PEDESTRIAN MOVING OUT OF DANGER ZONE" 10 "PEDESTRIAN MOVING INTO DANGER ZONE" 11 "CHILD CLOSE TO DANGER ZONE" 12 "CLUSTER OBJECT" ;
VAL_TABLE_ ALOI2_DirTk7 0 "Following" 1 "Oncoming" 2 "Following Goup" 3 "Oncoming Group" 4 "Unknown" ;
VAL_TABLE_ ALOI2_DirTk6 0 "Following" 1 "Oncoming" 2 "Following Goup" 3 "Oncoming Group" 4 "Unknown" ;
VAL_TABLE_ ALOI2_CnfdTk6 0 "Highly Speculative" 1 "Speculative" 2 "Confident" 3 "Highly Confident" ;
VAL_TABLE_ ALOI2_CnfdTk5 0 "Highly Speculative" 1 "Speculative" 2 "Confident" 3 "Highly Confident" ;
VAL_TABLE_ ALOI2_DirTk8 0 "Following" 1 "Oncoming" 2 "Following Goup" 3 "Oncoming Group" 4 "Unknown" ;
VAL_TABLE_ ALOI2_MeasStsTk6 0 "No Object" 1 "New Object" 2 "Latent Track Not Detected This Cycle" 3 "Measured This Cycle" ;
VAL_TABLE_ ALOI2_MeasStsTk5 0 "No Object" 1 "New Object" 2 "Latent Track Not Detected This Cycle" 3 "Measured This Cycle" ;
VAL_TABLE_ ALOI2_CnfdTk8 0 "Highly Speculative" 1 "Speculative" 2 "Confident" 3 "Highly Confident" ;
VAL_TABLE_ ALOI2_CnfdTk7 0 "Highly Speculative" 1 "Speculative" 2 "Confident" 3 "Highly Confident" ;
VAL_TABLE_ ALOI2_RltvLnTk6 0 "Unknown" 1 "Host Lane" 2 "Right Lane" 3 "Left Lane" ;
VAL_TABLE_ ALOI2_RltvLnTk5 0 "Unknown" 1 "Host Lane" 2 "Right Lane" 3 "Left Lane" ;
VAL_TABLE_ ALOI2_MeasStsTk8 0 "No Object" 1 "New Object" 2 "Latent Track Not Detected This Cycle" 3 "Measured This Cycle" ;
VAL_TABLE_ ALOI2_MeasStsTk7 0 "No Object" 1 "New Object" 2 "Latent Track Not Detected This Cycle" 3 "Measured This Cycle" ;
VAL_TABLE_ ALOI2_RngTk6_Inv 0 "FALSE" 1 "TRUE" ;
VAL_TABLE_ ALOI2_RngTk5_Inv 0 "FALSE" 1 "TRUE" ;
VAL_TABLE_ ALOI2_AcqTmStm_Inv 0 "FALSE" 1 "TRUE" ;
VAL_TABLE_ ALOI2_RltvLnTk8 0 "Unknown" 1 "Host Lane" 2 "Right Lane" 3 "Left Lane" ;
VAL_TABLE_ ALOI2_RltvLnTk7 0 "Unknown" 1 "Host Lane" 2 "Right Lane" 3 "Left Lane" ;
VAL_TABLE_ ALOI2_RngTk8_Inv 0 "FALSE" 1 "TRUE" ;
VAL_TABLE_ ALOI2_RngTk7_Inv 0 "FALSE" 1 "TRUE" ;
VAL_TABLE_ ARDG1_HstLnLtTyp 0 "Undecided" 1 "Solid" 2 "Dashed" 3 "Road Edge" 4 "Double Line" 5 "Botts Dots" 6 "Virtual" 7 "Triple Line" ;
VAL_TABLE_ ARDG1_HstLnLtQlty 0 "Very Low Quality" 1 "Low Quality" 2 "Prediction" 3 "High Quality" ;
VAL_TABLE_ ARDG1_HstNxtLnLtTyp 0 "Undecided" 1 "Solid" 2 "Dashed" 3 "Road Edge" 4 "Double Line" 5 "Botts Dots" 6 "Virtual" 7 "Triple Line" ;
VAL_TABLE_ ARDG1_HstNxtLnLtQlty 0 "Very Low Quality" 1 "Low Quality" 2 "Prediction" 3 "High Quality" ;
VAL_TABLE_ ARDG1_LtVehAhdMeasSts 0 "No Object" 1 "New Object" 2 "Latent Track Not Detected this Cycle" 3 "Measured this Cycle" ;
VAL_TABLE_ ARDG2_AutfxOutOfCal 0 "Unknown" 1 "Yaw" 2 "Horizon" 3 "Both" ;
VAL_TABLE_ ARDG2_FrwdCamSysOprtgSts 0 "Unknown" 1 "Initializing" 2 "Inactive" 3 "Active" 4 "Programing" 5 "Reserved 1" 6 "Reserved 2" 7 "Failed" ;
VAL_TABLE_ ARDG2_HstVehAhdMeasSts 0 "No Object" 1 "New Object" 2 "Latent Track Not Detected this Cycle" 3 "Measured this Cycle" ;
VAL_TABLE_ ARDG2_FrwdVsnUnv 0 "FALSE" 1 "TRUE" ;
VAL_TABLE_ ARDG2_FrwdVsnTmStm_Inv 0 "FALSE" 1 "TRUE" ;
VAL_TABLE_ ARDG3_HstLnRtTyp 0 "Undecided" 1 "Solid" 2 "Dashed" 3 "Road Edge" 4 "Double Line" 5 "Botts Dots" 6 "Virtual" 7 "Triple Line" ;
VAL_TABLE_ ARDG3_HstLnRtQlty 0 "Very Low Quality" 1 "Low Quality" 2 "Prediction" 3 "High Quality" ;
VAL_TABLE_ ARDG3_HstNxtLnRtTyp 0 "Undecided" 1 "Solid" 2 "Dashed" 3 "Road Edge" 4 "Double Line" 5 "Botts Dots" 6 "Virtual" 7 "Triple Line" ;
VAL_TABLE_ ARDG3_HstNxtLnRtQlty 0 "Very Low Quality" 1 "Low Quality" 2 "Prediction" 3 "High Quality" ;
VAL_TABLE_ ARDG3_RtVehAhdMeasSts 0 "No Object" 1 "New Object" 2 "Latent Track Not Detected this Cycle" 3 "Measured this Cycle" ;
VAL_TABLE_ BSPMP_SecRunCrnkCmdActvAuth_Inv 0 "FALSE" 1 "TRUE" ;
VAL_TABLE_ BSPMP_SecRunCrnkCmdActvAuth 0 "FALSE" 1 "TRUE" ;
VAL_TABLE_ BSPMP_SecPwrModePBActvAuth_Inv 0 "FALSE" 1 "TRUE" ;
VAL_TABLE_ BSPMP_SecPwrModePBActvAuth 0 "FALSE" 1 "TRUE" ;
VAL_TABLE_ BSPMP_BkupSysPwrModeAuth_Inv 0 "FALSE" 1 "TRUE" ;
VAL_TABLE_ BSPMP_BkupSysPwrModeAuth 0 "Off" 1 "Accessory" 2 "Run" 3 "Start Request" 4 "Propulsion" ;
VAL_TABLE_ BSPMP_RmtProgmActvAuth 0 "FALSE" 1 "TRUE" ;
VAL_TABLE_ FCODPB11P_FVVOTk10PoI4PsVisAuth 0 "Unknown" 1 "Visible" 2 "Projected" ;
VAL_TABLE_ FCODPB11P_FVVOTk1PoI4PsVisAuth 0 "Unknown" 1 "Visible" 2 "Projected" ;
VAL_TABLE_ FCODPB11P_FVVOTk2PoI4PsVisAuth 0 "Unknown" 1 "Visible" 2 "Projected" ;
VAL_TABLE_ FCODPB11P_FVVOTk3PoI4PsVisAuth 0 "Unknown" 1 "Visible" 2 "Projected" ;
VAL_TABLE_ FCODPB11P_FVVOTk4PoI4PsVisAuth 0 "Unknown" 1 "Visible" 2 "Projected" ;
VAL_TABLE_ FCODPB11P_FVVOTk5PoI4PsVisAuth 0 "Unknown" 1 "Visible" 2 "Projected" ;
VAL_TABLE_ FCODPB11P_FVVOTk6PoI4PsVisAuth 0 "Unknown" 1 "Visible" 2 "Projected" ;
VAL_TABLE_ FCODPB11P_FVVOTk7PoI4PsVisAuth 0 "Unknown" 1 "Visible" 2 "Projected" ;
VAL_TABLE_ FCODPB11P_FVVOTk8PoI4PsVisAuth 0 "Unknown" 1 "Visible" 2 "Projected" ;
VAL_TABLE_ FCODPB11P_FVVOTk9PoI4PsVisAuth 0 "Unknown" 1 "Visible" 2 "Projected" ;
VAL_TABLE_ FCODPB11P_LnTrPtEndTypAuth 0 "Unknown" 1 "Merge End" 2 "Split End" ;
VAL_TABLE_ FCODPB11P_LnTrPtStrtTypAuth 0 "Unknown" 1 "Merge Start" 2 "Split Start" ;
VAL_TABLE_ FCODPB11P_FrwdVsnModeCmdStsAuth 0 "Not Reporting Object Data" 1 "Reporting Object Data" ;
VAL_TABLE_ FCODPB11P_ShldrDtnRtofVehAuth 0 "Shoulder Not Detected" 1 "Shoulder Detected" 2 "Reserved" 3 "Not Valid" ;
VAL_TABLE_ FCODPB11P_ShldrDtnLtofVehAuth 0 "Shoulder Not Detected" 1 "Shoulder Detected" 2 "Reserved" 3 "Not Valid" ;
VAL_TABLE_ FCODPB12P_FVTS1PsdbyHstVehAuth 0 "FALSE" 1 "TRUE" ;
VAL_TABLE_ FCODPB12P_FVTS1PhysTypAuth 0 "Static" 1 "Variable" 2 "Temporary" ;
VAL_TABLE_ FCODPB12P_FVTS1MeasVldAuth 0 "FALSE" 1 "TRUE" ;
VAL_TABLE_ FCODPB12P_FVTS1FiltTypAuth 0 "Not Filtered" 1 "Irrelevant To Host Driver" 2 "On Vehicle/Truck" 3 "Embedded" ;
VAL_TABLE_ FCODPB12P_FVTS1ZnDtdAuth 0 "FALSE" 1 "TRUE" ;
VAL_TABLE_ FCODPB12P_FVTS2ZnDtdAuth 0 "FALSE" 1 "TRUE" ;
VAL_TABLE_ FCODPB12P_FVTS2PsdbyHstVehAuth 0 "FALSE" 1 "TRUE" ;
VAL_TABLE_ FCODPB12P_FVTS2PhysTypAuth 0 "Static" 1 "Variable" 2 "Temporary" ;
VAL_TABLE_ FCODPB12P_FVTS2MeasVldAuth 0 "FALSE" 1 "TRUE" ;
VAL_TABLE_ FCODPB12P_FVTS2FiltTypAuth 0 "Not Filtered" 1 "Irrelevant To Host Driver" 2 "On Vehicle/Truck" 3 "Embedded" ;
VAL_TABLE_ FCODPB12P_FVTS3ZnDtdAuth 0 "FALSE" 1 "TRUE" ;
VAL_TABLE_ FCODPB12P_FVTS3PsdbyHstVehAuth 0 "FALSE" 1 "TRUE" ;
VAL_TABLE_ FCODPB12P_FVTS3PhysTypAuth 0 "Static" 1 "Variable" 2 "Temporary" ;
VAL_TABLE_ FCODPB12P_FVTS3MeasVldAuth 0 "FALSE" 1 "TRUE" ;
VAL_TABLE_ FCODPB12P_FVTS3FiltTypAuth 0 "Not Filtered" 1 "Irrelevant To Host Driver" 2 "On Vehicle/Truck" 3 "Embedded" ;
VAL_TABLE_ FCODPB12P_FVTS4FiltTypAuth 0 "Not Filtered" 1 "Irrelevant To Host Driver" 2 "On Vehicle/Truck" 3 "Embedded" ;
VAL_TABLE_ FCODPB12P_FVTS4ZnDtdAuth 0 "FALSE" 1 "TRUE" ;
VAL_TABLE_ FCODPB12P_FVTS4PsdbyHstVehAuth 0 "FALSE" 1 "TRUE" ;
VAL_TABLE_ FCODPB12P_FVTS4PhysTypAuth 0 "Static" 1 "Variable" 2 "Temporary" ;
VAL_TABLE_ FCODPB12P_FVTS4MeasVldAuth 0 "FALSE" 1 "TRUE" ;
VAL_TABLE_ FCODPB12P_FVTS5FiltTypAuth 0 "Not Filtered" 1 "Irrelevant To Host Driver" 2 "On Vehicle/Truck" 3 "Embedded" ;
VAL_TABLE_ FCODPB12P_FVTS5ZnDtdAuth 0 "FALSE" 1 "TRUE" ;
VAL_TABLE_ FCODPB12P_FVTS5PsdbyHstVehAuth 0 "FALSE" 1 "TRUE" ;
VAL_TABLE_ FCODPB12P_FVTS5PhysTypAuth 0 "Static" 1 "Variable" 2 "Temporary" ;
VAL_TABLE_ FCODPB12P_FVTS5MeasVldAuth 0 "FALSE" 1 "TRUE" ;
VAL_TABLE_ FCODPB12P_FVTS6MeasVldAuth 0 "FALSE" 1 "TRUE" ;
VAL_TABLE_ FCODPB12P_FVTS6FiltTypAuth 0 "Not Filtered" 1 "Irrelevant To Host Driver" 2 "On Vehicle/Truck" 3 "Embedded" ;
VAL_TABLE_ FCODPB12P_RdBnkCrv1CnfdStsAuth 0 "Highly Speculative" 1 "Speculative" 2 "Confident" 3 "Highly Confident" ;
VAL_TABLE_ FCODPB12P_FVTS6ZnDtdAuth 0 "FALSE" 1 "TRUE" ;
VAL_TABLE_ FCODPB12P_FVTS6PsdbyHstVehAuth 0 "FALSE" 1 "TRUE" ;
VAL_TABLE_ FCODPB12P_FVTS6PhysTypAuth 0 "Static" 1 "Variable" 2 "Temporary" ;
VAL_TABLE_ FCODPB12P_RdBnkCrv2CnfdStsAuth 0 "Highly Speculative" 1 "Speculative" 2 "Confident" 3 "Highly Confident" ;
VAL_TABLE_ FCODPB12P_RdBnkCrv3CnfdStsAuth 0 "Highly Speculative" 1 "Speculative" 2 "Confident" 3 "Highly Confident" ;
VAL_TABLE_ FCODPB13P_FVTS10PsdbyHstVehAuth 0 "FALSE" 1 "TRUE" ;
VAL_TABLE_ FCODPB13P_FVTS10PhysTypAuth 0 "Static" 1 "Variable" 2 "Temporary" ;
VAL_TABLE_ FCODPB13P_FVTS10MeasVldAuth 0 "FALSE" 1 "TRUE" ;
VAL_TABLE_ FCODPB13P_FVTS10FiltTypAuth 0 "Not Filtered" 1 "Irrelevant To Host Driver" 2 "On Vehicle/Truck" 3 "Embedded" ;
VAL_TABLE_ FCODPB13P_FVTS10ZnDtdAuth 0 "FALSE" 1 "TRUE" ;
VAL_TABLE_ FCODPB13P_FVTS7ZnDtdAuth 0 "FALSE" 1 "TRUE" ;
VAL_TABLE_ FCODPB13P_FVTS7PsdbyHstVehAuth 0 "FALSE" 1 "TRUE" ;
VAL_TABLE_ FCODPB13P_FVTS7PhysTypAuth 0 "Static" 1 "Variable" 2 "Temporary" ;
VAL_TABLE_ FCODPB13P_FVTS7MeasVldAuth 0 "FALSE" 1 "TRUE" ;
VAL_TABLE_ FCODPB13P_FVTS7FiltTypAuth 0 "Not Filtered" 1 "Irrelevant To Host Driver" 2 "On Vehicle/Truck" 3 "Embedded" ;
VAL_TABLE_ FCODPB13P_FVTS8ZnDtdAuth 0 "FALSE" 1 "TRUE" ;
VAL_TABLE_ FCODPB13P_FVTS8PsdbyHstVehAuth 0 "FALSE" 1 "TRUE" ;
VAL_TABLE_ FCODPB13P_FVTS8PhysTypAuth 0 "Static" 1 "Variable" 2 "Temporary" ;
VAL_TABLE_ FCODPB13P_FVTS8MeasVldAuth 0 "FALSE" 1 "TRUE" ;
VAL_TABLE_ FCODPB13P_FVTS8FiltTypAuth 0 "Not Filtered" 1 "Irrelevant To Host Driver" 2 "On Vehicle/Truck" 3 "Embedded" ;
VAL_TABLE_ FCODPB13P_FVTS9FiltTypAuth 0 "Not Filtered" 1 "Irrelevant To Host Driver" 2 "On Vehicle/Truck" 3 "Embedded" ;
VAL_TABLE_ FCODPB13P_FVTSTk10CnfdStsAuth 0 "Highly Speculative" 1 "Speculative" 2 "Confident" 3 "Highly Confident" ;
VAL_TABLE_ FCODPB13P_FVTS9ZnDtdAuth 0 "FALSE" 1 "TRUE" ;
VAL_TABLE_ FCODPB13P_FVTS9PsdbyHstVehAuth 0 "FALSE" 1 "TRUE" ;
VAL_TABLE_ FCODPB13P_FVTS9PhysTypAuth 0 "Static" 1 "Variable" 2 "Temporary" ;
VAL_TABLE_ FCODPB13P_FVTS9MeasVldAuth 0 "FALSE" 1 "TRUE" ;
VAL_TABLE_ FCODPB13P_FVTSTk10SupTypAuth 0 "None" 1 "Rain" 2 "Snow" 3 "Trailer" 4 "Time" 5 "Arrow Left" 6 "Arrow Right" 7 "Bend Arrow Left" 8 "Bend Arrow Right" 9 "Truck" 10 "Distance Arrow" 11 "Weight" 12 "Distance In" 13 "Tractor" 14 "Snow Rain" 15 "School" 16 "Rain Cloud" 17 "Fog" 18 "Hazardous" 19 "Material" 20 "Night" 21 "Supp Sign Generic" 22 "Rappel" 23 "Tractor Passable" 24 "Wet Conditions" 25 "Motorcycle" 26 "Bus" 27 "Camper" 28 "Car" 29 "Tank" 30 "Hazard Spot" 31 "Traffic Jam" 32 "Train" 33 "Tram/Street Car" 34 "Noise Prevention" 35 "Residents Only" 36 "Invalid Supp" 37 "School When Flashing" 38 "End of Speed Limit" 39 "Where Workers Present" ;
VAL_TABLE_ FCODPB13P_FVTSTk10MeasStsAuth 0 "No Object" 1 "New Object" 2 "Latent Track Not Detected this Cycle" 3 "Measured this Cycle" ;
VAL_TABLE_ FCODPB13P_FVTSTk10TypAuth 0 "No Sign Detected" 1 "End of Speed Limit" 2 "End of All Restrictions" 3 "Begin of Motorway" 4 "End of Motorway" 5 "Begin of Expressway" 6 "End of Expressway" 7 "Begin of Play Street Zone" 8 "End of Play Street Zone" 9 "Begin of Passing Restriction" 10 "End of Passing Restriction" 11 "No Entry" 12 "Begin of City Limits" 13 "End of City Limits" 14 "Yield" 15 "Crosswalk" 16 "Round About" 17 "Stop Sign" 18 "Yield to Oncoming Traffic" 19 "Pedestrian Zone" 20 "No Stopping Sign" 21 "No Parking Sign" 22 "Begin of No Parking Zone" 23 "End of No Parking Zone" 24 "Invalid Sign" 25 "Unknown Sign" 26 "Speed Limit 5" 27 "Speed Limit 10" 28 "Speed Limit 15" 29 "Speed Limit 20" 30 "Speed Limit 25" 31 "Speed Limit 30" 32 "Speed Limit 35" 33 "Speed Limit 40" 34 "Speed Limit 45" 35 "Speed Limit 50" 36 "Speed Limit 55" 37 "Speed Limit 60" 38 "Speed Limit 65" 39 "Speed Limit 70" 40 "Speed Limit 75" 41 "Speed Limit 80" 42 "Speed Limit 85" 43 "Speed Limit 90" 44 "Speed Limit 95" 45 "Speed Limit 100" 46 "Speed Limit 105" 47 "Speed Limit 110" 48 "Speed Limit 115" 49 "Speed Limit 120" 50 "Speed Limit 125" 51 "Speed Limit 130" 52 "Speed Limit 135" 53 "Speed Limit 140" 54 "Speed Limit 145" 55 "Speed Limit 150" 56 "Attention Sign Construction" 57 "Attention Sign Crosswalk" 58 "Attention Sign Round About" 59 "Attention Sign Children" 60 "Attention Sign Animals Crossing" 61 "Attention Sign General" 62 "Attention Sign Cross-way" 63 "Attention Sign Sharp Turn Left" 64 "Attention Sign Sharp Turn Right" 65 "Attention Sign Winding Road" 66 "Attention Sign Up-Grade" 67 "Attention Sign Down-Grade" 68 "Attention Sign Narrow Road Left" 69 "Attention Sign Narrow Road Right" 70 "Attention Sign Narrow Road Left & Right" 71 "Attention Sign Slippery Raod" 72 "Restricted Access for All Vehicles" 73 "Restricted Access for Cars" 74 "Restricted Access for Cars & Motorcycles" 75 "Restricted Access for Campers" ;
VAL_TABLE_ FCODPB13P_FVTSTk10TypCnfdAuth 0 "Highly Speculative" 1 "Speculative" 2 "Confident" 3 "Highly Confident" ;
VAL_TABLE_ FCODPB13P_FVTSTk1CnfdStsAuth 0 "Highly Speculative" 1 "Speculative" 2 "Confident" 3 "Highly Confident" ;
VAL_TABLE_ FCODPB13P_FVTSTk1MeasStsAuth 0 "No Object" 1 "New Object" 2 "Latent Track Not Detected this Cycle" 3 "Measured this Cycle" ;
VAL_TABLE_ FCODPB13P_FVTSTk1TypAuth 0 "No Sign Detected" 1 "End of Speed Limit" 2 "End of All Restrictions" 3 "Begin of Motorway" 4 "End of Motorway" 5 "Begin of Expressway" 6 "End of Expressway" 7 "Begin of Play Street Zone" 8 "End of Play Street Zone" 9 "Begin of Passing Restriction" 10 "End of Passing Restriction" 11 "No Entry" 12 "Begin of City Limits" 13 "End of City Limits" 14 "Yield" 15 "Crosswalk" 16 "Round About" 17 "Stop Sign" 18 "Yield to Oncoming Traffic" 19 "Pedestrian Zone" 20 "No Stopping Sign" 21 "No Parking Sign" 22 "Begin of No Parking Zone" 23 "End of No Parking Zone" 24 "Invalid Sign" 25 "Unknown Sign" 26 "Speed Limit 5" 27 "Speed Limit 10" 28 "Speed Limit 15" 29 "Speed Limit 20" 30 "Speed Limit 25" 31 "Speed Limit 30" 32 "Speed Limit 35" 33 "Speed Limit 40" 34 "Speed Limit 45" 35 "Speed Limit 50" 36 "Speed Limit 55" 37 "Speed Limit 60" 38 "Speed Limit 65" 39 "Speed Limit 70" 40 "Speed Limit 75" 41 "Speed Limit 80" 42 "Speed Limit 85" 43 "Speed Limit 90" 44 "Speed Limit 95" 45 "Speed Limit 100" 46 "Speed Limit 105" 47 "Speed Limit 110" 48 "Speed Limit 115" 49 "Speed Limit 120" 50 "Speed Limit 125" 51 "Speed Limit 130" 52 "Speed Limit 135" 53 "Speed Limit 140" 54 "Speed Limit 145" 55 "Speed Limit 150" 56 "Attention Sign Construction" 57 "Attention Sign Crosswalk" 58 "Attention Sign Round About" 59 "Attention Sign Children" 60 "Attention Sign Animals Crossing" 61 "Attention Sign General" 62 "Attention Sign Cross-way" 63 "Attention Sign Sharp Turn Left" 64 "Attention Sign Sharp Turn Right" 65 "Attention Sign Winding Road" 66 "Attention Sign Up-Grade" 67 "Attention Sign Down-Grade" 68 "Attention Sign Narrow Road Left" 69 "Attention Sign Narrow Road Right" 70 "Attention Sign Narrow Road Left & Right" 71 "Attention Sign Slippery Raod" 72 "Restricted Access for All Vehicles" 73 "Restricted Access for Cars" 74 "Restricted Access for Cars & Motorcycles" 75 "Restricted Access for Campers" ;
VAL_TABLE_ FCODPB13P_FVTSTk1SupTypAuth 0 "None" 1 "Rain" 2 "Snow" 3 "Trailer" 4 "Time" 5 "Arrow Left" 6 "Arrow Right" 7 "Bend Arrow Left" 8 "Bend Arrow Right" 9 "Truck" 10 "Distance Arrow" 11 "Weight" 12 "Distance In" 13 "Tractor" 14 "Snow Rain" 15 "School" 16 "Rain Cloud" 17 "Fog" 18 "Hazardous" 19 "Material" 20 "Night" 21 "Supp Sign Generic" 22 "Rappel" 23 "Tractor Passable" 24 "Wet Conditions" 25 "Motorcycle" 26 "Bus" 27 "Camper" 28 "Car" 29 "Tank" 30 "Hazard Spot" 31 "Traffic Jam" 32 "Train" 33 "Tram/Street Car" 34 "Noise Prevention" 35 "Residents Only" 36 "Invalid Supp" 37 "School When Flashing" 38 "End of Speed Limit" 39 "Where Workers Present" ;
VAL_TABLE_ FCODPB13P_FVTSTk1TypCnfdAuth 0 "Highly Speculative" 1 "Speculative" 2 "Confident" 3 "Highly Confident" ;
VAL_TABLE_ FCODPB13P_FVTSTk2CnfdStsAuth 0 "Highly Speculative" 1 "Speculative" 2 "Confident" 3 "Highly Confident" ;
VAL_TABLE_ FCODPB13P_FVTSTk2SupTypAuth 0 "None" 1 "Rain" 2 "Snow" 3 "Trailer" 4 "Time" 5 "Arrow Left" 6 "Arrow Right" 7 "Bend Arrow Left" 8 "Bend Arrow Right" 9 "Truck" 10 "Distance Arrow" 11 "Weight" 12 "Distance In" 13 "Tractor" 14 "Snow Rain" 15 "School" 16 "Rain Cloud" 17 "Fog" 18 "Hazardous" 19 "Material" 20 "Night" 21 "Supp Sign Generic" 22 "Rappel" 23 "Tractor Passable" 24 "Wet Conditions" 25 "Motorcycle" 26 "Bus" 27 "Camper" 28 "Car" 29 "Tank" 30 "Hazard Spot" 31 "Traffic Jam" 32 "Train" 33 "Tram/Street Car" 34 "Noise Prevention" 35 "Residents Only" 36 "Invalid Supp" 37 "School When Flashing" 38 "End of Speed Limit" 39 "Where Workers Present" ;
VAL_TABLE_ FCODPB13P_FVTSTk2MeasStsAuth 0 "No Object" 1 "New Object" 2 "Latent Track Not Detected this Cycle" 3 "Measured this Cycle" ;
VAL_TABLE_ FCODPB13P_FVTSTk2TypAuth 0 "No Sign Detected" 1 "End of Speed Limit" 2 "End of All Restrictions" 3 "Begin of Motorway" 4 "End of Motorway" 5 "Begin of Expressway" 6 "End of Expressway" 7 "Begin of Play Street Zone" 8 "End of Play Street Zone" 9 "Begin of Passing Restriction" 10 "End of Passing Restriction" 11 "No Entry" 12 "Begin of City Limits" 13 "End of City Limits" 14 "Yield" 15 "Crosswalk" 16 "Round About" 17 "Stop Sign" 18 "Yield to Oncoming Traffic" 19 "Pedestrian Zone" 20 "No Stopping Sign" 21 "No Parking Sign" 22 "Begin of No Parking Zone" 23 "End of No Parking Zone" 24 "Invalid Sign" 25 "Unknown Sign" 26 "Speed Limit 5" 27 "Speed Limit 10" 28 "Speed Limit 15" 29 "Speed Limit 20" 30 "Speed Limit 25" 31 "Speed Limit 30" 32 "Speed Limit 35" 33 "Speed Limit 40" 34 "Speed Limit 45" 35 "Speed Limit 50" 36 "Speed Limit 55" 37 "Speed Limit 60" 38 "Speed Limit 65" 39 "Speed Limit 70" 40 "Speed Limit 75" 41 "Speed Limit 80" 42 "Speed Limit 85" 43 "Speed Limit 90" 44 "Speed Limit 95" 45 "Speed Limit 100" 46 "Speed Limit 105" 47 "Speed Limit 110" 48 "Speed Limit 115" 49 "Speed Limit 120" 50 "Speed Limit 125" 51 "Speed Limit 130" 52 "Speed Limit 135" 53 "Speed Limit 140" 54 "Speed Limit 145" 55 "Speed Limit 150" 56 "Attention Sign Construction" 57 "Attention Sign Crosswalk" 58 "Attention Sign Round About" 59 "Attention Sign Children" 60 "Attention Sign Animals Crossing" 61 "Attention Sign General" 62 "Attention Sign Cross-way" 63 "Attention Sign Sharp Turn Left" 64 "Attention Sign Sharp Turn Right" 65 "Attention Sign Winding Road" 66 "Attention Sign Up-Grade" 67 "Attention Sign Down-Grade" 68 "Attention Sign Narrow Road Left" 69 "Attention Sign Narrow Road Right" 70 "Attention Sign Narrow Road Left & Right" 71 "Attention Sign Slippery Raod" 72 "Restricted Access for All Vehicles" 73 "Restricted Access for Cars" 74 "Restricted Access for Cars & Motorcycles" 75 "Restricted Access for Campers" ;
VAL_TABLE_ FCODPB13P_FVTSTk2TypCnfdAuth 0 "Highly Speculative" 1 "Speculative" 2 "Confident" 3 "Highly Confident" ;
VAL_TABLE_ FCODPB13P_FVTSTk3CnfdStsAuth 0 "Highly Speculative" 1 "Speculative" 2 "Confident" 3 "Highly Confident" ;
VAL_TABLE_ FCODPB13P_FVTSTk3SupTypAuth 0 "None" 1 "Rain" 2 "Snow" 3 "Trailer" 4 "Time" 5 "Arrow Left" 6 "Arrow Right" 7 "Bend Arrow Left" 8 "Bend Arrow Right" 9 "Truck" 10 "Distance Arrow" 11 "Weight" 12 "Distance In" 13 "Tractor" 14 "Snow Rain" 15 "School" 16 "Rain Cloud" 17 "Fog" 18 "Hazardous" 19 "Material" 20 "Night" 21 "Supp Sign Generic" 22 "Rappel" 23 "Tractor Passable" 24 "Wet Conditions" 25 "Motorcycle" 26 "Bus" 27 "Camper" 28 "Car" 29 "Tank" 30 "Hazard Spot" 31 "Traffic Jam" 32 "Train" 33 "Tram/Street Car" 34 "Noise Prevention" 35 "Residents Only" 36 "Invalid Supp" 37 "School When Flashing" 38 "End of Speed Limit" 39 "Where Workers Present" ;
VAL_TABLE_ FCODPB13P_FVTSTk3MeasStsAuth 0 "No Object" 1 "New Object" 2 "Latent Track Not Detected this Cycle" 3 "Measured this Cycle" ;
VAL_TABLE_ FCODPB13P_FVTSTk3TypAuth 0 "No Sign Detected" 1 "End of Speed Limit" 2 "End of All Restrictions" 3 "Begin of Motorway" 4 "End of Motorway" 5 "Begin of Expressway" 6 "End of Expressway" 7 "Begin of Play Street Zone" 8 "End of Play Street Zone" 9 "Begin of Passing Restriction" 10 "End of Passing Restriction" 11 "No Entry" 12 "Begin of City Limits" 13 "End of City Limits" 14 "Yield" 15 "Crosswalk" 16 "Round About" 17 "Stop Sign" 18 "Yield to Oncoming Traffic" 19 "Pedestrian Zone" 20 "No Stopping Sign" 21 "No Parking Sign" 22 "Begin of No Parking Zone" 23 "End of No Parking Zone" 24 "Invalid Sign" 25 "Unknown Sign" 26 "Speed Limit 5" 27 "Speed Limit 10" 28 "Speed Limit 15" 29 "Speed Limit 20" 30 "Speed Limit 25" 31 "Speed Limit 30" 32 "Speed Limit 35" 33 "Speed Limit 40" 34 "Speed Limit 45" 35 "Speed Limit 50" 36 "Speed Limit 55" 37 "Speed Limit 60" 38 "Speed Limit 65" 39 "Speed Limit 70" 40 "Speed Limit 75" 41 "Speed Limit 80" 42 "Speed Limit 85" 43 "Speed Limit 90" 44 "Speed Limit 95" 45 "Speed Limit 100" 46 "Speed Limit 105" 47 "Speed Limit 110" 48 "Speed Limit 115" 49 "Speed Limit 120" 50 "Speed Limit 125" 51 "Speed Limit 130" 52 "Speed Limit 135" 53 "Speed Limit 140" 54 "Speed Limit 145" 55 "Speed Limit 150" 56 "Attention Sign Construction" 57 "Attention Sign Crosswalk" 58 "Attention Sign Round About" 59 "Attention Sign Children" 60 "Attention Sign Animals Crossing" 61 "Attention Sign General" 62 "Attention Sign Cross-way" 63 "Attention Sign Sharp Turn Left" 64 "Attention Sign Sharp Turn Right" 65 "Attention Sign Winding Road" 66 "Attention Sign Up-Grade" 67 "Attention Sign Down-Grade" 68 "Attention Sign Narrow Road Left" 69 "Attention Sign Narrow Road Right" 70 "Attention Sign Narrow Road Left & Right" 71 "Attention Sign Slippery Raod" 72 "Restricted Access for All Vehicles" 73 "Restricted Access for Cars" 74 "Restricted Access for Cars & Motorcycles" 75 "Restricted Access for Campers" ;
VAL_TABLE_ FCODPB13P_FVTSTk3TypCnfdAuth 0 "Highly Speculative" 1 "Speculative" 2 "Confident" 3 "Highly Confident" ;
VAL_TABLE_ FCODPB13P_FVTSTk4CnfdStsAuth 0 "Highly Speculative" 1 "Speculative" 2 "Confident" 3 "Highly Confident" ;
VAL_TABLE_ FCODPB13P_FVTSTk4MeasStsAuth 0 "No Object" 1 "New Object" 2 "Latent Track Not Detected this Cycle" 3 "Measured this Cycle" ;
VAL_TABLE_ FCODPB13P_FVTSTk4TypAuth 0 "No Sign Detected" 1 "End of Speed Limit" 2 "End of All Restrictions" 3 "Begin of Motorway" 4 "End of Motorway" 5 "Begin of Expressway" 6 "End of Expressway" 7 "Begin of Play Street Zone" 8 "End of Play Street Zone" 9 "Begin of Passing Restriction" 10 "End of Passing Restriction" 11 "No Entry" 12 "Begin of City Limits" 13 "End of City Limits" 14 "Yield" 15 "Crosswalk" 16 "Round About" 17 "Stop Sign" 18 "Yield to Oncoming Traffic" 19 "Pedestrian Zone" 20 "No Stopping Sign" 21 "No Parking Sign" 22 "Begin of No Parking Zone" 23 "End of No Parking Zone" 24 "Invalid Sign" 25 "Unknown Sign" 26 "Speed Limit 5" 27 "Speed Limit 10" 28 "Speed Limit 15" 29 "Speed Limit 20" 30 "Speed Limit 25" 31 "Speed Limit 30" 32 "Speed Limit 35" 33 "Speed Limit 40" 34 "Speed Limit 45" 35 "Speed Limit 50" 36 "Speed Limit 55" 37 "Speed Limit 60" 38 "Speed Limit 65" 39 "Speed Limit 70" 40 "Speed Limit 75" 41 "Speed Limit 80" 42 "Speed Limit 85" 43 "Speed Limit 90" 44 "Speed Limit 95" 45 "Speed Limit 100" 46 "Speed Limit 105" 47 "Speed Limit 110" 48 "Speed Limit 115" 49 "Speed Limit 120" 50 "Speed Limit 125" 51 "Speed Limit 130" 52 "Speed Limit 135" 53 "Speed Limit 140" 54 "Speed Limit 145" 55 "Speed Limit 150" 56 "Attention Sign Construction" 57 "Attention Sign Crosswalk" 58 "Attention Sign Round About" 59 "Attention Sign Children" 60 "Attention Sign Animals Crossing" 61 "Attention Sign General" 62 "Attention Sign Cross-way" 63 "Attention Sign Sharp Turn Left" 64 "Attention Sign Sharp Turn Right" 65 "Attention Sign Winding Road" 66 "Attention Sign Up-Grade" 67 "Attention Sign Down-Grade" 68 "Attention Sign Narrow Road Left" 69 "Attention Sign Narrow Road Right" 70 "Attention Sign Narrow Road Left & Right" 71 "Attention Sign Slippery Raod" 72 "Restricted Access for All Vehicles" 73 "Restricted Access for Cars" 74 "Restricted Access for Cars & Motorcycles" 75 "Restricted Access for Campers" ;
VAL_TABLE_ FCODPB13P_FVTSTk4SupTypAuth 0 "None" 1 "Rain" 2 "Snow" 3 "Trailer" 4 "Time" 5 "Arrow Left" 6 "Arrow Right" 7 "Bend Arrow Left" 8 "Bend Arrow Right" 9 "Truck" 10 "Distance Arrow" 11 "Weight" 12 "Distance In" 13 "Tractor" 14 "Snow Rain" 15 "School" 16 "Rain Cloud" 17 "Fog" 18 "Hazardous" 19 "Material" 20 "Night" 21 "Supp Sign Generic" 22 "Rappel" 23 "Tractor Passable" 24 "Wet Conditions" 25 "Motorcycle" 26 "Bus" 27 "Camper" 28 "Car" 29 "Tank" 30 "Hazard Spot" 31 "Traffic Jam" 32 "Train" 33 "Tram/Street Car" 34 "Noise Prevention" 35 "Residents Only" 36 "Invalid Supp" 37 "School When Flashing" 38 "End of Speed Limit" 39 "Where Workers Present" ;
VAL_TABLE_ FCODPB13P_FVTSTk4TypCnfdAuth 0 "Highly Speculative" 1 "Speculative" 2 "Confident" 3 "Highly Confident" ;
VAL_TABLE_ FCODPB13P_FVTSTk5CnfdStsAuth 0 "Highly Speculative" 1 "Speculative" 2 "Confident" 3 "Highly Confident" ;
VAL_TABLE_ FCODPB13P_FVTSTk5SupTypAuth 0 "None" 1 "Rain" 2 "Snow" 3 "Trailer" 4 "Time" 5 "Arrow Left" 6 "Arrow Right" 7 "Bend Arrow Left" 8 "Bend Arrow Right" 9 "Truck" 10 "Distance Arrow" 11 "Weight" 12 "Distance In" 13 "Tractor" 14 "Snow Rain" 15 "School" 16 "Rain Cloud" 17 "Fog" 18 "Hazardous" 19 "Material" 20 "Night" 21 "Supp Sign Generic" 22 "Rappel" 23 "Tractor Passable" 24 "Wet Conditions" 25 "Motorcycle" 26 "Bus" 27 "Camper" 28 "Car" 29 "Tank" 30 "Hazard Spot" 31 "Traffic Jam" 32 "Train" 33 "Tram/Street Car" 34 "Noise Prevention" 35 "Residents Only" 36 "Invalid Supp" 37 "School When Flashing" 38 "End of Speed Limit" 39 "Where Workers Present" ;
VAL_TABLE_ FCODPB13P_FVTSTk5MeasStsAuth 0 "No Object" 1 "New Object" 2 "Latent Track Not Detected this Cycle" 3 "Measured this Cycle" ;
VAL_TABLE_ FCODPB13P_FVTSTk5TypAuth 0 "No Sign Detected" 1 "End of Speed Limit" 2 "End of All Restrictions" 3 "Begin of Motorway" 4 "End of Motorway" 5 "Begin of Expressway" 6 "End of Expressway" 7 "Begin of Play Street Zone" 8 "End of Play Street Zone" 9 "Begin of Passing Restriction" 10 "End of Passing Restriction" 11 "No Entry" 12 "Begin of City Limits" 13 "End of City Limits" 14 "Yield" 15 "Crosswalk" 16 "Round About" 17 "Stop Sign" 18 "Yield to Oncoming Traffic" 19 "Pedestrian Zone" 20 "No Stopping Sign" 21 "No Parking Sign" 22 "Begin of No Parking Zone" 23 "End of No Parking Zone" 24 "Invalid Sign" 25 "Unknown Sign" 26 "Speed Limit 5" 27 "Speed Limit 10" 28 "Speed Limit 15" 29 "Speed Limit 20" 30 "Speed Limit 25" 31 "Speed Limit 30" 32 "Speed Limit 35" 33 "Speed Limit 40" 34 "Speed Limit 45" 35 "Speed Limit 50" 36 "Speed Limit 55" 37 "Speed Limit 60" 38 "Speed Limit 65" 39 "Speed Limit 70" 40 "Speed Limit 75" 41 "Speed Limit 80" 42 "Speed Limit 85" 43 "Speed Limit 90" 44 "Speed Limit 95" 45 "Speed Limit 100" 46 "Speed Limit 105" 47 "Speed Limit 110" 48 "Speed Limit 115" 49 "Speed Limit 120" 50 "Speed Limit 125" 51 "Speed Limit 130" 52 "Speed Limit 135" 53 "Speed Limit 140" 54 "Speed Limit 145" 55 "Speed Limit 150" 56 "Attention Sign Construction" 57 "Attention Sign Crosswalk" 58 "Attention Sign Round About" 59 "Attention Sign Children" 60 "Attention Sign Animals Crossing" 61 "Attention Sign General" 62 "Attention Sign Cross-way" 63 "Attention Sign Sharp Turn Left" 64 "Attention Sign Sharp Turn Right" 65 "Attention Sign Winding Road" 66 "Attention Sign Up-Grade" 67 "Attention Sign Down-Grade" 68 "Attention Sign Narrow Road Left" 69 "Attention Sign Narrow Road Right" 70 "Attention Sign Narrow Road Left & Right" 71 "Attention Sign Slippery Raod" 72 "Restricted Access for All Vehicles" 73 "Restricted Access for Cars" 74 "Restricted Access for Cars & Motorcycles" 75 "Restricted Access for Campers" ;
VAL_TABLE_ FCODPB13P_FVTSTk5TypCnfdAuth 0 "Highly Speculative" 1 "Speculative" 2 "Confident" 3 "Highly Confident" ;
VAL_TABLE_ FCODPB13P_FVTSTk6CnfdStsAuth 0 "Highly Speculative" 1 "Speculative" 2 "Confident" 3 "Highly Confident" ;
VAL_TABLE_ FCODPB13P_FVTSTk6SupTypAuth 0 "None" 1 "Rain" 2 "Snow" 3 "Trailer" 4 "Time" 5 "Arrow Left" 6 "Arrow Right" 7 "Bend Arrow Left" 8 "Bend Arrow Right" 9 "Truck" 10 "Distance Arrow" 11 "Weight" 12 "Distance In" 13 "Tractor" 14 "Snow Rain" 15 "School" 16 "Rain Cloud" 17 "Fog" 18 "Hazardous" 19 "Material" 20 "Night" 21 "Supp Sign Generic" 22 "Rappel" 23 "Tractor Passable" 24 "Wet Conditions" 25 "Motorcycle" 26 "Bus" 27 "Camper" 28 "Car" 29 "Tank" 30 "Hazard Spot" 31 "Traffic Jam" 32 "Train" 33 "Tram/Street Car" 34 "Noise Prevention" 35 "Residents Only" 36 "Invalid Supp" 37 "School When Flashing" 38 "End of Speed Limit" 39 "Where Workers Present" ;
VAL_TABLE_ FCODPB13P_FVTSTk6MeasStsAuth 0 "No Object" 1 "New Object" 2 "Latent Track Not Detected this Cycle" 3 "Measured this Cycle" ;
VAL_TABLE_ FCODPB13P_FVTSTk6TypCnfdAuth 0 "Highly Speculative" 1 "Speculative" 2 "Confident" 3 "Highly Confident" ;
VAL_TABLE_ FCODPB13P_FVTSTk6TypAuth 0 "No Sign Detected" 1 "End of Speed Limit" 2 "End of All Restrictions" 3 "Begin of Motorway" 4 "End of Motorway" 5 "Begin of Expressway" 6 "End of Expressway" 7 "Begin of Play Street Zone" 8 "End of Play Street Zone" 9 "Begin of Passing Restriction" 10 "End of Passing Restriction" 11 "No Entry" 12 "Begin of City Limits" 13 "End of City Limits" 14 "Yield" 15 "Crosswalk" 16 "Round About" 17 "Stop Sign" 18 "Yield to Oncoming Traffic" 19 "Pedestrian Zone" 20 "No Stopping Sign" 21 "No Parking Sign" 22 "Begin of No Parking Zone" 23 "End of No Parking Zone" 24 "Invalid Sign" 25 "Unknown Sign" 26 "Speed Limit 5" 27 "Speed Limit 10" 28 "Speed Limit 15" 29 "Speed Limit 20" 30 "Speed Limit 25" 31 "Speed Limit 30" 32 "Speed Limit 35" 33 "Speed Limit 40" 34 "Speed Limit 45" 35 "Speed Limit 50" 36 "Speed Limit 55" 37 "Speed Limit 60" 38 "Speed Limit 65" 39 "Speed Limit 70" 40 "Speed Limit 75" 41 "Speed Limit 80" 42 "Speed Limit 85" 43 "Speed Limit 90" 44 "Speed Limit 95" 45 "Speed Limit 100" 46 "Speed Limit 105" 47 "Speed Limit 110" 48 "Speed Limit 115" 49 "Speed Limit 120" 50 "Speed Limit 125" 51 "Speed Limit 130" 52 "Speed Limit 135" 53 "Speed Limit 140" 54 "Speed Limit 145" 55 "Speed Limit 150" 56 "Attention Sign Construction" 57 "Attention Sign Crosswalk" 58 "Attention Sign Round About" 59 "Attention Sign Children" 60 "Attention Sign Animals Crossing" 61 "Attention Sign General" 62 "Attention Sign Cross-way" 63 "Attention Sign Sharp Turn Left" 64 "Attention Sign Sharp Turn Right" 65 "Attention Sign Winding Road" 66 "Attention Sign Up-Grade" 67 "Attention Sign Down-Grade" 68 "Attention Sign Narrow Road Left" 69 "Attention Sign Narrow Road Right" 70 "Attention Sign Narrow Road Left & Right" 71 "Attention Sign Slippery Raod" 72 "Restricted Access for All Vehicles" 73 "Restricted Access for Cars" 74 "Restricted Access for Cars & Motorcycles" 75 "Restricted Access for Campers" ;
VAL_TABLE_ FCODPB13P_FVTSTk7CnfdStsAuth 0 "Highly Speculative" 1 "Speculative" 2 "Confident" 3 "Highly Confident" ;
VAL_TABLE_ FCODPB13P_FVTSTk7SupTypAuth 0 "None" 1 "Rain" 2 "Snow" 3 "Trailer" 4 "Time" 5 "Arrow Left" 6 "Arrow Right" 7 "Bend Arrow Left" 8 "Bend Arrow Right" 9 "Truck" 10 "Distance Arrow" 11 "Weight" 12 "Distance In" 13 "Tractor" 14 "Snow Rain" 15 "School" 16 "Rain Cloud" 17 "Fog" 18 "Hazardous" 19 "Material" 20 "Night" 21 "Supp Sign Generic" 22 "Rappel" 23 "Tractor Passable" 24 "Wet Conditions" 25 "Motorcycle" 26 "Bus" 27 "Camper" 28 "Car" 29 "Tank" 30 "Hazard Spot" 31 "Traffic Jam" 32 "Train" 33 "Tram/Street Car" 34 "Noise Prevention" 35 "Residents Only" 36 "Invalid Supp" 37 "School When Flashing" 38 "End of Speed Limit" 39 "Where Workers Present" ;
VAL_TABLE_ FCODPB13P_FVTSTk7MeasStsAuth 0 "No Object" 1 "New Object" 2 "Latent Track Not Detected this Cycle" 3 "Measured this Cycle" ;
VAL_TABLE_ FCODPB13P_FVTSTk7TypAuth 0 "No Sign Detected" 1 "End of Speed Limit" 2 "End of All Restrictions" 3 "Begin of Motorway" 4 "End of Motorway" 5 "Begin of Expressway" 6 "End of Expressway" 7 "Begin of Play Street Zone" 8 "End of Play Street Zone" 9 "Begin of Passing Restriction" 10 "End of Passing Restriction" 11 "No Entry" 12 "Begin of City Limits" 13 "End of City Limits" 14 "Yield" 15 "Crosswalk" 16 "Round About" 17 "Stop Sign" 18 "Yield to Oncoming Traffic" 19 "Pedestrian Zone" 20 "No Stopping Sign" 21 "No Parking Sign" 22 "Begin of No Parking Zone" 23 "End of No Parking Zone" 24 "Invalid Sign" 25 "Unknown Sign" 26 "Speed Limit 5" 27 "Speed Limit 10" 28 "Speed Limit 15" 29 "Speed Limit 20" 30 "Speed Limit 25" 31 "Speed Limit 30" 32 "Speed Limit 35" 33 "Speed Limit 40" 34 "Speed Limit 45" 35 "Speed Limit 50" 36 "Speed Limit 55" 37 "Speed Limit 60" 38 "Speed Limit 65" 39 "Speed Limit 70" 40 "Speed Limit 75" 41 "Speed Limit 80" 42 "Speed Limit 85" 43 "Speed Limit 90" 44 "Speed Limit 95" 45 "Speed Limit 100" 46 "Speed Limit 105" 47 "Speed Limit 110" 48 "Speed Limit 115" 49 "Speed Limit 120" 50 "Speed Limit 125" 51 "Speed Limit 130" 52 "Speed Limit 135" 53 "Speed Limit 140" 54 "Speed Limit 145" 55 "Speed Limit 150" 56 "Attention Sign Construction" 57 "Attention Sign Crosswalk" 58 "Attention Sign Round About" 59 "Attention Sign Children" 60 "Attention Sign Animals Crossing" 61 "Attention Sign General" 62 "Attention Sign Cross-way" 63 "Attention Sign Sharp Turn Left" 64 "Attention Sign Sharp Turn Right" 65 "Attention Sign Winding Road" 66 "Attention Sign Up-Grade" 67 "Attention Sign Down-Grade" 68 "Attention Sign Narrow Road Left" 69 "Attention Sign Narrow Road Right" 70 "Attention Sign Narrow Road Left & Right" 71 "Attention Sign Slippery Raod" 72 "Restricted Access for All Vehicles" 73 "Restricted Access for Cars" 74 "Restricted Access for Cars & Motorcycles" 75 "Restricted Access for Campers" ;
VAL_TABLE_ FCODPB13P_FVTSTk7TypCnfdAuth 0 "Highly Speculative" 1 "Speculative" 2 "Confident" 3 "Highly Confident" ;
VAL_TABLE_ FCODPB14P_CnstrObj10CnfdStsAuth 0 "Highly Speculative" 1 "Speculative" 2 "Confident" 3 "Highly Confident" ;
VAL_TABLE_ FCODPB14P_CnstrObj11CnfdStsAuth 0 "Highly Speculative" 1 "Speculative" 2 "Confident" 3 "Highly Confident" ;
VAL_TABLE_ FCODPB14P_CnstrObj10TypAuth 0 "Unknown" 1 "Barrels" 2 "Cones" 3 "Marker Object" ;
VAL_TABLE_ FCODPB14P_CnstrObj12CnfdStsAuth 0 "Highly Speculative" 1 "Speculative" 2 "Confident" 3 "Highly Confident" ;
VAL_TABLE_ FCODPB14P_CnstrObj11TypAuth 0 "Unknown" 1 "Barrels" 2 "Cones" 3 "Marker Object" ;
VAL_TABLE_ FCODPB14P_CnstrObj12TypAuth 0 "Unknown" 1 "Barrels" 2 "Cones" 3 "Marker Object" ;
VAL_TABLE_ FCODPB14P_CnstrObj13CnfdStsAuth 0 "Highly Speculative" 1 "Speculative" 2 "Confident" 3 "Highly Confident" ;
VAL_TABLE_ FCODPB14P_CnstrObj14CnfdStsAuth 0 "Highly Speculative" 1 "Speculative" 2 "Confident" 3 "Highly Confident" ;
VAL_TABLE_ FCODPB14P_CnstrObj13TypAuth 0 "Unknown" 1 "Barrels" 2 "Cones" 3 "Marker Object" ;
VAL_TABLE_ FCODPB14P_CnstrObj15CnfdStsAuth 0 "Highly Speculative" 1 "Speculative" 2 "Confident" 3 "Highly Confident" ;
VAL_TABLE_ FCODPB14P_CnstrObj14TypAuth 0 "Unknown" 1 "Barrels" 2 "Cones" 3 "Marker Object" ;
VAL_TABLE_ FCODPB14P_CnstrObj1CnfdStsAuth 0 "Highly Speculative" 1 "Speculative" 2 "Confident" 3 "Highly Confident" ;
VAL_TABLE_ FCODPB14P_CnstrObj15TypAuth 0 "Unknown" 1 "Barrels" 2 "Cones" 3 "Marker Object" ;
VAL_TABLE_ FCODPB14P_CnstrObj1TypAuth 0 "Unknown" 1 "Barrels" 2 "Cones" 3 "Marker Object" ;
VAL_TABLE_ FCODPB14P_CnstrObj2CnfdStsAuth 0 "Highly Speculative" 1 "Speculative" 2 "Confident" 3 "Highly Confident" ;
VAL_TABLE_ FCODPB14P_CnstrObj3CnfdStsAuth 0 "Highly Speculative" 1 "Speculative" 2 "Confident" 3 "Highly Confident" ;
VAL_TABLE_ FCODPB14P_CnstrObj2TypAuth 0 "Unknown" 1 "Barrels" 2 "Cones" 3 "Marker Object" ;
VAL_TABLE_ FCODPB14P_CnstrObj4CnfdStsAuth 0 "Highly Speculative" 1 "Speculative" 2 "Confident" 3 "Highly Confident" ;
VAL_TABLE_ FCODPB14P_CnstrObj3TypAuth 0 "Unknown" 1 "Barrels" 2 "Cones" 3 "Marker Object" ;
VAL_TABLE_ FCODPB14P_CnstrObj5CnfdStsAuth 0 "Highly Speculative" 1 "Speculative" 2 "Confident" 3 "Highly Confident" ;
VAL_TABLE_ FCODPB14P_CnstrObj4TypAuth 0 "Unknown" 1 "Barrels" 2 "Cones" 3 "Marker Object" ;
VAL_TABLE_ FCODPB14P_CnstrObj5TypAuth 0 "Unknown" 1 "Barrels" 2 "Cones" 3 "Marker Object" ;
VAL_TABLE_ FCODPB14P_CnstrObj6CnfdStsAuth 0 "Highly Speculative" 1 "Speculative" 2 "Confident" 3 "Highly Confident" ;
VAL_TABLE_ FCODPB14P_CnstrObj7CnfdStsAuth 0 "Highly Speculative" 1 "Speculative" 2 "Confident" 3 "Highly Confident" ;
VAL_TABLE_ FCODPB14P_CnstrObj6TypAuth 0 "Unknown" 1 "Barrels" 2 "Cones" 3 "Marker Object" ;
VAL_TABLE_ FCODPB14P_CnstrObj8CnfdStsAuth 0 "Highly Speculative" 1 "Speculative" 2 "Confident" 3 "Highly Confident" ;
VAL_TABLE_ FCODPB14P_CnstrObj7TypAuth 0 "Unknown" 1 "Barrels" 2 "Cones" 3 "Marker Object" ;
VAL_TABLE_ FCODPB14P_CnstrObj9CnfdStsAuth 0 "Highly Speculative" 1 "Speculative" 2 "Confident" 3 "Highly Confident" ;
VAL_TABLE_ FCODPB14P_CnstrObj8TypAuth 0 "Unknown" 1 "Barrels" 2 "Cones" 3 "Marker Object" ;
VAL_TABLE_ FCODPB14P_CnstrObj9TypAuth 0 "Unknown" 1 "Barrels" 2 "Cones" 3 "Marker Object" ;
VAL_TABLE_ FCODPB14P_FVTSTk8CnfdStsAuth 0 "Highly Speculative" 1 "Speculative" 2 "Confident" 3 "Highly Confident" ;
VAL_TABLE_ FCODPB14P_FVTSTk8SupTypAuth 0 "None" 1 "Rain" 2 "Snow" 3 "Trailer" 4 "Time" 5 "Arrow Left" 6 "Arrow Right" 7 "Bend Arrow Left" 8 "Bend Arrow Right" 9 "Truck" 10 "Distance Arrow" 11 "Weight" 12 "Distance In" 13 "Tractor" 14 "Snow Rain" 15 "School" 16 "Rain Cloud" 17 "Fog" 18 "Hazardous" 19 "Material" 20 "Night" 21 "Supp Sign Generic" 22 "Rappel" 23 "Tractor Passable" 24 "Wet Conditions" 25 "Motorcycle" 26 "Bus" 27 "Camper" 28 "Car" 29 "Tank" 30 "Hazard Spot" 31 "Traffic Jam" 32 "Train" 33 "Tram/Street Car" 34 "Noise Prevention" 35 "Residents Only" 36 "Invalid Supp" 37 "School When Flashing" 38 "End of Speed Limit" 39 "Where Workers Present" ;
VAL_TABLE_ FCODPB14P_FVTSTk8MeasStsAuth 0 "No Object" 1 "New Object" 2 "Latent Track Not Detected this Cycle" 3 "Measured this Cycle" ;
VAL_TABLE_ FCODPB14P_FVTSTk8TypAuth 0 "No Sign Detected" 1 "End of Speed Limit" 2 "End of All Restrictions" 3 "Begin of Motorway" 4 "End of Motorway" 5 "Begin of Expressway" 6 "End of Expressway" 7 "Begin of Play Street Zone" 8 "End of Play Street Zone" 9 "Begin of Passing Restriction" 10 "End of Passing Restriction" 11 "No Entry" 12 "Begin of City Limits" 13 "End of City Limits" 14 "Yield" 15 "Crosswalk" 16 "Round About" 17 "Stop Sign" 18 "Yield to Oncoming Traffic" 19 "Pedestrian Zone" 20 "No Stopping Sign" 21 "No Parking Sign" 22 "Begin of No Parking Zone" 23 "End of No Parking Zone" 24 "Invalid Sign" 25 "Unknown Sign" 26 "Speed Limit 5" 27 "Speed Limit 10" 28 "Speed Limit 15" 29 "Speed Limit 20" 30 "Speed Limit 25" 31 "Speed Limit 30" 32 "Speed Limit 35" 33 "Speed Limit 40" 34 "Speed Limit 45" 35 "Speed Limit 50" 36 "Speed Limit 55" 37 "Speed Limit 60" 38 "Speed Limit 65" 39 "Speed Limit 70" 40 "Speed Limit 75" 41 "Speed Limit 80" 42 "Speed Limit 85" 43 "Speed Limit 90" 44 "Speed Limit 95" 45 "Speed Limit 100" 46 "Speed Limit 105" 47 "Speed Limit 110" 48 "Speed Limit 115" 49 "Speed Limit 120" 50 "Speed Limit 125" 51 "Speed Limit 130" 52 "Speed Limit 135" 53 "Speed Limit 140" 54 "Speed Limit 145" 55 "Speed Limit 150" 56 "Attention Sign Construction" 57 "Attention Sign Crosswalk" 58 "Attention Sign Round About" 59 "Attention Sign Children" 60 "Attention Sign Animals Crossing" 61 "Attention Sign General" 62 "Attention Sign Cross-way" 63 "Attention Sign Sharp Turn Left" 64 "Attention Sign Sharp Turn Right" 65 "Attention Sign Winding Road" 66 "Attention Sign Up-Grade" 67 "Attention Sign Down-Grade" 68 "Attention Sign Narrow Road Left" 69 "Attention Sign Narrow Road Right" 70 "Attention Sign Narrow Road Left & Right" 71 "Attention Sign Slippery Raod" 72 "Restricted Access for All Vehicles" 73 "Restricted Access for Cars" 74 "Restricted Access for Cars & Motorcycles" 75 "Restricted Access for Campers" ;
VAL_TABLE_ FCODPB14P_FVTSTk8TypCnfdAuth 0 "Highly Speculative" 1 "Speculative" 2 "Confident" 3 "Highly Confident" ;
VAL_TABLE_ FCODPB14P_FVTSTk9CnfdStsAuth 0 "Highly Speculative" 1 "Speculative" 2 "Confident" 3 "Highly Confident" ;
VAL_TABLE_ FCODPB14P_FVTSTk9SupTypAuth 0 "None" 1 "Rain" 2 "Snow" 3 "Trailer" 4 "Time" 5 "Arrow Left" 6 "Arrow Right" 7 "Bend Arrow Left" 8 "Bend Arrow Right" 9 "Truck" 10 "Distance Arrow" 11 "Weight" 12 "Distance In" 13 "Tractor" 14 "Snow Rain" 15 "School" 16 "Rain Cloud" 17 "Fog" 18 "Hazardous" 19 "Material" 20 "Night" 21 "Supp Sign Generic" 22 "Rappel" 23 "Tractor Passable" 24 "Wet Conditions" 25 "Motorcycle" 26 "Bus" 27 "Camper" 28 "Car" 29 "Tank" 30 "Hazard Spot" 31 "Traffic Jam" 32 "Train" 33 "Tram/Street Car" 34 "Noise Prevention" 35 "Residents Only" 36 "Invalid Supp" 37 "School When Flashing" 38 "End of Speed Limit" 39 "Where Workers Present" ;
VAL_TABLE_ FCODPB14P_FVTSTk9MeasStsAuth 0 "No Object" 1 "New Object" 2 "Latent Track Not Detected this Cycle" 3 "Measured this Cycle" ;
VAL_TABLE_ FCODPB14P_FVTSTk9TypAuth 0 "No Sign Detected" 1 "End of Speed Limit" 2 "End of All Restrictions" 3 "Begin of Motorway" 4 "End of Motorway" 5 "Begin of Expressway" 6 "End of Expressway" 7 "Begin of Play Street Zone" 8 "End of Play Street Zone" 9 "Begin of Passing Restriction" 10 "End of Passing Restriction" 11 "No Entry" 12 "Begin of City Limits" 13 "End of City Limits" 14 "Yield" 15 "Crosswalk" 16 "Round About" 17 "Stop Sign" 18 "Yield to Oncoming Traffic" 19 "Pedestrian Zone" 20 "No Stopping Sign" 21 "No Parking Sign" 22 "Begin of No Parking Zone" 23 "End of No Parking Zone" 24 "Invalid Sign" 25 "Unknown Sign" 26 "Speed Limit 5" 27 "Speed Limit 10" 28 "Speed Limit 15" 29 "Speed Limit 20" 30 "Speed Limit 25" 31 "Speed Limit 30" 32 "Speed Limit 35" 33 "Speed Limit 40" 34 "Speed Limit 45" 35 "Speed Limit 50" 36 "Speed Limit 55" 37 "Speed Limit 60" 38 "Speed Limit 65" 39 "Speed Limit 70" 40 "Speed Limit 75" 41 "Speed Limit 80" 42 "Speed Limit 85" 43 "Speed Limit 90" 44 "Speed Limit 95" 45 "Speed Limit 100" 46 "Speed Limit 105" 47 "Speed Limit 110" 48 "Speed Limit 115" 49 "Speed Limit 120" 50 "Speed Limit 125" 51 "Speed Limit 130" 52 "Speed Limit 135" 53 "Speed Limit 140" 54 "Speed Limit 145" 55 "Speed Limit 150" 56 "Attention Sign Construction" 57 "Attention Sign Crosswalk" 58 "Attention Sign Round About" 59 "Attention Sign Children" 60 "Attention Sign Animals Crossing" 61 "Attention Sign General" 62 "Attention Sign Cross-way" 63 "Attention Sign Sharp Turn Left" 64 "Attention Sign Sharp Turn Right" 65 "Attention Sign Winding Road" 66 "Attention Sign Up-Grade" 67 "Attention Sign Down-Grade" 68 "Attention Sign Narrow Road Left" 69 "Attention Sign Narrow Road Right" 70 "Attention Sign Narrow Road Left & Right" 71 "Attention Sign Slippery Raod" 72 "Restricted Access for All Vehicles" 73 "Restricted Access for Cars" 74 "Restricted Access for Cars & Motorcycles" 75 "Restricted Access for Campers" ;
VAL_TABLE_ FCODPB14P_FVTSTk9TypCnfdAuth 0 "Highly Speculative" 1 "Speculative" 2 "Confident" 3 "Highly Confident" ;
VAL_TABLE_ FCODPB2P_AutofxOutOfCalAuth 0 "UNKNOWN" 1 "YAW" 2 "HORIZON" 3 "BOTH" ;
VAL_TABLE_ FCODPB2P_FrwdCamSysOprtgStsAuth 0 "UNKNOWN" 1 "INITIALIZING" 2 "INACTIVE" 3 "ACTIVE" 4 "RESERVED1" 5 "RESERVED2" 6 "RESERVED3" 7 "FAILED" ;
VAL_TABLE_ FCODPB2P_EnvIllumAuth 0 "UNKNOWN" 1 "LIT ENVIRONMENT DURING NIGHT" 2 "UNLIT ENVIRONMENT DURING NIGHT" 3 "DAYLIGHT" ;
VAL_TABLE_ FCODPB2P_FVFaildAuth 0 "FALSE" 1 "TRUE" ;
VAL_TABLE_ FCODPB2P_FVBlkgStsAuth 0 "UNKNOWN" 1 "NOT BLOCKED" 2 "FULL BLOCKAGE" 3 "PARTIAL BLOCKAGE" 4 "RESERVED3" 5 "RESERVED4" 6 "RESERVED5" 7 "RESERVED6" ;
VAL_TABLE_ FCODPB2P_FVAdvWthrStsAuth 0 "CLEAR WEATHER" 1 "LIGHT FOG" 2 "MEDIUM FOG" 3 "HEAVY FOG" 4 "LIGHT SNOW" 5 "MEDIUM SNOW" 6 "HEAVY SNOW" 7 "LIGHT RAIN" 8 "MEDIUM RAIN" 9 "HEAVY RAIN" ;
VAL_TABLE_ FCODPB2P_FVFailDtnStsAuth 0 "NO FAILURE" 1 "HARDWARE FAILURE" 2 "SIGNAL SUPERVISION FAILURE" 3 "RECEIVE SIGNAL TIMEOUT" 4 "GENERAL UNAVAILABILITY" 5 "UNKNOWN" ;
VAL_TABLE_ FCODPB2P_FVLBTk2ClrAuth 0 "UNKNOWN" 1 "WHITE" 2 "YELLOW/ORANGE" 3 "OTHER" ;
VAL_TABLE_ FCODPB2P_FVLBDtnAqTmStmAuth_Inv 0 "FALSE" 1 "TRUE" ;
VAL_TABLE_ FCODPB2P_FVLBTk2PstnTypAuth 0 "Unknown" 1 "Host Left Lane" 2 "Host Right Lane" 3 "Next Left Lane" 4 "Next Right Lane" 5 "Second Next Left Lane" 6 "Second Next Right Lane" 7 "Third Next Left Lane" 8 "Third Next Right Lane" 9 "Fourth Next Left Lane" 10 "Fourth Next Right Lane" 11 "Fifth Next Left Lane" 12 "Fifth Next Right Lane" ;
VAL_TABLE_ FCODPB2P_FVLBTk2TypAuth 0 "UNDECIDED" 1 "SOLID" 2 "DASHED" 3 "ROAD EDGE" 4 "DOUBLE LINE" 5 "BOTTS DOTS" 6 "VIRTUAL" 7 "TRIPLE LINE" ;
VAL_TABLE_ FCODPB2P_FVLBTk2QltyAuth 0 "VERY LOW QUALITY" 1 "LOW QUALITY" 2 "PREDICTION" 3 "HIGH QUALITY" ;
VAL_TABLE_ FCODPB2P_FVLnChngIndAuth 0 "FALSE" 1 "TRUE" ;
VAL_TABLE_ FCODPB2P_FVLtdAccssRdTypAuth 0 "Unknown" 1 "Non Limited Access Road" 2 "Limited Access Road" ;
VAL_TABLE_ FCODPB2P_FVPOTk2DynPrpAuth 0 "Has Never Moved" 1 "Has Moved But Currently Stopped" 2 "Moving In Same Direction As Host" 3 "Moving In Opposite Direction As Host" 4 "Crossing Path" ;
VAL_TABLE_ FCODPB2P_FVPOTk2CnfdStsAuth 0 "Highly Speculative" 1 "Speculative" 2 "Confident" 3 "Highly Confident" ;
VAL_TABLE_ FCODPB2P_FVPOTk2MStsAuth 0 "No Object" 1 "New Object" 2 "Latent Track Not Detected this Cycle" 3 "Measured this Cycle" ;
VAL_TABLE_ FCODPB2P_FVPOTk2TypCnfdAuth 0 "Highly Speculative" 1 "Speculative" 2 "Confident" 3 "Highly Confident" ;
VAL_TABLE_ FCODPB2P_FVPOTk2TypAuth 0 "Unknown" 1 "Pedestrian" 2 "Bicycle" ;
VAL_TABLE_ FCODPB2P_FVServAlgnRtnStsAuth 0 "NOT STARTED" 1 "IN PROGRESS" 2 "SUCCEEDED" 3 "STOPPED BY USER" 4 "FULL BLOCKAGE" 5 "PARTIAL BLOCKAGE" 6 "GENERAL UNAVAILABILITY" 7 "HARDWARE FAILURE" 8 "SIGNAL SUPERVISION FAILURE" 9 "RECEIVE SIGNAL TIMEOUT" 10 "POWER MODE NOT RUN" 11 "FAILED" ;
VAL_TABLE_ FCODPB2P_FVServAlgnInPrcAuth 0 "FALSE" 1 "TRUE" ;
VAL_TABLE_ FCODPB2P_FVSysCalStsAuth 0 "NOT CALIBRATED" 1 "CALIBRATED" 2 "DYNAMICALLY CALIBRATED" 3 "UNKNOWN" ;
VAL_TABLE_ FCODPB2P_FVServRqAuth 0 "FALSE" 1 "TRUE" ;
VAL_TABLE_ FCODPB2P_FVVOTk2BrkLgtStsAuth 0 "UNKNOWN" 1 "OFF" 2 "ON" 3 "FLASHING" ;
VAL_TABLE_ FCODPB2P_FVUnvAuth 0 "FALSE" 1 "TRUE" ;
VAL_TABLE_ FCODPB2P_FVVOTk2CnfdStsAuth 0 "Highly Speculative" 1 "Speculative" 2 "Confident" 3 "Highly Confident" ;
VAL_TABLE_ FCODPB2P_FVVOTk2DynPrpStsAuth 0 "Stopped" 1 "Not Stopped" ;
VAL_TABLE_ FCODPB2P_FVVOTk2DynPrpAuth 0 "Has Never Moved" 1 "Has Moved But Currently Stopped" 2 "Moving In Same Direction As Host" 3 "Moving In Opposite Direction As Host" 4 "Crossing From Left To Right" 5 "Crossing From Right To Left" 6 "Unknown" ;
VAL_TABLE_ FCODPB2P_FVVOTk2MStsAuth 0 "No Object" 1 "New Object" 2 "Latent Track Not Detected this Cycle" 3 "Measured this Cycle" ;
VAL_TABLE_ FCODPB2P_FVVOTk2LnAsmtAuth 0 "UNKNOWN" 1 "HOST LANE" 2 "RIGHT LANE" 3 "LEFT LANE" 4 "2nd RIGHT LANE" 5 "2nd LEFT LANE" ;
VAL_TABLE_ FCODPB2P_FVVOTk2TypAuth 0 "Unknown" 1 "Motorcycle" 2 "Vehicle" 3 "Truck" ;
VAL_TABLE_ FCODPB2P_FVVOTk2TSLgtStsAuth 0 "UNKNOWN" 1 "OFF" 2 "LEFT" 3 "RIGHT" 4 "BOTH" ;
VAL_TABLE_ FCODPB2P_RdTypAuth 0 "TOWN" 1 "COUNTRY ROAD" 2 "MOTORWAY" 3 "RESERVED1" 4 "RESERVED2" 5 "RESERVED3" 6 "RESERVED 4" 7 "UNDEFINED" ;
VAL_TABLE_ FCODPB2P_FVVOTk2TypCnfdAuth 0 "Highly Speculative" 1 "Speculative" 2 "Confident" 3 "Highly Confident" ;
VAL_TABLE_ FCODPB3P_FlSfBlrdImgDtdAuth 0 "FALSE" 1 "TRUE" ;
VAL_TABLE_ FCODPB3P_ConstrArRtDtdAuth 0 "FALSE" 1 "TRUE" ;
VAL_TABLE_ FCODPB3P_ConstrArLtDtdAuth 0 "FALSE" 1 "TRUE" ;
VAL_TABLE_ FCODPB3P_AmbLnMrksRtAuth 0 "FALSE" 1 "TRUE" ;
VAL_TABLE_ FCODPB3P_AmbLnMrksLtAuth 0 "FALSE" 1 "TRUE" ;
VAL_TABLE_ FCODPB3P_FlSfFggyScnDtdAuth 0 "FALSE" 1 "TRUE" ;
VAL_TABLE_ FCODPB3P_FlSfFllBlkgDtdAuth 0 "FALSE" 1 "TRUE" ;
VAL_TABLE_ FCODPB3P_FlSfLoSnDtdAuth 0 "FALSE" 1 "TRUE" ;
VAL_TABLE_ FCODPB3P_FlSfPtlBlkgDtdAuth 0 "FALSE" 1 "TRUE" ;
VAL_TABLE_ FCODPB3P_FlSfSmrdSptDtdAuth 0 "FALSE" 1 "TRUE" ;
VAL_TABLE_ FCODPB3P_FlSfSplshsDtdAuth 0 "FALSE" 1 "TRUE" ;
VAL_TABLE_ FCODPB3P_FrwyExtRtDtdAuth 0 "FALSE" 1 "TRUE" ;
VAL_TABLE_ FCODPB3P_FrwyExtLtDtdAuth 0 "FALSE" 1 "TRUE" ;
VAL_TABLE_ FCODPB3P_FrwyMrgRtDtdAuth 0 "FALSE" 1 "TRUE" ;
VAL_TABLE_ FCODPB3P_FrwyMrgLtDtdAuth 0 "FALSE" 1 "TRUE" ;
VAL_TABLE_ FCODPB3P_FVAcqTmStmAuth_Inv 0 "FALSE" 1 "TRUE" ;
VAL_TABLE_ FCODPB3P_FVConstrArDtdCnfdAuth 0 "Highly Speculative" 1 "Speculative" 2 "Confident" 3 "Highly Confident" ;
VAL_TABLE_ FCODPB3P_FVConstrArDtnStsAuth 0 "Not Detected" 1 "Detected" 2 "Unknown" ;
VAL_TABLE_ FCODPB3P_FVLBTk3ClrAuth 0 "UNKNOWN" 1 "WHITE" 2 "YELLOW/ORANGE" 3 "OTHER" ;
VAL_TABLE_ FCODPB3P_FVLBTk3PstnTypAuth 0 "Unknown" 1 "Host Left Lane" 2 "Host Right Lane" 3 "Next Left Lane" 4 "Next Right Lane" 5 "Second Next Left Lane" 6 "Second Next Right Lane" 7 "Third Next Left Lane" 8 "Third Next Right Lane" 9 "Fourth Next Left Lane" 10 "Fourth Next Right Lane" 11 "Fifth Next Left Lane" 12 "Fifth Next Right Lane" ;
VAL_TABLE_ FCODPB3P_FVLBTk3TypAuth 0 "UNDECIDED" 1 "SOLID" 2 "DASHED" 3 "ROAD EDGE" 4 "DOUBLE LINE" 5 "BOTTS DOTS" 6 "VIRTUAL" 7 "TRIPLE LINE" ;
VAL_TABLE_ FCODPB3P_FVLBTk3QltyAuth 0 "VERY LOW QUALITY" 1 "LOW QUALITY" 2 "PREDICTION" 3 "HIGH QUALITY" ;
VAL_TABLE_ FCODPB3P_FVPOTk3DynPrpAuth 0 "Has Never Moved" 1 "Has Moved But Currently Stopped" 2 "Moving In Same Direction As Host" 3 "Moving In Opposite Direction As Host" 4 "Crossing Path" ;
VAL_TABLE_ FCODPB3P_FVPOTk3CnfdStsAuth 0 "Highly Speculative" 1 "Speculative" 2 "Confident" 3 "Highly Confident" ;
VAL_TABLE_ FCODPB3P_FVPOTk3MStsAuth 0 "No Object" 1 "New Object" 2 "Latent Track Not Detected this Cycle" 3 "Measured this Cycle" ;
VAL_TABLE_ FCODPB3P_FVVOTk3BrkLgtStsAuth 0 "UNKNOWN" 1 "OFF" 2 "ON" 3 "FLASHING" ;
VAL_TABLE_ FCODPB3P_FVVCRngCutInRtAuth 0 "NO CUT IN" 1 "CUT IN" ;
VAL_TABLE_ FCODPB3P_FVVCRngCutInLtAuth 0 "NO CUT IN" 1 "CUT IN" ;
VAL_TABLE_ FCODPB3P_FVPOTk3TypCnfdAuth 0 "Highly Speculative" 1 "Speculative" 2 "Confident" 3 "Highly Confident" ;
VAL_TABLE_ FCODPB3P_FVPOTk3TypAuth 0 "Unknown" 1 "Pedestrian" 2 "Bicycle" ;
VAL_TABLE_ FCODPB3P_FVVOTk3CnfdStsAuth 0 "Highly Speculative" 1 "Speculative" 2 "Confident" 3 "Highly Confident" ;
VAL_TABLE_ FCODPB3P_FVVOTk3DynPrpStsAuth 0 "Stopped" 1 "Not Stopped" ;
VAL_TABLE_ FCODPB3P_FVVOTk3DynPrpAuth 0 "Has Never Moved" 1 "Has Moved But Currently Stopped" 2 "Moving In Same Direction As Host" 3 "Moving In Opposite Direction As Host" 4 "Crossing From Left To Right" 5 "Crossing From Right To Left" 6 "Unknown" ;
VAL_TABLE_ FCODPB3P_FVVOTk3MStsAuth 0 "No Object" 1 "New Object" 2 "Latent Track Not Detected this Cycle" 3 "Measured this Cycle" ;
VAL_TABLE_ FCODPB3P_FVVOTk3LnAsmtAuth 0 "UNKNOWN" 1 "HOST LANE" 2 "RIGHT LANE" 3 "LEFT LANE" 4 "2nd RIGHT LANE" 5 "2nd LEFT LANE" ;
VAL_TABLE_ FCODPB3P_FVVOTk3TypAuth 0 "Unknown" 1 "Motorcycle" 2 "Vehicle" 3 "Truck" ;
VAL_TABLE_ FCODPB3P_FVVOTk3TSLgtStsAuth 0 "UNKNOWN" 1 "OFF" 2 "LEFT" 3 "RIGHT" 4 "BOTH" ;
VAL_TABLE_ FCODPB3P_OvrhdStrctDtdAuth 0 "FALSE" 1 "TRUE" ;
VAL_TABLE_ FCODPB3P_IntTrffcDtdAuth 0 "FALSE" 1 "TRUE" ;
VAL_TABLE_ FCODPB3P_FVVOTk3TypCnfdAuth 0 "Highly Speculative" 1 "Speculative" 2 "Confident" 3 "Highly Confident" ;
VAL_TABLE_ FCODPB3P_VehInTnnlCnfdAuth 0 "Highly Speculative" 1 "Speculative" 2 "Confident" 3 "Highly Confident" ;
VAL_TABLE_ FCODPB3P_TrffcLgtDtdAuth 0 "FALSE" 1 "TRUE" ;
VAL_TABLE_ FCODPB3P_VehInTnnlDtdAuth 0 "FALSE" 1 "TRUE" ;
VAL_TABLE_ FCODPB4P_FVLBTk11ClrAuth 0 "UNKNOWN" 1 "WHITE" 2 "YELLOW/ORANGE" 3 "OTHER" ;
VAL_TABLE_ FCODPB4P_FVLBTk11PstnTypAuth 0 "Unknown" 1 "Host Left Lane" 2 "Host Right Lane" 3 "Next Left Lane" 4 "Next Right Lane" 5 "Second Next Left Lane" 6 "Second Next Right Lane" 7 "Third Next Left Lane" 8 "Third Next Right Lane" 9 "Fourth Next Left Lane" 10 "Fourth Next Right Lane" 11 "Fifth Next Left Lane" 12 "Fifth Next Right Lane" ;
VAL_TABLE_ FCODPB4P_FVLBTk11TypAuth 0 "UNDECIDED" 1 "SOLID" 2 "DASHED" 3 "ROAD EDGE" 4 "DOUBLE LINE" 5 "BOTTS DOTS" 6 "VIRTUAL" 7 "TRIPLE LINE" ;
VAL_TABLE_ FCODPB4P_FVLBTk11QltyAuth 0 "VERY LOW QUALITY" 1 "LOW QUALITY" 2 "PREDICTION" 3 "HIGH QUALITY" ;
VAL_TABLE_ FCODPB4P_FVLBTk4ClrAuth 0 "UNKNOWN" 1 "WHITE" 2 "YELLOW/ORANGE" 3 "OTHER" ;
VAL_TABLE_ FCODPB4P_FVLBTk4TypAuth 0 "UNDECIDED" 1 "SOLID" 2 "DASHED" 3 "ROAD EDGE" 4 "DOUBLE LINE" 5 "BOTTS DOTS" 6 "VIRTUAL" 7 "TRIPLE LINE" ;
VAL_TABLE_ FCODPB4P_FVLBTk4QltyAuth 0 "VERY LOW QUALITY" 1 "LOW QUALITY" 2 "PREDICTION" 3 "HIGH QUALITY" ;
VAL_TABLE_ FCODPB4P_FVLBTk4PstnTypAuth 0 "Unknown" 1 "Host Left Lane" 2 "Host Right Lane" 3 "Next Left Lane" 4 "Next Right Lane" 5 "Second Next Left Lane" 6 "Second Next Right Lane" 7 "Third Next Left Lane" 8 "Third Next Right Lane" 9 "Fourth Next Left Lane" 10 "Fourth Next Right Lane" 11 "Fifth Next Left Lane" 12 "Fifth Next Right Lane" ;
VAL_TABLE_ FCODPB4P_FVPOTk4CnfdStsAuth 0 "Highly Speculative" 1 "Speculative" 2 "Confident" 3 "Highly Confident" ;
VAL_TABLE_ FCODPB4P_FVPOTk4DynPrpAuth 0 "Has Never Moved" 1 "Has Moved But Currently Stopped" 2 "Moving In Same Direction As Host" 3 "Moving In Opposite Direction As Host" 4 "Crossing Path" ;
VAL_TABLE_ FCODPB4P_FVPOTk4MStsAuth 0 "No Object" 1 "New Object" 2 "Latent Track Not Detected this Cycle" 3 "Measured this Cycle" ;
VAL_TABLE_ FCODPB4P_FVVOTk4BrkLgtStsAuth 0 "UNKNOWN" 1 "OFF" 2 "ON" 3 "FLASHING" ;
VAL_TABLE_ FCODPB4P_FVPOTk4TypCnfdAuth 0 "Highly Speculative" 1 "Speculative" 2 "Confident" 3 "Highly Confident" ;
VAL_TABLE_ FCODPB4P_FVPOTk4TypAuth 0 "Unknown" 1 "Pedestrian" 2 "Bicycle" ;
VAL_TABLE_ FCODPB4P_FVVOTk4CnfdStsAuth 0 "Highly Speculative" 1 "Speculative" 2 "Confident" 3 "Highly Confident" ;
VAL_TABLE_ FCODPB4P_FVVOTk4DynPrpStsAuth 0 "Stopped" 1 "Not Stopped" ;
VAL_TABLE_ FCODPB4P_FVVOTk4DynPrpAuth 0 "Has Never Moved" 1 "Has Moved But Currently Stopped" 2 "Moving In Same Direction As Host" 3 "Moving In Opposite Direction As Host" 4 "Crossing From Left To Right" 5 "Crossing From Right To Left" 6 "Unknown" ;
VAL_TABLE_ FCODPB4P_FVVOTk4MStsAuth 0 "No Object" 1 "New Object" 2 "Latent Track Not Detected this Cycle" 3 "Measured this Cycle" ;
VAL_TABLE_ FCODPB4P_FVVOTk4LnAsmtAuth 0 "UNKNOWN" 1 "HOST LANE" 2 "RIGHT LANE" 3 "LEFT LANE" 4 "2nd RIGHT LANE" 5 "2nd LEFT LANE" ;
VAL_TABLE_ FCODPB4P_FVVOTk4TypAuth 0 "Unknown" 1 "Motorcycle" 2 "Vehicle" 3 "Truck" ;
VAL_TABLE_ FCODPB4P_FVVOTk4TSLgtStsAuth 0 "UNKNOWN" 1 "OFF" 2 "LEFT" 3 "RIGHT" 4 "BOTH" ;
VAL_TABLE_ FCODPB4P_FVVOTk4TypCnfdAuth 0 "Highly Speculative" 1 "Speculative" 2 "Confident" 3 "Highly Confident" ;
VAL_TABLE_ FCODPB5P_FVLBTk10ClrAuth 0 "UNKNOWN" 1 "WHITE" 2 "YELLOW/ORANGE" 3 "OTHER" ;
VAL_TABLE_ FCODPB5P_FVLBTk10PstnTypAuth 0 "Unknown" 1 "Host Left Lane" 2 "Host Right Lane" 3 "Next Left Lane" 4 "Next Right Lane" 5 "Second Next Left Lane" 6 "Second Next Right Lane" 7 "Third Next Left Lane" 8 "Third Next Right Lane" 9 "Fourth Next Left Lane" 10 "Fourth Next Right Lane" 11 "Fifth Next Left Lane" 12 "Fifth Next Right Lane" ;
VAL_TABLE_ FCODPB5P_FVLBTk10TypAuth 0 "UNDECIDED" 1 "SOLID" 2 "DASHED" 3 "ROAD EDGE" 4 "DOUBLE LINE" 5 "BOTTS DOTS" 6 "VIRTUAL" 7 "TRIPLE LINE" ;
VAL_TABLE_ FCODPB5P_FVLBTk10QltyAuth 0 "VERY LOW QUALITY" 1 "LOW QUALITY" 2 "PREDICTION" 3 "HIGH QUALITY" ;
VAL_TABLE_ FCODPB5P_FVLBTk5ClrAuth 0 "UNKNOWN" 1 "WHITE" 2 "YELLOW/ORANGE" 3 "OTHER" ;
VAL_TABLE_ FCODPB5P_FVLBTk5TypAuth 0 "UNDECIDED" 1 "SOLID" 2 "DASHED" 3 "ROAD EDGE" 4 "DOUBLE LINE" 5 "BOTTS DOTS" 6 "VIRTUAL" 7 "TRIPLE LINE" ;
VAL_TABLE_ FCODPB5P_FVLBTk5QltyAuth 0 "VERY LOW QUALITY" 1 "LOW QUALITY" 2 "PREDICTION" 3 "HIGH QUALITY" ;
VAL_TABLE_ FCODPB5P_FVLBTk5PstnTypAuth 0 "Unknown" 1 "Host Left Lane" 2 "Host Right Lane" 3 "Next Left Lane" 4 "Next Right Lane" 5 "Second Next Left Lane" 6 "Second Next Right Lane" 7 "Third Next Left Lane" 8 "Third Next Right Lane" 9 "Fourth Next Left Lane" 10 "Fourth Next Right Lane" 11 "Fifth Next Left Lane" 12 "Fifth Next Right Lane" ;
VAL_TABLE_ FCODPB5P_FVPOTk5CnfdStsAuth 0 "Highly Speculative" 1 "Speculative" 2 "Confident" 3 "Highly Confident" ;
VAL_TABLE_ FCODPB5P_FVPOTk5DynPrpAuth 0 "Has Never Moved" 1 "Has Moved But Currently Stopped" 2 "Moving In Same Direction As Host" 3 "Moving In Opposite Direction As Host" 4 "Crossing Path" ;
VAL_TABLE_ FCODPB5P_FVPOTk5MStsAuth 0 "No Object" 1 "New Object" 2 "Latent Track Not Detected this Cycle" 3 "Measured this Cycle" ;
VAL_TABLE_ FCODPB5P_FVVOTk5BrkLgtStsAuth 0 "UNKNOWN" 1 "OFF" 2 "ON" 3 "FLASHING" ;
VAL_TABLE_ FCODPB5P_FVPOTk5TypCnfdAuth 0 "Highly Speculative" 1 "Speculative" 2 "Confident" 3 "Highly Confident" ;
VAL_TABLE_ FCODPB5P_FVPOTk5TypAuth 0 "Unknown" 1 "Pedestrian" 2 "Bicycle" ;
VAL_TABLE_ FCODPB5P_FVVOTk5CnfdStsAuth 0 "Highly Speculative" 1 "Speculative" 2 "Confident" 3 "Highly Confident" ;
VAL_TABLE_ FCODPB5P_FVVOTk5DynPrpStsAuth 0 "Stopped" 1 "Not Stopped" ;
VAL_TABLE_ FCODPB5P_FVVOTk5DynPrpAuth 0 "Has Never Moved" 1 "Has Moved But Currently Stopped" 2 "Moving In Same Direction As Host" 3 "Moving In Opposite Direction As Host" 4 "Crossing From Left To Right" 5 "Crossing From Right To Left" 6 "Unknown" ;
VAL_TABLE_ FCODPB5P_FVVOTk5MStsAuth 0 "No Object" 1 "New Object" 2 "Latent Track Not Detected this Cycle" 3 "Measured this Cycle" ;
VAL_TABLE_ FCODPB5P_FVVOTk5LnAsmtAuth 0 "UNKNOWN" 1 "HOST LANE" 2 "RIGHT LANE" 3 "LEFT LANE" 4 "2nd RIGHT LANE" 5 "2nd LEFT LANE" ;
VAL_TABLE_ FCODPB5P_FVVOTk5TypAuth 0 "Unknown" 1 "Motorcycle" 2 "Vehicle" 3 "Truck" ;
VAL_TABLE_ FCODPB5P_FVVOTk5TSLgtStsAuth 0 "UNKNOWN" 1 "OFF" 2 "LEFT" 3 "RIGHT" 4 "BOTH" ;
VAL_TABLE_ FCODPB5P_FVVOTk5TypCnfdAuth 0 "Highly Speculative" 1 "Speculative" 2 "Confident" 3 "Highly Confident" ;
VAL_TABLE_ FCODPB6P_FVLBTk6ClrAuth 0 "UNKNOWN" 1 "WHITE" 2 "YELLOW/ORANGE" 3 "OTHER" ;
VAL_TABLE_ FCODPB6P_FVLBTk6PstnTypAuth 0 "Unknown" 1 "Host Left Lane" 2 "Host Right Lane" 3 "Next Left Lane" 4 "Next Right Lane" 5 "Second Next Left Lane" 6 "Second Next Right Lane" 7 "Third Next Left Lane" 8 "Third Next Right Lane" 9 "Fourth Next Left Lane" 10 "Fourth Next Right Lane" 11 "Fifth Next Left Lane" 12 "Fifth Next Right Lane" ;
VAL_TABLE_ FCODPB6P_FVLBTk6TypAuth 0 "UNDECIDED" 1 "SOLID" 2 "DASHED" 3 "ROAD EDGE" 4 "DOUBLE LINE" 5 "BOTTS DOTS" 6 "VIRTUAL" 7 "TRIPLE LINE" ;
VAL_TABLE_ FCODPB6P_FVLBTk6QltyAuth 0 "VERY LOW QUALITY" 1 "LOW QUALITY" 2 "PREDICTION" 3 "HIGH QUALITY" ;
VAL_TABLE_ FCODPB6P_FVVOTk10BrkLgtStsAuth 0 "UNKNOWN" 1 "OFF" 2 "ON" 3 "FLASHING" ;
VAL_TABLE_ FCODPB6P_FVVOTk10DynPrpAuth 0 "Has Never Moved" 1 "Has Moved But Currently Stopped" 2 "Moving In Same Direction As Host" 3 "Moving In Opposite Direction As Host" 4 "Crossing From Left To Right" 5 "Crossing From Right To Left" 6 "Unknown" ;
VAL_TABLE_ FCODPB6P_FVVOTk10CnfdStsAuth 0 "Highly Speculative" 1 "Speculative" 2 "Confident" 3 "Highly Confident" ;
VAL_TABLE_ FCODPB6P_FVVOTk10DynPrpStsAuth 0 "Stopped" 1 "Not Stopped" ;
VAL_TABLE_ FCODPB6P_FVVOTk10MStsAuth 0 "No Object" 1 "New Object" 2 "Latent Track Not Detected this Cycle" 3 "Measured this Cycle" ;
VAL_TABLE_ FCODPB6P_FVVOTk10LnAsmtAuth 0 "UNKNOWN" 1 "HOST LANE" 2 "RIGHT LANE" 3 "LEFT LANE" 4 "2nd RIGHT LANE" 5 "2nd LEFT LANE" ;
VAL_TABLE_ FCODPB6P_FVVOTk6BrkLgtStsAuth 0 "UNKNOWN" 1 "OFF" 2 "ON" 3 "FLASHING" ;
VAL_TABLE_ FCODPB6P_FVVOTk10TypCnfdAuth 0 "Highly Speculative" 1 "Speculative" 2 "Confident" 3 "Highly Confident" ;
VAL_TABLE_ FCODPB6P_FVVOTk10TypAuth 0 "Unknown" 1 "Motorcycle" 2 "Vehicle" 3 "Truck" ;
VAL_TABLE_ FCODPB6P_FVVOTk10TSLgtStsAuth 0 "UNKNOWN" 1 "OFF" 2 "LEFT" 3 "RIGHT" 4 "BOTH" ;
VAL_TABLE_ FCODPB6P_FVVOTk6CnfdStsAuth 0 "Highly Speculative" 1 "Speculative" 2 "Confident" 3 "Highly Confident" ;
VAL_TABLE_ FCODPB6P_FVVOTk6DynPrpStsAuth 0 "Stopped" 1 "Not Stopped" ;
VAL_TABLE_ FCODPB6P_FVVOTk6DynPrpAuth 0 "Has Never Moved" 1 "Has Moved But Currently Stopped" 2 "Moving In Same Direction As Host" 3 "Moving In Opposite Direction As Host" 4 "Crossing From Left To Right" 5 "Crossing From Right To Left" 6 "Unknown" ;
VAL_TABLE_ FCODPB6P_FVVOTk6MStsAuth 0 "No Object" 1 "New Object" 2 "Latent Track Not Detected this Cycle" 3 "Measured this Cycle" ;
VAL_TABLE_ FCODPB6P_FVVOTk6LnAsmtAuth 0 "UNKNOWN" 1 "HOST LANE" 2 "RIGHT LANE" 3 "LEFT LANE" 4 "2nd RIGHT LANE" 5 "2nd LEFT LANE" ;
VAL_TABLE_ FCODPB6P_FVVOTk6TypAuth 0 "Unknown" 1 "Motorcycle" 2 "Vehicle" 3 "Truck" ;
VAL_TABLE_ FCODPB6P_FVVOTk6TSLgtStsAuth 0 "UNKNOWN" 1 "OFF" 2 "LEFT" 3 "RIGHT" 4 "BOTH" ;
VAL_TABLE_ FCODPB6P_FVVOTk6TypCnfdAuth 0 "Highly Speculative" 1 "Speculative" 2 "Confident" 3 "Highly Confident" ;
VAL_TABLE_ FCODPB7P_FVLBTk7ClrAuth 0 "UNKNOWN" 1 "WHITE" 2 "YELLOW/ORANGE" 3 "OTHER" ;
VAL_TABLE_ FCODPB7P_FVLBTk7PstnTypAuth 0 "Unknown" 1 "Host Left Lane" 2 "Host Right Lane" 3 "Next Left Lane" 4 "Next Right Lane" 5 "Second Next Left Lane" 6 "Second Next Right Lane" 7 "Third Next Left Lane" 8 "Third Next Right Lane" 9 "Fourth Next Left Lane" 10 "Fourth Next Right Lane" 11 "Fifth Next Left Lane" 12 "Fifth Next Right Lane" ;
VAL_TABLE_ FCODPB7P_FVLBTk7TypAuth 0 "UNDECIDED" 1 "SOLID" 2 "DASHED" 3 "ROAD EDGE" 4 "DOUBLE LINE" 5 "BOTTS DOTS" 6 "VIRTUAL" 7 "TRIPLE LINE" ;
VAL_TABLE_ FCODPB7P_FVLBTk7QltyAuth 0 "VERY LOW QUALITY" 1 "LOW QUALITY" 2 "PREDICTION" 3 "HIGH QUALITY" ;
VAL_TABLE_ FCODPB7P_FVLBTk9ClrAuth 0 "UNKNOWN" 1 "WHITE" 2 "YELLOW/ORANGE" 3 "OTHER" ;
VAL_TABLE_ FCODPB7P_FVLBTk9TypAuth 0 "UNDECIDED" 1 "SOLID" 2 "DASHED" 3 "ROAD EDGE" 4 "DOUBLE LINE" 5 "BOTTS DOTS" 6 "VIRTUAL" 7 "TRIPLE LINE" ;
VAL_TABLE_ FCODPB7P_FVLBTk9QltyAuth 0 "VERY LOW QUALITY" 1 "LOW QUALITY" 2 "PREDICTION" 3 "HIGH QUALITY" ;
VAL_TABLE_ FCODPB7P_FVLBTk9PstnTypAuth 0 "Unknown" 1 "Host Left Lane" 2 "Host Right Lane" 3 "Next Left Lane" 4 "Next Right Lane" 5 "Second Next Left Lane" 6 "Second Next Right Lane" 7 "Third Next Left Lane" 8 "Third Next Right Lane" 9 "Fourth Next Left Lane" 10 "Fourth Next Right Lane" 11 "Fifth Next Left Lane" 12 "Fifth Next Right Lane" ;
VAL_TABLE_ FCODPB7P_FVVOTk7BrkLgtStsAuth 0 "UNKNOWN" 1 "OFF" 2 "ON" 3 "FLASHING" ;
VAL_TABLE_ FCODPB7P_FVVOTk7CnfdStsAuth 0 "Highly Speculative" 1 "Speculative" 2 "Confident" 3 "Highly Confident" ;
VAL_TABLE_ FCODPB7P_FVVOTk7DynPrpStsAuth 0 "Stopped" 1 "Not Stopped" ;
VAL_TABLE_ FCODPB7P_FVVOTk7DynPrpAuth 0 "Has Never Moved" 1 "Has Moved But Currently Stopped" 2 "Moving In Same Direction As Host" 3 "Moving In Opposite Direction As Host" 4 "Crossing From Left To Right" 5 "Crossing From Right To Left" 6 "Unknown" ;
VAL_TABLE_ FCODPB7P_FVVOTk7MStsAuth 0 "No Object" 1 "New Object" 2 "Latent Track Not Detected this Cycle" 3 "Measured this Cycle" ;
VAL_TABLE_ FCODPB7P_FVVOTk7LnAsmtAuth 0 "UNKNOWN" 1 "HOST LANE" 2 "RIGHT LANE" 3 "LEFT LANE" 4 "2nd RIGHT LANE" 5 "2nd LEFT LANE" ;
VAL_TABLE_ FCODPB7P_FVVOTk7TypCnfdAuth 0 "Highly Speculative" 1 "Speculative" 2 "Confident" 3 "Highly Confident" ;
VAL_TABLE_ FCODPB7P_FVVOTk7TypAuth 0 "Unknown" 1 "Motorcycle" 2 "Vehicle" 3 "Truck" ;
VAL_TABLE_ FCODPB7P_FVVOTk7TSLgtStsAuth 0 "UNKNOWN" 1 "OFF" 2 "LEFT" 3 "RIGHT" 4 "BOTH" ;
VAL_TABLE_ FCODPB8P_FVLBTk8ClrAuth 0 "UNKNOWN" 1 "WHITE" 2 "YELLOW/ORANGE" 3 "OTHER" ;
VAL_TABLE_ FCODPB8P_FVLBTk8PstnTypAuth 0 "Unknown" 1 "Host Left Lane" 2 "Host Right Lane" 3 "Next Left Lane" 4 "Next Right Lane" 5 "Second Next Left Lane" 6 "Second Next Right Lane" 7 "Third Next Left Lane" 8 "Third Next Right Lane" 9 "Fourth Next Left Lane" 10 "Fourth Next Right Lane" 11 "Fifth Next Left Lane" 12 "Fifth Next Right Lane" ;
VAL_TABLE_ FCODPB8P_FVLBTk8TypAuth 0 "UNDECIDED" 1 "SOLID" 2 "DASHED" 3 "ROAD EDGE" 4 "DOUBLE LINE" 5 "BOTTS DOTS" 6 "VIRTUAL" 7 "TRIPLE LINE" ;
VAL_TABLE_ FCODPB8P_FVLBTk8QltyAuth 0 "VERY LOW QUALITY" 1 "LOW QUALITY" 2 "PREDICTION" 3 "HIGH QUALITY" ;
VAL_TABLE_ FCODPB8P_FVVOTk8BrkLgtStsAuth 0 "UNKNOWN" 1 "OFF" 2 "ON" 3 "FLASHING" ;
VAL_TABLE_ FCODPB8P_FVVOTk8DynPrpAuth 0 "Has Never Moved" 1 "Has Moved But Currently Stopped" 2 "Moving In Same Direction As Host" 3 "Moving In Opposite Direction As Host" 4 "Crossing From Left To Right" 5 "Crossing From Right To Left" 6 "Unknown" ;
VAL_TABLE_ FCODPB8P_FVVOTk8CnfdStsAuth 0 "Highly Speculative" 1 "Speculative" 2 "Confident" 3 "Highly Confident" ;
VAL_TABLE_ FCODPB8P_FVVOTk8DynPrpStsAuth 0 "Stopped" 1 "Not Stopped" ;
VAL_TABLE_ FCODPB8P_FVVOTk8MStsAuth 0 "No Object" 1 "New Object" 2 "Latent Track Not Detected this Cycle" 3 "Measured this Cycle" ;
VAL_TABLE_ FCODPB8P_FVVOTk8LnAsmtAuth 0 "UNKNOWN" 1 "HOST LANE" 2 "RIGHT LANE" 3 "LEFT LANE" 4 "2nd RIGHT LANE" 5 "2nd LEFT LANE" ;
VAL_TABLE_ FCODPB8P_FVVOTk9BrkLgtStsAuth 0 "UNKNOWN" 1 "OFF" 2 "ON" 3 "FLASHING" ;
VAL_TABLE_ FCODPB8P_FVVOTk8TypCnfdAuth 0 "Highly Speculative" 1 "Speculative" 2 "Confident" 3 "Highly Confident" ;
VAL_TABLE_ FCODPB8P_FVVOTk8TypAuth 0 "Unknown" 1 "Motorcycle" 2 "Vehicle" 3 "Truck" ;
VAL_TABLE_ FCODPB8P_FVVOTk8TSLgtStsAuth 0 "UNKNOWN" 1 "OFF" 2 "LEFT" 3 "RIGHT" 4 "BOTH" ;
VAL_TABLE_ FCODPB8P_FVVOTk9CnfdStsAuth 0 "Highly Speculative" 1 "Speculative" 2 "Confident" 3 "Highly Confident" ;
VAL_TABLE_ FCODPB8P_FVVOTk9DynPrpStsAuth 0 "Stopped" 1 "Not Stopped" ;
VAL_TABLE_ FCODPB8P_FVVOTk9DynPrpAuth 0 "Has Never Moved" 1 "Has Moved But Currently Stopped" 2 "Moving In Same Direction As Host" 3 "Moving In Opposite Direction As Host" 4 "Crossing From Left To Right" 5 "Crossing From Right To Left" 6 "Unknown" ;
VAL_TABLE_ FCODPB8P_FVVOTk9MStsAuth 0 "No Object" 1 "New Object" 2 "Latent Track Not Detected this Cycle" 3 "Measured this Cycle" ;
VAL_TABLE_ FCODPB8P_FVVOTk9LnAsmtAuth 0 "UNKNOWN" 1 "HOST LANE" 2 "RIGHT LANE" 3 "LEFT LANE" 4 "2nd RIGHT LANE" 5 "2nd LEFT LANE" ;
VAL_TABLE_ FCODPB8P_FVVOTk9TypAuth 0 "Unknown" 1 "Motorcycle" 2 "Vehicle" 3 "Truck" ;
VAL_TABLE_ FCODPB8P_FVVOTk9TSLgtStsAuth 0 "UNKNOWN" 1 "OFF" 2 "LEFT" 3 "RIGHT" 4 "BOTH" ;
VAL_TABLE_ FCODPB8P_FVVOTk9TypCnfdAuth 0 "Highly Speculative" 1 "Speculative" 2 "Confident" 3 "Highly Confident" ;
VAL_TABLE_ FCODPB9P_FVCIPthVehAlrtNwAuth 0 "FALSE" 1 "TRUE" ;
VAL_TABLE_ FCODPB9P_FVCIPthVehAhdNwAuth 0 "FALSE" 1 "TRUE" ;
VAL_TABLE_ FCODPB9P_FrwdDistIndDgrdAuth 0 "FALSE" 1 "TRUE" ;
VAL_TABLE_ FCODPB9P_FrwdClsnAlrtDgrdAuth 0 "FALSE" 1 "TRUE" ;
VAL_TABLE_ FCODPB9P_ClsnImntBrkgDgrdAuth 0 "FALSE" 1 "TRUE" ;
VAL_TABLE_ FCODPB9P_AdpCruzCtlDgrdAuth 0 "FALSE" 1 "TRUE" ;
VAL_TABLE_ FCODPB9P_FVHTPNtfyNwAuth 0 "FALSE" 1 "TRUE" ;
VAL_TABLE_ FCODPB9P_FVHTPBrkNwAuth 0 "FALSE" 1 "TRUE" ;
VAL_TABLE_ FCODPB9P_FVHTPAlrtNwAuth 0 "FALSE" 1 "TRUE" ;
VAL_TABLE_ FCODPB9P_FVCIPthVehBrkNwAuth 0 "FALSE" 1 "TRUE" ;
VAL_TABLE_ FCODPB9P_FVLFTk1TypAuth 0 "Lane Fusion" 1 "HPP Left" 2 "HPP Center" 3 "HPP Right" ;
VAL_TABLE_ FCODPB9P_FVLFTk2TypAuth 0 "Lane Fusion" 1 "HPP Left" 2 "HPP Center" 3 "HPP Right" ;
VAL_TABLE_ FCODPB9P_FVLFTk3TypAuth 0 "Lane Fusion" 1 "HPP Left" 2 "HPP Center" 3 "HPP Right" ;
VAL_TABLE_ FCODPB9P_PedtrnClsnBrkgDgrdAuth 0 "FALSE" 1 "TRUE" ;
VAL_TABLE_ FCODPB9P_PedtrnClsnAlrtDgrdAuth 0 "FALSE" 1 "TRUE" ;
VAL_TABLE_ FCODPB9P_LnKeepAsstDgrdAuth 0 "FALSE" 1 "TRUE" ;
VAL_TABLE_ FCODPB9P_LnCntrDgrdAuth 0 "FALSE" 1 "TRUE" ;
VAL_TABLE_ FCODPB9P_IntsctClsnMtgnDgrdAuth 0 "FALSE" 1 "TRUE" ;
VAL_TABLE_ FCODPB9P_FVLFTk4TypAuth 0 "Lane Fusion" 1 "HPP Left" 2 "HPP Center" 3 "HPP Right" ;
VAL_TABLE_ FCODPB9P_PedtrnNtfnDgrdAuth 0 "FALSE" 1 "TRUE" ;
VAL_TABLE_ FCODPB10P_FVVOTk10PoI1PsVisAuth 0 "Unknown" 1 "Visible" 2 "Projected" ;
VAL_TABLE_ FCODPB10P_FVVOTk10PoI2PsVisAuth 0 "Unknown" 1 "Visible" 2 "Projected" ;
VAL_TABLE_ FCODPB10P_FVVOTk1PoI1PsVisAuth 0 "Unknown" 1 "Visible" 2 "Projected" ;
VAL_TABLE_ FCODPB10P_FVVOTk10PoI3PsVisAuth 0 "Unknown" 1 "Visible" 2 "Projected" ;
VAL_TABLE_ FCODPB10P_FVVOTk1PoI2PsVisAuth 0 "Unknown" 1 "Visible" 2 "Projected" ;
VAL_TABLE_ FCODPB10P_FVVOTk2PoI1PsVisAuth 0 "Unknown" 1 "Visible" 2 "Projected" ;
VAL_TABLE_ FCODPB10P_FVVOTk1PoI3PsVisAuth 0 "Unknown" 1 "Visible" 2 "Projected" ;
VAL_TABLE_ FCODPB10P_FVVOTk2PoI2PsVisAuth 0 "Unknown" 1 "Visible" 2 "Projected" ;
VAL_TABLE_ FCODPB10P_FVVOTk3PoI1PsVisAuth 0 "Unknown" 1 "Visible" 2 "Projected" ;
VAL_TABLE_ FCODPB10P_FVVOTk2PoI3PsVisAuth 0 "Unknown" 1 "Visible" 2 "Projected" ;
VAL_TABLE_ FCODPB10P_FVVOTk3PoI2PsVisAuth 0 "Unknown" 1 "Visible" 2 "Projected" ;
VAL_TABLE_ FCODPB10P_FVVOTk4PoI1PsVisAuth 0 "Unknown" 1 "Visible" 2 "Projected" ;
VAL_TABLE_ FCODPB10P_FVVOTk3PoI3PsVisAuth 0 "Unknown" 1 "Visible" 2 "Projected" ;
VAL_TABLE_ FCODPB10P_FVVOTk4PoI2PsVisAuth 0 "Unknown" 1 "Visible" 2 "Projected" ;
VAL_TABLE_ FCODPB10P_FVVOTk5PoI1PsVisAuth 0 "Unknown" 1 "Visible" 2 "Projected" ;
VAL_TABLE_ FCODPB10P_FVVOTk4PoI3PsVisAuth 0 "Unknown" 1 "Visible" 2 "Projected" ;
VAL_TABLE_ FCODPB10P_FVVOTk5PoI2PsVisAuth 0 "Unknown" 1 "Visible" 2 "Projected" ;
VAL_TABLE_ FCODPB10P_FVVOTk6PoI1PsVisAuth 0 "Unknown" 1 "Visible" 2 "Projected" ;
VAL_TABLE_ FCODPB10P_FVVOTk5PoI3PsVisAuth 0 "Unknown" 1 "Visible" 2 "Projected" ;
VAL_TABLE_ FCODPB10P_FVVOTk6PoI2PsVisAuth 0 "Unknown" 1 "Visible" 2 "Projected" ;
VAL_TABLE_ FCODPB10P_FVVOTk7PoI1PsVisAuth 0 "Unknown" 1 "Visible" 2 "Projected" ;
VAL_TABLE_ FCODPB10P_FVVOTk6PoI3PsVisAuth 0 "Unknown" 1 "Visible" 2 "Projected" ;
VAL_TABLE_ FCODPB10P_FVVOTk7PoI2PsVisAuth 0 "Unknown" 1 "Visible" 2 "Projected" ;
VAL_TABLE_ FCODPB10P_FVVOTk8PoI1PsVisAuth 0 "Unknown" 1 "Visible" 2 "Projected" ;
VAL_TABLE_ FCODPB10P_FVVOTk7PoI3PsVisAuth 0 "Unknown" 1 "Visible" 2 "Projected" ;
VAL_TABLE_ FCODPB10P_FVVOTk8PoI2PsVisAuth 0 "Unknown" 1 "Visible" 2 "Projected" ;
VAL_TABLE_ FCODPB10P_FVVOTk9PoI1PsVisAuth 0 "Unknown" 1 "Visible" 2 "Projected" ;
VAL_TABLE_ FCODPB10P_FVVOTk8PoI3PsVisAuth 0 "Unknown" 1 "Visible" 2 "Projected" ;
VAL_TABLE_ FCODPB10P_FVVOTk9PoI2PsVisAuth 0 "Unknown" 1 "Visible" 2 "Projected" ;
VAL_TABLE_ FCODPB10P_FVVOTk9PoI3PsVisAuth 0 "Unknown" 1 "Visible" 2 "Projected" ;
VAL_TABLE_ FCODPB1P_FVLBTk1ClrAuth 0 "UNKNOWN" 1 "WHITE" 2 "YELLOW/ORANGE" 3 "OTHER" ;
VAL_TABLE_ FCODPB1P_FVLBTk1PstnTypAuth 0 "Unknown" 1 "Host Left Lane" 2 "Host Right Lane" 3 "Next Left Lane" 4 "Next Right Lane" 5 "Second Next Left Lane" 6 "Second Next Right Lane" 7 "Third Next Left Lane" 8 "Third Next Right Lane" 9 "Fourth Next Left Lane" 10 "Fourth Next Right Lane" 11 "Fifth Next Left Lane" 12 "Fifth Next Right Lane" ;
VAL_TABLE_ FCODPB1P_FVLBTk1TypAuth 0 "UNDECIDED" 1 "SOLID" 2 "DASHED" 3 "ROAD EDGE" 4 "DOUBLE LINE" 5 "BOTTS DOTS" 6 "VIRTUAL" 7 "TRIPLE LINE" ;
VAL_TABLE_ FCODPB1P_FVLBTk1QltyAuth 0 "VERY LOW QUALITY" 1 "LOW QUALITY" 2 "PREDICTION" 3 "HIGH QUALITY" ;
VAL_TABLE_ FCODPB1P_FVPOTk1DynPrpAuth 0 "Has Never Moved" 1 "Has Moved But Currently Stopped" 2 "Moving In Same Direction As Host" 3 "Moving In Opposite Direction As Host" 4 "Crossing Path" ;
VAL_TABLE_ FCODPB1P_FVPOTk1CnfdStsAuth 0 "Highly Speculative" 1 "Speculative" 2 "Confident" 3 "Highly Confident" ;
VAL_TABLE_ FCODPB1P_FVPOTk1MStsAuth 0 "No Object" 1 "New Object" 2 "Latent Track Not Detected this Cycle" 3 "Measured this Cycle" ;
VAL_TABLE_ FCODPB1P_FVVOTk1BrkLgtStsAuth 0 "UNKNOWN" 1 "OFF" 2 "ON" 3 "FLASHING" ;
VAL_TABLE_ FCODPB1P_FVPOTk1TypCnfdAuth 0 "Highly Speculative" 1 "Speculative" 2 "Confident" 3 "Highly Confident" ;
VAL_TABLE_ FCODPB1P_FVPOTk1TypAuth 0 "Unknown" 1 "Pedestrian" 2 "Bicycle" ;
VAL_TABLE_ FCODPB1P_FVVOTk1DynPrpAuth 0 "Has Never Moved" 1 "Has Moved But Currently Stopped" 2 "Moving In Same Direction As Host" 3 "Moving In Opposite Direction As Host" 4 "Crossing From Left To Right" 5 "Crossing From Right To Left" 6 "Unknown" ;
VAL_TABLE_ FCODPB1P_FVVOTk1CnfdStsAuth 0 "Highly Speculative" 1 "Speculative" 2 "Confident" 3 "Highly Confident" ;
VAL_TABLE_ FCODPB1P_FVVOTk1DynPrpStsAuth 0 "Stopped" 1 "Not Stopped" ;
VAL_TABLE_ FCODPB1P_FVVOTk1MStsAuth 0 "No Object" 1 "New Object" 2 "Latent Track Not Detected this Cycle" 3 "Measured this Cycle" ;
VAL_TABLE_ FCODPB1P_FVVOTk1LnAsmtAuth 0 "UNKNOWN" 1 "HOST LANE" 2 "RIGHT LANE" 3 "LEFT LANE" 4 "2nd RIGHT LANE" 5 "2nd LEFT LANE" ;
VAL_TABLE_ FCODPB1P_FVVOTk1TypCnfdAuth 0 "Highly Speculative" 1 "Speculative" 2 "Confident" 3 "Highly Confident" ;
VAL_TABLE_ FCODPB1P_FVVOTk1TypAuth 0 "Unknown" 1 "Motorcycle" 2 "Vehicle" 3 "Truck" ;
VAL_TABLE_ FCODPB1P_FVVOTk1TSLgtStsAuth 0 "UNKNOWN" 1 "OFF" 2 "LEFT" 3 "RIGHT" 4 "BOTH" ;
VAL_TABLE_ LRRODPB2P_POTk2DynPrpAuth 0 "Has Never Moved" 1 "Has Moved But Currently Stopped" 2 "Moving In Same Direction As Host" 3 "Moving In Opposite Direction As Host" 4 "Crossing Path" ;
VAL_TABLE_ LRRODPB2P_POTk2CnfdStsAuth 0 "Highly Speculative" 1 "Speculative" 2 "Confident" 3 "Highly Confident" ;
VAL_TABLE_ LRRODPB2P_POTk2MStsAuth 0 "No Object" 1 "New Object" 2 "Latent Track Not Detected this Cycle" 3 "Measured this Cycle" ;
VAL_TABLE_ LRRODPB2P_POTk2TypCnfdAuth 0 "Highly Speculative" 1 "Speculative" 2 "Confident" 3 "Highly Confident" ;
VAL_TABLE_ LRRODPB2P_POTk2TypAuth 0 "Unknown" 1 "Pedestrian" 2 "Bicycle" ;
VAL_TABLE_ LRRODPB2P_VOTk3DynPrpStsAuth 0 "Stopped" 1 "Not Stopped" ;
VAL_TABLE_ LRRODPB2P_VOTk3DynPrpAuth 0 "Has Never Moved" 1 "Moving In Same Direction As Host" 2 "Moving In Opposite Direction As Host" 3 "Crossing From Left To Right" 4 "Crossing From Right To Left" ;
VAL_TABLE_ LRRODPB2P_VOTk3CnfdStsAuth 0 "Highly Speculative" 1 "Speculative" 2 "Confident" 3 "Highly Confident" ;
VAL_TABLE_ LRRODPB2P_VOTk3MStsAuth 0 "No Object" 1 "New Object" 2 "Latent Track Not Detected this Cycle" 3 "Measured this Cycle" ;
VAL_TABLE_ LRRODPB2P_VOTk3TypCnfdAuth 0 "Highly Speculative" 1 "Speculative" 2 "Confident" 3 "Highly Confident" ;
VAL_TABLE_ LRRODPB2P_VOTk4DynPrpStsAuth 0 "Stopped" 1 "Not Stopped" ;
VAL_TABLE_ LRRODPB2P_VOTk4DynPrpAuth 0 "Has Never Moved" 1 "Moving In Same Direction As Host" 2 "Moving In Opposite Direction As Host" 3 "Crossing From Left To Right" 4 "Crossing From Right To Left" ;
VAL_TABLE_ LRRODPB2P_VOTk4CnfdStsAuth 0 "Highly Speculative" 1 "Speculative" 2 "Confident" 3 "Highly Confident" ;
VAL_TABLE_ LRRODPB2P_VOTk4MStsAuth 0 "No Object" 1 "New Object" 2 "Latent Track Not Detected this Cycle" 3 "Measured this Cycle" ;
VAL_TABLE_ LRRODPB2P_VOTk4TypCnfdAuth 0 "Highly Speculative" 1 "Speculative" 2 "Confident" 3 "Highly Confident" ;
VAL_TABLE_ LRRODPB2P_VOTk5CnfdStsAuth 0 "Highly Speculative" 1 "Speculative" 2 "Confident" 3 "Highly Confident" ;
VAL_TABLE_ LRRODPB2P_VOTk5DynPrpStsAuth 0 "Stopped" 1 "Not Stopped" ;
VAL_TABLE_ LRRODPB2P_VOTk5DynPrpAuth 0 "Has Never Moved" 1 "Moving In Same Direction As Host" 2 "Moving In Opposite Direction As Host" 3 "Crossing From Left To Right" 4 "Crossing From Right To Left" ;
VAL_TABLE_ LRRODPB2P_VOTk5MStsAuth 0 "No Object" 1 "New Object" 2 "Latent Track Not Detected this Cycle" 3 "Measured this Cycle" ;
VAL_TABLE_ LRRODPB2P_VOTk5TypCnfdAuth 0 "Highly Speculative" 1 "Speculative" 2 "Confident" 3 "Highly Confident" ;
VAL_TABLE_ LRRODPB3P_POTk3DynPrpAuth 0 "Has Never Moved" 1 "Has Moved But Currently Stopped" 2 "Moving In Same Direction As Host" 3 "Moving In Opposite Direction As Host" 4 "Crossing Path" ;
VAL_TABLE_ LRRODPB3P_POTk3CnfdStsAuth 0 "Highly Speculative" 1 "Speculative" 2 "Confident" 3 "Highly Confident" ;
VAL_TABLE_ LRRODPB3P_POTk3MStsAuth 0 "No Object" 1 "New Object" 2 "Latent Track Not Detected this Cycle" 3 "Measured this Cycle" ;
VAL_TABLE_ LRRODPB3P_POTk3TypCnfdAuth 0 "Highly Speculative" 1 "Speculative" 2 "Confident" 3 "Highly Confident" ;
VAL_TABLE_ LRRODPB3P_POTk3TypAuth 0 "Unknown" 1 "Pedestrian" 2 "Bicycle" ;
VAL_TABLE_ LRRODPB3P_VOTk6DynPrpStsAuth 0 "Stopped" 1 "Not Stopped" ;
VAL_TABLE_ LRRODPB3P_VOTk6DynPrpAuth 0 "Has Never Moved" 1 "Moving In Same Direction As Host" 2 "Moving In Opposite Direction As Host" 3 "Crossing From Left To Right" 4 "Crossing From Right To Left" ;
VAL_TABLE_ LRRODPB3P_VOTk6CnfdStsAuth 0 "Highly Speculative" 1 "Speculative" 2 "Confident" 3 "Highly Confident" ;
VAL_TABLE_ LRRODPB3P_VOTk6MStsAuth 0 "No Object" 1 "New Object" 2 "Latent Track Not Detected this Cycle" 3 "Measured this Cycle" ;
VAL_TABLE_ LRRODPB3P_VOTk6TypCnfdAuth 0 "Highly Speculative" 1 "Speculative" 2 "Confident" 3 "Highly Confident" ;
VAL_TABLE_ LRRODPB3P_VOTk7DynPrpStsAuth 0 "Stopped" 1 "Not Stopped" ;
VAL_TABLE_ LRRODPB3P_VOTk7DynPrpAuth 0 "Has Never Moved" 1 "Moving In Same Direction As Host" 2 "Moving In Opposite Direction As Host" 3 "Crossing From Left To Right" 4 "Crossing From Right To Left" ;
VAL_TABLE_ LRRODPB3P_VOTk7CnfdStsAuth 0 "Highly Speculative" 1 "Speculative" 2 "Confident" 3 "Highly Confident" ;
VAL_TABLE_ LRRODPB3P_VOTk7MStsAuth 0 "No Object" 1 "New Object" 2 "Latent Track Not Detected this Cycle" 3 "Measured this Cycle" ;
VAL_TABLE_ LRRODPB3P_VOTk7TypCnfdAuth 0 "Highly Speculative" 1 "Speculative" 2 "Confident" 3 "Highly Confident" ;
VAL_TABLE_ LRRODPB3P_VOTk8CnfdStsAuth 0 "Highly Speculative" 1 "Speculative" 2 "Confident" 3 "Highly Confident" ;
VAL_TABLE_ LRRODPB3P_VOTk8DynPrpStsAuth 0 "Stopped" 1 "Not Stopped" ;
VAL_TABLE_ LRRODPB3P_VOTk8DynPrpAuth 0 "Has Never Moved" 1 "Moving In Same Direction As Host" 2 "Moving In Opposite Direction As Host" 3 "Crossing From Left To Right" 4 "Crossing From Right To Left" ;
VAL_TABLE_ LRRODPB3P_VOTk8MStsAuth 0 "No Object" 1 "New Object" 2 "Latent Track Not Detected this Cycle" 3 "Measured this Cycle" ;
VAL_TABLE_ LRRODPB3P_VOTk8TypCnfdAuth 0 "Highly Speculative" 1 "Speculative" 2 "Confident" 3 "Highly Confident" ;
VAL_TABLE_ LRRODPB4P_POTk4DynPrpAuth 0 "Has Never Moved" 1 "Has Moved But Currently Stopped" 2 "Moving In Same Direction As Host" 3 "Moving In Opposite Direction As Host" 4 "Crossing Path" ;
VAL_TABLE_ LRRODPB4P_POTk4CnfdStsAuth 0 "Highly Speculative" 1 "Speculative" 2 "Confident" 3 "Highly Confident" ;
VAL_TABLE_ LRRODPB4P_POTk4MStsAuth 0 "No Object" 1 "New Object" 2 "Latent Track Not Detected this Cycle" 3 "Measured this Cycle" ;
VAL_TABLE_ LRRODPB4P_POTk5DynPrpAuth 0 "Has Never Moved" 1 "Has Moved But Currently Stopped" 2 "Moving In Same Direction As Host" 3 "Moving In Opposite Direction As Host" 4 "Crossing Path" ;
VAL_TABLE_ LRRODPB4P_POTk5CnfdStsAuth 0 "Highly Speculative" 1 "Speculative" 2 "Confident" 3 "Highly Confident" ;
VAL_TABLE_ LRRODPB4P_POTk4TypCnfdAuth 0 "Highly Speculative" 1 "Speculative" 2 "Confident" 3 "Highly Confident" ;
VAL_TABLE_ LRRODPB4P_POTk4TypAuth 0 "Unknown" 1 "Pedestrian" 2 "Bicycle" ;
VAL_TABLE_ LRRODPB4P_POTk5MStsAuth 0 "No Object" 1 "New Object" 2 "Latent Track Not Detected this Cycle" 3 "Measured this Cycle" ;
VAL_TABLE_ LRRODPB4P_POTk5TypCnfdAuth 0 "Highly Speculative" 1 "Speculative" 2 "Confident" 3 "Highly Confident" ;
VAL_TABLE_ LRRODPB4P_POTk5TypAuth 0 "Unknown" 1 "Pedestrian" 2 "Bicycle" ;
VAL_TABLE_ LRRODPB4P_VOTk10DynPrpAuth 0 "Has Never Moved" 1 "Moving In Same Direction As Host" 2 "Moving In Opposite Direction As Host" 3 "Crossing From Left To Right" 4 "Crossing From Right To Left" ;
VAL_TABLE_ LRRODPB4P_VOTk10CnfdStsAuth 0 "Highly Speculative" 1 "Speculative" 2 "Confident" 3 "Highly Confident" ;
VAL_TABLE_ LRRODPB4P_VOTk10DynPrpStsAuth 0 "Stopped" 1 "Not Stopped" ;
VAL_TABLE_ LRRODPB4P_VOTk10MStsAuth 0 "No Object" 1 "New Object" 2 "Latent Track Not Detected this Cycle" 3 "Measured this Cycle" ;
VAL_TABLE_ LRRODPB4P_VOTk10TypCnfdAuth 0 "Highly Speculative" 1 "Speculative" 2 "Confident" 3 "Highly Confident" ;
VAL_TABLE_ LRRODPB4P_VOTk9DynPrpStsAuth 0 "Stopped" 1 "Not Stopped" ;
VAL_TABLE_ LRRODPB4P_VOTk9DynPrpAuth 0 "Has Never Moved" 1 "Moving In Same Direction As Host" 2 "Moving In Opposite Direction As Host" 3 "Crossing From Left To Right" 4 "Crossing From Right To Left" ;
VAL_TABLE_ LRRODPB4P_VOTk9CnfdStsAuth 0 "Highly Speculative" 1 "Speculative" 2 "Confident" 3 "Highly Confident" ;
VAL_TABLE_ LRRODPB4P_VOTk9MStsAuth 0 "No Object" 1 "New Object" 2 "Latent Track Not Detected this Cycle" 3 "Measured this Cycle" ;
VAL_TABLE_ LRRODPB4P_VOTk9TypCnfdAuth 0 "Highly Speculative" 1 "Speculative" 2 "Confident" 3 "Highly Confident" ;
VAL_TABLE_ LRRODPB5P_IOTk10ElvtnAuth 0 "Not Elevated" 1 "Elevation Speculative" 2 "Elevation Confident" 3 "Elevation Very Confident" ;
VAL_TABLE_ LRRODPB5P_IOTk10CnfdStsAuth 0 "Highly Speculative" 1 "Speculative" 2 "Confident" 3 "Highly Confident" ;
VAL_TABLE_ LRRODPB5P_IOTk10MStsAuth 0 "No Object" 1 "New Object" 2 "Latent Track Not Detected this Cycle" 3 "Measured this Cycle" ;
VAL_TABLE_ LRRODPB5P_IOTk1CnfdStsAuth 0 "Highly Speculative" 1 "Speculative" 2 "Confident" 3 "Highly Confident" ;
VAL_TABLE_ LRRODPB5P_IOTk10TypCnfdAuth 0 "Highly Speculative" 1 "Speculative" 2 "Confident" 3 "Highly Confident" ;
VAL_TABLE_ LRRODPB5P_IOTk10TypAuth 0 "Unknown" 1 "Guard Rail" 2 "Tunnel" 3 "Traffic Sign" 4 "Bridge" 5 "Pole" ;
VAL_TABLE_ LRRODPB5P_IOTk1ElvtnAuth 0 "Not Elevated" 1 "Elevation Speculative" 2 "Elevation Confident" 3 "Elevation Very Confident" ;
VAL_TABLE_ LRRODPB5P_IOTk1MStsAuth 0 "No Object" 1 "New Object" 2 "Latent Track Not Detected this Cycle" 3 "Measured this Cycle" ;
VAL_TABLE_ LRRODPB5P_IOTk1TypAuth 0 "Unknown" 1 "Guard Rail" 2 "Tunnel" 3 "Traffic Sign" 4 "Bridge" 5 "Pole" ;
VAL_TABLE_ LRRODPB5P_IOTk2ElvtnAuth 0 "Not Elevated" 1 "Elevation Speculative" 2 "Elevation Confident" 3 "Elevation Very Confident" ;
VAL_TABLE_ LRRODPB5P_IOTk2CnfdStsAuth 0 "Highly Speculative" 1 "Speculative" 2 "Confident" 3 "Highly Confident" ;
VAL_TABLE_ LRRODPB5P_IOTk1TypCnfdAuth 0 "Highly Speculative" 1 "Speculative" 2 "Confident" 3 "Highly Confident" ;
VAL_TABLE_ LRRODPB5P_IOTk2MStsAuth 0 "No Object" 1 "New Object" 2 "Latent Track Not Detected this Cycle" 3 "Measured this Cycle" ;
VAL_TABLE_ LRRODPB5P_IOTk2TypCnfdAuth 0 "Highly Speculative" 1 "Speculative" 2 "Confident" 3 "Highly Confident" ;
VAL_TABLE_ LRRODPB5P_IOTk2TypAuth 0 "Unknown" 1 "Guard Rail" 2 "Tunnel" 3 "Traffic Sign" 4 "Bridge" 5 "Pole" ;
VAL_TABLE_ LRRODPB5P_IOTk3ElvtnAuth 0 "Not Elevated" 1 "Elevation Speculative" 2 "Elevation Confident" 3 "Elevation Very Confident" ;
VAL_TABLE_ LRRODPB5P_IOTk3CnfdStsAuth 0 "Highly Speculative" 1 "Speculative" 2 "Confident" 3 "Highly Confident" ;
VAL_TABLE_ LRRODPB5P_IOTk3MStsAuth 0 "No Object" 1 "New Object" 2 "Latent Track Not Detected this Cycle" 3 "Measured this Cycle" ;
VAL_TABLE_ LRRODPB5P_IOTk4CnfdStsAuth 0 "Highly Speculative" 1 "Speculative" 2 "Confident" 3 "Highly Confident" ;
VAL_TABLE_ LRRODPB5P_IOTk3TypCnfdAuth 0 "Highly Speculative" 1 "Speculative" 2 "Confident" 3 "Highly Confident" ;
VAL_TABLE_ LRRODPB5P_IOTk3TypAuth 0 "Unknown" 1 "Guard Rail" 2 "Tunnel" 3 "Traffic Sign" 4 "Bridge" 5 "Pole" ;
VAL_TABLE_ LRRODPB5P_IOTk4ElvtnAuth 0 "Not Elevated" 1 "Elevation Speculative" 2 "Elevation Confident" 3 "Elevation Very Confident" ;
VAL_TABLE_ LRRODPB5P_IOTk4MStsAuth 0 "No Object" 1 "New Object" 2 "Latent Track Not Detected this Cycle" 3 "Measured this Cycle" ;
VAL_TABLE_ LRRODPB5P_IOTk4TypAuth 0 "Unknown" 1 "Guard Rail" 2 "Tunnel" 3 "Traffic Sign" 4 "Bridge" 5 "Pole" ;
VAL_TABLE_ LRRODPB5P_IOTk5ElvtnAuth 0 "Not Elevated" 1 "Elevation Speculative" 2 "Elevation Confident" 3 "Elevation Very Confident" ;
VAL_TABLE_ LRRODPB5P_IOTk5CnfdStsAuth 0 "Highly Speculative" 1 "Speculative" 2 "Confident" 3 "Highly Confident" ;
VAL_TABLE_ LRRODPB5P_IOTk4TypCnfdAuth 0 "Highly Speculative" 1 "Speculative" 2 "Confident" 3 "Highly Confident" ;
VAL_TABLE_ LRRODPB5P_IOTk5MStsAuth 0 "No Object" 1 "New Object" 2 "Latent Track Not Detected this Cycle" 3 "Measured this Cycle" ;
VAL_TABLE_ LRRODPB5P_IOTk5TypCnfdAuth 0 "Highly Speculative" 1 "Speculative" 2 "Confident" 3 "Highly Confident" ;
VAL_TABLE_ LRRODPB5P_IOTk5TypAuth 0 "Unknown" 1 "Guard Rail" 2 "Tunnel" 3 "Traffic Sign" 4 "Bridge" 5 "Pole" ;
VAL_TABLE_ LRRODPB5P_IOTk6ElvtnAuth 0 "Not Elevated" 1 "Elevation Speculative" 2 "Elevation Confident" 3 "Elevation Very Confident" ;
VAL_TABLE_ LRRODPB5P_IOTk6CnfdStsAuth 0 "Highly Speculative" 1 "Speculative" 2 "Confident" 3 "Highly Confident" ;
VAL_TABLE_ LRRODPB5P_IOTk6MStsAuth 0 "No Object" 1 "New Object" 2 "Latent Track Not Detected this Cycle" 3 "Measured this Cycle" ;
VAL_TABLE_ LRRODPB5P_IOTk7ElvtnAuth 0 "Not Elevated" 1 "Elevation Speculative" 2 "Elevation Confident" 3 "Elevation Very Confident" ;
VAL_TABLE_ LRRODPB5P_IOTk7CnfdStsAuth 0 "Highly Speculative" 1 "Speculative" 2 "Confident" 3 "Highly Confident" ;
VAL_TABLE_ LRRODPB5P_IOTk6TypCnfdAuth 0 "Highly Speculative" 1 "Speculative" 2 "Confident" 3 "Highly Confident" ;
VAL_TABLE_ LRRODPB5P_IOTk6TypAuth 0 "Unknown" 1 "Guard Rail" 2 "Tunnel" 3 "Traffic Sign" 4 "Bridge" 5 "Pole" ;
VAL_TABLE_ LRRODPB5P_IOTk7MStsAuth 0 "No Object" 1 "New Object" 2 "Latent Track Not Detected this Cycle" 3 "Measured this Cycle" ;
VAL_TABLE_ LRRODPB5P_IOTk7TypAuth 0 "Unknown" 1 "Guard Rail" 2 "Tunnel" 3 "Traffic Sign" 4 "Bridge" 5 "Pole" ;
VAL_TABLE_ LRRODPB5P_IOTk8ElvtnAuth 0 "Not Elevated" 1 "Elevation Speculative" 2 "Elevation Confident" 3 "Elevation Very Confident" ;
VAL_TABLE_ LRRODPB5P_IOTk8CnfdStsAuth 0 "Highly Speculative" 1 "Speculative" 2 "Confident" 3 "Highly Confident" ;
VAL_TABLE_ LRRODPB5P_IOTk7TypCnfdAuth 0 "Highly Speculative" 1 "Speculative" 2 "Confident" 3 "Highly Confident" ;
VAL_TABLE_ LRRODPB5P_IOTk8MStsAuth 0 "No Object" 1 "New Object" 2 "Latent Track Not Detected this Cycle" 3 "Measured this Cycle" ;
VAL_TABLE_ LRRODPB5P_IOTk9CnfdStsAuth 0 "Highly Speculative" 1 "Speculative" 2 "Confident" 3 "Highly Confident" ;
VAL_TABLE_ LRRODPB5P_IOTk8TypCnfdAuth 0 "Highly Speculative" 1 "Speculative" 2 "Confident" 3 "Highly Confident" ;
VAL_TABLE_ LRRODPB5P_IOTk8TypAuth 0 "Unknown" 1 "Guard Rail" 2 "Tunnel" 3 "Traffic Sign" 4 "Bridge" 5 "Pole" ;
VAL_TABLE_ LRRODPB5P_IOTk9ElvtnAuth 0 "Not Elevated" 1 "Elevation Speculative" 2 "Elevation Confident" 3 "Elevation Very Confident" ;
VAL_TABLE_ LRRODPB5P_IOTk9MStsAuth 0 "No Object" 1 "New Object" 2 "Latent Track Not Detected this Cycle" 3 "Measured this Cycle" ;
VAL_TABLE_ LRRODPB5P_IOTk9TypAuth 0 "Unknown" 1 "Guard Rail" 2 "Tunnel" 3 "Traffic Sign" 4 "Bridge" 5 "Pole" ;
VAL_TABLE_ LRRODPB5P_IOTk9TypCnfdAuth 0 "Highly Speculative" 1 "Speculative" 2 "Confident" 3 "Highly Confident" ;
VAL_TABLE_ LRRODPB1P_ConstrArDtnCnfdAuth 0 "Highly Speculative" 1 "Speculative" 2 "Confident" 3 "Highly Confident" ;
VAL_TABLE_ LRRODPB1P_AcqTmStmAuth_Inv 0 "FALSE" 1 "TRUE" ;
VAL_TABLE_ LRRODPB1P_POTk1DynPrpAuth 0 "Has Never Moved" 1 "Has Moved But Currently Stopped" 2 "Moving In Same Direction As Host" 3 "Moving In Opposite Direction As Host" 4 "Crossing Path" ;
VAL_TABLE_ LRRODPB1P_POTk1CnfdStsAuth 0 "Highly Speculative" 1 "Speculative" 2 "Confident" 3 "Highly Confident" ;
VAL_TABLE_ LRRODPB1P_MdCmdStsAuth 0 "Not Radiating" 1 "Reporting Object Data" 2 "Not Reporting Object Data" ;
VAL_TABLE_ LRRODPB1P_InTnnlDtnAuth 0 "FALSE" 1 "TRUE" ;
VAL_TABLE_ LRRODPB1P_ConstrArDtnStsAuth 0 "Not Detected" 1 "Detected" 2 "Unknown" ;
VAL_TABLE_ LRRODPB1P_POTk1MStsAuth 0 "No Object" 1 "New Object" 2 "Latent Track Not Detected this Cycle" 3 "Measured this Cycle" ;
VAL_TABLE_ LRRODPB1P_RdTypAuth 0 "Unknown" 1 "City" 2 "Secondary Road" 3 "Highway" 4 "Construction Zone Entry" 5 "Construction Zone Exit" ;
VAL_TABLE_ LRRODPB1P_POTk1TypCnfdAuth 0 "Highly Speculative" 1 "Speculative" 2 "Confident" 3 "Highly Confident" ;
VAL_TABLE_ LRRODPB1P_POTk1TypAuth 0 "Unknown" 1 "Pedestrian" 2 "Bicycle" ;
VAL_TABLE_ LRRODPB1P_ServRqrdAuth 0 "FALSE" 1 "TRUE" ;
VAL_TABLE_ LRRODPB1P_ServAlgnInPrcAuth 0 "FALSE" 1 "TRUE" ;
VAL_TABLE_ LRRODPB1P_RngModeStatuStsAuth 0 "Near Range" 1 "Mid Range" 2 "Far Range" ;
VAL_TABLE_ LRRODPB1P_RdTypCnfdAuth 0 "Highly Speculative" 1 "Speculative" 2 "Confident" 3 "Highly Confident" ;
VAL_TABLE_ LRRODPB1P_SnsrUnvAuth 0 "FALSE" 1 "TRUE" ;
VAL_TABLE_ LRRODPB1P_SnsrBlckdAuth 0 "FALSE" 1 "TRUE" ;
VAL_TABLE_ LRRODPB1P_VOTk1DynPrpStsAuth 0 "Stopped" 1 "Not Stopped" ;
VAL_TABLE_ LRRODPB1P_VOTk1DynPrpAuth 0 "Has Never Moved" 1 "Moving In Same Direction As Host" 2 "Moving In Opposite Direction As Host" 3 "Crossing From Left To Right" 4 "Crossing From Right To Left" ;
VAL_TABLE_ LRRODPB1P_VOTk1CnfdStsAuth 0 "Highly Speculative" 1 "Speculative" 2 "Confident" 3 "Highly Confident" ;
VAL_TABLE_ LRRODPB1P_VOTk1MStsAuth 0 "No Object" 1 "New Object" 2 "Latent Track Not Detected this Cycle" 3 "Measured this Cycle" ;
VAL_TABLE_ LRRODPB1P_VOTk1TypCnfdAuth 0 "Highly Speculative" 1 "Speculative" 2 "Confident" 3 "Highly Confident" ;
VAL_TABLE_ LRRODPB1P_VOTk2CnfdStsAuth 0 "Highly Speculative" 1 "Speculative" 2 "Confident" 3 "Highly Confident" ;
VAL_TABLE_ LRRODPB1P_VOTk2DynPrpStsAuth 0 "Stopped" 1 "Not Stopped" ;
VAL_TABLE_ LRRODPB1P_VOTk2DynPrpAuth 0 "Has Never Moved" 1 "Moving In Same Direction As Host" 2 "Moving In Opposite Direction As Host" 3 "Crossing From Left To Right" 4 "Crossing From Right To Left" ;
VAL_TABLE_ LRRODPB1P_VOTk2MStsAuth 0 "No Object" 1 "New Object" 2 "Latent Track Not Detected this Cycle" 3 "Measured this Cycle" ;
VAL_TABLE_ LRRODPB1P_VOTk2TypCnfdAuth 0 "Highly Speculative" 1 "Speculative" 2 "Confident" 3 "Highly Confident" ;
VAL_TABLE_ LRRODPB6P_REOTkLtCnfdStsAuth 0 "Highly Speculative" 1 "Speculative" 2 "Confident" 3 "Highly Confident" ;
VAL_TABLE_ LRRODPB6P_REOTkLtTypAuth 0 "Unknown" 1 "Barriers" 2 "Guard Rails" 3 "Bridge Abutments" 4 "Edge of Road" 5 "Open Area" ;
VAL_TABLE_ LRRODPB6P_REOTkRtCnfdStsAuth 0 "Highly Speculative" 1 "Speculative" 2 "Confident" 3 "Highly Confident" ;
VAL_TABLE_ LRRODPB6P_REOTkLtTypCnfdAuth 0 "Highly Speculative" 1 "Speculative" 2 "Confident" 3 "Highly Confident" ;
VAL_TABLE_ LRRODPB6P_REOTkRtTypAuth 0 "Unknown" 1 "Barriers" 2 "Guard Rails" 3 "Bridge Abutments" 4 "Edge of Road" 5 "Open Area" ;
VAL_TABLE_ LRRODPB6P_REOTkRtTypCnfdAuth 0 "Highly Speculative" 1 "Speculative" 2 "Confident" 3 "Highly Confident" ;
VAL_TABLE_ SRRLFODPB2P_POTk3DynPrpAuth 0 "Has Never Moved" 1 "Has Moved But Currently Stopped" 2 "Moving In Same Direction As Host" 3 "Moving In Opposite Direction As Host" 4 "Crossing Path" ;
VAL_TABLE_ SRRLFODPB2P_POTk3CnfdStsAuth 0 "Highly Speculative" 1 "Speculative" 2 "Confident" 3 "Highly Confident" ;
VAL_TABLE_ SRRLFODPB2P_POTk3MStsAuth 0 "No Object" 1 "New Object" 2 "Latent Track Not Detected this Cycle" 3 "Measured this Cycle" ;
VAL_TABLE_ SRRLFODPB2P_POTk3TypCnfdAuth 0 "Highly Speculative" 1 "Speculative" 2 "Confident" 3 "Highly Confident" ;
VAL_TABLE_ SRRLFODPB2P_POTk3TypAuth 0 "Unknown" 1 "Pedestrian" 2 "Bicycle" ;
VAL_TABLE_ SRRLFODPB2P_VOTk2DynPrpStsAuth 0 "Stopped" 1 "Not Stopped" ;
VAL_TABLE_ SRRLFODPB2P_VOTk2DynPrpAuth 0 "Has Never Moved" 1 "Moving In Same Direction As Host" 2 "Moving In Opposite Direction As Host" 3 "Crossing From Left To Right" 4 "Crossing From Right To Left" ;
VAL_TABLE_ SRRLFODPB2P_VOTk2CnfdStsAuth 0 "Highly Speculative" 1 "Speculative" 2 "Confident" 3 "Highly Confident" ;
VAL_TABLE_ SRRLFODPB2P_VOTk2MStsAuth 0 "No Object" 1 "New Object" 2 "Latent Track Not Detected this Cycle" 3 "Measured this Cycle" ;
VAL_TABLE_ SRRLFODPB2P_VOTk2TypCnfdAuth 0 "Highly Speculative" 1 "Speculative" 2 "Confident" 3 "Highly Confident" ;
VAL_TABLE_ SRRLFODPB2P_VOTk3CnfdStsAuth 0 "Highly Speculative" 1 "Speculative" 2 "Confident" 3 "Highly Confident" ;
VAL_TABLE_ SRRLFODPB2P_VOTk3DynPrpStsAuth 0 "Stopped" 1 "Not Stopped" ;
VAL_TABLE_ SRRLFODPB2P_VOTk3DynPrpAuth 0 "Has Never Moved" 1 "Moving In Same Direction As Host" 2 "Moving In Opposite Direction As Host" 3 "Crossing From Left To Right" 4 "Crossing From Right To Left" ;
VAL_TABLE_ SRRLFODPB2P_VOTk3MStsAuth 0 "No Object" 1 "New Object" 2 "Latent Track Not Detected this Cycle" 3 "Measured this Cycle" ;
VAL_TABLE_ SRRLFODPB2P_VOTk3TypCnfdAuth 0 "Highly Speculative" 1 "Speculative" 2 "Confident" 3 "Highly Confident" ;
VAL_TABLE_ SRRLFODPB2P_VOTk4DynPrpStsAuth 0 "Stopped" 1 "Not Stopped" ;
VAL_TABLE_ SRRLFODPB2P_VOTk4DynPrpAuth 0 "Has Never Moved" 1 "Moving In Same Direction As Host" 2 "Moving In Opposite Direction As Host" 3 "Crossing From Left To Right" 4 "Crossing From Right To Left" ;
VAL_TABLE_ SRRLFODPB2P_VOTk4CnfdStsAuth 0 "Highly Speculative" 1 "Speculative" 2 "Confident" 3 "Highly Confident" ;
VAL_TABLE_ SRRLFODPB2P_VOTk4MStsAuth 0 "No Object" 1 "New Object" 2 "Latent Track Not Detected this Cycle" 3 "Measured this Cycle" ;
VAL_TABLE_ SRRLFODPB2P_VOTk4TypCnfdAuth 0 "Highly Speculative" 1 "Speculative" 2 "Confident" 3 "Highly Confident" ;
VAL_TABLE_ SRRLFODPB3P_POTk4DynPrpAuth 0 "Has Never Moved" 1 "Has Moved But Currently Stopped" 2 "Moving In Same Direction As Host" 3 "Moving In Opposite Direction As Host" 4 "Crossing Path" ;
VAL_TABLE_ SRRLFODPB3P_POTk4CnfdStsAuth 0 "Highly Speculative" 1 "Speculative" 2 "Confident" 3 "Highly Confident" ;
VAL_TABLE_ SRRLFODPB3P_POTk4MStsAuth 0 "No Object" 1 "New Object" 2 "Latent Track Not Detected this Cycle" 3 "Measured this Cycle" ;
VAL_TABLE_ SRRLFODPB3P_POTk4TypCnfdAuth 0 "Highly Speculative" 1 "Speculative" 2 "Confident" 3 "Highly Confident" ;
VAL_TABLE_ SRRLFODPB3P_POTk4TypAuth 0 "Unknown" 1 "Pedestrian" 2 "Bicycle" ;
VAL_TABLE_ SRRLFODPB3P_VOTk5DynPrpStsAuth 0 "Stopped" 1 "Not Stopped" ;
VAL_TABLE_ SRRLFODPB3P_VOTk5DynPrpAuth 0 "Has Never Moved" 1 "Moving In Same Direction As Host" 2 "Moving In Opposite Direction As Host" 3 "Crossing From Left To Right" 4 "Crossing From Right To Left" ;
VAL_TABLE_ SRRLFODPB3P_VOTk5CnfdStsAuth 0 "Highly Speculative" 1 "Speculative" 2 "Confident" 3 "Highly Confident" ;
VAL_TABLE_ SRRLFODPB3P_VOTk5MStsAuth 0 "No Object" 1 "New Object" 2 "Latent Track Not Detected this Cycle" 3 "Measured this Cycle" ;
VAL_TABLE_ SRRLFODPB3P_VOTk5TypCnfdAuth 0 "Highly Speculative" 1 "Speculative" 2 "Confident" 3 "Highly Confident" ;
VAL_TABLE_ SRRLFODPB3P_VOTk6CnfdStsAuth 0 "Highly Speculative" 1 "Speculative" 2 "Confident" 3 "Highly Confident" ;
VAL_TABLE_ SRRLFODPB3P_VOTk6DynPrpStsAuth 0 "Stopped" 1 "Not Stopped" ;
VAL_TABLE_ SRRLFODPB3P_VOTk6DynPrpAuth 0 "Has Never Moved" 1 "Moving In Same Direction As Host" 2 "Moving In Opposite Direction As Host" 3 "Crossing From Left To Right" 4 "Crossing From Right To Left" ;
VAL_TABLE_ SRRLFODPB3P_VOTk6MStsAuth 0 "No Object" 1 "New Object" 2 "Latent Track Not Detected this Cycle" 3 "Measured this Cycle" ;
VAL_TABLE_ SRRLFODPB3P_VOTk6TypCnfdAuth 0 "Highly Speculative" 1 "Speculative" 2 "Confident" 3 "Highly Confident" ;
VAL_TABLE_ SRRLFODPB3P_VOTk7DynPrpStsAuth 0 "Stopped" 1 "Not Stopped" ;
VAL_TABLE_ SRRLFODPB3P_VOTk7DynPrpAuth 0 "Has Never Moved" 1 "Moving In Same Direction As Host" 2 "Moving In Opposite Direction As Host" 3 "Crossing From Left To Right" 4 "Crossing From Right To Left" ;
VAL_TABLE_ SRRLFODPB3P_VOTk7CnfdStsAuth 0 "Highly Speculative" 1 "Speculative" 2 "Confident" 3 "Highly Confident" ;
VAL_TABLE_ SRRLFODPB3P_VOTk7MStsAuth 0 "No Object" 1 "New Object" 2 "Latent Track Not Detected this Cycle" 3 "Measured this Cycle" ;
VAL_TABLE_ SRRLFODPB3P_VOTk7TypCnfdAuth 0 "Highly Speculative" 1 "Speculative" 2 "Confident" 3 "Highly Confident" ;
VAL_TABLE_ SRRLFODPB4P_POTk5DynPrpAuth 0 "Has Never Moved" 1 "Has Moved But Currently Stopped" 2 "Moving In Same Direction As Host" 3 "Moving In Opposite Direction As Host" 4 "Crossing Path" ;
VAL_TABLE_ SRRLFODPB4P_POTk5CnfdStsAuth 0 "Highly Speculative" 1 "Speculative" 2 "Confident" 3 "Highly Confident" ;
VAL_TABLE_ SRRLFODPB4P_POTk5MStsAuth 0 "No Object" 1 "New Object" 2 "Latent Track Not Detected this Cycle" 3 "Measured this Cycle" ;
VAL_TABLE_ SRRLFODPB4P_POTk5TypCnfdAuth 0 "Highly Speculative" 1 "Speculative" 2 "Confident" 3 "Highly Confident" ;
VAL_TABLE_ SRRLFODPB4P_POTk5TypAuth 0 "Unknown" 1 "Pedestrian" 2 "Bicycle" ;
VAL_TABLE_ SRRLFODPB4P_VOTk10DynPrpStsAuth 0 "Stopped" 1 "Not Stopped" ;
VAL_TABLE_ SRRLFODPB4P_VOTk10DynPrpAuth 0 "Has Never Moved" 1 "Moving In Same Direction As Host" 2 "Moving In Opposite Direction As Host" 3 "Crossing From Left To Right" 4 "Crossing From Right To Left" ;
VAL_TABLE_ SRRLFODPB4P_VOTk10CnfdStsAuth 0 "Highly Speculative" 1 "Speculative" 2 "Confident" 3 "Highly Confident" ;
VAL_TABLE_ SRRLFODPB4P_VOTk10MStsAuth 0 "No Object" 1 "New Object" 2 "Latent Track Not Detected this Cycle" 3 "Measured this Cycle" ;
VAL_TABLE_ SRRLFODPB4P_VOTk10TypCnfdAuth 0 "Highly Speculative" 1 "Speculative" 2 "Confident" 3 "Highly Confident" ;
VAL_TABLE_ SRRLFODPB4P_VOTk8CnfdStsAuth 0 "Highly Speculative" 1 "Speculative" 2 "Confident" 3 "Highly Confident" ;
VAL_TABLE_ SRRLFODPB4P_VOTk8DynPrpStsAuth 0 "Stopped" 1 "Not Stopped" ;
VAL_TABLE_ SRRLFODPB4P_VOTk8DynPrpAuth 0 "Has Never Moved" 1 "Moving In Same Direction As Host" 2 "Moving In Opposite Direction As Host" 3 "Crossing From Left To Right" 4 "Crossing From Right To Left" ;
VAL_TABLE_ SRRLFODPB4P_VOTk8MStsAuth 0 "No Object" 1 "New Object" 2 "Latent Track Not Detected this Cycle" 3 "Measured this Cycle" ;
VAL_TABLE_ SRRLFODPB4P_VOTk8TypCnfdAuth 0 "Highly Speculative" 1 "Speculative" 2 "Confident" 3 "Highly Confident" ;
VAL_TABLE_ SRRLFODPB4P_VOTk9DynPrpStsAuth 0 "Stopped" 1 "Not Stopped" ;
VAL_TABLE_ SRRLFODPB4P_VOTk9DynPrpAuth 0 "Has Never Moved" 1 "Moving In Same Direction As Host" 2 "Moving In Opposite Direction As Host" 3 "Crossing From Left To Right" 4 "Crossing From Right To Left" ;
VAL_TABLE_ SRRLFODPB4P_VOTk9CnfdStsAuth 0 "Highly Speculative" 1 "Speculative" 2 "Confident" 3 "Highly Confident" ;
VAL_TABLE_ SRRLFODPB4P_VOTk9MStsAuth 0 "No Object" 1 "New Object" 2 "Latent Track Not Detected this Cycle" 3 "Measured this Cycle" ;
VAL_TABLE_ SRRLFODPB4P_VOTk9TypCnfdAuth 0 "Highly Speculative" 1 "Speculative" 2 "Confident" 3 "Highly Confident" ;
VAL_TABLE_ SRRLFODPB5P_IOTk10ElvtnAuth 0 "Not Elevated" 1 "Elevation Speculative" 2 "Elevation Confident" 3 "Elevation Very Confident" ;
VAL_TABLE_ SRRLFODPB5P_IOTk10CnfdStsAuth 0 "Highly Speculative" 1 "Speculative" 2 "Confident" 3 "Highly Confident" ;
VAL_TABLE_ SRRLFODPB5P_IOTk10MStsAuth 0 "No Object" 1 "New Object" 2 "Latent Track Not Detected this Cycle" 3 "Measured this Cycle" ;
VAL_TABLE_ SRRLFODPB5P_IOTk1CnfdStsAuth 0 "Highly Speculative" 1 "Speculative" 2 "Confident" 3 "Highly Confident" ;
VAL_TABLE_ SRRLFODPB5P_IOTk10TypCnfdAuth 0 "Highly Speculative" 1 "Speculative" 2 "Confident" 3 "Highly Confident" ;
VAL_TABLE_ SRRLFODPB5P_IOTk10TypAuth 0 "Unknown" 1 "Guard Rail" 2 "Tunnel" 3 "Traffic Sign" 4 "Bridge" 5 "Pole" ;
VAL_TABLE_ SRRLFODPB5P_IOTk1ElvtnAuth 0 "Not Elevated" 1 "Elevation Speculative" 2 "Elevation Confident" 3 "Elevation Very Confident" ;
VAL_TABLE_ SRRLFODPB5P_IOTk1MStsAuth 0 "No Object" 1 "New Object" 2 "Latent Track Not Detected this Cycle" 3 "Measured this Cycle" ;
VAL_TABLE_ SRRLFODPB5P_IOTk1TypAuth 0 "Unknown" 1 "Guard Rail" 2 "Tunnel" 3 "Traffic Sign" 4 "Bridge" 5 "Pole" ;
VAL_TABLE_ SRRLFODPB5P_IOTk2ElvtnAuth 0 "Not Elevated" 1 "Elevation Speculative" 2 "Elevation Confident" 3 "Elevation Very Confident" ;
VAL_TABLE_ SRRLFODPB5P_IOTk2CnfdStsAuth 0 "Highly Speculative" 1 "Speculative" 2 "Confident" 3 "Highly Confident" ;
VAL_TABLE_ SRRLFODPB5P_IOTk1TypCnfdAuth 0 "Highly Speculative" 1 "Speculative" 2 "Confident" 3 "Highly Confident" ;
VAL_TABLE_ SRRLFODPB5P_IOTk2MStsAuth 0 "No Object" 1 "New Object" 2 "Latent Track Not Detected this Cycle" 3 "Measured this Cycle" ;
VAL_TABLE_ SRRLFODPB5P_IOTk2TypCnfdAuth 0 "Highly Speculative" 1 "Speculative" 2 "Confident" 3 "Highly Confident" ;
VAL_TABLE_ SRRLFODPB5P_IOTk2TypAuth 0 "Unknown" 1 "Guard Rail" 2 "Tunnel" 3 "Traffic Sign" 4 "Bridge" 5 "Pole" ;
VAL_TABLE_ SRRLFODPB5P_IOTk3ElvtnAuth 0 "Not Elevated" 1 "Elevation Speculative" 2 "Elevation Confident" 3 "Elevation Very Confident" ;
VAL_TABLE_ SRRLFODPB5P_IOTk3CnfdStsAuth 0 "Highly Speculative" 1 "Speculative" 2 "Confident" 3 "Highly Confident" ;
VAL_TABLE_ SRRLFODPB5P_IOTk3MStsAuth 0 "No Object" 1 "New Object" 2 "Latent Track Not Detected this Cycle" 3 "Measured this Cycle" ;
VAL_TABLE_ SRRLFODPB5P_IOTk4CnfdStsAuth 0 "Highly Speculative" 1 "Speculative" 2 "Confident" 3 "Highly Confident" ;
VAL_TABLE_ SRRLFODPB5P_IOTk3TypCnfdAuth 0 "Highly Speculative" 1 "Speculative" 2 "Confident" 3 "Highly Confident" ;
VAL_TABLE_ SRRLFODPB5P_IOTk3TypAuth 0 "Unknown" 1 "Guard Rail" 2 "Tunnel" 3 "Traffic Sign" 4 "Bridge" 5 "Pole" ;
VAL_TABLE_ SRRLFODPB5P_IOTk4ElvtnAuth 0 "Not Elevated" 1 "Elevation Speculative" 2 "Elevation Confident" 3 "Elevation Very Confident" ;
VAL_TABLE_ SRRLFODPB5P_IOTk4MStsAuth 0 "No Object" 1 "New Object" 2 "Latent Track Not Detected this Cycle" 3 "Measured this Cycle" ;
VAL_TABLE_ SRRLFODPB5P_IOTk4TypAuth 0 "Unknown" 1 "Guard Rail" 2 "Tunnel" 3 "Traffic Sign" 4 "Bridge" 5 "Pole" ;
VAL_TABLE_ SRRLFODPB5P_IOTk5ElvtnAuth 0 "Not Elevated" 1 "Elevation Speculative" 2 "Elevation Confident" 3 "Elevation Very Confident" ;
VAL_TABLE_ SRRLFODPB5P_IOTk5CnfdStsAuth 0 "Highly Speculative" 1 "Speculative" 2 "Confident" 3 "Highly Confident" ;
VAL_TABLE_ SRRLFODPB5P_IOTk4TypCnfdAuth 0 "Highly Speculative" 1 "Speculative" 2 "Confident" 3 "Highly Confident" ;
VAL_TABLE_ SRRLFODPB5P_IOTk5MStsAuth 0 "No Object" 1 "New Object" 2 "Latent Track Not Detected this Cycle" 3 "Measured this Cycle" ;
VAL_TABLE_ SRRLFODPB5P_IOTk5TypCnfdAuth 0 "Highly Speculative" 1 "Speculative" 2 "Confident" 3 "Highly Confident" ;
VAL_TABLE_ SRRLFODPB5P_IOTk5TypAuth 0 "Unknown" 1 "Guard Rail" 2 "Tunnel" 3 "Traffic Sign" 4 "Bridge" 5 "Pole" ;
VAL_TABLE_ SRRLFODPB5P_IOTk6ElvtnAuth 0 "Not Elevated" 1 "Elevation Speculative" 2 "Elevation Confident" 3 "Elevation Very Confident" ;
VAL_TABLE_ SRRLFODPB5P_IOTk6CnfdStsAuth 0 "Highly Speculative" 1 "Speculative" 2 "Confident" 3 "Highly Confident" ;
VAL_TABLE_ SRRLFODPB5P_IOTk6MStsAuth 0 "No Object" 1 "New Object" 2 "Latent Track Not Detected this Cycle" 3 "Measured this Cycle" ;
VAL_TABLE_ SRRLFODPB5P_IOTk7ElvtnAuth 0 "Not Elevated" 1 "Elevation Speculative" 2 "Elevation Confident" 3 "Elevation Very Confident" ;
VAL_TABLE_ SRRLFODPB5P_IOTk7CnfdStsAuth 0 "Highly Speculative" 1 "Speculative" 2 "Confident" 3 "Highly Confident" ;
VAL_TABLE_ SRRLFODPB5P_IOTk6TypCnfdAuth 0 "Highly Speculative" 1 "Speculative" 2 "Confident" 3 "Highly Confident" ;
VAL_TABLE_ SRRLFODPB5P_IOTk6TypAuth 0 "Unknown" 1 "Guard Rail" 2 "Tunnel" 3 "Traffic Sign" 4 "Bridge" 5 "Pole" ;
VAL_TABLE_ SRRLFODPB5P_IOTk7MStsAuth 0 "No Object" 1 "New Object" 2 "Latent Track Not Detected this Cycle" 3 "Measured this Cycle" ;
VAL_TABLE_ SRRLFODPB5P_IOTk7TypAuth 0 "Unknown" 1 "Guard Rail" 2 "Tunnel" 3 "Traffic Sign" 4 "Bridge" 5 "Pole" ;
VAL_TABLE_ SRRLFODPB5P_IOTk8ElvtnAuth 0 "Not Elevated" 1 "Elevation Speculative" 2 "Elevation Confident" 3 "Elevation Very Confident" ;
VAL_TABLE_ SRRLFODPB5P_IOTk8CnfdStsAuth 0 "Highly Speculative" 1 "Speculative" 2 "Confident" 3 "Highly Confident" ;
VAL_TABLE_ SRRLFODPB5P_IOTk7TypCnfdAuth 0 "Highly Speculative" 1 "Speculative" 2 "Confident" 3 "Highly Confident" ;
VAL_TABLE_ SRRLFODPB5P_IOTk8MStsAuth 0 "No Object" 1 "New Object" 2 "Latent Track Not Detected this Cycle" 3 "Measured this Cycle" ;
VAL_TABLE_ SRRLFODPB5P_IOTk9CnfdStsAuth 0 "Highly Speculative" 1 "Speculative" 2 "Confident" 3 "Highly Confident" ;
VAL_TABLE_ SRRLFODPB5P_IOTk8TypCnfdAuth 0 "Highly Speculative" 1 "Speculative" 2 "Confident" 3 "Highly Confident" ;
VAL_TABLE_ SRRLFODPB5P_IOTk8TypAuth 0 "Unknown" 1 "Guard Rail" 2 "Tunnel" 3 "Traffic Sign" 4 "Bridge" 5 "Pole" ;
VAL_TABLE_ SRRLFODPB5P_IOTk9ElvtnAuth 0 "Not Elevated" 1 "Elevation Speculative" 2 "Elevation Confident" 3 "Elevation Very Confident" ;
VAL_TABLE_ SRRLFODPB5P_IOTk9MStsAuth 0 "No Object" 1 "New Object" 2 "Latent Track Not Detected this Cycle" 3 "Measured this Cycle" ;
VAL_TABLE_ SRRLFODPB5P_IOTk9TypAuth 0 "Unknown" 1 "Guard Rail" 2 "Tunnel" 3 "Traffic Sign" 4 "Bridge" 5 "Pole" ;
VAL_TABLE_ SRRLFODPB5P_IOTk9TypCnfdAuth 0 "Highly Speculative" 1 "Speculative" 2 "Confident" 3 "Highly Confident" ;
VAL_TABLE_ SRRLFODPB1P_ConstrArDtnCnfdAuth 0 "Highly Speculative" 1 "Speculative" 2 "Confident" 3 "Highly Confident" ;
VAL_TABLE_ SRRLFODPB1P_AcqTmStmAuth_Inv 0 "FALSE" 1 "TRUE" ;
VAL_TABLE_ SRRLFODPB1P_POTk1DynPrpAuth 0 "Has Never Moved" 1 "Has Moved But Currently Stopped" 2 "Moving In Same Direction As Host" 3 "Moving In Opposite Direction As Host" 4 "Crossing Path" ;
VAL_TABLE_ SRRLFODPB1P_POTk1CnfdStsAuth 0 "Highly Speculative" 1 "Speculative" 2 "Confident" 3 "Highly Confident" ;
VAL_TABLE_ SRRLFODPB1P_MdCmdStsAuth 0 "Not Radiating" 1 "Reporting Object Data" 2 "Not Reporting Object Data" ;
VAL_TABLE_ SRRLFODPB1P_ConstrArDtnStsAuth 0 "Not Detected" 1 "Detected" 2 "Unknown" ;
VAL_TABLE_ SRRLFODPB1P_POTk1MStsAuth 0 "No Object" 1 "New Object" 2 "Latent Track Not Detected this Cycle" 3 "Measured this Cycle" ;
VAL_TABLE_ SRRLFODPB1P_POTk2CnfdStsAuth 0 "Highly Speculative" 1 "Speculative" 2 "Confident" 3 "Highly Confident" ;
VAL_TABLE_ SRRLFODPB1P_POTk1TypCnfdAuth 0 "Highly Speculative" 1 "Speculative" 2 "Confident" 3 "Highly Confident" ;
VAL_TABLE_ SRRLFODPB1P_POTk1TypAuth 0 "Unknown" 1 "Pedestrian" 2 "Bicycle" ;
VAL_TABLE_ SRRLFODPB1P_POTk2DynPrpAuth 0 "Has Never Moved" 1 "Has Moved But Currently Stopped" 2 "Moving In Same Direction As Host" 3 "Moving In Opposite Direction As Host" 4 "Crossing Path" ;
VAL_TABLE_ SRRLFODPB1P_POTk2MStsAuth 0 "No Object" 1 "New Object" 2 "Latent Track Not Detected this Cycle" 3 "Measured this Cycle" ;
VAL_TABLE_ SRRLFODPB1P_POTk2TypCnfdAuth 0 "Highly Speculative" 1 "Speculative" 2 "Confident" 3 "Highly Confident" ;
VAL_TABLE_ SRRLFODPB1P_POTk2TypAuth 0 "Unknown" 1 "Pedestrian" 2 "Bicycle" ;
VAL_TABLE_ SRRLFODPB1P_SnsrUnvAuth 0 "FALSE" 1 "TRUE" ;
VAL_TABLE_ SRRLFODPB1P_SnsrBlckdAuth 0 "FALSE" 1 "TRUE" ;
VAL_TABLE_ SRRLFODPB1P_ServRqrdAuth 0 "FALSE" 1 "TRUE" ;
VAL_TABLE_ SRRLFODPB1P_RdTypCnfdAuth 0 "Highly Speculative" 1 "Speculative" 2 "Confident" 3 "Highly Confident" ;
VAL_TABLE_ SRRLFODPB1P_RdTypAuth 0 "Unknown" 1 "City" 2 "Secondary Road" 3 "Highway" 4 "Construction Zone Entry" 5 "Construction Zone Exit" ;
VAL_TABLE_ SRRLFODPB1P_SwpBndwdthStsAuth 0 "Mode A" 1 "Mode B" 2 "Mode C" 3 "Mode D" ;
VAL_TABLE_ SRRLFODPB1P_VOTk1DynPrpStsAuth 0 "Stopped" 1 "Not Stopped" ;
VAL_TABLE_ SRRLFODPB1P_VOTk1DynPrpAuth 0 "Has Never Moved" 1 "Moving In Same Direction As Host" 2 "Moving In Opposite Direction As Host" 3 "Crossing From Left To Right" 4 "Crossing From Right To Left" ;
VAL_TABLE_ SRRLFODPB1P_VOTk1CnfdStsAuth 0 "Highly Speculative" 1 "Speculative" 2 "Confident" 3 "Highly Confident" ;
VAL_TABLE_ SRRLFODPB1P_VOTk1MStsAuth 0 "No Object" 1 "New Object" 2 "Latent Track Not Detected this Cycle" 3 "Measured this Cycle" ;
VAL_TABLE_ SRRLFODPB1P_VOTk1TypCnfdAuth 0 "Highly Speculative" 1 "Speculative" 2 "Confident" 3 "Highly Confident" ;
VAL_TABLE_ SRRLFODPB6P_REOTk1CnfdStsAuth 0 "Highly Speculative" 1 "Speculative" 2 "Confident" 3 "Highly Confident" ;
VAL_TABLE_ SRRLFODPB6P_REOTk2CnfdStsAuth 0 "Highly Speculative" 1 "Speculative" 2 "Confident" 3 "Highly Confident" ;
VAL_TABLE_ SRRLFODPB6P_REOTk1TypCnfdAuth 0 "Highly Speculative" 1 "Speculative" 2 "Confident" 3 "Highly Confident" ;
VAL_TABLE_ SRRLFODPB6P_REOTk1TypAuth 0 "Unknown" 1 "Barriers" 2 "Guard Rails" 3 "Bridge Abutments" 4 "Edge of Road" 5 "Open Area" ;
VAL_TABLE_ SRRLFODPB6P_REOTk3CnfdStsAuth 0 "Highly Speculative" 1 "Speculative" 2 "Confident" 3 "Highly Confident" ;
VAL_TABLE_ SRRLFODPB6P_REOTk2TypCnfdAuth 0 "Highly Speculative" 1 "Speculative" 2 "Confident" 3 "Highly Confident" ;
VAL_TABLE_ SRRLFODPB6P_REOTk2TypAuth 0 "Unknown" 1 "Barriers" 2 "Guard Rails" 3 "Bridge Abutments" 4 "Edge of Road" 5 "Open Area" ;
VAL_TABLE_ SRRLFODPB6P_REOTk3TypCnfdAuth 0 "Highly Speculative" 1 "Speculative" 2 "Confident" 3 "Highly Confident" ;
VAL_TABLE_ SRRLFODPB6P_REOTk3TypAuth 0 "Unknown" 1 "Barriers" 2 "Guard Rails" 3 "Bridge Abutments" 4 "Edge of Road" 5 "Open Area" ;
VAL_TABLE_ SRRLRCODPB2P_POTk3DynPrpAuth 0 "Has Never Moved" 1 "Has Moved But Currently Stopped" 2 "Moving In Same Direction As Host" 3 "Moving In Opposite Direction As Host" 4 "Crossing Path" ;
VAL_TABLE_ SRRLRCODPB2P_POTk3CnfdStsAuth 0 "Highly Speculative" 1 "Speculative" 2 "Confident" 3 "Highly Confident" ;
VAL_TABLE_ SRRLRCODPB2P_POTk3MStsAuth 0 "No Object" 1 "New Object" 2 "Latent Track Not Detected this Cycle" 3 "Measured this Cycle" ;
VAL_TABLE_ SRRLRCODPB2P_POTk3TypCnfdAuth 0 "Highly Speculative" 1 "Speculative" 2 "Confident" 3 "Highly Confident" ;
VAL_TABLE_ SRRLRCODPB2P_POTk3TypAuth 0 "Unknown" 1 "Pedestrian" 2 "Bicycle" ;
VAL_TABLE_ SRRLRCODPB2P_VOTk2DynPrpStsAuth 0 "Stopped" 1 "Not Stopped" ;
VAL_TABLE_ SRRLRCODPB2P_VOTk2DynPrpAuth 0 "Has Never Moved" 1 "Moving In Same Direction As Host" 2 "Moving In Opposite Direction As Host" 3 "Crossing From Left To Right" 4 "Crossing From Right To Left" ;
VAL_TABLE_ SRRLRCODPB2P_VOTk2CnfdStsAuth 0 "Highly Speculative" 1 "Speculative" 2 "Confident" 3 "Highly Confident" ;
VAL_TABLE_ SRRLRCODPB2P_VOTk2MStsAuth 0 "No Object" 1 "New Object" 2 "Latent Track Not Detected this Cycle" 3 "Measured this Cycle" ;
VAL_TABLE_ SRRLRCODPB2P_VOTk2TypCnfdAuth 0 "Highly Speculative" 1 "Speculative" 2 "Confident" 3 "Highly Confident" ;
VAL_TABLE_ SRRLRCODPB2P_VOTk3CnfdStsAuth 0 "Highly Speculative" 1 "Speculative" 2 "Confident" 3 "Highly Confident" ;
VAL_TABLE_ SRRLRCODPB2P_VOTk3DynPrpStsAuth 0 "Stopped" 1 "Not Stopped" ;
VAL_TABLE_ SRRLRCODPB2P_VOTk3DynPrpAuth 0 "Has Never Moved" 1 "Moving In Same Direction As Host" 2 "Moving In Opposite Direction As Host" 3 "Crossing From Left To Right" 4 "Crossing From Right To Left" ;
VAL_TABLE_ SRRLRCODPB2P_VOTk3MStsAuth 0 "No Object" 1 "New Object" 2 "Latent Track Not Detected this Cycle" 3 "Measured this Cycle" ;
VAL_TABLE_ SRRLRCODPB2P_VOTk3TypCnfdAuth 0 "Highly Speculative" 1 "Speculative" 2 "Confident" 3 "Highly Confident" ;
VAL_TABLE_ SRRLRCODPB2P_VOTk4DynPrpStsAuth 0 "Stopped" 1 "Not Stopped" ;
VAL_TABLE_ SRRLRCODPB2P_VOTk4DynPrpAuth 0 "Has Never Moved" 1 "Moving In Same Direction As Host" 2 "Moving In Opposite Direction As Host" 3 "Crossing From Left To Right" 4 "Crossing From Right To Left" ;
VAL_TABLE_ SRRLRCODPB2P_VOTk4CnfdStsAuth 0 "Highly Speculative" 1 "Speculative" 2 "Confident" 3 "Highly Confident" ;
VAL_TABLE_ SRRLRCODPB2P_VOTk4MStsAuth 0 "No Object" 1 "New Object" 2 "Latent Track Not Detected this Cycle" 3 "Measured this Cycle" ;
VAL_TABLE_ SRRLRCODPB2P_VOTk4TypCnfdAuth 0 "Highly Speculative" 1 "Speculative" 2 "Confident" 3 "Highly Confident" ;
VAL_TABLE_ SRRLRCODPB3P_POTk4DynPrpAuth 0 "Has Never Moved" 1 "Has Moved But Currently Stopped" 2 "Moving In Same Direction As Host" 3 "Moving In Opposite Direction As Host" 4 "Crossing Path" ;
VAL_TABLE_ SRRLRCODPB3P_POTk4CnfdStsAuth 0 "Highly Speculative" 1 "Speculative" 2 "Confident" 3 "Highly Confident" ;
VAL_TABLE_ SRRLRCODPB3P_POTk4MStsAuth 0 "No Object" 1 "New Object" 2 "Latent Track Not Detected this Cycle" 3 "Measured this Cycle" ;
VAL_TABLE_ SRRLRCODPB3P_POTk4TypCnfdAuth 0 "Highly Speculative" 1 "Speculative" 2 "Confident" 3 "Highly Confident" ;
VAL_TABLE_ SRRLRCODPB3P_POTk4TypAuth 0 "Unknown" 1 "Pedestrian" 2 "Bicycle" ;
VAL_TABLE_ SRRLRCODPB3P_VOTk5DynPrpStsAuth 0 "Stopped" 1 "Not Stopped" ;
VAL_TABLE_ SRRLRCODPB3P_VOTk5DynPrpAuth 0 "Has Never Moved" 1 "Moving In Same Direction As Host" 2 "Moving In Opposite Direction As Host" 3 "Crossing From Left To Right" 4 "Crossing From Right To Left" ;
VAL_TABLE_ SRRLRCODPB3P_VOTk5CnfdStsAuth 0 "Highly Speculative" 1 "Speculative" 2 "Confident" 3 "Highly Confident" ;
VAL_TABLE_ SRRLRCODPB3P_VOTk5MStsAuth 0 "No Object" 1 "New Object" 2 "Latent Track Not Detected this Cycle" 3 "Measured this Cycle" ;
VAL_TABLE_ SRRLRCODPB3P_VOTk5TypCnfdAuth 0 "Highly Speculative" 1 "Speculative" 2 "Confident" 3 "Highly Confident" ;
VAL_TABLE_ SRRLRCODPB3P_VOTk6CnfdStsAuth 0 "Highly Speculative" 1 "Speculative" 2 "Confident" 3 "Highly Confident" ;
VAL_TABLE_ SRRLRCODPB3P_VOTk6DynPrpStsAuth 0 "Stopped" 1 "Not Stopped" ;
VAL_TABLE_ SRRLRCODPB3P_VOTk6DynPrpAuth 0 "Has Never Moved" 1 "Moving In Same Direction As Host" 2 "Moving In Opposite Direction As Host" 3 "Crossing From Left To Right" 4 "Crossing From Right To Left" ;
VAL_TABLE_ SRRLRCODPB3P_VOTk6MStsAuth 0 "No Object" 1 "New Object" 2 "Latent Track Not Detected this Cycle" 3 "Measured this Cycle" ;
VAL_TABLE_ SRRLRCODPB3P_VOTk6TypCnfdAuth 0 "Highly Speculative" 1 "Speculative" 2 "Confident" 3 "Highly Confident" ;
VAL_TABLE_ SRRLRCODPB3P_VOTk7DynPrpStsAuth 0 "Stopped" 1 "Not Stopped" ;
VAL_TABLE_ SRRLRCODPB3P_VOTk7DynPrpAuth 0 "Has Never Moved" 1 "Moving In Same Direction As Host" 2 "Moving In Opposite Direction As Host" 3 "Crossing From Left To Right" 4 "Crossing From Right To Left" ;
VAL_TABLE_ SRRLRCODPB3P_VOTk7CnfdStsAuth 0 "Highly Speculative" 1 "Speculative" 2 "Confident" 3 "Highly Confident" ;
VAL_TABLE_ SRRLRCODPB3P_VOTk7MStsAuth 0 "No Object" 1 "New Object" 2 "Latent Track Not Detected this Cycle" 3 "Measured this Cycle" ;
VAL_TABLE_ SRRLRCODPB3P_VOTk7TypCnfdAuth 0 "Highly Speculative" 1 "Speculative" 2 "Confident" 3 "Highly Confident" ;
VAL_TABLE_ SRRLRCODPB4P_POTk5DynPrpAuth 0 "Has Never Moved" 1 "Has Moved But Currently Stopped" 2 "Moving In Same Direction As Host" 3 "Moving In Opposite Direction As Host" 4 "Crossing Path" ;
VAL_TABLE_ SRRLRCODPB4P_POTk5CnfdStsAuth 0 "Highly Speculative" 1 "Speculative" 2 "Confident" 3 "Highly Confident" ;
VAL_TABLE_ SRRLRCODPB4P_POTk5MStsAuth 0 "No Object" 1 "New Object" 2 "Latent Track Not Detected this Cycle" 3 "Measured this Cycle" ;
VAL_TABLE_ SRRLRCODPB4P_POTk5TypCnfdAuth 0 "Highly Speculative" 1 "Speculative" 2 "Confident" 3 "Highly Confident" ;
VAL_TABLE_ SRRLRCODPB4P_POTk5TypAuth 0 "Unknown" 1 "Pedestrian" 2 "Bicycle" ;
VAL_TABLE_ SRRLRCODPB4P_VOTk10DynPrpStsAuth 0 "Stopped" 1 "Not Stopped" ;
VAL_TABLE_ SRRLRCODPB4P_VOTk10DynPrpAuth 0 "Has Never Moved" 1 "Moving In Same Direction As Host" 2 "Moving In Opposite Direction As Host" 3 "Crossing From Left To Right" 4 "Crossing From Right To Left" ;
VAL_TABLE_ SRRLRCODPB4P_VOTk10CnfdStsAuth 0 "Highly Speculative" 1 "Speculative" 2 "Confident" 3 "Highly Confident" ;
VAL_TABLE_ SRRLRCODPB4P_VOTk10MStsAuth 0 "No Object" 1 "New Object" 2 "Latent Track Not Detected this Cycle" 3 "Measured this Cycle" ;
VAL_TABLE_ SRRLRCODPB4P_VOTk10TypCnfdAuth 0 "Highly Speculative" 1 "Speculative" 2 "Confident" 3 "Highly Confident" ;
VAL_TABLE_ SRRLRCODPB4P_VOTk8CnfdStsAuth 0 "Highly Speculative" 1 "Speculative" 2 "Confident" 3 "Highly Confident" ;
VAL_TABLE_ SRRLRCODPB4P_VOTk8DynPrpStsAuth 0 "Stopped" 1 "Not Stopped" ;
VAL_TABLE_ SRRLRCODPB4P_VOTk8DynPrpAuth 0 "Has Never Moved" 1 "Moving In Same Direction As Host" 2 "Moving In Opposite Direction As Host" 3 "Crossing From Left To Right" 4 "Crossing From Right To Left" ;
VAL_TABLE_ SRRLRCODPB4P_VOTk8MStsAuth 0 "No Object" 1 "New Object" 2 "Latent Track Not Detected this Cycle" 3 "Measured this Cycle" ;
VAL_TABLE_ SRRLRCODPB4P_VOTk8TypCnfdAuth 0 "Highly Speculative" 1 "Speculative" 2 "Confident" 3 "Highly Confident" ;
VAL_TABLE_ SRRLRCODPB4P_VOTk9DynPrpStsAuth 0 "Stopped" 1 "Not Stopped" ;
VAL_TABLE_ SRRLRCODPB4P_VOTk9DynPrpAuth 0 "Has Never Moved" 1 "Moving In Same Direction As Host" 2 "Moving In Opposite Direction As Host" 3 "Crossing From Left To Right" 4 "Crossing From Right To Left" ;
VAL_TABLE_ SRRLRCODPB4P_VOTk9CnfdStsAuth 0 "Highly Speculative" 1 "Speculative" 2 "Confident" 3 "Highly Confident" ;
VAL_TABLE_ SRRLRCODPB4P_VOTk9MStsAuth 0 "No Object" 1 "New Object" 2 "Latent Track Not Detected this Cycle" 3 "Measured this Cycle" ;
VAL_TABLE_ SRRLRCODPB4P_VOTk9TypCnfdAuth 0 "Highly Speculative" 1 "Speculative" 2 "Confident" 3 "Highly Confident" ;
VAL_TABLE_ SRRLRCODPB5P_IOTk10ElvtnAuth 0 "Not Elevated" 1 "Elevation Speculative" 2 "Elevation Confident" 3 "Elevation Very Confident" ;
VAL_TABLE_ SRRLRCODPB5P_IOTk10CnfdStsAuth 0 "Highly Speculative" 1 "Speculative" 2 "Confident" 3 "Highly Confident" ;
VAL_TABLE_ SRRLRCODPB5P_IOTk10MStsAuth 0 "No Object" 1 "New Object" 2 "Latent Track Not Detected this Cycle" 3 "Measured this Cycle" ;
VAL_TABLE_ SRRLRCODPB5P_IOTk1CnfdStsAuth 0 "Highly Speculative" 1 "Speculative" 2 "Confident" 3 "Highly Confident" ;
VAL_TABLE_ SRRLRCODPB5P_IOTk10TypCnfdAuth 0 "Highly Speculative" 1 "Speculative" 2 "Confident" 3 "Highly Confident" ;
VAL_TABLE_ SRRLRCODPB5P_IOTk10TypAuth 0 "Unknown" 1 "Guard Rail" 2 "Tunnel" 3 "Traffic Sign" 4 "Bridge" 5 "Pole" ;
VAL_TABLE_ SRRLRCODPB5P_IOTk1ElvtnAuth 0 "Not Elevated" 1 "Elevation Speculative" 2 "Elevation Confident" 3 "Elevation Very Confident" ;
VAL_TABLE_ SRRLRCODPB5P_IOTk1MStsAuth 0 "No Object" 1 "New Object" 2 "Latent Track Not Detected this Cycle" 3 "Measured this Cycle" ;
VAL_TABLE_ SRRLRCODPB5P_IOTk1TypAuth 0 "Unknown" 1 "Guard Rail" 2 "Tunnel" 3 "Traffic Sign" 4 "Bridge" 5 "Pole" ;
VAL_TABLE_ SRRLRCODPB5P_IOTk2ElvtnAuth 0 "Not Elevated" 1 "Elevation Speculative" 2 "Elevation Confident" 3 "Elevation Very Confident" ;
VAL_TABLE_ SRRLRCODPB5P_IOTk2CnfdStsAuth 0 "Highly Speculative" 1 "Speculative" 2 "Confident" 3 "Highly Confident" ;
VAL_TABLE_ SRRLRCODPB5P_IOTk1TypCnfdAuth 0 "Highly Speculative" 1 "Speculative" 2 "Confident" 3 "Highly Confident" ;
VAL_TABLE_ SRRLRCODPB5P_IOTk2MStsAuth 0 "No Object" 1 "New Object" 2 "Latent Track Not Detected this Cycle" 3 "Measured this Cycle" ;
VAL_TABLE_ SRRLRCODPB5P_IOTk2TypCnfdAuth 0 "Highly Speculative" 1 "Speculative" 2 "Confident" 3 "Highly Confident" ;
VAL_TABLE_ SRRLRCODPB5P_IOTk2TypAuth 0 "Unknown" 1 "Guard Rail" 2 "Tunnel" 3 "Traffic Sign" 4 "Bridge" 5 "Pole" ;
VAL_TABLE_ SRRLRCODPB5P_IOTk3ElvtnAuth 0 "Not Elevated" 1 "Elevation Speculative" 2 "Elevation Confident" 3 "Elevation Very Confident" ;
VAL_TABLE_ SRRLRCODPB5P_IOTk3CnfdStsAuth 0 "Highly Speculative" 1 "Speculative" 2 "Confident" 3 "Highly Confident" ;
VAL_TABLE_ SRRLRCODPB5P_IOTk3MStsAuth 0 "No Object" 1 "New Object" 2 "Latent Track Not Detected this Cycle" 3 "Measured this Cycle" ;
VAL_TABLE_ SRRLRCODPB5P_IOTk4CnfdStsAuth 0 "Highly Speculative" 1 "Speculative" 2 "Confident" 3 "Highly Confident" ;
VAL_TABLE_ SRRLRCODPB5P_IOTk3TypCnfdAuth 0 "Highly Speculative" 1 "Speculative" 2 "Confident" 3 "Highly Confident" ;
VAL_TABLE_ SRRLRCODPB5P_IOTk3TypAuth 0 "Unknown" 1 "Guard Rail" 2 "Tunnel" 3 "Traffic Sign" 4 "Bridge" 5 "Pole" ;
VAL_TABLE_ SRRLRCODPB5P_IOTk4ElvtnAuth 0 "Not Elevated" 1 "Elevation Speculative" 2 "Elevation Confident" 3 "Elevation Very Confident" ;
VAL_TABLE_ SRRLRCODPB5P_IOTk4MStsAuth 0 "No Object" 1 "New Object" 2 "Latent Track Not Detected this Cycle" 3 "Measured this Cycle" ;
VAL_TABLE_ SRRLRCODPB5P_IOTk4TypAuth 0 "Unknown" 1 "Guard Rail" 2 "Tunnel" 3 "Traffic Sign" 4 "Bridge" 5 "Pole" ;
VAL_TABLE_ SRRLRCODPB5P_IOTk5ElvtnAuth 0 "Not Elevated" 1 "Elevation Speculative" 2 "Elevation Confident" 3 "Elevation Very Confident" ;
VAL_TABLE_ SRRLRCODPB5P_IOTk5CnfdStsAuth 0 "Highly Speculative" 1 "Speculative" 2 "Confident" 3 "Highly Confident" ;
VAL_TABLE_ SRRLRCODPB5P_IOTk4TypCnfdAuth 0 "Highly Speculative" 1 "Speculative" 2 "Confident" 3 "Highly Confident" ;
VAL_TABLE_ SRRLRCODPB5P_IOTk5MStsAuth 0 "No Object" 1 "New Object" 2 "Latent Track Not Detected this Cycle" 3 "Measured this Cycle" ;
VAL_TABLE_ SRRLRCODPB5P_IOTk5TypCnfdAuth 0 "Highly Speculative" 1 "Speculative" 2 "Confident" 3 "Highly Confident" ;
VAL_TABLE_ SRRLRCODPB5P_IOTk5TypAuth 0 "Unknown" 1 "Guard Rail" 2 "Tunnel" 3 "Traffic Sign" 4 "Bridge" 5 "Pole" ;
VAL_TABLE_ SRRLRCODPB5P_IOTk6ElvtnAuth 0 "Not Elevated" 1 "Elevation Speculative" 2 "Elevation Confident" 3 "Elevation Very Confident" ;
VAL_TABLE_ SRRLRCODPB5P_IOTk6CnfdStsAuth 0 "Highly Speculative" 1 "Speculative" 2 "Confident" 3 "Highly Confident" ;
VAL_TABLE_ SRRLRCODPB5P_IOTk6MStsAuth 0 "No Object" 1 "New Object" 2 "Latent Track Not Detected this Cycle" 3 "Measured this Cycle" ;
VAL_TABLE_ SRRLRCODPB5P_IOTk7ElvtnAuth 0 "Not Elevated" 1 "Elevation Speculative" 2 "Elevation Confident" 3 "Elevation Very Confident" ;
VAL_TABLE_ SRRLRCODPB5P_IOTk7CnfdStsAuth 0 "Highly Speculative" 1 "Speculative" 2 "Confident" 3 "Highly Confident" ;
VAL_TABLE_ SRRLRCODPB5P_IOTk6TypCnfdAuth 0 "Highly Speculative" 1 "Speculative" 2 "Confident" 3 "Highly Confident" ;
VAL_TABLE_ SRRLRCODPB5P_IOTk6TypAuth 0 "Unknown" 1 "Guard Rail" 2 "Tunnel" 3 "Traffic Sign" 4 "Bridge" 5 "Pole" ;
VAL_TABLE_ SRRLRCODPB5P_IOTk7MStsAuth 0 "No Object" 1 "New Object" 2 "Latent Track Not Detected this Cycle" 3 "Measured this Cycle" ;
VAL_TABLE_ SRRLRCODPB5P_IOTk7TypAuth 0 "Unknown" 1 "Guard Rail" 2 "Tunnel" 3 "Traffic Sign" 4 "Bridge" 5 "Pole" ;
VAL_TABLE_ SRRLRCODPB5P_IOTk8ElvtnAuth 0 "Not Elevated" 1 "Elevation Speculative" 2 "Elevation Confident" 3 "Elevation Very Confident" ;
VAL_TABLE_ SRRLRCODPB5P_IOTk8CnfdStsAuth 0 "Highly Speculative" 1 "Speculative" 2 "Confident" 3 "Highly Confident" ;
VAL_TABLE_ SRRLRCODPB5P_IOTk7TypCnfdAuth 0 "Highly Speculative" 1 "Speculative" 2 "Confident" 3 "Highly Confident" ;
VAL_TABLE_ SRRLRCODPB5P_IOTk8MStsAuth 0 "No Object" 1 "New Object" 2 "Latent Track Not Detected this Cycle" 3 "Measured this Cycle" ;
VAL_TABLE_ SRRLRCODPB5P_IOTk9CnfdStsAuth 0 "Highly Speculative" 1 "Speculative" 2 "Confident" 3 "Highly Confident" ;
VAL_TABLE_ SRRLRCODPB5P_IOTk8TypCnfdAuth 0 "Highly Speculative" 1 "Speculative" 2 "Confident" 3 "Highly Confident" ;
VAL_TABLE_ SRRLRCODPB5P_IOTk8TypAuth 0 "Unknown" 1 "Guard Rail" 2 "Tunnel" 3 "Traffic Sign" 4 "Bridge" 5 "Pole" ;
VAL_TABLE_ SRRLRCODPB5P_IOTk9ElvtnAuth 0 "Not Elevated" 1 "Elevation Speculative" 2 "Elevation Confident" 3 "Elevation Very Confident" ;
VAL_TABLE_ SRRLRCODPB5P_IOTk9MStsAuth 0 "No Object" 1 "New Object" 2 "Latent Track Not Detected this Cycle" 3 "Measured this Cycle" ;
VAL_TABLE_ SRRLRCODPB5P_IOTk9TypAuth 0 "Unknown" 1 "Guard Rail" 2 "Tunnel" 3 "Traffic Sign" 4 "Bridge" 5 "Pole" ;
VAL_TABLE_ SRRLRCODPB5P_IOTk9TypCnfdAuth 0 "Highly Speculative" 1 "Speculative" 2 "Confident" 3 "Highly Confident" ;
VAL_TABLE_ SRRLRCODPB1P_ConstrArDtnCnfdAuth 0 "Highly Speculative" 1 "Speculative" 2 "Confident" 3 "Highly Confident" ;
VAL_TABLE_ SRRLRCODPB1P_AcqTmStmAuth_Inv 0 "FALSE" 1 "TRUE" ;
VAL_TABLE_ SRRLRCODPB1P_POTk1DynPrpAuth 0 "Has Never Moved" 1 "Has Moved But Currently Stopped" 2 "Moving In Same Direction As Host" 3 "Moving In Opposite Direction As Host" 4 "Crossing Path" ;
VAL_TABLE_ SRRLRCODPB1P_POTk1CnfdStsAuth 0 "Highly Speculative" 1 "Speculative" 2 "Confident" 3 "Highly Confident" ;
VAL_TABLE_ SRRLRCODPB1P_MdCmdStsAuth 0 "Not Radiating" 1 "Reporting Object Data" 2 "Not Reporting Object Data" ;
VAL_TABLE_ SRRLRCODPB1P_ConstrArDtnStsAuth 0 "Not Detected" 1 "Detected" 2 "Unknown" ;
VAL_TABLE_ SRRLRCODPB1P_POTk1MStsAuth 0 "No Object" 1 "New Object" 2 "Latent Track Not Detected this Cycle" 3 "Measured this Cycle" ;
VAL_TABLE_ SRRLRCODPB1P_POTk2CnfdStsAuth 0 "Highly Speculative" 1 "Speculative" 2 "Confident" 3 "Highly Confident" ;
VAL_TABLE_ SRRLRCODPB1P_POTk1TypCnfdAuth 0 "Highly Speculative" 1 "Speculative" 2 "Confident" 3 "Highly Confident" ;
VAL_TABLE_ SRRLRCODPB1P_POTk1TypAuth 0 "Unknown" 1 "Pedestrian" 2 "Bicycle" ;
VAL_TABLE_ SRRLRCODPB1P_POTk2DynPrpAuth 0 "Has Never Moved" 1 "Has Moved But Currently Stopped" 2 "Moving In Same Direction As Host" 3 "Moving In Opposite Direction As Host" 4 "Crossing Path" ;
VAL_TABLE_ SRRLRCODPB1P_POTk2MStsAuth 0 "No Object" 1 "New Object" 2 "Latent Track Not Detected this Cycle" 3 "Measured this Cycle" ;
VAL_TABLE_ SRRLRCODPB1P_POTk2TypCnfdAuth 0 "Highly Speculative" 1 "Speculative" 2 "Confident" 3 "Highly Confident" ;
VAL_TABLE_ SRRLRCODPB1P_POTk2TypAuth 0 "Unknown" 1 "Pedestrian" 2 "Bicycle" ;
VAL_TABLE_ SRRLRCODPB1P_SnsrUnvAuth 0 "FALSE" 1 "TRUE" ;
VAL_TABLE_ SRRLRCODPB1P_SnsrBlckdAuth 0 "FALSE" 1 "TRUE" ;
VAL_TABLE_ SRRLRCODPB1P_ServRqrdAuth 0 "FALSE" 1 "TRUE" ;
VAL_TABLE_ SRRLRCODPB1P_RdTypCnfdAuth 0 "Highly Speculative" 1 "Speculative" 2 "Confident" 3 "Highly Confident" ;
VAL_TABLE_ SRRLRCODPB1P_RdTypAuth 0 "Unknown" 1 "City" 2 "Secondary Road" 3 "Highway" 4 "Construction Zone Entry" 5 "Construction Zone Exit" ;
VAL_TABLE_ SRRLRCODPB1P_SwpBndwdthStsAuth 0 "Mode A" 1 "Mode B" 2 "Mode C" 3 "Mode D" ;
VAL_TABLE_ SRRLRCODPB1P_VOTk1DynPrpStsAuth 0 "Stopped" 1 "Not Stopped" ;
VAL_TABLE_ SRRLRCODPB1P_VOTk1DynPrpAuth 0 "Has Never Moved" 1 "Moving In Same Direction As Host" 2 "Moving In Opposite Direction As Host" 3 "Crossing From Left To Right" 4 "Crossing From Right To Left" ;
VAL_TABLE_ SRRLRCODPB1P_VOTk1CnfdStsAuth 0 "Highly Speculative" 1 "Speculative" 2 "Confident" 3 "Highly Confident" ;
VAL_TABLE_ SRRLRCODPB1P_VOTk1MStsAuth 0 "No Object" 1 "New Object" 2 "Latent Track Not Detected this Cycle" 3 "Measured this Cycle" ;
VAL_TABLE_ SRRLRCODPB1P_VOTk1TypCnfdAuth 0 "Highly Speculative" 1 "Speculative" 2 "Confident" 3 "Highly Confident" ;
VAL_TABLE_ SRRLRCODPB6P_REOTk1CnfdStsAuth 0 "Highly Speculative" 1 "Speculative" 2 "Confident" 3 "Highly Confident" ;
VAL_TABLE_ SRRLRCODPB6P_REOTk2CnfdStsAuth 0 "Highly Speculative" 1 "Speculative" 2 "Confident" 3 "Highly Confident" ;
VAL_TABLE_ SRRLRCODPB6P_REOTk1TypCnfdAuth 0 "Highly Speculative" 1 "Speculative" 2 "Confident" 3 "Highly Confident" ;
VAL_TABLE_ SRRLRCODPB6P_REOTk1TypAuth 0 "Unknown" 1 "Barriers" 2 "Guard Rails" 3 "Bridge Abutments" 4 "Edge of Road" 5 "Open Area" ;
VAL_TABLE_ SRRLRCODPB6P_REOTk3CnfdStsAuth 0 "Highly Speculative" 1 "Speculative" 2 "Confident" 3 "Highly Confident" ;
VAL_TABLE_ SRRLRCODPB6P_REOTk2TypCnfdAuth 0 "Highly Speculative" 1 "Speculative" 2 "Confident" 3 "Highly Confident" ;
VAL_TABLE_ SRRLRCODPB6P_REOTk2TypAuth 0 "Unknown" 1 "Barriers" 2 "Guard Rails" 3 "Bridge Abutments" 4 "Edge of Road" 5 "Open Area" ;
VAL_TABLE_ SRRLRCODPB6P_REOTk3TypCnfdAuth 0 "Highly Speculative" 1 "Speculative" 2 "Confident" 3 "Highly Confident" ;
VAL_TABLE_ SRRLRCODPB6P_REOTk3TypAuth 0 "Unknown" 1 "Barriers" 2 "Guard Rails" 3 "Bridge Abutments" 4 "Edge of Road" 5 "Open Area" ;
VAL_TABLE_ SRRRFODPB2P_POTk3DynPrpAuth 0 "Has Never Moved" 1 "Has Moved But Currently Stopped" 2 "Moving In Same Direction As Host" 3 "Moving In Opposite Direction As Host" 4 "Crossing Path" ;
VAL_TABLE_ SRRRFODPB2P_POTk3CnfdStsAuth 0 "Highly Speculative" 1 "Speculative" 2 "Confident" 3 "Highly Confident" ;
VAL_TABLE_ SRRRFODPB2P_POTk3MStsAuth 0 "No Object" 1 "New Object" 2 "Latent Track Not Detected this Cycle" 3 "Measured this Cycle" ;
VAL_TABLE_ SRRRFODPB2P_POTk3TypCnfdAuth 0 "Highly Speculative" 1 "Speculative" 2 "Confident" 3 "Highly Confident" ;
VAL_TABLE_ SRRRFODPB2P_POTk3TypAuth 0 "Unknown" 1 "Pedestrian" 2 "Bicycle" ;
VAL_TABLE_ SRRRFODPB2P_VOTk2DynPrpStsAuth 0 "Stopped" 1 "Not Stopped" ;
VAL_TABLE_ SRRRFODPB2P_VOTk2DynPrpAuth 0 "Has Never Moved" 1 "Moving In Same Direction As Host" 2 "Moving In Opposite Direction As Host" 3 "Crossing From Left To Right" 4 "Crossing From Right To Left" ;
VAL_TABLE_ SRRRFODPB2P_VOTk2CnfdStsAuth 0 "Highly Speculative" 1 "Speculative" 2 "Confident" 3 "Highly Confident" ;
VAL_TABLE_ SRRRFODPB2P_VOTk2MStsAuth 0 "No Object" 1 "New Object" 2 "Latent Track Not Detected this Cycle" 3 "Measured this Cycle" ;
VAL_TABLE_ SRRRFODPB2P_VOTk2TypCnfdAuth 0 "Highly Speculative" 1 "Speculative" 2 "Confident" 3 "Highly Confident" ;
VAL_TABLE_ SRRRFODPB2P_VOTk3CnfdStsAuth 0 "Highly Speculative" 1 "Speculative" 2 "Confident" 3 "Highly Confident" ;
VAL_TABLE_ SRRRFODPB2P_VOTk3DynPrpStsAuth 0 "Stopped" 1 "Not Stopped" ;
VAL_TABLE_ SRRRFODPB2P_VOTk3DynPrpAuth 0 "Has Never Moved" 1 "Moving In Same Direction As Host" 2 "Moving In Opposite Direction As Host" 3 "Crossing From Left To Right" 4 "Crossing From Right To Left" ;
VAL_TABLE_ SRRRFODPB2P_VOTk3MStsAuth 0 "No Object" 1 "New Object" 2 "Latent Track Not Detected this Cycle" 3 "Measured this Cycle" ;
VAL_TABLE_ SRRRFODPB2P_VOTk3TypCnfdAuth 0 "Highly Speculative" 1 "Speculative" 2 "Confident" 3 "Highly Confident" ;
VAL_TABLE_ SRRRFODPB2P_VOTk4DynPrpStsAuth 0 "Stopped" 1 "Not Stopped" ;
VAL_TABLE_ SRRRFODPB2P_VOTk4DynPrpAuth 0 "Has Never Moved" 1 "Moving In Same Direction As Host" 2 "Moving In Opposite Direction As Host" 3 "Crossing From Left To Right" 4 "Crossing From Right To Left" ;
VAL_TABLE_ SRRRFODPB2P_VOTk4CnfdStsAuth 0 "Highly Speculative" 1 "Speculative" 2 "Confident" 3 "Highly Confident" ;
VAL_TABLE_ SRRRFODPB2P_VOTk4MStsAuth 0 "No Object" 1 "New Object" 2 "Latent Track Not Detected this Cycle" 3 "Measured this Cycle" ;
VAL_TABLE_ SRRRFODPB2P_VOTk4TypCnfdAuth 0 "Highly Speculative" 1 "Speculative" 2 "Confident" 3 "Highly Confident" ;
VAL_TABLE_ SRRRFODPB3P_POTk4DynPrpAuth 0 "Has Never Moved" 1 "Has Moved But Currently Stopped" 2 "Moving In Same Direction As Host" 3 "Moving In Opposite Direction As Host" 4 "Crossing Path" ;
VAL_TABLE_ SRRRFODPB3P_POTk4CnfdStsAuth 0 "Highly Speculative" 1 "Speculative" 2 "Confident" 3 "Highly Confident" ;
VAL_TABLE_ SRRRFODPB3P_POTk4MStsAuth 0 "No Object" 1 "New Object" 2 "Latent Track Not Detected this Cycle" 3 "Measured this Cycle" ;
VAL_TABLE_ SRRRFODPB3P_POTk4TypCnfdAuth 0 "Highly Speculative" 1 "Speculative" 2 "Confident" 3 "Highly Confident" ;
VAL_TABLE_ SRRRFODPB3P_POTk4TypAuth 0 "Unknown" 1 "Pedestrian" 2 "Bicycle" ;
VAL_TABLE_ SRRRFODPB3P_VOTk5DynPrpStsAuth 0 "Stopped" 1 "Not Stopped" ;
VAL_TABLE_ SRRRFODPB3P_VOTk5DynPrpAuth 0 "Has Never Moved" 1 "Moving In Same Direction As Host" 2 "Moving In Opposite Direction As Host" 3 "Crossing From Left To Right" 4 "Crossing From Right To Left" ;
VAL_TABLE_ SRRRFODPB3P_VOTk5CnfdStsAuth 0 "Highly Speculative" 1 "Speculative" 2 "Confident" 3 "Highly Confident" ;
VAL_TABLE_ SRRRFODPB3P_VOTk5MStsAuth 0 "No Object" 1 "New Object" 2 "Latent Track Not Detected this Cycle" 3 "Measured this Cycle" ;
VAL_TABLE_ SRRRFODPB3P_VOTk5TypCnfdAuth 0 "Highly Speculative" 1 "Speculative" 2 "Confident" 3 "Highly Confident" ;
VAL_TABLE_ SRRRFODPB3P_VOTk6CnfdStsAuth 0 "Highly Speculative" 1 "Speculative" 2 "Confident" 3 "Highly Confident" ;
VAL_TABLE_ SRRRFODPB3P_VOTk6DynPrpStsAuth 0 "Stopped" 1 "Not Stopped" ;
VAL_TABLE_ SRRRFODPB3P_VOTk6DynPrpAuth 0 "Has Never Moved" 1 "Moving In Same Direction As Host" 2 "Moving In Opposite Direction As Host" 3 "Crossing From Left To Right" 4 "Crossing From Right To Left" ;
VAL_TABLE_ SRRRFODPB3P_VOTk6MStsAuth 0 "No Object" 1 "New Object" 2 "Latent Track Not Detected this Cycle" 3 "Measured this Cycle" ;
VAL_TABLE_ SRRRFODPB3P_VOTk6TypCnfdAuth 0 "Highly Speculative" 1 "Speculative" 2 "Confident" 3 "Highly Confident" ;
VAL_TABLE_ SRRRFODPB3P_VOTk7DynPrpStsAuth 0 "Stopped" 1 "Not Stopped" ;
VAL_TABLE_ SRRRFODPB3P_VOTk7DynPrpAuth 0 "Has Never Moved" 1 "Moving In Same Direction As Host" 2 "Moving In Opposite Direction As Host" 3 "Crossing From Left To Right" 4 "Crossing From Right To Left" ;
VAL_TABLE_ SRRRFODPB3P_VOTk7CnfdStsAuth 0 "Highly Speculative" 1 "Speculative" 2 "Confident" 3 "Highly Confident" ;
VAL_TABLE_ SRRRFODPB3P_VOTk7MStsAuth 0 "No Object" 1 "New Object" 2 "Latent Track Not Detected this Cycle" 3 "Measured this Cycle" ;
VAL_TABLE_ SRRRFODPB3P_VOTk7TypCnfdAuth 0 "Highly Speculative" 1 "Speculative" 2 "Confident" 3 "Highly Confident" ;
VAL_TABLE_ SRRRFODPB4P_POTk5DynPrpAuth 0 "Has Never Moved" 1 "Has Moved But Currently Stopped" 2 "Moving In Same Direction As Host" 3 "Moving In Opposite Direction As Host" 4 "Crossing Path" ;
VAL_TABLE_ SRRRFODPB4P_POTk5CnfdStsAuth 0 "Highly Speculative" 1 "Speculative" 2 "Confident" 3 "Highly Confident" ;
VAL_TABLE_ SRRRFODPB4P_POTk5MStsAuth 0 "No Object" 1 "New Object" 2 "Latent Track Not Detected this Cycle" 3 "Measured this Cycle" ;
VAL_TABLE_ SRRRFODPB4P_POTk5TypCnfdAuth 0 "Highly Speculative" 1 "Speculative" 2 "Confident" 3 "Highly Confident" ;
VAL_TABLE_ SRRRFODPB4P_POTk5TypAuth 0 "Unknown" 1 "Pedestrian" 2 "Bicycle" ;
VAL_TABLE_ SRRRFODPB4P_VOTk10DynPrpStsAuth 0 "Stopped" 1 "Not Stopped" ;
VAL_TABLE_ SRRRFODPB4P_VOTk10DynPrpAuth 0 "Has Never Moved" 1 "Moving In Same Direction As Host" 2 "Moving In Opposite Direction As Host" 3 "Crossing From Left To Right" 4 "Crossing From Right To Left" ;
VAL_TABLE_ SRRRFODPB4P_VOTk10CnfdStsAuth 0 "Highly Speculative" 1 "Speculative" 2 "Confident" 3 "Highly Confident" ;
VAL_TABLE_ SRRRFODPB4P_VOTk10MStsAuth 0 "No Object" 1 "New Object" 2 "Latent Track Not Detected this Cycle" 3 "Measured this Cycle" ;
VAL_TABLE_ SRRRFODPB4P_VOTk10TypCnfdAuth 0 "Highly Speculative" 1 "Speculative" 2 "Confident" 3 "Highly Confident" ;
VAL_TABLE_ SRRRFODPB4P_VOTk8CnfdStsAuth 0 "Highly Speculative" 1 "Speculative" 2 "Confident" 3 "Highly Confident" ;
VAL_TABLE_ SRRRFODPB4P_VOTk8DynPrpStsAuth 0 "Stopped" 1 "Not Stopped" ;
VAL_TABLE_ SRRRFODPB4P_VOTk8DynPrpAuth 0 "Has Never Moved" 1 "Moving In Same Direction As Host" 2 "Moving In Opposite Direction As Host" 3 "Crossing From Left To Right" 4 "Crossing From Right To Left" ;
VAL_TABLE_ SRRRFODPB4P_VOTk8MStsAuth 0 "No Object" 1 "New Object" 2 "Latent Track Not Detected this Cycle" 3 "Measured this Cycle" ;
VAL_TABLE_ SRRRFODPB4P_VOTk8TypCnfdAuth 0 "Highly Speculative" 1 "Speculative" 2 "Confident" 3 "Highly Confident" ;
VAL_TABLE_ SRRRFODPB4P_VOTk9DynPrpStsAuth 0 "Stopped" 1 "Not Stopped" ;
VAL_TABLE_ SRRRFODPB4P_VOTk9DynPrpAuth 0 "Has Never Moved" 1 "Moving In Same Direction As Host" 2 "Moving In Opposite Direction As Host" 3 "Crossing From Left To Right" 4 "Crossing From Right To Left" ;
VAL_TABLE_ SRRRFODPB4P_VOTk9CnfdStsAuth 0 "Highly Speculative" 1 "Speculative" 2 "Confident" 3 "Highly Confident" ;
VAL_TABLE_ SRRRFODPB4P_VOTk9MStsAuth 0 "No Object" 1 "New Object" 2 "Latent Track Not Detected this Cycle" 3 "Measured this Cycle" ;
VAL_TABLE_ SRRRFODPB4P_VOTk9TypCnfdAuth 0 "Highly Speculative" 1 "Speculative" 2 "Confident" 3 "Highly Confident" ;
VAL_TABLE_ SRRRFODPB5P_IOTk10ElvtnAuth 0 "Not Elevated" 1 "Elevation Speculative" 2 "Elevation Confident" 3 "Elevation Very Confident" ;
VAL_TABLE_ SRRRFODPB5P_IOTk10CnfdStsAuth 0 "Highly Speculative" 1 "Speculative" 2 "Confident" 3 "Highly Confident" ;
VAL_TABLE_ SRRRFODPB5P_IOTk10MStsAuth 0 "No Object" 1 "New Object" 2 "Latent Track Not Detected this Cycle" 3 "Measured this Cycle" ;
VAL_TABLE_ SRRRFODPB5P_IOTk1CnfdStsAuth 0 "Highly Speculative" 1 "Speculative" 2 "Confident" 3 "Highly Confident" ;
VAL_TABLE_ SRRRFODPB5P_IOTk10TypCnfdAuth 0 "Highly Speculative" 1 "Speculative" 2 "Confident" 3 "Highly Confident" ;
VAL_TABLE_ SRRRFODPB5P_IOTk10TypAuth 0 "Unknown" 1 "Guard Rail" 2 "Tunnel" 3 "Traffic Sign" 4 "Bridge" 5 "Pole" ;
VAL_TABLE_ SRRRFODPB5P_IOTk1ElvtnAuth 0 "Not Elevated" 1 "Elevation Speculative" 2 "Elevation Confident" 3 "Elevation Very Confident" ;
VAL_TABLE_ SRRRFODPB5P_IOTk1MStsAuth 0 "No Object" 1 "New Object" 2 "Latent Track Not Detected this Cycle" 3 "Measured this Cycle" ;
VAL_TABLE_ SRRRFODPB5P_IOTk1TypAuth 0 "Unknown" 1 "Guard Rail" 2 "Tunnel" 3 "Traffic Sign" 4 "Bridge" 5 "Pole" ;
VAL_TABLE_ SRRRFODPB5P_IOTk2ElvtnAuth 0 "Not Elevated" 1 "Elevation Speculative" 2 "Elevation Confident" 3 "Elevation Very Confident" ;
VAL_TABLE_ SRRRFODPB5P_IOTk2CnfdStsAuth 0 "Highly Speculative" 1 "Speculative" 2 "Confident" 3 "Highly Confident" ;
VAL_TABLE_ SRRRFODPB5P_IOTk1TypCnfdAuth 0 "Highly Speculative" 1 "Speculative" 2 "Confident" 3 "Highly Confident" ;
VAL_TABLE_ SRRRFODPB5P_IOTk2MStsAuth 0 "No Object" 1 "New Object" 2 "Latent Track Not Detected this Cycle" 3 "Measured this Cycle" ;
VAL_TABLE_ SRRRFODPB5P_IOTk2TypCnfdAuth 0 "Highly Speculative" 1 "Speculative" 2 "Confident" 3 "Highly Confident" ;
VAL_TABLE_ SRRRFODPB5P_IOTk2TypAuth 0 "Unknown" 1 "Guard Rail" 2 "Tunnel" 3 "Traffic Sign" 4 "Bridge" 5 "Pole" ;
VAL_TABLE_ SRRRFODPB5P_IOTk3ElvtnAuth 0 "Not Elevated" 1 "Elevation Speculative" 2 "Elevation Confident" 3 "Elevation Very Confident" ;
VAL_TABLE_ SRRRFODPB5P_IOTk3CnfdStsAuth 0 "Highly Speculative" 1 "Speculative" 2 "Confident" 3 "Highly Confident" ;
VAL_TABLE_ SRRRFODPB5P_IOTk3MStsAuth 0 "No Object" 1 "New Object" 2 "Latent Track Not Detected this Cycle" 3 "Measured this Cycle" ;
VAL_TABLE_ SRRRFODPB5P_IOTk4CnfdStsAuth 0 "Highly Speculative" 1 "Speculative" 2 "Confident" 3 "Highly Confident" ;
VAL_TABLE_ SRRRFODPB5P_IOTk3TypCnfdAuth 0 "Highly Speculative" 1 "Speculative" 2 "Confident" 3 "Highly Confident" ;
VAL_TABLE_ SRRRFODPB5P_IOTk3TypAuth 0 "Unknown" 1 "Guard Rail" 2 "Tunnel" 3 "Traffic Sign" 4 "Bridge" 5 "Pole" ;
VAL_TABLE_ SRRRFODPB5P_IOTk4ElvtnAuth 0 "Not Elevated" 1 "Elevation Speculative" 2 "Elevation Confident" 3 "Elevation Very Confident" ;
VAL_TABLE_ SRRRFODPB5P_IOTk4MStsAuth 0 "No Object" 1 "New Object" 2 "Latent Track Not Detected this Cycle" 3 "Measured this Cycle" ;
VAL_TABLE_ SRRRFODPB5P_IOTk4TypAuth 0 "Unknown" 1 "Guard Rail" 2 "Tunnel" 3 "Traffic Sign" 4 "Bridge" 5 "Pole" ;
VAL_TABLE_ SRRRFODPB5P_IOTk5ElvtnAuth 0 "Not Elevated" 1 "Elevation Speculative" 2 "Elevation Confident" 3 "Elevation Very Confident" ;
VAL_TABLE_ SRRRFODPB5P_IOTk5CnfdStsAuth 0 "Highly Speculative" 1 "Speculative" 2 "Confident" 3 "Highly Confident" ;
VAL_TABLE_ SRRRFODPB5P_IOTk4TypCnfdAuth 0 "Highly Speculative" 1 "Speculative" 2 "Confident" 3 "Highly Confident" ;
VAL_TABLE_ SRRRFODPB5P_IOTk5MStsAuth 0 "No Object" 1 "New Object" 2 "Latent Track Not Detected this Cycle" 3 "Measured this Cycle" ;
VAL_TABLE_ SRRRFODPB5P_IOTk5TypCnfdAuth 0 "Highly Speculative" 1 "Speculative" 2 "Confident" 3 "Highly Confident" ;
VAL_TABLE_ SRRRFODPB5P_IOTk5TypAuth 0 "Unknown" 1 "Guard Rail" 2 "Tunnel" 3 "Traffic Sign" 4 "Bridge" 5 "Pole" ;
VAL_TABLE_ SRRRFODPB5P_IOTk6ElvtnAuth 0 "Not Elevated" 1 "Elevation Speculative" 2 "Elevation Confident" 3 "Elevation Very Confident" ;
VAL_TABLE_ SRRRFODPB5P_IOTk6CnfdStsAuth 0 "Highly Speculative" 1 "Speculative" 2 "Confident" 3 "Highly Confident" ;
VAL_TABLE_ SRRRFODPB5P_IOTk6MStsAuth 0 "No Object" 1 "New Object" 2 "Latent Track Not Detected this Cycle" 3 "Measured this Cycle" ;
VAL_TABLE_ SRRRFODPB5P_IOTk7ElvtnAuth 0 "Not Elevated" 1 "Elevation Speculative" 2 "Elevation Confident" 3 "Elevation Very Confident" ;
VAL_TABLE_ SRRRFODPB5P_IOTk7CnfdStsAuth 0 "Highly Speculative" 1 "Speculative" 2 "Confident" 3 "Highly Confident" ;
VAL_TABLE_ SRRRFODPB5P_IOTk6TypCnfdAuth 0 "Highly Speculative" 1 "Speculative" 2 "Confident" 3 "Highly Confident" ;
VAL_TABLE_ SRRRFODPB5P_IOTk6TypAuth 0 "Unknown" 1 "Guard Rail" 2 "Tunnel" 3 "Traffic Sign" 4 "Bridge" 5 "Pole" ;
VAL_TABLE_ SRRRFODPB5P_IOTk7MStsAuth 0 "No Object" 1 "New Object" 2 "Latent Track Not Detected this Cycle" 3 "Measured this Cycle" ;
VAL_TABLE_ SRRRFODPB5P_IOTk7TypAuth 0 "Unknown" 1 "Guard Rail" 2 "Tunnel" 3 "Traffic Sign" 4 "Bridge" 5 "Pole" ;
VAL_TABLE_ SRRRFODPB5P_IOTk8ElvtnAuth 0 "Not Elevated" 1 "Elevation Speculative" 2 "Elevation Confident" 3 "Elevation Very Confident" ;
VAL_TABLE_ SRRRFODPB5P_IOTk8CnfdStsAuth 0 "Highly Speculative" 1 "Speculative" 2 "Confident" 3 "Highly Confident" ;
VAL_TABLE_ SRRRFODPB5P_IOTk7TypCnfdAuth 0 "Highly Speculative" 1 "Speculative" 2 "Confident" 3 "Highly Confident" ;
VAL_TABLE_ SRRRFODPB5P_IOTk8MStsAuth 0 "No Object" 1 "New Object" 2 "Latent Track Not Detected this Cycle" 3 "Measured this Cycle" ;
VAL_TABLE_ SRRRFODPB5P_IOTk9CnfdStsAuth 0 "Highly Speculative" 1 "Speculative" 2 "Confident" 3 "Highly Confident" ;
VAL_TABLE_ SRRRFODPB5P_IOTk8TypCnfdAuth 0 "Highly Speculative" 1 "Speculative" 2 "Confident" 3 "Highly Confident" ;
VAL_TABLE_ SRRRFODPB5P_IOTk8TypAuth 0 "Unknown" 1 "Guard Rail" 2 "Tunnel" 3 "Traffic Sign" 4 "Bridge" 5 "Pole" ;
VAL_TABLE_ SRRRFODPB5P_IOTk9ElvtnAuth 0 "Not Elevated" 1 "Elevation Speculative" 2 "Elevation Confident" 3 "Elevation Very Confident" ;
VAL_TABLE_ SRRRFODPB5P_IOTk9MStsAuth 0 "No Object" 1 "New Object" 2 "Latent Track Not Detected this Cycle" 3 "Measured this Cycle" ;
VAL_TABLE_ SRRRFODPB5P_IOTk9TypAuth 0 "Unknown" 1 "Guard Rail" 2 "Tunnel" 3 "Traffic Sign" 4 "Bridge" 5 "Pole" ;
VAL_TABLE_ SRRRFODPB5P_IOTk9TypCnfdAuth 0 "Highly Speculative" 1 "Speculative" 2 "Confident" 3 "Highly Confident" ;
VAL_TABLE_ SRRRFODPB1P_ConstrArDtnCnfdAuth 0 "Highly Speculative" 1 "Speculative" 2 "Confident" 3 "Highly Confident" ;
VAL_TABLE_ SRRRFODPB1P_AcqTmStmAuth_Inv 0 "FALSE" 1 "TRUE" ;
VAL_TABLE_ SRRRFODPB1P_POTk1DynPrpAuth 0 "Has Never Moved" 1 "Has Moved But Currently Stopped" 2 "Moving In Same Direction As Host" 3 "Moving In Opposite Direction As Host" 4 "Crossing Path" ;
VAL_TABLE_ SRRRFODPB1P_POTk1CnfdStsAuth 0 "Highly Speculative" 1 "Speculative" 2 "Confident" 3 "Highly Confident" ;
VAL_TABLE_ SRRRFODPB1P_MdCmdStsAuth 0 "Not Radiating" 1 "Reporting Object Data" 2 "Not Reporting Object Data" ;
VAL_TABLE_ SRRRFODPB1P_ConstrArDtnStsAuth 0 "Not Detected" 1 "Detected" 2 "Unknown" ;
VAL_TABLE_ SRRRFODPB1P_POTk1MStsAuth 0 "No Object" 1 "New Object" 2 "Latent Track Not Detected this Cycle" 3 "Measured this Cycle" ;
VAL_TABLE_ SRRRFODPB1P_POTk2CnfdStsAuth 0 "Highly Speculative" 1 "Speculative" 2 "Confident" 3 "Highly Confident" ;
VAL_TABLE_ SRRRFODPB1P_POTk1TypCnfdAuth 0 "Highly Speculative" 1 "Speculative" 2 "Confident" 3 "Highly Confident" ;
VAL_TABLE_ SRRRFODPB1P_POTk1TypAuth 0 "Unknown" 1 "Pedestrian" 2 "Bicycle" ;
VAL_TABLE_ SRRRFODPB1P_POTk2DynPrpAuth 0 "Has Never Moved" 1 "Has Moved But Currently Stopped" 2 "Moving In Same Direction As Host" 3 "Moving In Opposite Direction As Host" 4 "Crossing Path" ;
VAL_TABLE_ SRRRFODPB1P_POTk2MStsAuth 0 "No Object" 1 "New Object" 2 "Latent Track Not Detected this Cycle" 3 "Measured this Cycle" ;
VAL_TABLE_ SRRRFODPB1P_POTk2TypCnfdAuth 0 "Highly Speculative" 1 "Speculative" 2 "Confident" 3 "Highly Confident" ;
VAL_TABLE_ SRRRFODPB1P_POTk2TypAuth 0 "Unknown" 1 "Pedestrian" 2 "Bicycle" ;
VAL_TABLE_ SRRRFODPB1P_SnsrUnvAuth 0 "FALSE" 1 "TRUE" ;
VAL_TABLE_ SRRRFODPB1P_SnsrBlckdAuth 0 "FALSE" 1 "TRUE" ;
VAL_TABLE_ SRRRFODPB1P_ServRqrdAuth 0 "FALSE" 1 "TRUE" ;
VAL_TABLE_ SRRRFODPB1P_RdTypCnfdAuth 0 "Highly Speculative" 1 "Speculative" 2 "Confident" 3 "Highly Confident" ;
VAL_TABLE_ SRRRFODPB1P_RdTypAuth 0 "Unknown" 1 "City" 2 "Secondary Road" 3 "Highway" 4 "Construction Zone Entry" 5 "Construction Zone Exit" ;
VAL_TABLE_ SRRRFODPB1P_SwpBndwdthStsAuth 0 "Mode A" 1 "Mode B" 2 "Mode C" 3 "Mode D" ;
VAL_TABLE_ SRRRFODPB1P_VOTk1DynPrpStsAuth 0 "Stopped" 1 "Not Stopped" ;
VAL_TABLE_ SRRRFODPB1P_VOTk1DynPrpAuth 0 "Has Never Moved" 1 "Moving In Same Direction As Host" 2 "Moving In Opposite Direction As Host" 3 "Crossing From Left To Right" 4 "Crossing From Right To Left" ;
VAL_TABLE_ SRRRFODPB1P_VOTk1CnfdStsAuth 0 "Highly Speculative" 1 "Speculative" 2 "Confident" 3 "Highly Confident" ;
VAL_TABLE_ SRRRFODPB1P_VOTk1MStsAuth 0 "No Object" 1 "New Object" 2 "Latent Track Not Detected this Cycle" 3 "Measured this Cycle" ;
VAL_TABLE_ SRRRFODPB1P_VOTk1TypCnfdAuth 0 "Highly Speculative" 1 "Speculative" 2 "Confident" 3 "Highly Confident" ;
VAL_TABLE_ SRRRFODPB6P_REOTk1CnfdStsAuth 0 "Highly Speculative" 1 "Speculative" 2 "Confident" 3 "Highly Confident" ;
VAL_TABLE_ SRRRFODPB6P_REOTk2CnfdStsAuth 0 "Highly Speculative" 1 "Speculative" 2 "Confident" 3 "Highly Confident" ;
VAL_TABLE_ SRRRFODPB6P_REOTk1TypCnfdAuth 0 "Highly Speculative" 1 "Speculative" 2 "Confident" 3 "Highly Confident" ;
VAL_TABLE_ SRRRFODPB6P_REOTk1TypAuth 0 "Unknown" 1 "Barriers" 2 "Guard Rails" 3 "Bridge Abutments" 4 "Edge of Road" 5 "Open Area" ;
VAL_TABLE_ SRRRFODPB6P_REOTk3CnfdStsAuth 0 "Highly Speculative" 1 "Speculative" 2 "Confident" 3 "Highly Confident" ;
VAL_TABLE_ SRRRFODPB6P_REOTk2TypCnfdAuth 0 "Highly Speculative" 1 "Speculative" 2 "Confident" 3 "Highly Confident" ;
VAL_TABLE_ SRRRFODPB6P_REOTk2TypAuth 0 "Unknown" 1 "Barriers" 2 "Guard Rails" 3 "Bridge Abutments" 4 "Edge of Road" 5 "Open Area" ;
VAL_TABLE_ SRRRFODPB6P_REOTk3TypCnfdAuth 0 "Highly Speculative" 1 "Speculative" 2 "Confident" 3 "Highly Confident" ;
VAL_TABLE_ SRRRFODPB6P_REOTk3TypAuth 0 "Unknown" 1 "Barriers" 2 "Guard Rails" 3 "Bridge Abutments" 4 "Edge of Road" 5 "Open Area" ;
VAL_TABLE_ SRRRRODPB2P_POTk3DynPrpAuth 0 "Has Never Moved" 1 "Has Moved But Currently Stopped" 2 "Moving In Same Direction As Host" 3 "Moving In Opposite Direction As Host" 4 "Crossing Path" ;
VAL_TABLE_ SRRRRODPB2P_POTk3CnfdStsAuth 0 "Highly Speculative" 1 "Speculative" 2 "Confident" 3 "Highly Confident" ;
VAL_TABLE_ SRRRRODPB2P_POTk3MStsAuth 0 "No Object" 1 "New Object" 2 "Latent Track Not Detected this Cycle" 3 "Measured this Cycle" ;
VAL_TABLE_ SRRRRODPB2P_POTk3TypCnfdAuth 0 "Highly Speculative" 1 "Speculative" 2 "Confident" 3 "Highly Confident" ;
VAL_TABLE_ SRRRRODPB2P_POTk3TypAuth 0 "Unknown" 1 "Pedestrian" 2 "Bicycle" ;
VAL_TABLE_ SRRRRODPB2P_VOTk2DynPrpStsAuth 0 "Stopped" 1 "Not Stopped" ;
VAL_TABLE_ SRRRRODPB2P_VOTk2DynPrpAuth 0 "Has Never Moved" 1 "Moving In Same Direction As Host" 2 "Moving In Opposite Direction As Host" 3 "Crossing From Left To Right" 4 "Crossing From Right To Left" ;
VAL_TABLE_ SRRRRODPB2P_VOTk2CnfdStsAuth 0 "Highly Speculative" 1 "Speculative" 2 "Confident" 3 "Highly Confident" ;
VAL_TABLE_ SRRRRODPB2P_VOTk2MStsAuth 0 "No Object" 1 "New Object" 2 "Latent Track Not Detected this Cycle" 3 "Measured this Cycle" ;
VAL_TABLE_ SRRRRODPB2P_VOTk2TypCnfdAuth 0 "Highly Speculative" 1 "Speculative" 2 "Confident" 3 "Highly Confident" ;
VAL_TABLE_ SRRRRODPB2P_VOTk3CnfdStsAuth 0 "Highly Speculative" 1 "Speculative" 2 "Confident" 3 "Highly Confident" ;
VAL_TABLE_ SRRRRODPB2P_VOTk3DynPrpStsAuth 0 "Stopped" 1 "Not Stopped" ;
VAL_TABLE_ SRRRRODPB2P_VOTk3DynPrpAuth 0 "Has Never Moved" 1 "Moving In Same Direction As Host" 2 "Moving In Opposite Direction As Host" 3 "Crossing From Left To Right" 4 "Crossing From Right To Left" ;
VAL_TABLE_ SRRRRODPB2P_VOTk3MStsAuth 0 "No Object" 1 "New Object" 2 "Latent Track Not Detected this Cycle" 3 "Measured this Cycle" ;
VAL_TABLE_ SRRRRODPB2P_VOTk3TypCnfdAuth 0 "Highly Speculative" 1 "Speculative" 2 "Confident" 3 "Highly Confident" ;
VAL_TABLE_ SRRRRODPB2P_VOTk4DynPrpStsAuth 0 "Stopped" 1 "Not Stopped" ;
VAL_TABLE_ SRRRRODPB2P_VOTk4DynPrpAuth 0 "Has Never Moved" 1 "Moving In Same Direction As Host" 2 "Moving In Opposite Direction As Host" 3 "Crossing From Left To Right" 4 "Crossing From Right To Left" ;
VAL_TABLE_ SRRRRODPB2P_VOTk4CnfdStsAuth 0 "Highly Speculative" 1 "Speculative" 2 "Confident" 3 "Highly Confident" ;
VAL_TABLE_ SRRRRODPB2P_VOTk4MStsAuth 0 "No Object" 1 "New Object" 2 "Latent Track Not Detected this Cycle" 3 "Measured this Cycle" ;
VAL_TABLE_ SRRRRODPB2P_VOTk4TypCnfdAuth 0 "Highly Speculative" 1 "Speculative" 2 "Confident" 3 "Highly Confident" ;
VAL_TABLE_ SRRRRODPB3P_POTk4DynPrpAuth 0 "Has Never Moved" 1 "Has Moved But Currently Stopped" 2 "Moving In Same Direction As Host" 3 "Moving In Opposite Direction As Host" 4 "Crossing Path" ;
VAL_TABLE_ SRRRRODPB3P_POTk4CnfdStsAuth 0 "Highly Speculative" 1 "Speculative" 2 "Confident" 3 "Highly Confident" ;
VAL_TABLE_ SRRRRODPB3P_POTk4MStsAuth 0 "No Object" 1 "New Object" 2 "Latent Track Not Detected this Cycle" 3 "Measured this Cycle" ;
VAL_TABLE_ SRRRRODPB3P_POTk4TypCnfdAuth 0 "Highly Speculative" 1 "Speculative" 2 "Confident" 3 "Highly Confident" ;
VAL_TABLE_ SRRRRODPB3P_POTk4TypAuth 0 "Unknown" 1 "Pedestrian" 2 "Bicycle" ;
VAL_TABLE_ SRRRRODPB3P_VOTk5DynPrpStsAuth 0 "Stopped" 1 "Not Stopped" ;
VAL_TABLE_ SRRRRODPB3P_VOTk5DynPrpAuth 0 "Has Never Moved" 1 "Moving In Same Direction As Host" 2 "Moving In Opposite Direction As Host" 3 "Crossing From Left To Right" 4 "Crossing From Right To Left" ;
VAL_TABLE_ SRRRRODPB3P_VOTk5CnfdStsAuth 0 "Highly Speculative" 1 "Speculative" 2 "Confident" 3 "Highly Confident" ;
VAL_TABLE_ SRRRRODPB3P_VOTk5MStsAuth 0 "No Object" 1 "New Object" 2 "Latent Track Not Detected this Cycle" 3 "Measured this Cycle" ;
VAL_TABLE_ SRRRRODPB3P_VOTk5TypCnfdAuth 0 "Highly Speculative" 1 "Speculative" 2 "Confident" 3 "Highly Confident" ;
VAL_TABLE_ SRRRRODPB3P_VOTk6CnfdStsAuth 0 "Highly Speculative" 1 "Speculative" 2 "Confident" 3 "Highly Confident" ;
VAL_TABLE_ SRRRRODPB3P_VOTk6DynPrpStsAuth 0 "Stopped" 1 "Not Stopped" ;
VAL_TABLE_ SRRRRODPB3P_VOTk6DynPrpAuth 0 "Has Never Moved" 1 "Moving In Same Direction As Host" 2 "Moving In Opposite Direction As Host" 3 "Crossing From Left To Right" 4 "Crossing From Right To Left" ;
VAL_TABLE_ SRRRRODPB3P_VOTk6MStsAuth 0 "No Object" 1 "New Object" 2 "Latent Track Not Detected this Cycle" 3 "Measured this Cycle" ;
VAL_TABLE_ SRRRRODPB3P_VOTk6TypCnfdAuth 0 "Highly Speculative" 1 "Speculative" 2 "Confident" 3 "Highly Confident" ;
VAL_TABLE_ SRRRRODPB3P_VOTk7DynPrpStsAuth 0 "Stopped" 1 "Not Stopped" ;
VAL_TABLE_ SRRRRODPB3P_VOTk7DynPrpAuth 0 "Has Never Moved" 1 "Moving In Same Direction As Host" 2 "Moving In Opposite Direction As Host" 3 "Crossing From Left To Right" 4 "Crossing From Right To Left" ;
VAL_TABLE_ SRRRRODPB3P_VOTk7CnfdStsAuth 0 "Highly Speculative" 1 "Speculative" 2 "Confident" 3 "Highly Confident" ;
VAL_TABLE_ SRRRRODPB3P_VOTk7MStsAuth 0 "No Object" 1 "New Object" 2 "Latent Track Not Detected this Cycle" 3 "Measured this Cycle" ;
VAL_TABLE_ SRRRRODPB3P_VOTk7TypCnfdAuth 0 "Highly Speculative" 1 "Speculative" 2 "Confident" 3 "Highly Confident" ;
VAL_TABLE_ SRRRRODPB4P_POTk5DynPrpAuth 0 "Has Never Moved" 1 "Has Moved But Currently Stopped" 2 "Moving In Same Direction As Host" 3 "Moving In Opposite Direction As Host" 4 "Crossing Path" ;
VAL_TABLE_ SRRRRODPB4P_POTk5CnfdStsAuth 0 "Highly Speculative" 1 "Speculative" 2 "Confident" 3 "Highly Confident" ;
VAL_TABLE_ SRRRRODPB4P_POTk5MStsAuth 0 "No Object" 1 "New Object" 2 "Latent Track Not Detected this Cycle" 3 "Measured this Cycle" ;
VAL_TABLE_ SRRRRODPB4P_POTk5TypCnfdAuth 0 "Highly Speculative" 1 "Speculative" 2 "Confident" 3 "Highly Confident" ;
VAL_TABLE_ SRRRRODPB4P_POTk5TypAuth 0 "Unknown" 1 "Pedestrian" 2 "Bicycle" ;
VAL_TABLE_ SRRRRODPB4P_VOTk10DynPrpStsAuth 0 "Stopped" 1 "Not Stopped" ;
VAL_TABLE_ SRRRRODPB4P_VOTk10DynPrpAuth 0 "Has Never Moved" 1 "Moving In Same Direction As Host" 2 "Moving In Opposite Direction As Host" 3 "Crossing From Left To Right" 4 "Crossing From Right To Left" ;
VAL_TABLE_ SRRRRODPB4P_VOTk10CnfdStsAuth 0 "Highly Speculative" 1 "Speculative" 2 "Confident" 3 "Highly Confident" ;
VAL_TABLE_ SRRRRODPB4P_VOTk10MStsAuth 0 "No Object" 1 "New Object" 2 "Latent Track Not Detected this Cycle" 3 "Measured this Cycle" ;
VAL_TABLE_ SRRRRODPB4P_VOTk10TypCnfdAuth 0 "Highly Speculative" 1 "Speculative" 2 "Confident" 3 "Highly Confident" ;
VAL_TABLE_ SRRRRODPB4P_VOTk8CnfdStsAuth 0 "Highly Speculative" 1 "Speculative" 2 "Confident" 3 "Highly Confident" ;
VAL_TABLE_ SRRRRODPB4P_VOTk8DynPrpStsAuth 0 "Stopped" 1 "Not Stopped" ;
VAL_TABLE_ SRRRRODPB4P_VOTk8DynPrpAuth 0 "Has Never Moved" 1 "Moving In Same Direction As Host" 2 "Moving In Opposite Direction As Host" 3 "Crossing From Left To Right" 4 "Crossing From Right To Left" ;
VAL_TABLE_ SRRRRODPB4P_VOTk8MStsAuth 0 "No Object" 1 "New Object" 2 "Latent Track Not Detected this Cycle" 3 "Measured this Cycle" ;
VAL_TABLE_ SRRRRODPB4P_VOTk8TypCnfdAuth 0 "Highly Speculative" 1 "Speculative" 2 "Confident" 3 "Highly Confident" ;
VAL_TABLE_ SRRRRODPB4P_VOTk9DynPrpStsAuth 0 "Stopped" 1 "Not Stopped" ;
VAL_TABLE_ SRRRRODPB4P_VOTk9DynPrpAuth 0 "Has Never Moved" 1 "Moving In Same Direction As Host" 2 "Moving In Opposite Direction As Host" 3 "Crossing From Left To Right" 4 "Crossing From Right To Left" ;
VAL_TABLE_ SRRRRODPB4P_VOTk9CnfdStsAuth 0 "Highly Speculative" 1 "Speculative" 2 "Confident" 3 "Highly Confident" ;
VAL_TABLE_ SRRRRODPB4P_VOTk9MStsAuth 0 "No Object" 1 "New Object" 2 "Latent Track Not Detected this Cycle" 3 "Measured this Cycle" ;
VAL_TABLE_ SRRRRODPB4P_VOTk9TypCnfdAuth 0 "Highly Speculative" 1 "Speculative" 2 "Confident" 3 "Highly Confident" ;
VAL_TABLE_ SRRRRODPB5P_IOTk10ElvtnAuth 0 "Not Elevated" 1 "Elevation Speculative" 2 "Elevation Confident" 3 "Elevation Very Confident" ;
VAL_TABLE_ SRRRRODPB5P_IOTk10CnfdStsAuth 0 "Highly Speculative" 1 "Speculative" 2 "Confident" 3 "Highly Confident" ;
VAL_TABLE_ SRRRRODPB5P_IOTk10MStsAuth 0 "No Object" 1 "New Object" 2 "Latent Track Not Detected this Cycle" 3 "Measured this Cycle" ;
VAL_TABLE_ SRRRRODPB5P_IOTk1CnfdStsAuth 0 "Highly Speculative" 1 "Speculative" 2 "Confident" 3 "Highly Confident" ;
VAL_TABLE_ SRRRRODPB5P_IOTk10TypCnfdAuth 0 "Highly Speculative" 1 "Speculative" 2 "Confident" 3 "Highly Confident" ;
VAL_TABLE_ SRRRRODPB5P_IOTk10TypAuth 0 "Unknown" 1 "Guard Rail" 2 "Tunnel" 3 "Traffic Sign" 4 "Bridge" 5 "Pole" ;
VAL_TABLE_ SRRRRODPB5P_IOTk1ElvtnAuth 0 "Not Elevated" 1 "Elevation Speculative" 2 "Elevation Confident" 3 "Elevation Very Confident" ;
VAL_TABLE_ SRRRRODPB5P_IOTk1MStsAuth 0 "No Object" 1 "New Object" 2 "Latent Track Not Detected this Cycle" 3 "Measured this Cycle" ;
VAL_TABLE_ SRRRRODPB5P_IOTk1TypAuth 0 "Unknown" 1 "Guard Rail" 2 "Tunnel" 3 "Traffic Sign" 4 "Bridge" 5 "Pole" ;
VAL_TABLE_ SRRRRODPB5P_IOTk2ElvtnAuth 0 "Not Elevated" 1 "Elevation Speculative" 2 "Elevation Confident" 3 "Elevation Very Confident" ;
VAL_TABLE_ SRRRRODPB5P_IOTk2CnfdStsAuth 0 "Highly Speculative" 1 "Speculative" 2 "Confident" 3 "Highly Confident" ;
VAL_TABLE_ SRRRRODPB5P_IOTk1TypCnfdAuth 0 "Highly Speculative" 1 "Speculative" 2 "Confident" 3 "Highly Confident" ;
VAL_TABLE_ SRRRRODPB5P_IOTk2MStsAuth 0 "No Object" 1 "New Object" 2 "Latent Track Not Detected this Cycle" 3 "Measured this Cycle" ;
VAL_TABLE_ SRRRRODPB5P_IOTk2TypCnfdAuth 0 "Highly Speculative" 1 "Speculative" 2 "Confident" 3 "Highly Confident" ;
VAL_TABLE_ SRRRRODPB5P_IOTk2TypAuth 0 "Unknown" 1 "Guard Rail" 2 "Tunnel" 3 "Traffic Sign" 4 "Bridge" 5 "Pole" ;
VAL_TABLE_ SRRRRODPB5P_IOTk3ElvtnAuth 0 "Not Elevated" 1 "Elevation Speculative" 2 "Elevation Confident" 3 "Elevation Very Confident" ;
VAL_TABLE_ SRRRRODPB5P_IOTk3CnfdStsAuth 0 "Highly Speculative" 1 "Speculative" 2 "Confident" 3 "Highly Confident" ;
VAL_TABLE_ SRRRRODPB5P_IOTk3MStsAuth 0 "No Object" 1 "New Object" 2 "Latent Track Not Detected this Cycle" 3 "Measured this Cycle" ;
VAL_TABLE_ SRRRRODPB5P_IOTk4CnfdStsAuth 0 "Highly Speculative" 1 "Speculative" 2 "Confident" 3 "Highly Confident" ;
VAL_TABLE_ SRRRRODPB5P_IOTk3TypCnfdAuth 0 "Highly Speculative" 1 "Speculative" 2 "Confident" 3 "Highly Confident" ;
VAL_TABLE_ SRRRRODPB5P_IOTk3TypAuth 0 "Unknown" 1 "Guard Rail" 2 "Tunnel" 3 "Traffic Sign" 4 "Bridge" 5 "Pole" ;
VAL_TABLE_ SRRRRODPB5P_IOTk4ElvtnAuth 0 "Not Elevated" 1 "Elevation Speculative" 2 "Elevation Confident" 3 "Elevation Very Confident" ;
VAL_TABLE_ SRRRRODPB5P_IOTk4MStsAuth 0 "No Object" 1 "New Object" 2 "Latent Track Not Detected this Cycle" 3 "Measured this Cycle" ;
VAL_TABLE_ SRRRRODPB5P_IOTk4TypAuth 0 "Unknown" 1 "Guard Rail" 2 "Tunnel" 3 "Traffic Sign" 4 "Bridge" 5 "Pole" ;
VAL_TABLE_ SRRRRODPB5P_IOTk5ElvtnAuth 0 "Not Elevated" 1 "Elevation Speculative" 2 "Elevation Confident" 3 "Elevation Very Confident" ;
VAL_TABLE_ SRRRRODPB5P_IOTk5CnfdStsAuth 0 "Highly Speculative" 1 "Speculative" 2 "Confident" 3 "Highly Confident" ;
VAL_TABLE_ SRRRRODPB5P_IOTk4TypCnfdAuth 0 "Highly Speculative" 1 "Speculative" 2 "Confident" 3 "Highly Confident" ;
VAL_TABLE_ SRRRRODPB5P_IOTk5MStsAuth 0 "No Object" 1 "New Object" 2 "Latent Track Not Detected this Cycle" 3 "Measured this Cycle" ;
VAL_TABLE_ SRRRRODPB5P_IOTk5TypCnfdAuth 0 "Highly Speculative" 1 "Speculative" 2 "Confident" 3 "Highly Confident" ;
VAL_TABLE_ SRRRRODPB5P_IOTk5TypAuth 0 "Unknown" 1 "Guard Rail" 2 "Tunnel" 3 "Traffic Sign" 4 "Bridge" 5 "Pole" ;
VAL_TABLE_ SRRRRODPB5P_IOTk6ElvtnAuth 0 "Not Elevated" 1 "Elevation Speculative" 2 "Elevation Confident" 3 "Elevation Very Confident" ;
VAL_TABLE_ SRRRRODPB5P_IOTk6CnfdStsAuth 0 "Highly Speculative" 1 "Speculative" 2 "Confident" 3 "Highly Confident" ;
VAL_TABLE_ SRRRRODPB5P_IOTk6MStsAuth 0 "No Object" 1 "New Object" 2 "Latent Track Not Detected this Cycle" 3 "Measured this Cycle" ;
VAL_TABLE_ SRRRRODPB5P_IOTk7ElvtnAuth 0 "Not Elevated" 1 "Elevation Speculative" 2 "Elevation Confident" 3 "Elevation Very Confident" ;
VAL_TABLE_ SRRRRODPB5P_IOTk7CnfdStsAuth 0 "Highly Speculative" 1 "Speculative" 2 "Confident" 3 "Highly Confident" ;
VAL_TABLE_ SRRRRODPB5P_IOTk6TypCnfdAuth 0 "Highly Speculative" 1 "Speculative" 2 "Confident" 3 "Highly Confident" ;
VAL_TABLE_ SRRRRODPB5P_IOTk6TypAuth 0 "Unknown" 1 "Guard Rail" 2 "Tunnel" 3 "Traffic Sign" 4 "Bridge" 5 "Pole" ;
VAL_TABLE_ SRRRRODPB5P_IOTk7MStsAuth 0 "No Object" 1 "New Object" 2 "Latent Track Not Detected this Cycle" 3 "Measured this Cycle" ;
VAL_TABLE_ SRRRRODPB5P_IOTk7TypAuth 0 "Unknown" 1 "Guard Rail" 2 "Tunnel" 3 "Traffic Sign" 4 "Bridge" 5 "Pole" ;
VAL_TABLE_ SRRRRODPB5P_IOTk8ElvtnAuth 0 "Not Elevated" 1 "Elevation Speculative" 2 "Elevation Confident" 3 "Elevation Very Confident" ;
VAL_TABLE_ SRRRRODPB5P_IOTk8CnfdStsAuth 0 "Highly Speculative" 1 "Speculative" 2 "Confident" 3 "Highly Confident" ;
VAL_TABLE_ SRRRRODPB5P_IOTk7TypCnfdAuth 0 "Highly Speculative" 1 "Speculative" 2 "Confident" 3 "Highly Confident" ;
VAL_TABLE_ SRRRRODPB5P_IOTk8MStsAuth 0 "No Object" 1 "New Object" 2 "Latent Track Not Detected this Cycle" 3 "Measured this Cycle" ;
VAL_TABLE_ SRRRRODPB5P_IOTk9CnfdStsAuth 0 "Highly Speculative" 1 "Speculative" 2 "Confident" 3 "Highly Confident" ;
VAL_TABLE_ SRRRRODPB5P_IOTk8TypCnfdAuth 0 "Highly Speculative" 1 "Speculative" 2 "Confident" 3 "Highly Confident" ;
VAL_TABLE_ SRRRRODPB5P_IOTk8TypAuth 0 "Unknown" 1 "Guard Rail" 2 "Tunnel" 3 "Traffic Sign" 4 "Bridge" 5 "Pole" ;
VAL_TABLE_ SRRRRODPB5P_IOTk9ElvtnAuth 0 "Not Elevated" 1 "Elevation Speculative" 2 "Elevation Confident" 3 "Elevation Very Confident" ;
VAL_TABLE_ SRRRRODPB5P_IOTk9MStsAuth 0 "No Object" 1 "New Object" 2 "Latent Track Not Detected this Cycle" 3 "Measured this Cycle" ;
VAL_TABLE_ SRRRRODPB5P_IOTk9TypAuth 0 "Unknown" 1 "Guard Rail" 2 "Tunnel" 3 "Traffic Sign" 4 "Bridge" 5 "Pole" ;
VAL_TABLE_ SRRRRODPB5P_IOTk9TypCnfdAuth 0 "Highly Speculative" 1 "Speculative" 2 "Confident" 3 "Highly Confident" ;
VAL_TABLE_ SRRRRODPB1P_ConstrArDtnCnfdAuth 0 "Highly Speculative" 1 "Speculative" 2 "Confident" 3 "Highly Confident" ;
VAL_TABLE_ SRRRRODPB1P_AcqTmStmAuth_Inv 0 "FALSE" 1 "TRUE" ;
VAL_TABLE_ SRRRRODPB1P_POTk1DynPrpAuth 0 "Has Never Moved" 1 "Has Moved But Currently Stopped" 2 "Moving In Same Direction As Host" 3 "Moving In Opposite Direction As Host" 4 "Crossing Path" ;
VAL_TABLE_ SRRRRODPB1P_POTk1CnfdStsAuth 0 "Highly Speculative" 1 "Speculative" 2 "Confident" 3 "Highly Confident" ;
VAL_TABLE_ SRRRRODPB1P_MdCmdStsAuth 0 "Not Radiating" 1 "Reporting Object Data" 2 "Not Reporting Object Data" ;
VAL_TABLE_ SRRRRODPB1P_ConstrArDtnStsAuth 0 "Not Detected" 1 "Detected" 2 "Unknown" ;
VAL_TABLE_ SRRRRODPB1P_POTk1MStsAuth 0 "No Object" 1 "New Object" 2 "Latent Track Not Detected this Cycle" 3 "Measured this Cycle" ;
VAL_TABLE_ SRRRRODPB1P_POTk2CnfdStsAuth 0 "Highly Speculative" 1 "Speculative" 2 "Confident" 3 "Highly Confident" ;
VAL_TABLE_ SRRRRODPB1P_POTk1TypCnfdAuth 0 "Highly Speculative" 1 "Speculative" 2 "Confident" 3 "Highly Confident" ;
VAL_TABLE_ SRRRRODPB1P_POTk1TypAuth 0 "Unknown" 1 "Pedestrian" 2 "Bicycle" ;
VAL_TABLE_ SRRRRODPB1P_POTk2DynPrpAuth 0 "Has Never Moved" 1 "Has Moved But Currently Stopped" 2 "Moving In Same Direction As Host" 3 "Moving In Opposite Direction As Host" 4 "Crossing Path" ;
VAL_TABLE_ SRRRRODPB1P_POTk2MStsAuth 0 "No Object" 1 "New Object" 2 "Latent Track Not Detected this Cycle" 3 "Measured this Cycle" ;
VAL_TABLE_ SRRRRODPB1P_POTk2TypCnfdAuth 0 "Highly Speculative" 1 "Speculative" 2 "Confident" 3 "Highly Confident" ;
VAL_TABLE_ SRRRRODPB1P_POTk2TypAuth 0 "Unknown" 1 "Pedestrian" 2 "Bicycle" ;
VAL_TABLE_ SRRRRODPB1P_SnsrUnvAuth 0 "FALSE" 1 "TRUE" ;
VAL_TABLE_ SRRRRODPB1P_SnsrBlckdAuth 0 "FALSE" 1 "TRUE" ;
VAL_TABLE_ SRRRRODPB1P_ServRqrdAuth 0 "FALSE" 1 "TRUE" ;
VAL_TABLE_ SRRRRODPB1P_RdTypCnfdAuth 0 "Highly Speculative" 1 "Speculative" 2 "Confident" 3 "Highly Confident" ;
VAL_TABLE_ SRRRRODPB1P_RdTypAuth 0 "Unknown" 1 "City" 2 "Secondary Road" 3 "Highway" 4 "Construction Zone Entry" 5 "Construction Zone Exit" ;
VAL_TABLE_ SRRRRODPB1P_SwpBndwdthStsAuth 0 "Mode A" 1 "Mode B" 2 "Mode C" 3 "Mode D" ;
VAL_TABLE_ SRRRRODPB1P_VOTk1DynPrpStsAuth 0 "Stopped" 1 "Not Stopped" ;
VAL_TABLE_ SRRRRODPB1P_VOTk1DynPrpAuth 0 "Has Never Moved" 1 "Moving In Same Direction As Host" 2 "Moving In Opposite Direction As Host" 3 "Crossing From Left To Right" 4 "Crossing From Right To Left" ;
VAL_TABLE_ SRRRRODPB1P_VOTk1CnfdStsAuth 0 "Highly Speculative" 1 "Speculative" 2 "Confident" 3 "Highly Confident" ;
VAL_TABLE_ SRRRRODPB1P_VOTk1MStsAuth 0 "No Object" 1 "New Object" 2 "Latent Track Not Detected this Cycle" 3 "Measured this Cycle" ;
VAL_TABLE_ SRRRRODPB1P_VOTk1TypCnfdAuth 0 "Highly Speculative" 1 "Speculative" 2 "Confident" 3 "Highly Confident" ;
VAL_TABLE_ SRRRRODPB6P_REOTk1CnfdStsAuth 0 "Highly Speculative" 1 "Speculative" 2 "Confident" 3 "Highly Confident" ;
VAL_TABLE_ SRRRRODPB6P_REOTk2CnfdStsAuth 0 "Highly Speculative" 1 "Speculative" 2 "Confident" 3 "Highly Confident" ;
VAL_TABLE_ SRRRRODPB6P_REOTk1TypCnfdAuth 0 "Highly Speculative" 1 "Speculative" 2 "Confident" 3 "Highly Confident" ;
VAL_TABLE_ SRRRRODPB6P_REOTk1TypAuth 0 "Unknown" 1 "Barriers" 2 "Guard Rails" 3 "Bridge Abutments" 4 "Edge of Road" 5 "Open Area" ;
VAL_TABLE_ SRRRRODPB6P_REOTk3CnfdStsAuth 0 "Highly Speculative" 1 "Speculative" 2 "Confident" 3 "Highly Confident" ;
VAL_TABLE_ SRRRRODPB6P_REOTk2TypCnfdAuth 0 "Highly Speculative" 1 "Speculative" 2 "Confident" 3 "Highly Confident" ;
VAL_TABLE_ SRRRRODPB6P_REOTk2TypAuth 0 "Unknown" 1 "Barriers" 2 "Guard Rails" 3 "Bridge Abutments" 4 "Edge of Road" 5 "Open Area" ;
VAL_TABLE_ SRRRRODPB6P_REOTk3TypCnfdAuth 0 "Highly Speculative" 1 "Speculative" 2 "Confident" 3 "Highly Confident" ;
VAL_TABLE_ SRRRRODPB6P_REOTk3TypAuth 0 "Unknown" 1 "Barriers" 2 "Guard Rails" 3 "Bridge Abutments" 4 "Edge of Road" 5 "Open Area" ;
VAL_TABLE_ SRRSLRODPB2P_POTk3DynPrpAuth 0 "Has Never Moved" 1 "Has Moved But Currently Stopped" 2 "Moving In Same Direction As Host" 3 "Moving In Opposite Direction As Host" 4 "Crossing Path" ;
VAL_TABLE_ SRRSLRODPB2P_POTk3CnfdStsAuth 0 "Highly Speculative" 1 "Speculative" 2 "Confident" 3 "Highly Confident" ;
VAL_TABLE_ SRRSLRODPB2P_POTk3MStsAuth 0 "No Object" 1 "New Object" 2 "Latent Track Not Detected this Cycle" 3 "Measured this Cycle" ;
VAL_TABLE_ SRRSLRODPB2P_POTk3TypCnfdAuth 0 "Highly Speculative" 1 "Speculative" 2 "Confident" 3 "Highly Confident" ;
VAL_TABLE_ SRRSLRODPB2P_POTk3TypAuth 0 "Unknown" 1 "Pedestrian" 2 "Bicycle" ;
VAL_TABLE_ SRRSLRODPB2P_VOTk2DynPrpStsAuth 0 "Stopped" 1 "Not Stopped" ;
VAL_TABLE_ SRRSLRODPB2P_VOTk2DynPrpAuth 0 "Has Never Moved" 1 "Moving In Same Direction As Host" 2 "Moving In Opposite Direction As Host" 3 "Crossing From Left To Right" 4 "Crossing From Right To Left" ;
VAL_TABLE_ SRRSLRODPB2P_VOTk2CnfdStsAuth 0 "Highly Speculative" 1 "Speculative" 2 "Confident" 3 "Highly Confident" ;
VAL_TABLE_ SRRSLRODPB2P_VOTk2MStsAuth 0 "No Object" 1 "New Object" 2 "Latent Track Not Detected this Cycle" 3 "Measured this Cycle" ;
VAL_TABLE_ SRRSLRODPB2P_VOTk2TypCnfdAuth 0 "Highly Speculative" 1 "Speculative" 2 "Confident" 3 "Highly Confident" ;
VAL_TABLE_ SRRSLRODPB2P_VOTk3CnfdStsAuth 0 "Highly Speculative" 1 "Speculative" 2 "Confident" 3 "Highly Confident" ;
VAL_TABLE_ SRRSLRODPB2P_VOTk3DynPrpStsAuth 0 "Stopped" 1 "Not Stopped" ;
VAL_TABLE_ SRRSLRODPB2P_VOTk3DynPrpAuth 0 "Has Never Moved" 1 "Moving In Same Direction As Host" 2 "Moving In Opposite Direction As Host" 3 "Crossing From Left To Right" 4 "Crossing From Right To Left" ;
VAL_TABLE_ SRRSLRODPB2P_VOTk3MStsAuth 0 "No Object" 1 "New Object" 2 "Latent Track Not Detected this Cycle" 3 "Measured this Cycle" ;
VAL_TABLE_ SRRSLRODPB2P_VOTk3TypCnfdAuth 0 "Highly Speculative" 1 "Speculative" 2 "Confident" 3 "Highly Confident" ;
VAL_TABLE_ SRRSLRODPB2P_VOTk4DynPrpStsAuth 0 "Stopped" 1 "Not Stopped" ;
VAL_TABLE_ SRRSLRODPB2P_VOTk4DynPrpAuth 0 "Has Never Moved" 1 "Moving In Same Direction As Host" 2 "Moving In Opposite Direction As Host" 3 "Crossing From Left To Right" 4 "Crossing From Right To Left" ;
VAL_TABLE_ SRRSLRODPB2P_VOTk4CnfdStsAuth 0 "Highly Speculative" 1 "Speculative" 2 "Confident" 3 "Highly Confident" ;
VAL_TABLE_ SRRSLRODPB2P_VOTk4MStsAuth 0 "No Object" 1 "New Object" 2 "Latent Track Not Detected this Cycle" 3 "Measured this Cycle" ;
VAL_TABLE_ SRRSLRODPB2P_VOTk4TypCnfdAuth 0 "Highly Speculative" 1 "Speculative" 2 "Confident" 3 "Highly Confident" ;
VAL_TABLE_ SRRSLRODPB3P_POTk4DynPrpAuth 0 "Has Never Moved" 1 "Has Moved But Currently Stopped" 2 "Moving In Same Direction As Host" 3 "Moving In Opposite Direction As Host" 4 "Crossing Path" ;
VAL_TABLE_ SRRSLRODPB3P_POTk4CnfdStsAuth 0 "Highly Speculative" 1 "Speculative" 2 "Confident" 3 "Highly Confident" ;
VAL_TABLE_ SRRSLRODPB3P_POTk4MStsAuth 0 "No Object" 1 "New Object" 2 "Latent Track Not Detected this Cycle" 3 "Measured this Cycle" ;
VAL_TABLE_ SRRSLRODPB3P_POTk4TypCnfdAuth 0 "Highly Speculative" 1 "Speculative" 2 "Confident" 3 "Highly Confident" ;
VAL_TABLE_ SRRSLRODPB3P_POTk4TypAuth 0 "Unknown" 1 "Pedestrian" 2 "Bicycle" ;
VAL_TABLE_ SRRSLRODPB3P_VOTk5DynPrpStsAuth 0 "Stopped" 1 "Not Stopped" ;
VAL_TABLE_ SRRSLRODPB3P_VOTk5DynPrpAuth 0 "Has Never Moved" 1 "Moving In Same Direction As Host" 2 "Moving In Opposite Direction As Host" 3 "Crossing From Left To Right" 4 "Crossing From Right To Left" ;
VAL_TABLE_ SRRSLRODPB3P_VOTk5CnfdStsAuth 0 "Highly Speculative" 1 "Speculative" 2 "Confident" 3 "Highly Confident" ;
VAL_TABLE_ SRRSLRODPB3P_VOTk5MStsAuth 0 "No Object" 1 "New Object" 2 "Latent Track Not Detected this Cycle" 3 "Measured this Cycle" ;
VAL_TABLE_ SRRSLRODPB3P_VOTk5TypCnfdAuth 0 "Highly Speculative" 1 "Speculative" 2 "Confident" 3 "Highly Confident" ;
VAL_TABLE_ SRRSLRODPB3P_VOTk6CnfdStsAuth 0 "Highly Speculative" 1 "Speculative" 2 "Confident" 3 "Highly Confident" ;
VAL_TABLE_ SRRSLRODPB3P_VOTk6DynPrpStsAuth 0 "Stopped" 1 "Not Stopped" ;
VAL_TABLE_ SRRSLRODPB3P_VOTk6DynPrpAuth 0 "Has Never Moved" 1 "Moving In Same Direction As Host" 2 "Moving In Opposite Direction As Host" 3 "Crossing From Left To Right" 4 "Crossing From Right To Left" ;
VAL_TABLE_ SRRSLRODPB3P_VOTk6MStsAuth 0 "No Object" 1 "New Object" 2 "Latent Track Not Detected this Cycle" 3 "Measured this Cycle" ;
VAL_TABLE_ SRRSLRODPB3P_VOTk6TypCnfdAuth 0 "Highly Speculative" 1 "Speculative" 2 "Confident" 3 "Highly Confident" ;
VAL_TABLE_ SRRSLRODPB3P_VOTk7DynPrpStsAuth 0 "Stopped" 1 "Not Stopped" ;
VAL_TABLE_ SRRSLRODPB3P_VOTk7DynPrpAuth 0 "Has Never Moved" 1 "Moving In Same Direction As Host" 2 "Moving In Opposite Direction As Host" 3 "Crossing From Left To Right" 4 "Crossing From Right To Left" ;
VAL_TABLE_ SRRSLRODPB3P_VOTk7CnfdStsAuth 0 "Highly Speculative" 1 "Speculative" 2 "Confident" 3 "Highly Confident" ;
VAL_TABLE_ SRRSLRODPB3P_VOTk7MStsAuth 0 "No Object" 1 "New Object" 2 "Latent Track Not Detected this Cycle" 3 "Measured this Cycle" ;
VAL_TABLE_ SRRSLRODPB3P_VOTk7TypCnfdAuth 0 "Highly Speculative" 1 "Speculative" 2 "Confident" 3 "Highly Confident" ;
VAL_TABLE_ SRRSLRODPB4P_POTk5DynPrpAuth 0 "Has Never Moved" 1 "Has Moved But Currently Stopped" 2 "Moving In Same Direction As Host" 3 "Moving In Opposite Direction As Host" 4 "Crossing Path" ;
VAL_TABLE_ SRRSLRODPB4P_POTk5CnfdStsAuth 0 "Highly Speculative" 1 "Speculative" 2 "Confident" 3 "Highly Confident" ;
VAL_TABLE_ SRRSLRODPB4P_POTk5MStsAuth 0 "No Object" 1 "New Object" 2 "Latent Track Not Detected this Cycle" 3 "Measured this Cycle" ;
VAL_TABLE_ SRRSLRODPB4P_POTk5TypCnfdAuth 0 "Highly Speculative" 1 "Speculative" 2 "Confident" 3 "Highly Confident" ;
VAL_TABLE_ SRRSLRODPB4P_POTk5TypAuth 0 "Unknown" 1 "Pedestrian" 2 "Bicycle" ;
VAL_TABLE_ SRRSLRODPB4P_VOTk10DynPrpStAuth 0 "Stopped" 1 "Not Stopped" ;
VAL_TABLE_ SRRSLRODPB4P_VOTk10DynPrpAuth 0 "Has Never Moved" 1 "Moving In Same Direction As Host" 2 "Moving In Opposite Direction As Host" 3 "Crossing From Left To Right" 4 "Crossing From Right To Left" ;
VAL_TABLE_ SRRSLRODPB4P_VOTk10CnfdStsAuth 0 "Highly Speculative" 1 "Speculative" 2 "Confident" 3 "Highly Confident" ;
VAL_TABLE_ SRRSLRODPB4P_VOTk10MStsAuth 0 "No Object" 1 "New Object" 2 "Latent Track Not Detected this Cycle" 3 "Measured this Cycle" ;
VAL_TABLE_ SRRSLRODPB4P_VOTk10TypCnfdAuth 0 "Highly Speculative" 1 "Speculative" 2 "Confident" 3 "Highly Confident" ;
VAL_TABLE_ SRRSLRODPB4P_VOTk8CnfdStsAuth 0 "Highly Speculative" 1 "Speculative" 2 "Confident" 3 "Highly Confident" ;
VAL_TABLE_ SRRSLRODPB4P_VOTk8DynPrpStsAuth 0 "Stopped" 1 "Not Stopped" ;
VAL_TABLE_ SRRSLRODPB4P_VOTk8DynPrpAuth 0 "Has Never Moved" 1 "Moving In Same Direction As Host" 2 "Moving In Opposite Direction As Host" 3 "Crossing From Left To Right" 4 "Crossing From Right To Left" ;
VAL_TABLE_ SRRSLRODPB4P_VOTk8MStsAuth 0 "No Object" 1 "New Object" 2 "Latent Track Not Detected this Cycle" 3 "Measured this Cycle" ;
VAL_TABLE_ SRRSLRODPB4P_VOTk8TypCnfdAuth 0 "Highly Speculative" 1 "Speculative" 2 "Confident" 3 "Highly Confident" ;
VAL_TABLE_ SRRSLRODPB4P_VOTk9DynPrpStsAuth 0 "Stopped" 1 "Not Stopped" ;
VAL_TABLE_ SRRSLRODPB4P_VOTk9DynPrpAuth 0 "Has Never Moved" 1 "Moving In Same Direction As Host" 2 "Moving In Opposite Direction As Host" 3 "Crossing From Left To Right" 4 "Crossing From Right To Left" ;
VAL_TABLE_ SRRSLRODPB4P_VOTk9CnfdStsAuth 0 "Highly Speculative" 1 "Speculative" 2 "Confident" 3 "Highly Confident" ;
VAL_TABLE_ SRRSLRODPB4P_VOTk9MStsAuth 0 "No Object" 1 "New Object" 2 "Latent Track Not Detected this Cycle" 3 "Measured this Cycle" ;
VAL_TABLE_ SRRSLRODPB4P_VOTk9TypCnfdAuth 0 "Highly Speculative" 1 "Speculative" 2 "Confident" 3 "Highly Confident" ;
VAL_TABLE_ SRRSLRODPB5P_IOTk10ElvtnAuth 0 "Not Elevated Elevation" 1 "Speculative Elevation" 2 "Confident Elevation" 3 "Very Confident" ;
VAL_TABLE_ SRRSLRODPB5P_IOTk10CnfdStsAuth 0 "Highly Speculative" 1 "Speculative" 2 "Confident" 3 "Highly Confident" ;
VAL_TABLE_ SRRSLRODPB5P_IOTk10MStsAuth 0 "No Object" 1 "New Object" 2 "Latent Track Not Detected this Cycle" 3 "Measured this Cycle" ;
VAL_TABLE_ SRRSLRODPB5P_IOTk1CnfdStsAuth 0 "Highly Speculative" 1 "Speculative" 2 "Confident" 3 "Highly Confident" ;
VAL_TABLE_ SRRSLRODPB5P_IOTk10TypCnfdAuth 0 "Highly Speculative" 1 "Speculative" 2 "Confident" 3 "Highly Confident" ;
VAL_TABLE_ SRRSLRODPB5P_IOTk10TypAuth 0 "Unknown" 1 "Guard Rail" 2 "Tunnel" 3 "Traffic Sign" 4 "Bridge" 5 "Pole" ;
VAL_TABLE_ SRRSLRODPB5P_IOTk1ElvtnAuth 0 "Not Elevated Elevation" 1 "Speculative Elevation" 2 "Confident Elevation" 3 "Very Confident" ;
VAL_TABLE_ SRRSLRODPB5P_IOTk1MStsAuth 0 "No Object" 1 "New Object" 2 "Latent Track Not Detected this Cycle" 3 "Measured this Cycle" ;
VAL_TABLE_ SRRSLRODPB5P_IOTk1TypAuth 0 "Unknown" 1 "Guard Rail" 2 "Tunnel" 3 "Traffic Sign" 4 "Bridge" 5 "Pole" ;
VAL_TABLE_ SRRSLRODPB5P_IOTk2ElvtnAuth 0 "Not Elevated Elevation" 1 "Speculative Elevation" 2 "Confident Elevation" 3 "Very Confident" ;
VAL_TABLE_ SRRSLRODPB5P_IOTk2CnfdStsAuth 0 "Highly Speculative" 1 "Speculative" 2 "Confident" 3 "Highly Confident" ;
VAL_TABLE_ SRRSLRODPB5P_IOTk1TypCnfdAuth 0 "Highly Speculative" 1 "Speculative" 2 "Confident" 3 "Highly Confident" ;
VAL_TABLE_ SRRSLRODPB5P_IOTk2MStsAuth 0 "No Object" 1 "New Object" 2 "Latent Track Not Detected this Cycle" 3 "Measured this Cycle" ;
VAL_TABLE_ SRRSLRODPB5P_IOTk2TypCnfdAuth 0 "Highly Speculative" 1 "Speculative" 2 "Confident" 3 "Highly Confident" ;
VAL_TABLE_ SRRSLRODPB5P_IOTk2TypAuth 0 "Unknown" 1 "Guard Rail" 2 "Tunnel" 3 "Traffic Sign" 4 "Bridge" 5 "Pole" ;
VAL_TABLE_ SRRSLRODPB5P_IOTk3ElvtnAuth 0 "Not Elevated Elevation" 1 "Speculative Elevation" 2 "Confident Elevation" 3 "Very Confident" ;
VAL_TABLE_ SRRSLRODPB5P_IOTk3CnfdStsAuth 0 "Highly Speculative" 1 "Speculative" 2 "Confident" 3 "Highly Confident" ;
VAL_TABLE_ SRRSLRODPB5P_IOTk3MStsAuth 0 "No Object" 1 "New Object" 2 "Latent Track Not Detected this Cycle" 3 "Measured this Cycle" ;
VAL_TABLE_ SRRSLRODPB5P_IOTk4CnfdStsAuth 0 "Highly Speculative" 1 "Speculative" 2 "Confident" 3 "Highly Confident" ;
VAL_TABLE_ SRRSLRODPB5P_IOTk3TypCnfdAuth 0 "Highly Speculative" 1 "Speculative" 2 "Confident" 3 "Highly Confident" ;
VAL_TABLE_ SRRSLRODPB5P_IOTk3TypAuth 0 "Unknown" 1 "Guard Rail" 2 "Tunnel" 3 "Traffic Sign" 4 "Bridge" 5 "Pole" ;
VAL_TABLE_ SRRSLRODPB5P_IOTk4ElvtnAuth 0 "Not Elevated Elevation" 1 "Speculative Elevation" 2 "Confident Elevation" 3 "Very Confident" ;
VAL_TABLE_ SRRSLRODPB5P_IOTk4MStsAuth 0 "No Object" 1 "New Object" 2 "Latent Track Not Detected this Cycle" 3 "Measured this Cycle" ;
VAL_TABLE_ SRRSLRODPB5P_IOTk4TypAuth 0 "Unknown" 1 "Guard Rail" 2 "Tunnel" 3 "Traffic Sign" 4 "Bridge" 5 "Pole" ;
VAL_TABLE_ SRRSLRODPB5P_IOTk5ElvtnAuth 0 "Not Elevated Elevation" 1 "Speculative Elevation" 2 "Confident Elevation" 3 "Very Confident" ;
VAL_TABLE_ SRRSLRODPB5P_IOTk5CnfdStsAuth 0 "Highly Speculative" 1 "Speculative" 2 "Confident" 3 "Highly Confident" ;
VAL_TABLE_ SRRSLRODPB5P_IOTk4TypCnfdAuth 0 "Highly Speculative" 1 "Speculative" 2 "Confident" 3 "Highly Confident" ;
VAL_TABLE_ SRRSLRODPB5P_IOTk5MStsAuth 0 "No Object" 1 "New Object" 2 "Latent Track Not Detected this Cycle" 3 "Measured this Cycle" ;
VAL_TABLE_ SRRSLRODPB5P_IOTk5TypCnfdAuth 0 "Highly Speculative" 1 "Speculative" 2 "Confident" 3 "Highly Confident" ;
VAL_TABLE_ SRRSLRODPB5P_IOTk5TypAuth 0 "Unknown" 1 "Guard Rail" 2 "Tunnel" 3 "Traffic Sign" 4 "Bridge" 5 "Pole" ;
VAL_TABLE_ SRRSLRODPB5P_IOTk6ElvtnAuth 0 "Not Elevated Elevation" 1 "Speculative Elevation" 2 "Confident Elevation" 3 "Very Confident" ;
VAL_TABLE_ SRRSLRODPB5P_IOTk6CnfdStsAuth 0 "Highly Speculative" 1 "Speculative" 2 "Confident" 3 "Highly Confident" ;
VAL_TABLE_ SRRSLRODPB5P_IOTk6MStsAuth 0 "No Object" 1 "New Object" 2 "Latent Track Not Detected this Cycle" 3 "Measured this Cycle" ;
VAL_TABLE_ SRRSLRODPB5P_IOTk7ElvtnAuth 0 "Not Elevated Elevation" 1 "Speculative Elevation" 2 "Confident Elevation" 3 "Very Confident" ;
VAL_TABLE_ SRRSLRODPB5P_IOTk7CnfdStsAuth 0 "Highly Speculative" 1 "Speculative" 2 "Confident" 3 "Highly Confident" ;
VAL_TABLE_ SRRSLRODPB5P_IOTk6TypCnfdAuth 0 "Highly Speculative" 1 "Speculative" 2 "Confident" 3 "Highly Confident" ;
VAL_TABLE_ SRRSLRODPB5P_IOTk6TypAuth 0 "Unknown" 1 "Guard Rail" 2 "Tunnel" 3 "Traffic Sign" 4 "Bridge" 5 "Pole" ;
VAL_TABLE_ SRRSLRODPB5P_IOTk7MStsAuth 0 "No Object" 1 "New Object" 2 "Latent Track Not Detected this Cycle" 3 "Measured this Cycle" ;
VAL_TABLE_ SRRSLRODPB5P_IOTk7TypAuth 0 "Unknown" 1 "Guard Rail" 2 "Tunnel" 3 "Traffic Sign" 4 "Bridge" 5 "Pole" ;
VAL_TABLE_ SRRSLRODPB5P_IOTk8ElvtnAuth 0 "Not Elevated Elevation" 1 "Speculative Elevation" 2 "Confident Elevation" 3 "Very Confident" ;
VAL_TABLE_ SRRSLRODPB5P_IOTk8CnfdStsAuth 0 "Highly Speculative" 1 "Speculative" 2 "Confident" 3 "Highly Confident" ;
VAL_TABLE_ SRRSLRODPB5P_IOTk7TypCnfdAuth 0 "Highly Speculative" 1 "Speculative" 2 "Confident" 3 "Highly Confident" ;
VAL_TABLE_ SRRSLRODPB5P_IOTk8MStsAuth 0 "No Object" 1 "New Object" 2 "Latent Track Not Detected this Cycle" 3 "Measured this Cycle" ;
VAL_TABLE_ SRRSLRODPB5P_IOTk9CnfdStsAuth 0 "Highly Speculative" 1 "Speculative" 2 "Confident" 3 "Highly Confident" ;
VAL_TABLE_ SRRSLRODPB5P_IOTk8TypCnfdAuth 0 "Highly Speculative" 1 "Speculative" 2 "Confident" 3 "Highly Confident" ;
VAL_TABLE_ SRRSLRODPB5P_IOTk8TypAuth 0 "Unknown" 1 "Guard Rail" 2 "Tunnel" 3 "Traffic Sign" 4 "Bridge" 5 "Pole" ;
VAL_TABLE_ SRRSLRODPB5P_IOTk9ElvtnAuth 0 "Not Elevated Elevation" 1 "Speculative Elevation" 2 "Confident Elevation" 3 "Very Confident" ;
VAL_TABLE_ SRRSLRODPB5P_IOTk9MStsAuth 0 "No Object" 1 "New Object" 2 "Latent Track Not Detected this Cycle" 3 "Measured this Cycle" ;
VAL_TABLE_ SRRSLRODPB5P_IOTk9TypAuth 0 "Unknown" 1 "Guard Rail" 2 "Tunnel" 3 "Traffic Sign" 4 "Bridge" 5 "Pole" ;
VAL_TABLE_ SRRSLRODPB5P_IOTk9TypCnfdAuth 0 "Highly Speculative" 1 "Speculative" 2 "Confident" 3 "Highly Confident" ;
VAL_TABLE_ SRRSLRODPB1P_CnstrArDtnCnfdAuth 0 "Highly Speculative" 1 "Speculative" 2 "Confident" 3 "Highly Confident" ;
VAL_TABLE_ SRRSLRODPB1P_AcqTmStmAuth_Inv 0 "FALSE" 1 "TRUE" ;
VAL_TABLE_ SRRSLRODPB1P_POTk1DynPrpAuth 0 "Has Never Moved" 1 "Has Moved But Currently Stopped" 2 "Moving In Same Direction As Host" 3 "Moving In Opposite Direction As Host" 4 "Crossing Path" ;
VAL_TABLE_ SRRSLRODPB1P_POTk1CnfdStsAuth 0 "Highly Speculative" 1 "Speculative" 2 "Confident" 3 "Highly Confident" ;
VAL_TABLE_ SRRSLRODPB1P_MdCmdStsAuth 0 "Not Radiating" 1 "Reporting Object Data" 2 "Not Reporting Object Data" ;
VAL_TABLE_ SRRSLRODPB1P_CnstrArDtnStsAuth 0 "Not Detected" 1 "Detected" 2 "Unknown" ;
VAL_TABLE_ SRRSLRODPB1P_POTk1MStsAuth 0 "No Object" 1 "New Object" 2 "Latent Track Not Detected this Cycle" 3 "Measured this Cycle" ;
VAL_TABLE_ SRRSLRODPB1P_POTk2CnfdStsAuth 0 "Highly Speculative" 1 "Speculative" 2 "Confident" 3 "Highly Confident" ;
VAL_TABLE_ SRRSLRODPB1P_POTk1TypCnfdAuth 0 "Highly Speculative" 1 "Speculative" 2 "Confident" 3 "Highly Confident" ;
VAL_TABLE_ SRRSLRODPB1P_POTk1TypAuth 0 "Unknown" 1 "Pedestrian" 2 "Bicycle" ;
VAL_TABLE_ SRRSLRODPB1P_POTk2DynPrpAuth 0 "Has Never Moved" 1 "Has Moved But Currently Stopped" 2 "Moving In Same Direction As Host" 3 "Moving In Opposite Direction As Host" 4 "Crossing Path" ;
VAL_TABLE_ SRRSLRODPB1P_POTk2MStsAuth 0 "No Object" 1 "New Object" 2 "Latent Track Not Detected this Cycle" 3 "Measured this Cycle" ;
VAL_TABLE_ SRRSLRODPB1P_POTk2TypCnfdAuth 0 "Highly Speculative" 1 "Speculative" 2 "Confident" 3 "Highly Confident" ;
VAL_TABLE_ SRRSLRODPB1P_POTk2TypAuth 0 "Unknown" 1 "Pedestrian" 2 "Bicycle" ;
VAL_TABLE_ SRRSLRODPB1P_SnsrUnvAuth 0 "FALSE" 1 "TRUE" ;
VAL_TABLE_ SRRSLRODPB1P_SnsrBlckdAuth 0 "FALSE" 1 "TRUE" ;
VAL_TABLE_ SRRSLRODPB1P_ServRqrdAuth 0 "FALSE" 1 "TRUE" ;
VAL_TABLE_ SRRSLRODPB1P_RdTypCnfdAuth 0 "Highly Speculative" 1 "Speculative" 2 "Confident" 3 "Highly Confident" ;
VAL_TABLE_ SRRSLRODPB1P_RdTypAuth 0 "Unknown" 1 "City" 2 "Secondary Road" 3 "Highway" 4 "Construction" 5 "Zone Entry" 6 "Construction" 7 "Zone Exit" ;
VAL_TABLE_ SRRSLRODPB1P_SwpBndwdthStsAuth 0 "Mode A" 1 "Mode B" 2 "Mode C" 3 "Mode D" ;
VAL_TABLE_ SRRSLRODPB1P_VOTk1DynPrpStsAuth 0 "Stopped" 1 "Not Stopped" ;
VAL_TABLE_ SRRSLRODPB1P_VOTk1DynPrpAuth 0 "Has Never Moved" 1 "Moving In Same Direction As Host" 2 "Moving In Opposite Direction As Host" 3 "Crossing From Left To Right" 4 "Crossing From Right To Left" ;
VAL_TABLE_ SRRSLRODPB1P_VOTk1CnfdStsAuth 0 "Highly Speculative" 1 "Speculative" 2 "Confident" 3 "Highly Confident" ;
VAL_TABLE_ SRRSLRODPB1P_VOTk1MStsAuth 0 "No Object" 1 "New Object" 2 "Latent Track Not Detected this Cycle" 3 "Measured this Cycle" ;
VAL_TABLE_ SRRSLRODPB1P_VOTk1TypCnfdAuth 0 "Highly Speculative" 1 "Speculative" 2 "Confident" 3 "Highly Confident" ;
VAL_TABLE_ SRRSLRODPB6P_REOTk1CnfdStsAuth 0 "Highly Speculative" 1 "Speculative" 2 "Confident" 3 "Highly Confident" ;
VAL_TABLE_ SRRSLRODPB6P_REOTk2CnfdStsAuth 0 "Highly Speculative" 1 "Speculative" 2 "Confident" 3 "Highly Confident" ;
VAL_TABLE_ SRRSLRODPB6P_REOTk1TypCnfdAuth 0 "Highly Speculative" 1 "Speculative" 2 "Confident" 3 "Highly Confident" ;
VAL_TABLE_ SRRSLRODPB6P_REOTk1TypAuth 0 "Unknown" 1 "Barriers" 2 "Guard Rails" 3 "Bridge Abutments" 4 "Edge of Road" 5 "Open Area" ;
VAL_TABLE_ SRRSLRODPB6P_REOTk3CnfdStsAuth 0 "Highly Speculative" 1 "Speculative" 2 "Confident" 3 "Highly Confident" ;
VAL_TABLE_ SRRSLRODPB6P_REOTk2TypCnfdAuth 0 "Highly Speculative" 1 "Speculative" 2 "Confident" 3 "Highly Confident" ;
VAL_TABLE_ SRRSLRODPB6P_REOTk2TypAuth 0 "Unknown" 1 "Barriers" 2 "Guard Rails" 3 "Bridge Abutments" 4 "Edge of Road" 5 "Open Area" ;
VAL_TABLE_ SRRSLRODPB6P_REOTk3TypCnfdAuth 0 "Highly Speculative" 1 "Speculative" 2 "Confident" 3 "Highly Confident" ;
VAL_TABLE_ SRRSLRODPB6P_REOTk3TypAuth 0 "Unknown" 1 "Barriers" 2 "Guard Rails" 3 "Bridge Abutments" 4 "Edge of Road" 5 "Open Area" ;
VAL_TABLE_ SRRSRRODPB2P_POTk3DynPrpAuth 0 "Has Never Moved" 1 "Has Moved But Currently Stopped" 2 "Moving In Same Direction As Host" 3 "Moving In Opposite Direction As Host" 4 "Crossing Path" ;
VAL_TABLE_ SRRSRRODPB2P_POTk3CnfdStsAuth 0 "Highly Speculative" 1 "Speculative" 2 "Confident" 3 "Highly Confident" ;
VAL_TABLE_ SRRSRRODPB2P_POTk3MStsAuth 0 "No Object" 1 "New Object" 2 "Latent Track Not Detected this Cycle" 3 "Measured this Cycle" ;
VAL_TABLE_ SRRSRRODPB2P_POTk3TypCnfdAuth 0 "Highly Speculative" 1 "Speculative" 2 "Confident" 3 "Highly Confident" ;
VAL_TABLE_ SRRSRRODPB2P_POTk3TypAuth 0 "Unknown" 1 "Pedestrian" 2 "Bicycle" ;
VAL_TABLE_ SRRSRRODPB2P_VOTk2DynPrpStsAuth 0 "Stopped" 1 "Not Stopped" ;
VAL_TABLE_ SRRSRRODPB2P_VOTk2DynPrpAuth 0 "Has Never Moved" 1 "Moving In Same Direction As Host" 2 "Moving In Opposite Direction As Host" 3 "Crossing From Left To Right" 4 "Crossing From Right To Left" ;
VAL_TABLE_ SRRSRRODPB2P_VOTk2CnfdStsAuth 0 "Highly Speculative" 1 "Speculative" 2 "Confident" 3 "Highly Confident" ;
VAL_TABLE_ SRRSRRODPB2P_VOTk2MStsAuth 0 "No Object" 1 "New Object" 2 "Latent Track Not Detected this Cycle" 3 "Measured this Cycle" ;
VAL_TABLE_ SRRSRRODPB2P_VOTk2TypCnfdAuth 0 "Highly Speculative" 1 "Speculative" 2 "Confident" 3 "Highly Confident" ;
VAL_TABLE_ SRRSRRODPB2P_VOTk3CnfdStsAuth 0 "Highly Speculative" 1 "Speculative" 2 "Confident" 3 "Highly Confident" ;
VAL_TABLE_ SRRSRRODPB2P_VOTk3DynPrpStsAuth 0 "Stopped" 1 "Not Stopped" ;
VAL_TABLE_ SRRSRRODPB2P_VOTk3DynPrpAuth 0 "Has Never Moved" 1 "Moving In Same Direction As Host" 2 "Moving In Opposite Direction As Host" 3 "Crossing From Left To Right" 4 "Crossing From Right To Left" ;
VAL_TABLE_ SRRSRRODPB2P_VOTk3MStsAuth 0 "No Object" 1 "New Object" 2 "Latent Track Not Detected this Cycle" 3 "Measured this Cycle" ;
VAL_TABLE_ SRRSRRODPB2P_VOTk3TypCnfdAuth 0 "Highly Speculative" 1 "Speculative" 2 "Confident" 3 "Highly Confident" ;
VAL_TABLE_ SRRSRRODPB2P_VOTk4DynPrpStsAuth 0 "Stopped" 1 "Not Stopped" ;
VAL_TABLE_ SRRSRRODPB2P_VOTk4DynPrpAuth 0 "Has Never Moved" 1 "Moving In Same Direction As Host" 2 "Moving In Opposite Direction As Host" 3 "Crossing From Left To Right" 4 "Crossing From Right To Left" ;
VAL_TABLE_ SRRSRRODPB2P_VOTk4CnfdStsAuth 0 "Highly Speculative" 1 "Speculative" 2 "Confident" 3 "Highly Confident" ;
VAL_TABLE_ SRRSRRODPB2P_VOTk4MStsAuth 0 "No Object" 1 "New Object" 2 "Latent Track Not Detected this Cycle" 3 "Measured this Cycle" ;
VAL_TABLE_ SRRSRRODPB2P_VOTk4TypCnfdAuth 0 "Highly Speculative" 1 "Speculative" 2 "Confident" 3 "Highly Confident" ;
VAL_TABLE_ SRRSRRODPB3P_POTk4DynPrpAuth 0 "Has Never Moved" 1 "Has Moved But Currently Stopped" 2 "Moving In Same Direction As Host" 3 "Moving In Opposite Direction As Host" 4 "Crossing Path" ;
VAL_TABLE_ SRRSRRODPB3P_POTk4CnfdStsAuth 0 "Highly Speculative" 1 "Speculative" 2 "Confident" 3 "Highly Confident" ;
VAL_TABLE_ SRRSRRODPB3P_POTk4MStsAuth 0 "No Object" 1 "New Object" 2 "Latent Track Not Detected this Cycle" 3 "Measured this Cycle" ;
VAL_TABLE_ SRRSRRODPB3P_POTk4TypCnfdAuth 0 "Highly Speculative" 1 "Speculative" 2 "Confident" 3 "Highly Confident" ;
VAL_TABLE_ SRRSRRODPB3P_POTk4TypAuth 0 "Unknown" 1 "Pedestrian" 2 "Bicycle" ;
VAL_TABLE_ SRRSRRODPB3P_VOTk5DynPrpStsAuth 0 "Stopped" 1 "Not Stopped" ;
VAL_TABLE_ SRRSRRODPB3P_VOTk5DynPrpAuth 0 "Has Never Moved" 1 "Moving In Same Direction As Host" 2 "Moving In Opposite Direction As Host" 3 "Crossing From Left To Right" 4 "Crossing From Right To Left" ;
VAL_TABLE_ SRRSRRODPB3P_VOTk5CnfdStsAuth 0 "Highly Speculative" 1 "Speculative" 2 "Confident" 3 "Highly Confident" ;
VAL_TABLE_ SRRSRRODPB3P_VOTk5MStsAuth 0 "No Object" 1 "New Object" 2 "Latent Track Not Detected this Cycle" 3 "Measured this Cycle" ;
VAL_TABLE_ SRRSRRODPB3P_VOTk5TypCnfdAuth 0 "Highly Speculative" 1 "Speculative" 2 "Confident" 3 "Highly Confident" ;
VAL_TABLE_ SRRSRRODPB3P_VOTk6CnfdStsAuth 0 "Highly Speculative" 1 "Speculative" 2 "Confident" 3 "Highly Confident" ;
VAL_TABLE_ SRRSRRODPB3P_VOTk6DynPrpStsAuth 0 "Stopped" 1 "Not Stopped" ;
VAL_TABLE_ SRRSRRODPB3P_VOTk6DynPrpAuth 0 "Has Never Moved" 1 "Moving In Same Direction As Host" 2 "Moving In Opposite Direction As Host" 3 "Crossing From Left To Right" 4 "Crossing From Right To Left" ;
VAL_TABLE_ SRRSRRODPB3P_VOTk6MStsAuth 0 "No Object" 1 "New Object" 2 "Latent Track Not Detected this Cycle" 3 "Measured this Cycle" ;
VAL_TABLE_ SRRSRRODPB3P_VOTk6TypCnfdAuth 0 "Highly Speculative" 1 "Speculative" 2 "Confident" 3 "Highly Confident" ;
VAL_TABLE_ SRRSRRODPB3P_VOTk7DynPrpStsAuth 0 "Stopped" 1 "Not Stopped" ;
VAL_TABLE_ SRRSRRODPB3P_VOTk7DynPrpAuth 0 "Has Never Moved" 1 "Moving In Same Direction As Host" 2 "Moving In Opposite Direction As Host" 3 "Crossing From Left To Right" 4 "Crossing From Right To Left" ;
VAL_TABLE_ SRRSRRODPB3P_VOTk7CnfdStsAuth 0 "Highly Speculative" 1 "Speculative" 2 "Confident" 3 "Highly Confident" ;
VAL_TABLE_ SRRSRRODPB3P_VOTk7MStsAuth 0 "No Object" 1 "New Object" 2 "Latent Track Not Detected this Cycle" 3 "Measured this Cycle" ;
VAL_TABLE_ SRRSRRODPB3P_VOTk7TypCnfdAuth 0 "Highly Speculative" 1 "Speculative" 2 "Confident" 3 "Highly Confident" ;
VAL_TABLE_ SRRSRRODPB4P_POTk5DynPrpAuth 0 "Has Never Moved" 1 "Has Moved But Currently Stopped" 2 "Moving In Same Direction As Host" 3 "Moving In Opposite Direction As Host" 4 "Crossing Path" ;
VAL_TABLE_ SRRSRRODPB4P_POTk5CnfdStsAuth 0 "Highly Speculative" 1 "Speculative" 2 "Confident" 3 "Highly Confident" ;
VAL_TABLE_ SRRSRRODPB4P_POTk5MStsAuth 0 "No Object" 1 "New Object" 2 "Latent Track Not Detected this Cycle" 3 "Measured this Cycle" ;
VAL_TABLE_ SRRSRRODPB4P_POTk5TypCnfdAuth 0 "Highly Speculative" 1 "Speculative" 2 "Confident" 3 "Highly Confident" ;
VAL_TABLE_ SRRSRRODPB4P_POTk5TypAuth 0 "Unknown" 1 "Pedestrian" 2 "Bicycle" ;
VAL_TABLE_ SRRSRRODPB4P_VOTk10DynPrpStAuth 0 "Stopped" 1 "Not Stopped" ;
VAL_TABLE_ SRRSRRODPB4P_VOTk10DynPrpAuth 0 "Has Never Moved" 1 "Moving In Same Direction As Host" 2 "Moving In Opposite Direction As Host" 3 "Crossing From Left To Right" 4 "Crossing From Right To Left" ;
VAL_TABLE_ SRRSRRODPB4P_VOTk10CnfdStsAuth 0 "Highly Speculative" 1 "Speculative" 2 "Confident" 3 "Highly Confident" ;
VAL_TABLE_ SRRSRRODPB4P_VOTk10MStsAuth 0 "No Object" 1 "New Object" 2 "Latent Track Not Detected this Cycle" 3 "Measured this Cycle" ;
VAL_TABLE_ SRRSRRODPB4P_VOTk10TypCnfdAuth 0 "Highly Speculative" 1 "Speculative" 2 "Confident" 3 "Highly Confident" ;
VAL_TABLE_ SRRSRRODPB4P_VOTk8CnfdStsAuth 0 "Highly Speculative" 1 "Speculative" 2 "Confident" 3 "Highly Confident" ;
VAL_TABLE_ SRRSRRODPB4P_VOTk8DynPrpStsAuth 0 "Stopped" 1 "Not Stopped" ;
VAL_TABLE_ SRRSRRODPB4P_VOTk8DynPrpAuth 0 "Has Never Moved" 1 "Moving In Same Direction As Host" 2 "Moving In Opposite Direction As Host" 3 "Crossing From Left To Right" 4 "Crossing From Right To Left" ;
VAL_TABLE_ SRRSRRODPB4P_VOTk8MStsAuth 0 "No Object" 1 "New Object" 2 "Latent Track Not Detected this Cycle" 3 "Measured this Cycle" ;
VAL_TABLE_ SRRSRRODPB4P_VOTk8TypCnfdAuth 0 "Highly Speculative" 1 "Speculative" 2 "Confident" 3 "Highly Confident" ;
VAL_TABLE_ SRRSRRODPB4P_VOTk9DynPrpStsAuth 0 "Stopped" 1 "Not Stopped" ;
VAL_TABLE_ SRRSRRODPB4P_VOTk9DynPrpAuth 0 "Has Never Moved" 1 "Moving In Same Direction As Host" 2 "Moving In Opposite Direction As Host" 3 "Crossing From Left To Right" 4 "Crossing From Right To Left" ;
VAL_TABLE_ SRRSRRODPB4P_VOTk9CnfdStsAuth 0 "Highly Speculative" 1 "Speculative" 2 "Confident" 3 "Highly Confident" ;
VAL_TABLE_ SRRSRRODPB4P_VOTk9MStsAuth 0 "No Object" 1 "New Object" 2 "Latent Track Not Detected this Cycle" 3 "Measured this Cycle" ;
VAL_TABLE_ SRRSRRODPB4P_VOTk9TypCnfdAuth 0 "Highly Speculative" 1 "Speculative" 2 "Confident" 3 "Highly Confident" ;
VAL_TABLE_ SRRSRRODPB5P_IOTk10ElvtnAuth 0 "Not Elevated Elevation" 1 "Speculative Elevation" 2 "Confident Elevation" 3 "Very Confident" ;
VAL_TABLE_ SRRSRRODPB5P_IOTk10CnfdStsAuth 0 "Highly Speculative" 1 "Speculative" 2 "Confident" 3 "Highly Confident" ;
VAL_TABLE_ SRRSRRODPB5P_IOTk10MStsAuth 0 "No Object" 1 "New Object" 2 "Latent Track Not Detected this Cycle" 3 "Measured this Cycle" ;
VAL_TABLE_ SRRSRRODPB5P_IOTk1CnfdStsAuth 0 "Highly Speculative" 1 "Speculative" 2 "Confident" 3 "Highly Confident" ;
VAL_TABLE_ SRRSRRODPB5P_IOTk10TypCnfdAuth 0 "Highly Speculative" 1 "Speculative" 2 "Confident" 3 "Highly Confident" ;
VAL_TABLE_ SRRSRRODPB5P_IOTk10TypAuth 0 "Unknown" 1 "Guard Rail" 2 "Tunnel" 3 "Traffic Sign" 4 "Bridge" 5 "Pole" ;
VAL_TABLE_ SRRSRRODPB5P_IOTk1ElvtnAuth 0 "Not Elevated Elevation" 1 "Speculative Elevation" 2 "Confident Elevation" 3 "Very Confident" ;
VAL_TABLE_ SRRSRRODPB5P_IOTk1MStsAuth 0 "No Object" 1 "New Object" 2 "Latent Track Not Detected this Cycle" 3 "Measured this Cycle" ;
VAL_TABLE_ SRRSRRODPB5P_IOTk1TypAuth 0 "Unknown" 1 "Guard Rail" 2 "Tunnel" 3 "Traffic Sign" 4 "Bridge" 5 "Pole" ;
VAL_TABLE_ SRRSRRODPB5P_IOTk2ElvtnAuth 0 "Not Elevated Elevation" 1 "Speculative Elevation" 2 "Confident Elevation" 3 "Very Confident" ;
VAL_TABLE_ SRRSRRODPB5P_IOTk2CnfdStsAuth 0 "Highly Speculative" 1 "Speculative" 2 "Confident" 3 "Highly Confident" ;
VAL_TABLE_ SRRSRRODPB5P_IOTk1TypCnfdAuth 0 "Highly Speculative" 1 "Speculative" 2 "Confident" 3 "Highly Confident" ;
VAL_TABLE_ SRRSRRODPB5P_IOTk2MStsAuth 0 "No Object" 1 "New Object" 2 "Latent Track Not Detected this Cycle" 3 "Measured this Cycle" ;
VAL_TABLE_ SRRSRRODPB5P_IOTk2TypCnfdAuth 0 "Highly Speculative" 1 "Speculative" 2 "Confident" 3 "Highly Confident" ;
VAL_TABLE_ SRRSRRODPB5P_IOTk2TypAuth 0 "Unknown" 1 "Guard Rail" 2 "Tunnel" 3 "Traffic Sign" 4 "Bridge" 5 "Pole" ;
VAL_TABLE_ SRRSRRODPB5P_IOTk3ElvtnAuth 0 "Not Elevated Elevation" 1 "Speculative Elevation" 2 "Confident Elevation" 3 "Very Confident" ;
VAL_TABLE_ SRRSRRODPB5P_IOTk3CnfdStsAuth 0 "Highly Speculative" 1 "Speculative" 2 "Confident" 3 "Highly Confident" ;
VAL_TABLE_ SRRSRRODPB5P_IOTk3MStsAuth 0 "No Object" 1 "New Object" 2 "Latent Track Not Detected this Cycle" 3 "Measured this Cycle" ;
VAL_TABLE_ SRRSRRODPB5P_IOTk4CnfdStsAuth 0 "Highly Speculative" 1 "Speculative" 2 "Confident" 3 "Highly Confident" ;
VAL_TABLE_ SRRSRRODPB5P_IOTk3TypCnfdAuth 0 "Highly Speculative" 1 "Speculative" 2 "Confident" 3 "Highly Confident" ;
VAL_TABLE_ SRRSRRODPB5P_IOTk3TypAuth 0 "Unknown" 1 "Guard Rail" 2 "Tunnel" 3 "Traffic Sign" 4 "Bridge" 5 "Pole" ;
VAL_TABLE_ SRRSRRODPB5P_IOTk4ElvtnAuth 0 "Not Elevated Elevation" 1 "Speculative Elevation" 2 "Confident Elevation" 3 "Very Confident" ;
VAL_TABLE_ SRRSRRODPB5P_IOTk4MStsAuth 0 "No Object" 1 "New Object" 2 "Latent Track Not Detected this Cycle" 3 "Measured this Cycle" ;
VAL_TABLE_ SRRSRRODPB5P_IOTk4TypAuth 0 "Unknown" 1 "Guard Rail" 2 "Tunnel" 3 "Traffic Sign" 4 "Bridge" 5 "Pole" ;
VAL_TABLE_ SRRSRRODPB5P_IOTk5ElvtnAuth 0 "Not Elevated Elevation" 1 "Speculative Elevation" 2 "Confident Elevation" 3 "Very Confident" ;
VAL_TABLE_ SRRSRRODPB5P_IOTk5CnfdStsAuth 0 "Highly Speculative" 1 "Speculative" 2 "Confident" 3 "Highly Confident" ;
VAL_TABLE_ SRRSRRODPB5P_IOTk4TypCnfdAuth 0 "Highly Speculative" 1 "Speculative" 2 "Confident" 3 "Highly Confident" ;
VAL_TABLE_ SRRSRRODPB5P_IOTk5MStsAuth 0 "No Object" 1 "New Object" 2 "Latent Track Not Detected this Cycle" 3 "Measured this Cycle" ;
VAL_TABLE_ SRRSRRODPB5P_IOTk5TypCnfdAuth 0 "Highly Speculative" 1 "Speculative" 2 "Confident" 3 "Highly Confident" ;
VAL_TABLE_ SRRSRRODPB5P_IOTk5TypAuth 0 "Unknown" 1 "Guard Rail" 2 "Tunnel" 3 "Traffic Sign" 4 "Bridge" 5 "Pole" ;
VAL_TABLE_ SRRSRRODPB5P_IOTk6ElvtnAuth 0 "Not Elevated Elevation" 1 "Speculative Elevation" 2 "Confident Elevation" 3 "Very Confident" ;
VAL_TABLE_ SRRSRRODPB5P_IOTk6CnfdStsAuth 0 "Highly Speculative" 1 "Speculative" 2 "Confident" 3 "Highly Confident" ;
VAL_TABLE_ SRRSRRODPB5P_IOTk6MStsAuth 0 "No Object" 1 "New Object" 2 "Latent Track Not Detected this Cycle" 3 "Measured this Cycle" ;
VAL_TABLE_ SRRSRRODPB5P_IOTk7ElvtnAuth 0 "Not Elevated Elevation" 1 "Speculative Elevation" 2 "Confident Elevation" 3 "Very Confident" ;
VAL_TABLE_ SRRSRRODPB5P_IOTk7CnfdStsAuth 0 "Highly Speculative" 1 "Speculative" 2 "Confident" 3 "Highly Confident" ;
VAL_TABLE_ SRRSRRODPB5P_IOTk6TypCnfdAuth 0 "Highly Speculative" 1 "Speculative" 2 "Confident" 3 "Highly Confident" ;
VAL_TABLE_ SRRSRRODPB5P_IOTk6TypAuth 0 "Unknown" 1 "Guard Rail" 2 "Tunnel" 3 "Traffic Sign" 4 "Bridge" 5 "Pole" ;
VAL_TABLE_ SRRSRRODPB5P_IOTk7MStsAuth 0 "No Object" 1 "New Object" 2 "Latent Track Not Detected this Cycle" 3 "Measured this Cycle" ;
VAL_TABLE_ SRRSRRODPB5P_IOTk7TypAuth 0 "Unknown" 1 "Guard Rail" 2 "Tunnel" 3 "Traffic Sign" 4 "Bridge" 5 "Pole" ;
VAL_TABLE_ SRRSRRODPB5P_IOTk8ElvtnAuth 0 "Not Elevated Elevation" 1 "Speculative Elevation" 2 "Confident Elevation" 3 "Very Confident" ;
VAL_TABLE_ SRRSRRODPB5P_IOTk8CnfdStsAuth 0 "Highly Speculative" 1 "Speculative" 2 "Confident" 3 "Highly Confident" ;
VAL_TABLE_ SRRSRRODPB5P_IOTk7TypCnfdAuth 0 "Highly Speculative" 1 "Speculative" 2 "Confident" 3 "Highly Confident" ;
VAL_TABLE_ SRRSRRODPB5P_IOTk8MStsAuth 0 "No Object" 1 "New Object" 2 "Latent Track Not Detected this Cycle" 3 "Measured this Cycle" ;
VAL_TABLE_ SRRSRRODPB5P_IOTk9CnfdStsAuth 0 "Highly Speculative" 1 "Speculative" 2 "Confident" 3 "Highly Confident" ;
VAL_TABLE_ SRRSRRODPB5P_IOTk8TypCnfdAuth 0 "Highly Speculative" 1 "Speculative" 2 "Confident" 3 "Highly Confident" ;
VAL_TABLE_ SRRSRRODPB5P_IOTk8TypAuth 0 "Unknown" 1 "Guard Rail" 2 "Tunnel" 3 "Traffic Sign" 4 "Bridge" 5 "Pole" ;
VAL_TABLE_ SRRSRRODPB5P_IOTk9ElvtnAuth 0 "Not Elevated Elevation" 1 "Speculative Elevation" 2 "Confident Elevation" 3 "Very Confident" ;
VAL_TABLE_ SRRSRRODPB5P_IOTk9MStsAuth 0 "No Object" 1 "New Object" 2 "Latent Track Not Detected this Cycle" 3 "Measured this Cycle" ;
VAL_TABLE_ SRRSRRODPB5P_IOTk9TypAuth 0 "Unknown" 1 "Guard Rail" 2 "Tunnel" 3 "Traffic Sign" 4 "Bridge" 5 "Pole" ;
VAL_TABLE_ SRRSRRODPB5P_IOTk9TypCnfdAuth 0 "Highly Speculative" 1 "Speculative" 2 "Confident" 3 "Highly Confident" ;
VAL_TABLE_ SRRSRRODPB1P_CnstrArDtnCnfdAuth 0 "Highly Speculative" 1 "Speculative" 2 "Confident" 3 "Highly Confident" ;
VAL_TABLE_ SRRSRRODPB1P_AcqTmStmAuth_Inv 0 "FALSE" 1 "TRUE" ;

BA_DEF_ SG_  "SignalType" STRING ;
BA_DEF_ SG_  "SignalLongName" STRING ;
BA_DEF_ BO_  "GenMsgCycleTime" INT 0 10000;
BA_DEF_ BO_  "GenMsgSendType" ENUM "cyclicX","spontanX","cyclicIfActiveX","spontanWithDelay","cyclicAndSpontanX","cyclicAndSpontanWithDelay","spontanWithRepetition","cyclicIfActiveAndSpontanWD";
BA_DEF_ BO_  "VFrameFormat" ENUM  "StandardCAN","ExtendedCAN","reserved","reserved","reserved","reserved","reserved","reserved","reserved","reserved","reserved","reserved","reserved","reserved","StandardCAN_FD","ExtendedCAN_FD";
BA_DEF_DEF_  "SignalType" "";
BA_DEF_DEF_  "SignalLongName" "";
BA_DEF_DEF_  "GenMsgCycleTime" 0;
BA_DEF_DEF_  "GenMsgSendType" "cyclicX";
BA_DEF_DEF_  "VFrameFormat" "StandardCAN";
