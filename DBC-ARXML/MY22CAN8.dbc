VERSION ""

NS_ :

BS_:

BU_: WCM VPM VLM VKM UVM TIM TEST_TOOL_2 TEST_TOOL_1 TCP TCM TCCM3 TCCM STC SRR_SRR SRR_SLR SRR_RR SRR_RF SRR_LR_CR SRR_LF SIB SDM SCL SBZA_R SBZA_L SBM SADS RadioLow RSC RDCM PTM PDR PA NVM MTCM_R MTCM_L MSM_RR MSM_P MSM_LR MSM_D MSB2 MSB1 MRCM_R MRCM_L MFC LRR_HC LRR LIB1 IPC ICS_Info ICCM HVAC_FP_R HVAC_FP_F HUD_CAN HDLM FCM_LC FCM EPS EOCM_HCP2 EOCM_HCP1 EOCM ELM ECP_X1 ECP_MC ECP_E ECM EBCM DMS DEFC DCM CSM CMMb CMMa CGM BSM_MH BSM BCM ARS ARB APA AOS AMP ALC AHS AHL_AFL AGC

BO_ 149 C8_FCODP_Consecutive_Frame_Num10: 64 FCM_LC
 SG_ FCODPB8P_FVLBTk8CrvAuth : 3|16@0- (9.77e-07,0) [-0.0320143|0.0320134] "1/m" EOCM,EOCM_HCP1,EOCM_HCP2,HDLM
 SG_ FCODPB8P_FVLBTk8ClrAuth : 5|2@0+ (1,0) [0|3] "" EOCM,EOCM_HCP1,EOCM_HCP2,HDLM
 SG_ FCODPB8P_BrstID : 7|2@0+ (1,0) [0|3] "" EOCM,EOCM_HCP1,EOCM_HCP2,HDLM
 SG_ FCODPB8P_FVLBTk8CrvDrvtAuth : 19|16@0- (3.73e-09,0) [-0.000122225|0.000122221] "1/m^2" EOCM,EOCM_HCP1,EOCM_HCP2,HDLM
 SG_ FCODPB8P_FVLBTk8FPSABCQOvrAuth : 35|7@0+ (1,0) [0|127] "%" EOCM,EOCM_HCP1,EOCM_HCP2,HDLM
 SG_ FCODPB8P_FVLBTk8FPSAQAuth : 44|7@0+ (1,0) [0|127] "%" EOCM,EOCM_HCP1,EOCM_HCP2,HDLM
 SG_ FCODPB8P_FVLBTk8FPSBQAuth : 53|7@0+ (1,0) [0|127] "%" EOCM,EOCM_HCP1,EOCM_HCP2,HDLM
 SG_ FCODPB8P_FVLBTk8FPSCQAuth : 62|7@0+ (1,0) [0|127] "%" EOCM,EOCM_HCP1,EOCM_HCP2,HDLM
 SG_ FCODPB8P_FVLBTk8HdgAuth : 71|10@0- (0.000977,0) [-0.500224|0.499247] "" EOCM,EOCM_HCP1,EOCM_HCP2,HDLM
 SG_ FCODPB8P_FVLBTk8OfstAuth : 77|13@0- (0.003906,0) [-15.999|15.9951] "m" EOCM,EOCM_HCP1,EOCM_HCP2,HDLM
 SG_ FCODPB8P_FVLBTk8PstnTypAuth : 80|4@0+ (1,0) [0|12] "" EOCM,EOCM_HCP1,EOCM_HCP2,HDLM
 SG_ FCODPB8P_FVLBTk8TypAuth : 90|3@0+ (1,0) [0|7] "" EOCM,EOCM_HCP1,EOCM_HCP2,HDLM
 SG_ FCODPB8P_FVLBTk8QltyAuth : 92|2@0+ (1,0) [0|3] "" EOCM,EOCM_HCP1,EOCM_HCP2,HDLM
 SG_ FCODPB8P_FVLBTk8VSLgDistAuth : 96|7@0+ (1,0) [0|127] "m" EOCM,EOCM_HCP1,EOCM_HCP2,HDLM
 SG_ FCODPB8P_FVLBTk8VRLgDistAuth : 103|7@0+ (1,0) [0|127] "m" EOCM,EOCM_HCP1,EOCM_HCP2,HDLM
 SG_ FCODPB8P_FVLBTk8WdthAuth : 105|6@0+ (0.01,0) [0|0.63] "m" EOCM,EOCM_HCP1,EOCM_HCP2,HDLM
 SG_ FCODPB8P_FVVOTk8CICOPotAuth : 113|6@0+ (2,0) [0|126] "%" EOCM,EOCM_HCP1,EOCM_HCP2,HDLM
 SG_ FCODPB8P_FVVOTk8BrkLgtStsAuth : 115|2@0+ (1,0) [0|3] "" EOCM,EOCM_HCP1,EOCM_HCP2,HDLM
 SG_ FCODPB8P_FVVOTk8DynPrpAuth : 121|3@0+ (1,0) [0|6] "" EOCM,EOCM_HCP1,EOCM_HCP2,HDLM
 SG_ FCODPB8P_FVVOTk8CnfdStsAuth : 123|2@0+ (1,0) [0|3] "" EOCM,EOCM_HCP1,EOCM_HCP2,HDLM
 SG_ FCODPB8P_FVVOTk8HdgAngAuth : 133|11@0- (0.002,0) [-2.048|2.046] "rad" EOCM,EOCM_HCP1,EOCM_HCP2,HDLM
 SG_ FCODPB8P_FVVOTk8DynPrpStsAuth : 134|1@0+ (1,0) [0|1] "" EOCM,EOCM_HCP1,EOCM_HCP2,HDLM
 SG_ FCODPB8P_FVVOTk8HdgAngCAuth : 138|13@0- (0.002,0) [-8.192|8.19] "rad" EOCM,EOCM_HCP1,EOCM_HCP2,HDLM
 SG_ FCODPB8P_FVVOTk8IDAuth : 157|6@0+ (1,0) [0|63] "" EOCM,EOCM_HCP1,EOCM_HCP2,HDLM
 SG_ FCODPB8P_FVVOTk8PoILAAuth : 162|9@0- (0.125,0) [-32|31.875] "m/s^2" EOCM,EOCM_HCP1,EOCM_HCP2,HDLM
 SG_ FCODPB8P_FVVOTk8MStsAuth : 164|2@0+ (1,0) [0|3] "" EOCM,EOCM_HCP1,EOCM_HCP2,HDLM
 SG_ FCODPB8P_FVVOTk8LnAsmtAuth : 167|3@0+ (1,0) [0|5] "" EOCM,EOCM_HCP1,EOCM_HCP2,HDLM
 SG_ FCODPB8P_FVVOTk8PoILgAAuth : 169|9@0- (0.125,0) [-32|31.875] "m/s^2" EOCM,EOCM_HCP1,EOCM_HCP2,HDLM
 SG_ FCODPB8P_FVVOTk8PoILgPsAuth : 176|11@0+ (0.125,0) [0|255.875] "m" EOCM,EOCM_HCP1,EOCM_HCP2,HDLM
 SG_ FCODPB8P_FVVOTk8PoILgPsCAuth : 197|15@0+ (0.01,0) [0|327.67] "m^2" EOCM,EOCM_HCP1,EOCM_HCP2,HDLM
 SG_ FCODPB8P_FVVOTk8PoILgVAuth : 214|11@0- (0.125,0) [-128|127.875] "m/s" EOCM,EOCM_HCP1,EOCM_HCP2,HDLM
 SG_ FCODPB8P_FVVOTk8PoILgVCAuth : 219|10@0+ (0.125,0) [0|127.875] "(m/s)^2" EOCM,EOCM_HCP1,EOCM_HCP2,HDLM
 SG_ FCODPB8P_FVVOTk8PoILPsAuth : 225|10@0- (0.125,0) [-64|63.875] "m" EOCM,EOCM_HCP1,EOCM_HCP2,HDLM
 SG_ FCODPB8P_FVVOTk8PoILPsCAuth : 247|14@0+ (0.01,0) [0|163.83] "m^2" EOCM,EOCM_HCP1,EOCM_HCP2,HDLM
 SG_ FCODPB8P_FVVOTk8PoILVAuth : 249|9@0- (0.125,0) [-32|31.875] "m/s" EOCM,EOCM_HCP1,EOCM_HCP2,HDLM
 SG_ FCODPB8P_FVVOTk8PoILVCAuth : 256|10@0+ (0.125,0) [0|127.875] "(m/s)^2" EOCM,EOCM_HCP1,EOCM_HCP2,HDLM
 SG_ FCODPB8P_FVVOTk8PoIWAuth : 278|7@0+ (0.125,0) [0|15.875] "m" EOCM,EOCM_HCP1,EOCM_HCP2,HDLM
 SG_ FCODPB8P_FVVOTk9BrkLgtStsAuth : 280|2@0+ (1,0) [0|3] "" EOCM,EOCM_HCP1,EOCM_HCP2,HDLM
 SG_ FCODPB8P_FVVOTk8TypCnfdAuth : 282|2@0+ (1,0) [0|3] "" EOCM,EOCM_HCP1,EOCM_HCP2,HDLM
 SG_ FCODPB8P_FVVOTk8TypAuth : 284|2@0+ (1,0) [0|3] "" EOCM,EOCM_HCP1,EOCM_HCP2,HDLM
 SG_ FCODPB8P_FVVOTk8TSLgtStsAuth : 287|3@0+ (1,0) [0|4] "" EOCM,EOCM_HCP1,EOCM_HCP2,HDLM
 SG_ FCODPB8P_FVVOTk9CnfdStsAuth : 288|2@0+ (1,0) [0|3] "" EOCM,EOCM_HCP1,EOCM_HCP2,HDLM
 SG_ FCODPB8P_FVVOTk9CICOPotAuth : 294|6@0+ (2,0) [0|126] "%" EOCM,EOCM_HCP1,EOCM_HCP2,HDLM
 SG_ FCODPB8P_FVVOTk9HdgAngAuth : 298|11@0- (0.002,0) [-2.048|2.046] "rad" EOCM,EOCM_HCP1,EOCM_HCP2,HDLM
 SG_ FCODPB8P_FVVOTk9DynPrpStsAuth : 299|1@0+ (1,0) [0|1] "" EOCM,EOCM_HCP1,EOCM_HCP2,HDLM
 SG_ FCODPB8P_FVVOTk9DynPrpAuth : 302|3@0+ (1,0) [0|6] "" EOCM,EOCM_HCP1,EOCM_HCP2,HDLM
 SG_ FCODPB8P_FVVOTk9HdgAngCAuth : 319|13@0- (0.002,0) [-8.192|8.19] "rad" EOCM,EOCM_HCP1,EOCM_HCP2,HDLM
 SG_ FCODPB8P_FVVOTk9IDAuth : 322|6@0+ (1,0) [0|63] "" EOCM,EOCM_HCP1,EOCM_HCP2,HDLM
 SG_ FCODPB8P_FVVOTk9MStsAuth : 329|2@0+ (1,0) [0|3] "" EOCM,EOCM_HCP1,EOCM_HCP2,HDLM
 SG_ FCODPB8P_FVVOTk9LnAsmtAuth : 332|3@0+ (1,0) [0|5] "" EOCM,EOCM_HCP1,EOCM_HCP2,HDLM
 SG_ FCODPB8P_FVVOTk9PoILAAuth : 343|9@0- (0.125,0) [-32|31.875] "m/s^2" EOCM,EOCM_HCP1,EOCM_HCP2,HDLM
 SG_ FCODPB8P_FVVOTk9PoILgAAuth : 350|9@0- (0.125,0) [-32|31.875] "m/s^2" EOCM,EOCM_HCP1,EOCM_HCP2,HDLM
 SG_ FCODPB8P_FVVOTk9PoILgPsAuth : 357|11@0+ (0.125,0) [0|255.875] "m" EOCM,EOCM_HCP1,EOCM_HCP2,HDLM
 SG_ FCODPB8P_FVVOTk9PoILgPsCAuth : 362|15@0+ (0.01,0) [0|327.67] "m^2" EOCM,EOCM_HCP1,EOCM_HCP2,HDLM
 SG_ FCODPB8P_FVVOTk9PoILgVAuth : 379|11@0- (0.125,0) [-128|127.875] "m/s" EOCM,EOCM_HCP1,EOCM_HCP2,HDLM
 SG_ FCODPB8P_FVVOTk9PoILgVCAuth : 384|10@0+ (0.125,0) [0|127.875] "(m/s)^2" EOCM,EOCM_HCP1,EOCM_HCP2,HDLM
 SG_ FCODPB8P_FVVOTk9PoILPsAuth : 406|10@0- (0.125,0) [-64|63.875] "m" EOCM,EOCM_HCP1,EOCM_HCP2,HDLM
 SG_ FCODPB8P_FVVOTk9PoILPsCAuth : 412|14@0+ (0.01,0) [0|163.83] "m^2" EOCM,EOCM_HCP1,EOCM_HCP2,HDLM
 SG_ FCODPB8P_FVVOTk9PoILVAuth : 430|9@0- (0.125,0) [-32|31.875] "m/s" EOCM,EOCM_HCP1,EOCM_HCP2,HDLM
 SG_ FCODPB8P_FVVOTk9PoILVCAuth : 437|10@0+ (0.125,0) [0|127.875] "(m/s)^2" EOCM,EOCM_HCP1,EOCM_HCP2,HDLM
 SG_ FCODPB8P_FVVOTk9PoIWAuth : 443|7@0+ (0.125,0) [0|15.875] "m" EOCM,EOCM_HCP1,EOCM_HCP2,HDLM
 SG_ FCODPB8P_FVVOTk9TypAuth : 449|2@0+ (1,0) [0|3] "" EOCM,EOCM_HCP1,EOCM_HCP2,HDLM
 SG_ FCODPB8P_FVVOTk9TSLgtStsAuth : 452|3@0+ (1,0) [0|4] "" EOCM,EOCM_HCP1,EOCM_HCP2,HDLM
 SG_ FCODPB8P_FVVOTk9TypCnfdAuth : 463|2@0+ (1,0) [0|3] "" EOCM,EOCM_HCP1,EOCM_HCP2,HDLM

BO_ 225 C8_FCODP_Consecutive_Frame_Num11: 48 FCM_LC
 SG_ FCODPB9P_FVCIPthVehAlrtNwAuth : 0|1@0+ (1,0) [0|1] "" EOCM,EOCM_HCP1,EOCM_HCP2,HDLM
 SG_ FCODPB9P_FVCIPthVehAhdNwAuth : 1|1@0+ (1,0) [0|1] "" EOCM,EOCM_HCP1,EOCM_HCP2,HDLM
 SG_ FCODPB9P_FrwdDistIndDgrdAuth : 2|1@0+ (1,0) [0|1] "" EOCM,EOCM_HCP1,EOCM_HCP2,HDLM
 SG_ FCODPB9P_FrwdClsnAlrtDgrdAuth : 3|1@0+ (1,0) [0|1] "" EOCM,EOCM_HCP1,EOCM_HCP2,HDLM
 SG_ FCODPB9P_ClsnImntBrkgDgrdAuth : 4|1@0+ (1,0) [0|1] "" EOCM,EOCM_HCP1,EOCM_HCP2,HDLM
 SG_ FCODPB9P_AdpCruzCtlDgrdAuth : 5|1@0+ (1,0) [0|1] "" EOCM,EOCM_HCP1,EOCM_HCP2,HDLM
 SG_ FCODPB9P_BrstID : 7|2@0+ (1,0) [0|3] "" EOCM,EOCM_HCP1,EOCM_HCP2,HDLM
 SG_ FCODPB9P_FVL1DrivableCnfdAuth : 11|7@0+ (1,0) [0|127] "%" EOCM,EOCM_HCP1,EOCM_HCP2,HDLM
 SG_ FCODPB9P_FVHTPNtfyNwAuth : 12|1@0+ (1,0) [0|1] "" EOCM,EOCM_HCP1,EOCM_HCP2,HDLM
 SG_ FCODPB9P_FVHTPBrkNwAuth : 13|1@0+ (1,0) [0|1] "" EOCM,EOCM_HCP1,EOCM_HCP2,HDLM
 SG_ FCODPB9P_FVHTPAlrtNwAuth : 14|1@0+ (1,0) [0|1] "" EOCM,EOCM_HCP1,EOCM_HCP2,HDLM
 SG_ FCODPB9P_FVCIPthVehBrkNwAuth : 15|1@0+ (1,0) [0|1] "" EOCM,EOCM_HCP1,EOCM_HCP2,HDLM
 SG_ FCODPB9P_FVL2DrivableCnfdAuth : 20|7@0+ (1,0) [0|127] "%" EOCM,EOCM_HCP1,EOCM_HCP2,HDLM
 SG_ FCODPB9P_FVL3DrivableCnfdAuth : 29|7@0+ (1,0) [0|127] "%" EOCM,EOCM_HCP1,EOCM_HCP2,HDLM
 SG_ FCODPB9P_FVL4DrivableCnfdAuth : 38|7@0+ (1,0) [0|127] "%" EOCM,EOCM_HCP1,EOCM_HCP2,HDLM
 SG_ FCODPB9P_FVLFTk1FPCrvCoefAuth : 40|16@0- (9.77e-07,0) [-0.0320143|0.0320134] "1/m" EOCM,EOCM_HCP1,EOCM_HCP2,HDLM
 SG_ FCODPB9P_FVL5DrivableCnfdAuth : 47|7@0+ (1,0) [0|127] "%" EOCM,EOCM_HCP1,EOCM_HCP2,HDLM
 SG_ FCODPB9P_FVLFTk1FPCrvDrvtCAuth : 56|16@0- (3.73e-09,0) [-0.000122225|0.000122221] "1/m^2" EOCM,EOCM_HCP1,EOCM_HCP2,HDLM
 SG_ FCODPB9P_FVLFTk1FPHdgCoefAuth : 72|10@0- (0.000977,0) [-0.500224|0.499247] "rad" EOCM,EOCM_HCP1,EOCM_HCP2,HDLM
 SG_ FCODPB9P_FVLFTk1FPOfstCoefAuth : 94|12@0- (0.003906,0) [-7.99949|7.99558] "m" EOCM,EOCM_HCP1,EOCM_HCP2,HDLM
 SG_ FCODPB9P_FVLFTk1FPSegQltyAuth : 98|7@0+ (1,0) [0|127] "%" EOCM,EOCM_HCP1,EOCM_HCP2,HDLM
 SG_ FCODPB9P_FVLFTk1FPVRLgDistAuth : 107|7@0+ (1,0) [0|127] "m" EOCM,EOCM_HCP1,EOCM_HCP2,HDLM
 SG_ FCODPB9P_FVLFTk1FPVSLgDistAuth : 116|7@0+ (1,0) [0|127] "m" EOCM,EOCM_HCP1,EOCM_HCP2,HDLM
 SG_ FCODPB9P_FVLFTk2FPCrvCoefAuth : 123|16@0- (9.77e-07,0) [-0.0320143|0.0320134] "1/m" EOCM,EOCM_HCP1,EOCM_HCP2,HDLM
 SG_ FCODPB9P_FVLFTk1TypAuth : 125|2@0+ (1,0) [0|3] "" EOCM,EOCM_HCP1,EOCM_HCP2,HDLM
 SG_ FCODPB9P_FVLFTk2FPCrvDrvtCAuth : 139|16@0- (3.73e-09,0) [-0.000122225|0.000122221] "1/m^2" EOCM,EOCM_HCP1,EOCM_HCP2,HDLM
 SG_ FCODPB9P_FVLFTk2FPHdgCoefAuth : 155|10@0- (0.000977,0) [-0.500224|0.499247] "rad" EOCM,EOCM_HCP1,EOCM_HCP2,HDLM
 SG_ FCODPB9P_FVLFTk2FPOfstCoefAuth : 161|12@0- (0.003906,0) [-7.99949|7.99558] "m" EOCM,EOCM_HCP1,EOCM_HCP2,HDLM
 SG_ FCODPB9P_FVLFTk2FPSegQltyAuth : 181|7@0+ (1,0) [0|127] "%" EOCM,EOCM_HCP1,EOCM_HCP2,HDLM
 SG_ FCODPB9P_FVLFTk2FPVRLgDistAuth : 190|7@0+ (1,0) [0|127] "m" EOCM,EOCM_HCP1,EOCM_HCP2,HDLM
 SG_ FCODPB9P_FVLFTk2TypAuth : 192|2@0+ (1,0) [0|3] "" EOCM,EOCM_HCP1,EOCM_HCP2,HDLM
 SG_ FCODPB9P_FVLFTk2FPVSLgDistAuth : 199|7@0+ (1,0) [0|127] "m" EOCM,EOCM_HCP1,EOCM_HCP2,HDLM
 SG_ FCODPB9P_FVLFTk3FPCrvCoefAuth : 206|16@0- (9.77e-07,0) [-0.0320143|0.0320134] "1/m" EOCM,EOCM_HCP1,EOCM_HCP2,HDLM
 SG_ FCODPB9P_FVLFTk3FPCrvDrvtCAuth : 222|16@0- (3.73e-09,0) [-0.000122225|0.000122221] "1/m^2" EOCM,EOCM_HCP1,EOCM_HCP2,HDLM
 SG_ FCODPB9P_FVLFTk3FPHdgCoefAuth : 238|10@0- (0.000977,0) [-0.500224|0.499247] "rad" EOCM,EOCM_HCP1,EOCM_HCP2,HDLM
 SG_ FCODPB9P_FVLFTk3FPOfstCoefAuth : 244|12@0- (0.003906,0) [-7.99949|7.99558] "m" EOCM,EOCM_HCP1,EOCM_HCP2,HDLM
 SG_ FCODPB9P_FVLFTk3FPSegQltyAuth : 248|7@0+ (1,0) [0|127] "%" EOCM,EOCM_HCP1,EOCM_HCP2,HDLM
 SG_ FCODPB9P_FVLFTk3FPVRLgDistAuth : 257|7@0+ (1,0) [0|127] "m" EOCM,EOCM_HCP1,EOCM_HCP2,HDLM
 SG_ FCODPB9P_FVLFTk3FPVSLgDistAuth : 266|7@0+ (1,0) [0|127] "m" EOCM,EOCM_HCP1,EOCM_HCP2,HDLM
 SG_ FCODPB9P_FVLFTk4FPCrvCoefAuth : 273|16@0- (9.77e-07,0) [-0.0320143|0.0320134] "1/m" EOCM,EOCM_HCP1,EOCM_HCP2,HDLM
 SG_ FCODPB9P_FVLFTk3TypAuth : 275|2@0+ (1,0) [0|3] "" EOCM,EOCM_HCP1,EOCM_HCP2,HDLM
 SG_ FCODPB9P_FVLFTk4FPCrvDrvtCAuth : 289|16@0- (3.73e-09,0) [-0.000122225|0.000122221] "1/m^2" EOCM,EOCM_HCP1,EOCM_HCP2,HDLM
 SG_ FCODPB9P_FVLFTk4FPHdgCoefAuth : 305|10@0- (0.000977,0) [-0.500224|0.499247] "rad" EOCM,EOCM_HCP1,EOCM_HCP2,HDLM
 SG_ FCODPB9P_FVLFTk4FPOfstCoefAuth : 327|12@0- (0.003906,0) [-7.99949|7.99558] "m" EOCM,EOCM_HCP1,EOCM_HCP2,HDLM
 SG_ FCODPB9P_FVLFTk4FPSegQltyAuth : 331|7@0+ (1,0) [0|127] "%" EOCM,EOCM_HCP1,EOCM_HCP2,HDLM
 SG_ FCODPB9P_FVLFTk4FPVRLgDistAuth : 340|7@0+ (1,0) [0|127] "m" EOCM,EOCM_HCP1,EOCM_HCP2,HDLM
 SG_ FCODPB9P_FVLFTk4FPVSLgDistAuth : 349|7@0+ (1,0) [0|127] "m" EOCM,EOCM_HCP1,EOCM_HCP2,HDLM
 SG_ FCODPB9P_PedtrnClsnBrkgDgrdAuth : 352|1@0+ (1,0) [0|1] "" EOCM,EOCM_HCP1,EOCM_HCP2,HDLM
 SG_ FCODPB9P_PedtrnClsnAlrtDgrdAuth : 353|1@0+ (1,0) [0|1] "" EOCM,EOCM_HCP1,EOCM_HCP2,HDLM
 SG_ FCODPB9P_LnKeepAsstDgrdAuth : 354|1@0+ (1,0) [0|1] "" EOCM,EOCM_HCP1,EOCM_HCP2,HDLM
 SG_ FCODPB9P_LnCntrDgrdAuth : 355|1@0+ (1,0) [0|1] "" EOCM,EOCM_HCP1,EOCM_HCP2,HDLM
 SG_ FCODPB9P_IntsctClsnMtgnDgrdAuth : 356|1@0+ (1,0) [0|1] "" EOCM,EOCM_HCP1,EOCM_HCP2,HDLM
 SG_ FCODPB9P_FVLFTk4TypAuth : 358|2@0+ (1,0) [0|3] "" EOCM,EOCM_HCP1,EOCM_HCP2,HDLM
 SG_ FCODPB9P_PedtrnNtfnDgrdAuth : 367|1@0+ (1,0) [0|1] "" EOCM,EOCM_HCP1,EOCM_HCP2,HDLM

BO_ 226 C8_FCODP_Consecutive_Frame_Num12: 64 FCM_LC
 SG_ FCODPB10P_FVVOTk10PoI2LgPsAuth : 3|11@0+ (0.125,0) [0|255.875] "m" EOCM,EOCM_HCP1,EOCM_HCP2,HDLM
 SG_ FCODPB10P_FVVOTk10PoI1PsVisAuth : 5|2@0+ (1,0) [0|2] "" EOCM,EOCM_HCP1,EOCM_HCP2,HDLM
 SG_ FCODPB10P_BrstID : 7|2@0+ (1,0) [0|3] "" EOCM,EOCM_HCP1,EOCM_HCP2,HDLM
 SG_ FCODPB10P_FVVOTk10PoI2LPsAuth : 8|10@0+ (0.125,-64) [-64|63.875] "m" EOCM,EOCM_HCP1,EOCM_HCP2,HDLM
 SG_ FCODPB10P_FVVOTk10PoI3LgPsAuth : 28|11@0+ (0.125,0) [0|255.875] "m" EOCM,EOCM_HCP1,EOCM_HCP2,HDLM
 SG_ FCODPB10P_FVVOTk10PoI2PsVisAuth : 30|2@0+ (1,0) [0|2] "" EOCM,EOCM_HCP1,EOCM_HCP2,HDLM
 SG_ FCODPB10P_FVVOTk10PoI3LPsAuth : 33|10@0+ (0.125,-64) [-64|63.875] "m" EOCM,EOCM_HCP1,EOCM_HCP2,HDLM
 SG_ FCODPB10P_FVVOTk1PoI2LgPsAuth : 51|11@0+ (0.125,0) [0|255.875] "m" EOCM,EOCM_HCP1,EOCM_HCP2,HDLM
 SG_ FCODPB10P_FVVOTk1PoI1PsVisAuth : 53|2@0+ (1,0) [0|2] "" EOCM,EOCM_HCP1,EOCM_HCP2,HDLM
 SG_ FCODPB10P_FVVOTk10PoI3PsVisAuth : 55|2@0+ (1,0) [0|2] "" EOCM,EOCM_HCP1,EOCM_HCP2,HDLM
 SG_ FCODPB10P_FVVOTk1PoI2LPsAuth : 56|10@0+ (0.125,-64) [-64|63.875] "m" EOCM,EOCM_HCP1,EOCM_HCP2,HDLM
 SG_ FCODPB10P_FVVOTk1PoI3LgPsAuth : 76|11@0+ (0.125,0) [0|255.875] "m" EOCM,EOCM_HCP1,EOCM_HCP2,HDLM
 SG_ FCODPB10P_FVVOTk1PoI2PsVisAuth : 78|2@0+ (1,0) [0|2] "" EOCM,EOCM_HCP1,EOCM_HCP2,HDLM
 SG_ FCODPB10P_FVVOTk1PoI3LPsAuth : 81|10@0+ (0.125,-64) [-64|63.875] "m" EOCM,EOCM_HCP1,EOCM_HCP2,HDLM
 SG_ FCODPB10P_FVVOTk2PoI2LgPsAuth : 99|11@0+ (0.125,0) [0|255.875] "m" EOCM,EOCM_HCP1,EOCM_HCP2,HDLM
 SG_ FCODPB10P_FVVOTk2PoI1PsVisAuth : 101|2@0+ (1,0) [0|2] "" EOCM,EOCM_HCP1,EOCM_HCP2,HDLM
 SG_ FCODPB10P_FVVOTk1PoI3PsVisAuth : 103|2@0+ (1,0) [0|2] "" EOCM,EOCM_HCP1,EOCM_HCP2,HDLM
 SG_ FCODPB10P_FVVOTk2PoI2LPsAuth : 104|10@0+ (0.125,-64) [-64|63.875] "m" EOCM,EOCM_HCP1,EOCM_HCP2,HDLM
 SG_ FCODPB10P_FVVOTk2PoI3LgPsAuth : 124|11@0+ (0.125,0) [0|255.875] "m" EOCM,EOCM_HCP1,EOCM_HCP2,HDLM
 SG_ FCODPB10P_FVVOTk2PoI2PsVisAuth : 126|2@0+ (1,0) [0|2] "" EOCM,EOCM_HCP1,EOCM_HCP2,HDLM
 SG_ FCODPB10P_FVVOTk2PoI3LPsAuth : 129|10@0+ (0.125,-64) [-64|63.875] "m" EOCM,EOCM_HCP1,EOCM_HCP2,HDLM
 SG_ FCODPB10P_FVVOTk3PoI2LgPsAuth : 147|11@0+ (0.125,0) [0|255.875] "m" EOCM,EOCM_HCP1,EOCM_HCP2,HDLM
 SG_ FCODPB10P_FVVOTk3PoI1PsVisAuth : 149|2@0+ (1,0) [0|2] "" EOCM,EOCM_HCP1,EOCM_HCP2,HDLM
 SG_ FCODPB10P_FVVOTk2PoI3PsVisAuth : 151|2@0+ (1,0) [0|2] "" EOCM,EOCM_HCP1,EOCM_HCP2,HDLM
 SG_ FCODPB10P_FVVOTk3PoI2LPsAuth : 152|10@0+ (0.125,-64) [-64|63.875] "m" EOCM,EOCM_HCP1,EOCM_HCP2,HDLM
 SG_ FCODPB10P_FVVOTk3PoI3LgPsAuth : 172|11@0+ (0.125,0) [0|255.875] "m" EOCM,EOCM_HCP1,EOCM_HCP2,HDLM
 SG_ FCODPB10P_FVVOTk3PoI2PsVisAuth : 174|2@0+ (1,0) [0|2] "" EOCM,EOCM_HCP1,EOCM_HCP2,HDLM
 SG_ FCODPB10P_FVVOTk3PoI3LPsAuth : 177|10@0+ (0.125,-64) [-64|63.875] "m" EOCM,EOCM_HCP1,EOCM_HCP2,HDLM
 SG_ FCODPB10P_FVVOTk4PoI2LgPsAuth : 195|11@0+ (0.125,0) [0|255.875] "m" EOCM,EOCM_HCP1,EOCM_HCP2,HDLM
 SG_ FCODPB10P_FVVOTk4PoI1PsVisAuth : 197|2@0+ (1,0) [0|2] "" EOCM,EOCM_HCP1,EOCM_HCP2,HDLM
 SG_ FCODPB10P_FVVOTk3PoI3PsVisAuth : 199|2@0+ (1,0) [0|2] "" EOCM,EOCM_HCP1,EOCM_HCP2,HDLM
 SG_ FCODPB10P_FVVOTk4PoI2LPsAuth : 200|10@0+ (0.125,-64) [-64|63.875] "m" EOCM,EOCM_HCP1,EOCM_HCP2,HDLM
 SG_ FCODPB10P_FVVOTk4PoI3LgPsAuth : 220|11@0+ (0.125,0) [0|255.875] "m" EOCM,EOCM_HCP1,EOCM_HCP2,HDLM
 SG_ FCODPB10P_FVVOTk4PoI2PsVisAuth : 222|2@0+ (1,0) [0|2] "" EOCM,EOCM_HCP1,EOCM_HCP2,HDLM
 SG_ FCODPB10P_FVVOTk4PoI3LPsAuth : 225|10@0+ (0.125,-64) [-64|63.875] "m" EOCM,EOCM_HCP1,EOCM_HCP2,HDLM
 SG_ FCODPB10P_FVVOTk5PoI2LgPsAuth : 243|11@0+ (0.125,0) [0|255.875] "m" EOCM,EOCM_HCP1,EOCM_HCP2,HDLM
 SG_ FCODPB10P_FVVOTk5PoI1PsVisAuth : 245|2@0+ (1,0) [0|2] "" EOCM,EOCM_HCP1,EOCM_HCP2,HDLM
 SG_ FCODPB10P_FVVOTk4PoI3PsVisAuth : 247|2@0+ (1,0) [0|2] "" EOCM,EOCM_HCP1,EOCM_HCP2,HDLM
 SG_ FCODPB10P_FVVOTk5PoI2LPsAuth : 248|10@0+ (0.125,-64) [-64|63.875] "m" EOCM,EOCM_HCP1,EOCM_HCP2,HDLM
 SG_ FCODPB10P_FVVOTk5PoI3LgPsAuth : 268|11@0+ (0.125,0) [0|255.875] "m" EOCM,EOCM_HCP1,EOCM_HCP2,HDLM
 SG_ FCODPB10P_FVVOTk5PoI2PsVisAuth : 270|2@0+ (1,0) [0|2] "" EOCM,EOCM_HCP1,EOCM_HCP2,HDLM
 SG_ FCODPB10P_FVVOTk5PoI3LPsAuth : 273|10@0+ (0.125,-64) [-64|63.875] "m" EOCM,EOCM_HCP1,EOCM_HCP2,HDLM
 SG_ FCODPB10P_FVVOTk6PoI2LgPsAuth : 291|11@0+ (0.125,0) [0|255.875] "m" EOCM,EOCM_HCP1,EOCM_HCP2,HDLM
 SG_ FCODPB10P_FVVOTk6PoI1PsVisAuth : 293|2@0+ (1,0) [0|2] "" EOCM,EOCM_HCP1,EOCM_HCP2,HDLM
 SG_ FCODPB10P_FVVOTk5PoI3PsVisAuth : 295|2@0+ (1,0) [0|2] "" EOCM,EOCM_HCP1,EOCM_HCP2,HDLM
 SG_ FCODPB10P_FVVOTk6PoI2LPsAuth : 296|10@0+ (0.125,-64) [-64|63.875] "m" EOCM,EOCM_HCP1,EOCM_HCP2,HDLM
 SG_ FCODPB10P_FVVOTk6PoI3LgPsAuth : 316|11@0+ (0.125,0) [0|255.875] "m" EOCM,EOCM_HCP1,EOCM_HCP2,HDLM
 SG_ FCODPB10P_FVVOTk6PoI2PsVisAuth : 318|2@0+ (1,0) [0|2] "" EOCM,EOCM_HCP1,EOCM_HCP2,HDLM
 SG_ FCODPB10P_FVVOTk6PoI3LPsAuth : 321|10@0+ (0.125,-64) [-64|63.875] "m" EOCM,EOCM_HCP1,EOCM_HCP2,HDLM
 SG_ FCODPB10P_FVVOTk7PoI2LgPsAuth : 339|11@0+ (0.125,0) [0|255.875] "m" EOCM,EOCM_HCP1,EOCM_HCP2,HDLM
 SG_ FCODPB10P_FVVOTk7PoI1PsVisAuth : 341|2@0+ (1,0) [0|2] "" EOCM,EOCM_HCP1,EOCM_HCP2,HDLM
 SG_ FCODPB10P_FVVOTk6PoI3PsVisAuth : 343|2@0+ (1,0) [0|2] "" EOCM,EOCM_HCP1,EOCM_HCP2,HDLM
 SG_ FCODPB10P_FVVOTk7PoI2LPsAuth : 344|10@0+ (0.125,-64) [-64|63.875] "m" EOCM,EOCM_HCP1,EOCM_HCP2,HDLM
 SG_ FCODPB10P_FVVOTk7PoI3LgPsAuth : 364|11@0+ (0.125,0) [0|255.875] "m" EOCM,EOCM_HCP1,EOCM_HCP2,HDLM
 SG_ FCODPB10P_FVVOTk7PoI2PsVisAuth : 366|2@0+ (1,0) [0|2] "" EOCM,EOCM_HCP1,EOCM_HCP2,HDLM
 SG_ FCODPB10P_FVVOTk7PoI3LPsAuth : 369|10@0+ (0.125,-64) [-64|63.875] "m" EOCM,EOCM_HCP1,EOCM_HCP2,HDLM
 SG_ FCODPB10P_FVVOTk8PoI2LgPsAuth : 387|11@0+ (0.125,0) [0|255.875] "m" EOCM,EOCM_HCP1,EOCM_HCP2,HDLM
 SG_ FCODPB10P_FVVOTk8PoI1PsVisAuth : 389|2@0+ (1,0) [0|2] "" EOCM,EOCM_HCP1,EOCM_HCP2,HDLM
 SG_ FCODPB10P_FVVOTk7PoI3PsVisAuth : 391|2@0+ (1,0) [0|2] "" EOCM,EOCM_HCP1,EOCM_HCP2,HDLM
 SG_ FCODPB10P_FVVOTk8PoI2LPsAuth : 392|10@0+ (0.125,-64) [-64|63.875] "m" EOCM,EOCM_HCP1,EOCM_HCP2,HDLM
 SG_ FCODPB10P_FVVOTk8PoI3LgPsAuth : 412|11@0+ (0.125,0) [0|255.875] "m" EOCM,EOCM_HCP1,EOCM_HCP2,HDLM
 SG_ FCODPB10P_FVVOTk8PoI2PsVisAuth : 414|2@0+ (1,0) [0|2] "" EOCM,EOCM_HCP1,EOCM_HCP2,HDLM
 SG_ FCODPB10P_FVVOTk8PoI3LPsAuth : 417|10@0+ (0.125,-64) [-64|63.875] "m" EOCM,EOCM_HCP1,EOCM_HCP2,HDLM
 SG_ FCODPB10P_FVVOTk9PoI2LgPsAuth : 435|11@0+ (0.125,0) [0|255.875] "m" EOCM,EOCM_HCP1,EOCM_HCP2,HDLM
 SG_ FCODPB10P_FVVOTk9PoI1PsVisAuth : 437|2@0+ (1,0) [0|2] "" EOCM,EOCM_HCP1,EOCM_HCP2,HDLM
 SG_ FCODPB10P_FVVOTk8PoI3PsVisAuth : 439|2@0+ (1,0) [0|2] "" EOCM,EOCM_HCP1,EOCM_HCP2,HDLM
 SG_ FCODPB10P_FVVOTk9PoI2LPsAuth : 440|10@0+ (0.125,-64) [-64|63.875] "m" EOCM,EOCM_HCP1,EOCM_HCP2,HDLM
 SG_ FCODPB10P_FVVOTk9PoI3LgPsAuth : 460|11@0+ (0.125,0) [0|255.875] "m" EOCM,EOCM_HCP1,EOCM_HCP2,HDLM
 SG_ FCODPB10P_FVVOTk9PoI2PsVisAuth : 462|2@0+ (1,0) [0|2] "" EOCM,EOCM_HCP1,EOCM_HCP2,HDLM
 SG_ FCODPB10P_FVVOTk9PoI3LPsAuth : 465|10@0+ (0.125,-64) [-64|63.875] "m" EOCM,EOCM_HCP1,EOCM_HCP2,HDLM
 SG_ FCODPB10P_FVVOTk9PoI3PsVisAuth : 487|2@0+ (1,0) [0|2] "" EOCM,EOCM_HCP1,EOCM_HCP2,HDLM

BO_ 142 C8_FCODP_First_Frame_PDU: 64 FCM_LC
 SG_ FCODPB1P_MAC : 7|32@0+ (1,0) [0|4.29497e+009] "" EOCM,EOCM_HCP1,EOCM_HCP2,HDLM
 SG_ FCODPB1P_FCnt : 39|5@0+ (1,0) [0|31] "" EOCM,EOCM_HCP1,EOCM_HCP2,HDLM
 SG_ FCODPB1P_FVLBTk1CrvAuth : 43|16@0- (9.77e-07,0) [-0.0320143|0.0320134] "1/m" EOCM,EOCM_HCP1,EOCM_HCP2,HDLM
 SG_ FCODPB1P_FVLBTk1ClrAuth : 45|2@0+ (1,0) [0|3] "" EOCM,EOCM_HCP1,EOCM_HCP2,HDLM
 SG_ FCODPB1P_BrstID : 47|2@0+ (1,0) [0|3] "" EOCM,EOCM_HCP1,EOCM_HCP2,HDLM
 SG_ FCODPB1P_FVLBTk1CrvDrvtAuth : 59|16@0- (3.73e-09,0) [-0.000122225|0.000122221] "1/m^2" EOCM,EOCM_HCP1,EOCM_HCP2,HDLM
 SG_ FCODPB1P_FVLBTk1FPSABCQOvrAuth : 75|7@0+ (1,0) [0|127] "%" EOCM,EOCM_HCP1,EOCM_HCP2,HDLM
 SG_ FCODPB1P_FVLBTk1FPSAQAuth : 84|7@0+ (1,0) [0|127] "%" EOCM,EOCM_HCP1,EOCM_HCP2,HDLM
 SG_ FCODPB1P_FVLBTk1FPSBQAuth : 93|7@0+ (1,0) [0|127] "%" EOCM,EOCM_HCP1,EOCM_HCP2,HDLM
 SG_ FCODPB1P_FVLBTk1FPSCQAuth : 102|7@0+ (1,0) [0|127] "%" EOCM,EOCM_HCP1,EOCM_HCP2,HDLM
 SG_ FCODPB1P_FVLBTk1HdgAuth : 111|10@0- (0.000977,0) [-0.500224|0.499247] "" EOCM,EOCM_HCP1,EOCM_HCP2,HDLM
 SG_ FCODPB1P_FVLBTk1OfstAuth : 117|13@0- (0.003906,0) [-15.999|15.9951] "m" EOCM,EOCM_HCP1,EOCM_HCP2,HDLM
 SG_ FCODPB1P_FVLBTk1PstnTypAuth : 120|4@0+ (1,0) [0|12] "" EOCM,EOCM_HCP1,EOCM_HCP2,HDLM
 SG_ FCODPB1P_FVLBTk1TypAuth : 130|3@0+ (1,0) [0|7] "" EOCM,EOCM_HCP1,EOCM_HCP2,HDLM
 SG_ FCODPB1P_FVLBTk1QltyAuth : 132|2@0+ (1,0) [0|3] "" EOCM,EOCM_HCP1,EOCM_HCP2,HDLM
 SG_ FCODPB1P_FVLBTk1VSLgDistAuth : 136|7@0+ (1,0) [0|127] "m" EOCM,EOCM_HCP1,EOCM_HCP2,HDLM
 SG_ FCODPB1P_FVLBTk1VRLgDistAuth : 143|7@0+ (1,0) [0|127] "m" EOCM,EOCM_HCP1,EOCM_HCP2,HDLM
 SG_ FCODPB1P_FVLBTk1WdthAuth : 145|6@0+ (0.01,0) [0|0.63] "m" EOCM,EOCM_HCP1,EOCM_HCP2,HDLM
 SG_ FCODPB1P_FVPOTk1DynPrpAuth : 153|3@0+ (1,0) [0|4] "" EOCM,EOCM_HCP1,EOCM_HCP2,HDLM
 SG_ FCODPB1P_FVPOTk1CnfdStsAuth : 155|2@0+ (1,0) [0|3] "" EOCM,EOCM_HCP1,EOCM_HCP2,HDLM
 SG_ FCODPB1P_FVPOTk1InPthPotAuth : 160|6@0+ (2,0) [0|126] "%" EOCM,EOCM_HCP1,EOCM_HCP2,HDLM
 SG_ FCODPB1P_FVPOTk1IDAuth : 166|6@0+ (1,0) [0|63] "" EOCM,EOCM_HCP1,EOCM_HCP2,HDLM
 SG_ FCODPB1P_FVPOTk1PoILAAuth : 168|9@0- (0.125,0) [-32|31.875] "m/s^2" EOCM,EOCM_HCP1,EOCM_HCP2,HDLM
 SG_ FCODPB1P_FVPOTk1MStsAuth : 170|2@0+ (1,0) [0|3] "" EOCM,EOCM_HCP1,EOCM_HCP2,HDLM
 SG_ FCODPB1P_FVPOTk1PoILgAAuth : 191|9@0- (0.125,0) [-32|31.875] "m/s^2" EOCM,EOCM_HCP1,EOCM_HCP2,HDLM
 SG_ FCODPB1P_FVPOTk1PoILgPsAuth : 198|11@0+ (0.125,0) [0|255.875] "m" EOCM,EOCM_HCP1,EOCM_HCP2,HDLM
 SG_ FCODPB1P_FVPOTk1PoILgVAuth : 203|10@0- (0.125,0) [-64|63.875] "m/s" EOCM,EOCM_HCP1,EOCM_HCP2,HDLM
 SG_ FCODPB1P_FVPOTk1PoILPsAuth : 209|10@0- (0.125,0) [-64|63.875] "m" EOCM,EOCM_HCP1,EOCM_HCP2,HDLM
 SG_ FCODPB1P_FVPOTk1PoILVAuth : 231|9@0- (0.125,0) [-32|31.875] "m/s" EOCM,EOCM_HCP1,EOCM_HCP2,HDLM
 SG_ FCODPB1P_FVVOTk1CICOPotAuth : 232|6@0+ (2,0) [0|126] "%" EOCM,EOCM_HCP1,EOCM_HCP2,HDLM
 SG_ FCODPB1P_FVVOTk1BrkLgtStsAuth : 234|2@0+ (1,0) [0|3] "" EOCM,EOCM_HCP1,EOCM_HCP2,HDLM
 SG_ FCODPB1P_FVPOTk1TypCnfdAuth : 236|2@0+ (1,0) [0|3] "" EOCM,EOCM_HCP1,EOCM_HCP2,HDLM
 SG_ FCODPB1P_FVPOTk1TypAuth : 238|2@0+ (1,0) [0|2] "" EOCM,EOCM_HCP1,EOCM_HCP2,HDLM
 SG_ FCODPB1P_FVVOTk1DynPrpAuth : 240|3@0+ (1,0) [0|6] "" EOCM,EOCM_HCP1,EOCM_HCP2,HDLM
 SG_ FCODPB1P_FVVOTk1CnfdStsAuth : 242|2@0+ (1,0) [0|3] "" EOCM,EOCM_HCP1,EOCM_HCP2,HDLM
 SG_ FCODPB1P_FVVOTk1HdgAngAuth : 252|11@0- (0.002,0) [-2.048|2.046] "rad" EOCM,EOCM_HCP1,EOCM_HCP2,HDLM
 SG_ FCODPB1P_FVVOTk1DynPrpStsAuth : 253|1@0+ (1,0) [0|1] "" EOCM,EOCM_HCP1,EOCM_HCP2,HDLM
 SG_ FCODPB1P_FVVOTk1HdgAngCAuth : 257|13@0- (0.002,0) [-8.192|8.19] "rad" EOCM,EOCM_HCP1,EOCM_HCP2,HDLM
 SG_ FCODPB1P_FVVOTk1IDAuth : 276|6@0+ (1,0) [0|63] "" EOCM,EOCM_HCP1,EOCM_HCP2,HDLM
 SG_ FCODPB1P_FVVOTk1PoILAAuth : 281|9@0- (0.125,0) [-32|31.875] "m/s^2" EOCM,EOCM_HCP1,EOCM_HCP2,HDLM
 SG_ FCODPB1P_FVVOTk1MStsAuth : 283|2@0+ (1,0) [0|3] "" EOCM,EOCM_HCP1,EOCM_HCP2,HDLM
 SG_ FCODPB1P_FVVOTk1LnAsmtAuth : 286|3@0+ (1,0) [0|5] "" EOCM,EOCM_HCP1,EOCM_HCP2,HDLM
 SG_ FCODPB1P_FVVOTk1PoILgAAuth : 288|9@0- (0.125,0) [-32|31.875] "m/s^2" EOCM,EOCM_HCP1,EOCM_HCP2,HDLM
 SG_ FCODPB1P_FVVOTk1PoILgPsAuth : 311|11@0+ (0.125,0) [0|255.875] "m" EOCM,EOCM_HCP1,EOCM_HCP2,HDLM
 SG_ FCODPB1P_FVVOTk1PoILgPsCAuth : 316|15@0+ (0.01,0) [0|327.67] "m^2" EOCM,EOCM_HCP1,EOCM_HCP2,HDLM
 SG_ FCODPB1P_FVVOTk1PoILgVAuth : 333|11@0- (0.125,0) [-128|127.875] "m/s" EOCM,EOCM_HCP1,EOCM_HCP2,HDLM
 SG_ FCODPB1P_FVVOTk1PoILgVCAuth : 338|10@0+ (0.125,0) [0|127.875] "(m/s)^2" EOCM,EOCM_HCP1,EOCM_HCP2,HDLM
 SG_ FCODPB1P_FVVOTk1PoILPsAuth : 344|10@0- (0.125,0) [-64|63.875] "m" EOCM,EOCM_HCP1,EOCM_HCP2,HDLM
 SG_ FCODPB1P_FVVOTk1PoILPsCAuth : 366|14@0+ (0.01,0) [0|163.83] "m^2" EOCM,EOCM_HCP1,EOCM_HCP2,HDLM
 SG_ FCODPB1P_FVVOTk1PoILVAuth : 368|9@0- (0.125,0) [-32|31.875] "m/s" EOCM,EOCM_HCP1,EOCM_HCP2,HDLM
 SG_ FCODPB1P_FVVOTk1PoILVCAuth : 391|10@0+ (0.125,0) [0|127.875] "(m/s)^2" EOCM,EOCM_HCP1,EOCM_HCP2,HDLM
 SG_ FCODPB1P_FVVOTk1PoIWAuth : 397|7@0+ (0.125,0) [0|15.875] "m" EOCM,EOCM_HCP1,EOCM_HCP2,HDLM
 SG_ FCODPB1P_FVVOTk1TypCnfdAuth : 401|2@0+ (1,0) [0|3] "" EOCM,EOCM_HCP1,EOCM_HCP2,HDLM
 SG_ FCODPB1P_FVVOTk1TypAuth : 403|2@0+ (1,0) [0|3] "" EOCM,EOCM_HCP1,EOCM_HCP2,HDLM
 SG_ FCODPB1P_FVVOTk1TSLgtStsAuth : 406|3@0+ (1,0) [0|4] "" EOCM,EOCM_HCP1,EOCM_HCP2,HDLM
 SG_ FCODPB1P_FVVOTk10VehLnCrsTmAuth : 413|9@0- (0.05,0) [-12.8|12.75] "s" EOCM,EOCM_HCP1,EOCM_HCP2,HDLM
 SG_ FCODPB1P_ARC : 415|2@0+ (1,0) [0|3] "" EOCM,EOCM_HCP1,EOCM_HCP2,HDLM
 SG_ FCODPB1P_FVVOTk1VehLnCrsTmAuth : 420|9@0- (0.05,0) [-12.8|12.75] "s" EOCM,EOCM_HCP1,EOCM_HCP2,HDLM
 SG_ FCODPB1P_FVVOTk2VehLnCrsTmAuth : 427|9@0- (0.05,0) [-12.8|12.75] "s" EOCM,EOCM_HCP1,EOCM_HCP2,HDLM
 SG_ FCODPB1P_FVVOTk3VehLnCrsTmAuth : 434|9@0- (0.05,0) [-12.8|12.75] "s" EOCM,EOCM_HCP1,EOCM_HCP2,HDLM
 SG_ FCODPB1P_FVVOTk4VehLnCrsTmAuth : 441|9@0- (0.05,0) [-12.8|12.75] "s" EOCM,EOCM_HCP1,EOCM_HCP2,HDLM
 SG_ FCODPB1P_FVVOTk5VehLnCrsTmAuth : 448|9@0- (0.05,0) [-12.8|12.75] "s" EOCM,EOCM_HCP1,EOCM_HCP2,HDLM
 SG_ FCODPB1P_FVVOTk6VehLnCrsTmAuth : 471|9@0- (0.05,0) [-12.8|12.75] "s" EOCM,EOCM_HCP1,EOCM_HCP2,HDLM
 SG_ FCODPB1P_FVVOTk7VehLnCrsTmAuth : 478|9@0- (0.05,0) [-12.8|12.75] "s" EOCM,EOCM_HCP1,EOCM_HCP2,HDLM
 SG_ FCODPB1P_FVVOTk8VehLnCrsTmAuth : 485|9@0- (0.05,0) [-12.8|12.75] "s" EOCM,EOCM_HCP1,EOCM_HCP2,HDLM
 SG_ FCODPB1P_FVVOTk9VehLnCrsTmAuth : 492|9@0- (0.05,0) [-12.8|12.75] "s" EOCM,EOCM_HCP1,EOCM_HCP2,HDLM

BO_ 239 C8_FCODP_Last_Frame_PDU: 20 FCM_LC
 SG_ FCODPB15P_CnstrObj10LngDistAuth : 5|10@0+ (0.125,0) [0|127.875] "m" EOCM,EOCM_HCP1,EOCM_HCP2,HDLM
 SG_ FCODPB15P_BrstID : 7|2@0+ (1,0) [0|3] "" EOCM,EOCM_HCP1,EOCM_HCP2,HDLM
 SG_ FCODPB15P_CnstrObj11LngDistAuth : 11|10@0+ (0.125,0) [0|127.875] "m" EOCM,EOCM_HCP1,EOCM_HCP2,HDLM
 SG_ FCODPB15P_CnstrObj12LngDistAuth : 17|10@0+ (0.125,0) [0|127.875] "m" EOCM,EOCM_HCP1,EOCM_HCP2,HDLM
 SG_ FCODPB15P_CnstrObj13LngDistAuth : 39|10@0+ (0.125,0) [0|127.875] "m" EOCM,EOCM_HCP1,EOCM_HCP2,HDLM
 SG_ FCODPB15P_CnstrObj14LngDistAuth : 45|10@0+ (0.125,0) [0|127.875] "m" EOCM,EOCM_HCP1,EOCM_HCP2,HDLM
 SG_ FCODPB15P_CnstrObj15LngDistAuth : 51|10@0+ (0.125,0) [0|127.875] "m" EOCM,EOCM_HCP1,EOCM_HCP2,HDLM
 SG_ FCODPB15P_CnstrObj1LngDistAuth : 57|10@0+ (0.125,0) [0|127.875] "m" EOCM,EOCM_HCP1,EOCM_HCP2,HDLM
 SG_ FCODPB15P_CnstrObj2LngDistAuth : 79|10@0+ (0.125,0) [0|127.875] "m" EOCM,EOCM_HCP1,EOCM_HCP2,HDLM
 SG_ FCODPB15P_CnstrObj3LngDistAuth : 85|10@0+ (0.125,0) [0|127.875] "m" EOCM,EOCM_HCP1,EOCM_HCP2,HDLM
 SG_ FCODPB15P_CnstrObj4LngDistAuth : 91|10@0+ (0.125,0) [0|127.875] "m" EOCM,EOCM_HCP1,EOCM_HCP2,HDLM
 SG_ FCODPB15P_CnstrObj5LngDistAuth : 97|10@0+ (0.125,0) [0|127.875] "m" EOCM,EOCM_HCP1,EOCM_HCP2,HDLM
 SG_ FCODPB15P_CnstrObj6LngDistAuth : 119|10@0+ (0.125,0) [0|127.875] "m" EOCM,EOCM_HCP1,EOCM_HCP2,HDLM
 SG_ FCODPB15P_CnstrObj7LngDistAuth : 125|10@0+ (0.125,0) [0|127.875] "m" EOCM,EOCM_HCP1,EOCM_HCP2,HDLM
 SG_ FCODPB15P_CnstrObj8LngDistAuth : 131|10@0+ (0.125,0) [0|127.875] "m" EOCM,EOCM_HCP1,EOCM_HCP2,HDLM
 SG_ FCODPB15P_CnstrObj9LngDistAuth : 137|10@0+ (0.125,0) [0|127.875] "m" EOCM,EOCM_HCP1,EOCM_HCP2,HDLM

BO_ 153 C8_LRRODP_Consecutive_Frame_Numb: 64 LRR
 SG_ LRRODPB2P_POTk2IDAuth : 0|7@0+ (1,0) [0|127] "" EOCM,EOCM_HCP1,EOCM_HCP2
 SG_ LRRODPB2P_POTk2DynPrpAuth : 3|3@0+ (1,0) [0|4] "" EOCM,EOCM_HCP1,EOCM_HCP2
 SG_ LRRODPB2P_POTk2CnfdStsAuth : 5|2@0+ (1,0) [0|3] "" EOCM,EOCM_HCP1,EOCM_HCP2
 SG_ LRRODPB2P_BrstID : 7|2@0+ (1,0) [0|3] "" EOCM,EOCM_HCP1,EOCM_HCP2
 SG_ LRRODPB2P_POTk2InPthPotAuth : 9|6@0+ (2,0) [0|126] "%" EOCM,EOCM_HCP1,EOCM_HCP2
 SG_ LRRODPB2P_POTk2PoILAAuth : 17|9@0- (0.125,0) [-32|31.875] "m/s^2" EOCM,EOCM_HCP1,EOCM_HCP2
 SG_ LRRODPB2P_POTk2MStsAuth : 19|2@0+ (1,0) [0|3] "" EOCM,EOCM_HCP1,EOCM_HCP2
 SG_ LRRODPB2P_POTk2PoILgAAuth : 24|9@0- (0.125,0) [-32|31.875] "m/s^2" EOCM,EOCM_HCP1,EOCM_HCP2
 SG_ LRRODPB2P_POTk2PoILgPsAuth : 47|11@0+ (0.125,0) [0|255.875] "m" EOCM,EOCM_HCP1,EOCM_HCP2
 SG_ LRRODPB2P_POTk2PoILgVAuth : 52|10@0- (0.125,0) [-64|63.875] "m/s" EOCM,EOCM_HCP1,EOCM_HCP2
 SG_ LRRODPB2P_POTk2PoILPsAuth : 58|10@0- (0.125,0) [-64|63.875] "m" EOCM,EOCM_HCP1,EOCM_HCP2
 SG_ LRRODPB2P_POTk2PoILVAuth : 64|9@0- (0.125,0) [-32|31.875] "m/s" EOCM,EOCM_HCP1,EOCM_HCP2
 SG_ LRRODPB2P_VOTk3CICOPotAuth : 83|6@0+ (2,0) [0|126] "%" EOCM,EOCM_HCP1,EOCM_HCP2
 SG_ LRRODPB2P_POTk2TypCnfdAuth : 85|2@0+ (1,0) [0|3] "" EOCM,EOCM_HCP1,EOCM_HCP2
 SG_ LRRODPB2P_POTk2TypAuth : 87|2@0+ (1,0) [0|2] "" EOCM,EOCM_HCP1,EOCM_HCP2
 SG_ LRRODPB2P_VOTk3DynPrpStsAuth : 88|1@0+ (1,0) [0|1] "" EOCM,EOCM_HCP1,EOCM_HCP2
 SG_ LRRODPB2P_VOTk3DynPrpAuth : 91|3@0+ (1,0) [0|4] "" EOCM,EOCM_HCP1,EOCM_HCP2
 SG_ LRRODPB2P_VOTk3CnfdStsAuth : 93|2@0+ (1,0) [0|3] "" EOCM,EOCM_HCP1,EOCM_HCP2
 SG_ LRRODPB2P_VOTk3MStsAuth : 96|2@0+ (1,0) [0|3] "" EOCM,EOCM_HCP1,EOCM_HCP2
 SG_ LRRODPB2P_VOTk3IDAuth : 103|7@0+ (1,0) [0|127] "" EOCM,EOCM_HCP1,EOCM_HCP2
 SG_ LRRODPB2P_VOTk3PoILAAuth : 110|9@0- (0.125,0) [-32|31.875] "m/s^2" EOCM,EOCM_HCP1,EOCM_HCP2
 SG_ LRRODPB2P_VOTk3PoILgAAuth : 117|9@0- (0.125,0) [-32|31.875] "m/s^2" EOCM,EOCM_HCP1,EOCM_HCP2
 SG_ LRRODPB2P_VOTk3PoILgPsAuth : 124|11@0+ (0.125,0) [0|255.875] "m" EOCM,EOCM_HCP1,EOCM_HCP2
 SG_ LRRODPB2P_VOTk3PoILgPsCAuth : 129|15@0+ (0.01,0) [0|327.67] "m^2" EOCM,EOCM_HCP1,EOCM_HCP2
 SG_ LRRODPB2P_VOTk3PoILgthAuth : 146|11@0+ (0.125,0) [0|255.875] "m" EOCM,EOCM_HCP1,EOCM_HCP2
 SG_ LRRODPB2P_VOTk3PoILgVAuth : 167|11@0- (0.125,0) [-128|127.875] "m/s" EOCM,EOCM_HCP1,EOCM_HCP2
 SG_ LRRODPB2P_VOTk3PoILgVCAuth : 172|10@0+ (0.125,0) [0|127.875] "(m/s)^2" EOCM,EOCM_HCP1,EOCM_HCP2
 SG_ LRRODPB2P_VOTk3PoILPsAuth : 178|10@0- (0.125,0) [-64|63.875] "m" EOCM,EOCM_HCP1,EOCM_HCP2
 SG_ LRRODPB2P_VOTk3PoILPsCAuth : 184|14@0+ (0.01,0) [0|163.83] "m^2" EOCM,EOCM_HCP1,EOCM_HCP2
 SG_ LRRODPB2P_VOTk3PoILVAuth : 202|9@0- (0.125,0) [-32|31.875] "m/s" EOCM,EOCM_HCP1,EOCM_HCP2
 SG_ LRRODPB2P_VOTk3PoILVCAuth : 209|10@0+ (0.125,0) [0|127.875] "(m/s)^2" EOCM,EOCM_HCP1,EOCM_HCP2
 SG_ LRRODPB2P_VOTk4CICOPotAuth : 229|6@0+ (2,0) [0|126] "%" EOCM,EOCM_HCP1,EOCM_HCP2
 SG_ LRRODPB2P_VOTk3TypCnfdAuth : 231|2@0+ (1,0) [0|3] "" EOCM,EOCM_HCP1,EOCM_HCP2
 SG_ LRRODPB2P_VOTk4IDAuth : 233|7@0+ (1,0) [0|127] "" EOCM,EOCM_HCP1,EOCM_HCP2
 SG_ LRRODPB2P_VOTk4DynPrpStsAuth : 234|1@0+ (1,0) [0|1] "" EOCM,EOCM_HCP1,EOCM_HCP2
 SG_ LRRODPB2P_VOTk4DynPrpAuth : 237|3@0+ (1,0) [0|4] "" EOCM,EOCM_HCP1,EOCM_HCP2
 SG_ LRRODPB2P_VOTk4CnfdStsAuth : 239|2@0+ (1,0) [0|3] "" EOCM,EOCM_HCP1,EOCM_HCP2
 SG_ LRRODPB2P_VOTk4PoILAAuth : 240|9@0- (0.125,0) [-32|31.875] "m/s^2" EOCM,EOCM_HCP1,EOCM_HCP2
 SG_ LRRODPB2P_VOTk4MStsAuth : 242|2@0+ (1,0) [0|3] "" EOCM,EOCM_HCP1,EOCM_HCP2
 SG_ LRRODPB2P_VOTk4PoILgAAuth : 263|9@0- (0.125,0) [-32|31.875] "m/s^2" EOCM,EOCM_HCP1,EOCM_HCP2
 SG_ LRRODPB2P_VOTk4PoILgPsAuth : 270|11@0+ (0.125,0) [0|255.875] "m" EOCM,EOCM_HCP1,EOCM_HCP2
 SG_ LRRODPB2P_VOTk4PoILgPsCAuth : 275|15@0+ (0.01,0) [0|327.67] "m^2" EOCM,EOCM_HCP1,EOCM_HCP2
 SG_ LRRODPB2P_VOTk4PoILgthAuth : 292|11@0+ (0.125,0) [0|255.875] "m" EOCM,EOCM_HCP1,EOCM_HCP2
 SG_ LRRODPB2P_VOTk4PoILgVAuth : 297|11@0- (0.125,0) [-128|127.875] "m/s" EOCM,EOCM_HCP1,EOCM_HCP2
 SG_ LRRODPB2P_VOTk4PoILgVCAuth : 318|10@0+ (0.125,0) [0|127.875] "(m/s)^2" EOCM,EOCM_HCP1,EOCM_HCP2
 SG_ LRRODPB2P_VOTk4PoILPsAuth : 324|10@0- (0.125,0) [-64|63.875] "m" EOCM,EOCM_HCP1,EOCM_HCP2
 SG_ LRRODPB2P_VOTk4PoILPsCAuth : 330|14@0+ (0.01,0) [0|163.83] "m^2" EOCM,EOCM_HCP1,EOCM_HCP2
 SG_ LRRODPB2P_VOTk4PoILVAuth : 348|9@0- (0.125,0) [-32|31.875] "m/s" EOCM,EOCM_HCP1,EOCM_HCP2
 SG_ LRRODPB2P_VOTk4PoILVCAuth : 355|10@0+ (0.125,0) [0|127.875] "(m/s)^2" EOCM,EOCM_HCP1,EOCM_HCP2
 SG_ LRRODPB2P_VOTk4TypCnfdAuth : 361|2@0+ (1,0) [0|3] "" EOCM,EOCM_HCP1,EOCM_HCP2
 SG_ LRRODPB2P_VOTk5CnfdStsAuth : 369|2@0+ (1,0) [0|3] "" EOCM,EOCM_HCP1,EOCM_HCP2
 SG_ LRRODPB2P_VOTk5CICOPotAuth : 375|6@0+ (2,0) [0|126] "%" EOCM,EOCM_HCP1,EOCM_HCP2
 SG_ LRRODPB2P_VOTk5IDAuth : 379|7@0+ (1,0) [0|127] "" EOCM,EOCM_HCP1,EOCM_HCP2
 SG_ LRRODPB2P_VOTk5DynPrpStsAuth : 380|1@0+ (1,0) [0|1] "" EOCM,EOCM_HCP1,EOCM_HCP2
 SG_ LRRODPB2P_VOTk5DynPrpAuth : 383|3@0+ (1,0) [0|4] "" EOCM,EOCM_HCP1,EOCM_HCP2
 SG_ LRRODPB2P_VOTk5LgthdthAuth : 388|11@0+ (0.125,0) [0|255.875] "m" EOCM,EOCM_HCP1,EOCM_HCP2
 SG_ LRRODPB2P_VOTk5MStsAuth : 393|2@0+ (1,0) [0|3] "" EOCM,EOCM_HCP1,EOCM_HCP2
 SG_ LRRODPB2P_VOTk5PoILAAuth : 407|9@0- (0.125,0) [-32|31.875] "m/s^2" EOCM,EOCM_HCP1,EOCM_HCP2
 SG_ LRRODPB2P_VOTk5PoILgAAuth : 414|9@0- (0.125,0) [-32|31.875] "m/s^2" EOCM,EOCM_HCP1,EOCM_HCP2
 SG_ LRRODPB2P_VOTk5PoILgPsAuth : 421|11@0+ (0.125,0) [0|255.875] "m" EOCM,EOCM_HCP1,EOCM_HCP2
 SG_ LRRODPB2P_VOTk5PoILgPsCAuth : 426|15@0+ (0.01,0) [0|327.67] "m^2" EOCM,EOCM_HCP1,EOCM_HCP2
 SG_ LRRODPB2P_VOTk5PoILgVAuth : 443|11@0- (0.125,0) [-128|127.875] "m/s" EOCM,EOCM_HCP1,EOCM_HCP2
 SG_ LRRODPB2P_VOTk5PoILgVCAuth : 448|10@0+ (0.125,0) [0|127.875] "(m/s)^2" EOCM,EOCM_HCP1,EOCM_HCP2
 SG_ LRRODPB2P_VOTk5PoILPsAuth : 470|10@0- (0.125,0) [-64|63.875] "m" EOCM,EOCM_HCP1,EOCM_HCP2
 SG_ LRRODPB2P_VOTk5PoILPsCAuth : 476|14@0+ (0.01,0) [0|163.83] "m^2" EOCM,EOCM_HCP1,EOCM_HCP2
 SG_ LRRODPB2P_VOTk5PoILVAuth : 494|9@0- (0.125,0) [-32|31.875] "m/s" EOCM,EOCM_HCP1,EOCM_HCP2
 SG_ LRRODPB2P_VOTk5PoILVCAuth : 501|10@0+ (0.125,0) [0|127.875] "(m/s)^2" EOCM,EOCM_HCP1,EOCM_HCP2
 SG_ LRRODPB2P_VOTk5TypCnfdAuth : 507|2@0+ (1,0) [0|3] "" EOCM,EOCM_HCP1,EOCM_HCP2

BO_ 154 C8_LRRODP_Consecutive_Frame_Nu01: 64 LRR
 SG_ LRRODPB3P_POTk3IDAuth : 0|7@0+ (1,0) [0|127] "" EOCM,EOCM_HCP1,EOCM_HCP2
 SG_ LRRODPB3P_POTk3DynPrpAuth : 3|3@0+ (1,0) [0|4] "" EOCM,EOCM_HCP1,EOCM_HCP2
 SG_ LRRODPB3P_POTk3CnfdStsAuth : 5|2@0+ (1,0) [0|3] "" EOCM,EOCM_HCP1,EOCM_HCP2
 SG_ LRRODPB3P_BrstID : 7|2@0+ (1,0) [0|3] "" EOCM,EOCM_HCP1,EOCM_HCP2
 SG_ LRRODPB3P_POTk3InPthPotAuth : 9|6@0+ (2,0) [0|126] "%" EOCM,EOCM_HCP1,EOCM_HCP2
 SG_ LRRODPB3P_POTk3PoILAAuth : 17|9@0- (0.125,0) [-32|31.875] "m/s^2" EOCM,EOCM_HCP1,EOCM_HCP2
 SG_ LRRODPB3P_POTk3MStsAuth : 19|2@0+ (1,0) [0|3] "" EOCM,EOCM_HCP1,EOCM_HCP2
 SG_ LRRODPB3P_POTk3PoILgAAuth : 24|9@0- (0.125,0) [-32|31.875] "m/s^2" EOCM,EOCM_HCP1,EOCM_HCP2
 SG_ LRRODPB3P_POTk3PoILgPsAuth : 47|11@0+ (0.125,0) [0|255.875] "m" EOCM,EOCM_HCP1,EOCM_HCP2
 SG_ LRRODPB3P_POTk3PoILgVAuth : 52|10@0- (0.125,0) [-64|63.875] "m/s" EOCM,EOCM_HCP1,EOCM_HCP2
 SG_ LRRODPB3P_POTk3PoILPsAuth : 58|10@0- (0.125,0) [-64|63.875] "m" EOCM,EOCM_HCP1,EOCM_HCP2
 SG_ LRRODPB3P_POTk3PoILVAuth : 64|9@0- (0.125,0) [-32|31.875] "m/s" EOCM,EOCM_HCP1,EOCM_HCP2
 SG_ LRRODPB3P_VOTk6CICOPotAuth : 83|6@0+ (2,0) [0|126] "%" EOCM,EOCM_HCP1,EOCM_HCP2
 SG_ LRRODPB3P_POTk3TypCnfdAuth : 85|2@0+ (1,0) [0|3] "" EOCM,EOCM_HCP1,EOCM_HCP2
 SG_ LRRODPB3P_POTk3TypAuth : 87|2@0+ (1,0) [0|2] "" EOCM,EOCM_HCP1,EOCM_HCP2
 SG_ LRRODPB3P_VOTk6DynPrpStsAuth : 88|1@0+ (1,0) [0|1] "" EOCM,EOCM_HCP1,EOCM_HCP2
 SG_ LRRODPB3P_VOTk6DynPrpAuth : 91|3@0+ (1,0) [0|4] "" EOCM,EOCM_HCP1,EOCM_HCP2
 SG_ LRRODPB3P_VOTk6CnfdStsAuth : 93|2@0+ (1,0) [0|3] "" EOCM,EOCM_HCP1,EOCM_HCP2
 SG_ LRRODPB3P_VOTk6MStsAuth : 96|2@0+ (1,0) [0|3] "" EOCM,EOCM_HCP1,EOCM_HCP2
 SG_ LRRODPB3P_VOTk6IDAuth : 103|7@0+ (1,0) [0|127] "" EOCM,EOCM_HCP1,EOCM_HCP2
 SG_ LRRODPB3P_VOTk6PoILAAuth : 110|9@0- (0.125,0) [-32|31.875] "m/s^2" EOCM,EOCM_HCP1,EOCM_HCP2
 SG_ LRRODPB3P_VOTk6PoILgAAuth : 117|9@0- (0.125,0) [-32|31.875] "m/s^2" EOCM,EOCM_HCP1,EOCM_HCP2
 SG_ LRRODPB3P_VOTk6PoILgPsAuth : 124|11@0+ (0.125,0) [0|255.875] "m" EOCM,EOCM_HCP1,EOCM_HCP2
 SG_ LRRODPB3P_VOTk6PoILgPsCAuth : 129|15@0+ (0.01,0) [0|327.67] "m^2" EOCM,EOCM_HCP1,EOCM_HCP2
 SG_ LRRODPB3P_VOTk6PoILgthAuth : 146|11@0+ (0.125,0) [0|255.875] "m" EOCM,EOCM_HCP1,EOCM_HCP2
 SG_ LRRODPB3P_VOTk6PoILgVAuth : 167|11@0- (0.125,0) [-128|127.875] "m/s" EOCM,EOCM_HCP1,EOCM_HCP2
 SG_ LRRODPB3P_VOTk6PoILgVCAuth : 172|10@0+ (0.125,0) [0|127.875] "(m/s)^2" EOCM,EOCM_HCP1,EOCM_HCP2
 SG_ LRRODPB3P_VOTk6PoILPsAuth : 178|10@0- (0.125,0) [-64|63.875] "m" EOCM,EOCM_HCP1,EOCM_HCP2
 SG_ LRRODPB3P_VOTk6PoILPsCAuth : 184|14@0+ (0.01,0) [0|163.83] "m^2" EOCM,EOCM_HCP1,EOCM_HCP2
 SG_ LRRODPB3P_VOTk6PoILVAuth : 202|9@0- (0.125,0) [-32|31.875] "m/s" EOCM,EOCM_HCP1,EOCM_HCP2
 SG_ LRRODPB3P_VOTk6PoILVCAuth : 209|10@0+ (0.125,0) [0|127.875] "(m/s)^2" EOCM,EOCM_HCP1,EOCM_HCP2
 SG_ LRRODPB3P_VOTk7CICOPotAuth : 229|6@0+ (2,0) [0|126] "%" EOCM,EOCM_HCP1,EOCM_HCP2
 SG_ LRRODPB3P_VOTk6TypCnfdAuth : 231|2@0+ (1,0) [0|3] "" EOCM,EOCM_HCP1,EOCM_HCP2
 SG_ LRRODPB3P_VOTk7IDAuth : 233|7@0+ (1,0) [0|127] "" EOCM,EOCM_HCP1,EOCM_HCP2
 SG_ LRRODPB3P_VOTk7DynPrpStsAuth : 234|1@0+ (1,0) [0|1] "" EOCM,EOCM_HCP1,EOCM_HCP2
 SG_ LRRODPB3P_VOTk7DynPrpAuth : 237|3@0+ (1,0) [0|4] "" EOCM,EOCM_HCP1,EOCM_HCP2
 SG_ LRRODPB3P_VOTk7CnfdStsAuth : 239|2@0+ (1,0) [0|3] "" EOCM,EOCM_HCP1,EOCM_HCP2
 SG_ LRRODPB3P_VOTk7PoILAAuth : 240|9@0- (0.125,0) [-32|31.875] "m/s^2" EOCM,EOCM_HCP1,EOCM_HCP2
 SG_ LRRODPB3P_VOTk7MStsAuth : 242|2@0+ (1,0) [0|3] "" EOCM,EOCM_HCP1,EOCM_HCP2
 SG_ LRRODPB3P_VOTk7PoILgAAuth : 263|9@0- (0.125,0) [-32|31.875] "m/s^2" EOCM,EOCM_HCP1,EOCM_HCP2
 SG_ LRRODPB3P_VOTk7PoILgPsAuth : 270|11@0+ (0.125,0) [0|255.875] "m" EOCM,EOCM_HCP1,EOCM_HCP2
 SG_ LRRODPB3P_VOTk7PoILgPsCAuth : 275|15@0+ (0.01,0) [0|327.67] "m^2" EOCM,EOCM_HCP1,EOCM_HCP2
 SG_ LRRODPB3P_VOTk7PoILgthAuth : 292|11@0+ (0.125,0) [0|255.875] "m" EOCM,EOCM_HCP1,EOCM_HCP2
 SG_ LRRODPB3P_VOTk7PoILgVAuth : 297|11@0- (0.125,0) [-128|127.875] "m/s" EOCM,EOCM_HCP1,EOCM_HCP2
 SG_ LRRODPB3P_VOTk7PoILgVCAuth : 318|10@0+ (0.125,0) [0|127.875] "(m/s)^2" EOCM,EOCM_HCP1,EOCM_HCP2
 SG_ LRRODPB3P_VOTk7PoILPsAuth : 324|10@0- (0.125,0) [-64|63.875] "m" EOCM,EOCM_HCP1,EOCM_HCP2
 SG_ LRRODPB3P_VOTk7PoILPsCAuth : 330|14@0+ (0.01,0) [0|163.83] "m^2" EOCM,EOCM_HCP1,EOCM_HCP2
 SG_ LRRODPB3P_VOTk7PoILVAuth : 348|9@0- (0.125,0) [-32|31.875] "m/s" EOCM,EOCM_HCP1,EOCM_HCP2
 SG_ LRRODPB3P_VOTk7PoILVCAuth : 355|10@0+ (0.125,0) [0|127.875] "(m/s)^2" EOCM,EOCM_HCP1,EOCM_HCP2
 SG_ LRRODPB3P_VOTk7TypCnfdAuth : 361|2@0+ (1,0) [0|3] "" EOCM,EOCM_HCP1,EOCM_HCP2
 SG_ LRRODPB3P_VOTk8CnfdStsAuth : 369|2@0+ (1,0) [0|3] "" EOCM,EOCM_HCP1,EOCM_HCP2
 SG_ LRRODPB3P_VOTk8CICOPotAuth : 375|6@0+ (2,0) [0|126] "%" EOCM,EOCM_HCP1,EOCM_HCP2
 SG_ LRRODPB3P_VOTk8IDAuth : 379|7@0+ (1,0) [0|127] "" EOCM,EOCM_HCP1,EOCM_HCP2
 SG_ LRRODPB3P_VOTk8DynPrpStsAuth : 380|1@0+ (1,0) [0|1] "" EOCM,EOCM_HCP1,EOCM_HCP2
 SG_ LRRODPB3P_VOTk8DynPrpAuth : 383|3@0+ (1,0) [0|4] "" EOCM,EOCM_HCP1,EOCM_HCP2
 SG_ LRRODPB3P_VOTk8PoILAAuth : 386|9@0- (0.125,0) [-32|31.875] "m/s^2" EOCM,EOCM_HCP1,EOCM_HCP2
 SG_ LRRODPB3P_VOTk8MStsAuth : 388|2@0+ (1,0) [0|3] "" EOCM,EOCM_HCP1,EOCM_HCP2
 SG_ LRRODPB3P_VOTk8PoILgAAuth : 393|9@0- (0.125,0) [-32|31.875] "m/s^2" EOCM,EOCM_HCP1,EOCM_HCP2
 SG_ LRRODPB3P_VOTk8PoILgPsAuth : 400|11@0+ (0.125,0) [0|255.875] "m" EOCM,EOCM_HCP1,EOCM_HCP2
 SG_ LRRODPB3P_VOTk8PoILgPsCAuth : 421|15@0+ (0.01,0) [0|327.67] "m^2" EOCM,EOCM_HCP1,EOCM_HCP2
 SG_ LRRODPB3P_VOTk8PoILgthAuth : 438|11@0+ (0.125,0) [0|255.875] "m" EOCM,EOCM_HCP1,EOCM_HCP2
 SG_ LRRODPB3P_VOTk8PoILgVAuth : 443|11@0- (0.125,0) [-128|127.875] "m/s" EOCM,EOCM_HCP1,EOCM_HCP2
 SG_ LRRODPB3P_VOTk8PoILgVCAuth : 448|10@0+ (0.125,0) [0|127.875] "(m/s)^2" EOCM,EOCM_HCP1,EOCM_HCP2
 SG_ LRRODPB3P_VOTk8PoILPsAuth : 470|10@0- (0.125,0) [-64|63.875] "m" EOCM,EOCM_HCP1,EOCM_HCP2
 SG_ LRRODPB3P_VOTk8PoILPsCAuth : 476|14@0+ (0.01,0) [0|163.83] "m^2" EOCM,EOCM_HCP1,EOCM_HCP2
 SG_ LRRODPB3P_VOTk8PoILVAuth : 494|9@0- (0.125,0) [-32|31.875] "m/s" EOCM,EOCM_HCP1,EOCM_HCP2
 SG_ LRRODPB3P_VOTk8PoILVCAuth : 501|10@0+ (0.125,0) [0|127.875] "(m/s)^2" EOCM,EOCM_HCP1,EOCM_HCP2
 SG_ LRRODPB3P_VOTk8TypCnfdAuth : 507|2@0+ (1,0) [0|3] "" EOCM,EOCM_HCP1,EOCM_HCP2

BO_ 155 C8_LRRODP_Consecutive_Frame_Nu02: 64 LRR
 SG_ LRRODPB4P_POTk4IDAuth : 0|7@0+ (1,0) [0|127] "" EOCM,EOCM_HCP1,EOCM_HCP2
 SG_ LRRODPB4P_POTk4DynPrpAuth : 3|3@0+ (1,0) [0|4] "" EOCM,EOCM_HCP1,EOCM_HCP2
 SG_ LRRODPB4P_POTk4CnfdStsAuth : 5|2@0+ (1,0) [0|3] "" EOCM,EOCM_HCP1,EOCM_HCP2
 SG_ LRRODPB4P_BrstID : 7|2@0+ (1,0) [0|3] "" EOCM,EOCM_HCP1,EOCM_HCP2
 SG_ LRRODPB4P_POTk4InPthPotAuth : 9|6@0+ (2,0) [0|126] "%" EOCM,EOCM_HCP1,EOCM_HCP2
 SG_ LRRODPB4P_POTk4PoILAAuth : 17|9@0- (0.125,0) [-32|31.875] "m/s^2" EOCM,EOCM_HCP1,EOCM_HCP2
 SG_ LRRODPB4P_POTk4MStsAuth : 19|2@0+ (1,0) [0|3] "" EOCM,EOCM_HCP1,EOCM_HCP2
 SG_ LRRODPB4P_POTk4PoILgAAuth : 24|9@0- (0.125,0) [-32|31.875] "m/s^2" EOCM,EOCM_HCP1,EOCM_HCP2
 SG_ LRRODPB4P_POTk4PoILgPsAuth : 47|11@0+ (0.125,0) [0|255.875] "m" EOCM,EOCM_HCP1,EOCM_HCP2
 SG_ LRRODPB4P_POTk4PoILgVAuth : 52|10@0- (0.125,0) [-64|63.875] "m/s" EOCM,EOCM_HCP1,EOCM_HCP2
 SG_ LRRODPB4P_POTk4PoILPsAuth : 58|10@0- (0.125,0) [-64|63.875] "m" EOCM,EOCM_HCP1,EOCM_HCP2
 SG_ LRRODPB4P_POTk4PoILVAuth : 64|9@0- (0.125,0) [-32|31.875] "m/s" EOCM,EOCM_HCP1,EOCM_HCP2
 SG_ LRRODPB4P_POTk5DynPrpAuth : 81|3@0+ (1,0) [0|4] "" EOCM,EOCM_HCP1,EOCM_HCP2
 SG_ LRRODPB4P_POTk5CnfdStsAuth : 83|2@0+ (1,0) [0|3] "" EOCM,EOCM_HCP1,EOCM_HCP2
 SG_ LRRODPB4P_POTk4TypCnfdAuth : 85|2@0+ (1,0) [0|3] "" EOCM,EOCM_HCP1,EOCM_HCP2
 SG_ LRRODPB4P_POTk4TypAuth : 87|2@0+ (1,0) [0|2] "" EOCM,EOCM_HCP1,EOCM_HCP2
 SG_ LRRODPB4P_POTk5IDAuth : 94|7@0+ (1,0) [0|127] "" EOCM,EOCM_HCP1,EOCM_HCP2
 SG_ LRRODPB4P_POTk5MStsAuth : 97|2@0+ (1,0) [0|3] "" EOCM,EOCM_HCP1,EOCM_HCP2
 SG_ LRRODPB4P_POTk5InPthPotAuth : 103|6@0+ (2,0) [0|126] "%" EOCM,EOCM_HCP1,EOCM_HCP2
 SG_ LRRODPB4P_POTk5PoILAAuth : 111|9@0- (0.125,0) [-32|31.875] "m/s^2" EOCM,EOCM_HCP1,EOCM_HCP2
 SG_ LRRODPB4P_POTk5PoILgAAuth : 118|9@0- (0.125,0) [-32|31.875] "m/s^2" EOCM,EOCM_HCP1,EOCM_HCP2
 SG_ LRRODPB4P_POTk5PoILgPsAuth : 125|11@0+ (0.125,0) [0|255.875] "m" EOCM,EOCM_HCP1,EOCM_HCP2
 SG_ LRRODPB4P_POTk5PoILgVAuth : 130|10@0- (0.125,0) [-64|63.875] "m/s" EOCM,EOCM_HCP1,EOCM_HCP2
 SG_ LRRODPB4P_POTk5PoILPsAuth : 136|10@0- (0.125,0) [-64|63.875] "m" EOCM,EOCM_HCP1,EOCM_HCP2
 SG_ LRRODPB4P_POTk5PoILVAuth : 158|9@0- (0.125,0) [-32|31.875] "m/s" EOCM,EOCM_HCP1,EOCM_HCP2
 SG_ LRRODPB4P_VOTk10CICOPotAuth : 161|6@0+ (2,0) [0|126] "%" EOCM,EOCM_HCP1,EOCM_HCP2
 SG_ LRRODPB4P_POTk5TypCnfdAuth : 163|2@0+ (1,0) [0|3] "" EOCM,EOCM_HCP1,EOCM_HCP2
 SG_ LRRODPB4P_POTk5TypAuth : 165|2@0+ (1,0) [0|2] "" EOCM,EOCM_HCP1,EOCM_HCP2
 SG_ LRRODPB4P_VOTk10DynPrpAuth : 169|3@0+ (1,0) [0|4] "" EOCM,EOCM_HCP1,EOCM_HCP2
 SG_ LRRODPB4P_VOTk10CnfdStsAuth : 171|2@0+ (1,0) [0|3] "" EOCM,EOCM_HCP1,EOCM_HCP2
 SG_ LRRODPB4P_VOTk10IDAuth : 181|7@0+ (1,0) [0|127] "" EOCM,EOCM_HCP1,EOCM_HCP2
 SG_ LRRODPB4P_VOTk10DynPrpStsAuth : 182|1@0+ (1,0) [0|1] "" EOCM,EOCM_HCP1,EOCM_HCP2
 SG_ LRRODPB4P_VOTk10PoILAAuth : 188|9@0- (0.125,0) [-32|31.875] "m/s^2" EOCM,EOCM_HCP1,EOCM_HCP2
 SG_ LRRODPB4P_VOTk10MStsAuth : 190|2@0+ (1,0) [0|3] "" EOCM,EOCM_HCP1,EOCM_HCP2
 SG_ LRRODPB4P_VOTk10PoILgAAuth : 195|9@0- (0.125,0) [-32|31.875] "m/s^2" EOCM,EOCM_HCP1,EOCM_HCP2
 SG_ LRRODPB4P_VOTk10PoILgPsAuth : 202|11@0+ (0.125,0) [0|255.875] "m" EOCM,EOCM_HCP1,EOCM_HCP2
 SG_ LRRODPB4P_VOTk10PoILgPsCAuth : 223|15@0+ (0.01,0) [0|327.67] "m^2" EOCM,EOCM_HCP1,EOCM_HCP2
 SG_ LRRODPB4P_VOTk10PoILgthAuth : 224|11@0+ (0.125,0) [0|255.875] "m" EOCM,EOCM_HCP1,EOCM_HCP2
 SG_ LRRODPB4P_VOTk10PoILgVAuth : 245|11@0- (0.125,0) [-128|127.875] "m/s" EOCM,EOCM_HCP1,EOCM_HCP2
 SG_ LRRODPB4P_VOTk10PoILgVCAuth : 250|10@0+ (0.125,0) [0|127.875] "(m/s)^2" EOCM,EOCM_HCP1,EOCM_HCP2
 SG_ LRRODPB4P_VOTk10PoILPsAuth : 256|10@0- (0.125,0) [-64|63.875] "m" EOCM,EOCM_HCP1,EOCM_HCP2
 SG_ LRRODPB4P_VOTk10PoILPsCAuth : 278|14@0+ (0.01,0) [0|163.83] "m^2" EOCM,EOCM_HCP1,EOCM_HCP2
 SG_ LRRODPB4P_VOTk10PoILVAuth : 280|9@0- (0.125,0) [-32|31.875] "m/s" EOCM,EOCM_HCP1,EOCM_HCP2
 SG_ LRRODPB4P_VOTk10PoILVCAuth : 303|10@0+ (0.125,0) [0|127.875] "(m/s)^2" EOCM,EOCM_HCP1,EOCM_HCP2
 SG_ LRRODPB4P_VOTk9CICOPotAuth : 307|6@0+ (2,0) [0|126] "%" EOCM,EOCM_HCP1,EOCM_HCP2
 SG_ LRRODPB4P_VOTk10TypCnfdAuth : 309|2@0+ (1,0) [0|3] "" EOCM,EOCM_HCP1,EOCM_HCP2
 SG_ LRRODPB4P_VOTk9DynPrpStsAuth : 312|1@0+ (1,0) [0|1] "" EOCM,EOCM_HCP1,EOCM_HCP2
 SG_ LRRODPB4P_VOTk9DynPrpAuth : 315|3@0+ (1,0) [0|4] "" EOCM,EOCM_HCP1,EOCM_HCP2
 SG_ LRRODPB4P_VOTk9CnfdStsAuth : 317|2@0+ (1,0) [0|3] "" EOCM,EOCM_HCP1,EOCM_HCP2
 SG_ LRRODPB4P_VOTk9MStsAuth : 320|2@0+ (1,0) [0|3] "" EOCM,EOCM_HCP1,EOCM_HCP2
 SG_ LRRODPB4P_VOTk9IDAuth : 327|7@0+ (1,0) [0|127] "" EOCM,EOCM_HCP1,EOCM_HCP2
 SG_ LRRODPB4P_VOTk9PoILAAuth : 334|9@0- (0.125,0) [-32|31.875] "m/s^2" EOCM,EOCM_HCP1,EOCM_HCP2
 SG_ LRRODPB4P_VOTk9PoILgAAuth : 341|9@0- (0.125,0) [-32|31.875] "m/s^2" EOCM,EOCM_HCP1,EOCM_HCP2
 SG_ LRRODPB4P_VOTk9PoILgPsAuth : 348|11@0+ (0.125,0) [0|255.875] "m" EOCM,EOCM_HCP1,EOCM_HCP2
 SG_ LRRODPB4P_VOTk9PoILgPsCAuth : 353|15@0+ (0.01,0) [0|327.67] "m^2" EOCM,EOCM_HCP1,EOCM_HCP2
 SG_ LRRODPB4P_VOTk9PoILgthAuth : 370|11@0+ (0.125,0) [0|255.875] "m" EOCM,EOCM_HCP1,EOCM_HCP2
 SG_ LRRODPB4P_VOTk9PoILgVAuth : 391|11@0- (0.125,0) [-128|127.875] "m/s" EOCM,EOCM_HCP1,EOCM_HCP2
 SG_ LRRODPB4P_VOTk9PoILgVCAuth : 396|10@0+ (0.125,0) [0|127.875] "(m/s)^2" EOCM,EOCM_HCP1,EOCM_HCP2
 SG_ LRRODPB4P_VOTk9PoILPsAuth : 402|10@0- (0.125,0) [-64|63.875] "m" EOCM,EOCM_HCP1,EOCM_HCP2
 SG_ LRRODPB4P_VOTk9PoILPsCAuth : 408|14@0+ (0.01,0) [0|163.83] "m^2" EOCM,EOCM_HCP1,EOCM_HCP2
 SG_ LRRODPB4P_VOTk9PoILVAuth : 426|9@0- (0.125,0) [-32|31.875] "m/s" EOCM,EOCM_HCP1,EOCM_HCP2
 SG_ LRRODPB4P_VOTk9PoILVCAuth : 433|10@0+ (0.125,0) [0|127.875] "(m/s)^2" EOCM,EOCM_HCP1,EOCM_HCP2
 SG_ LRRODPB4P_VOTk9TypCnfdAuth : 455|2@0+ (1,0) [0|3] "" EOCM,EOCM_HCP1,EOCM_HCP2

BA_DEF_ SG_  "SignalType" STRING ;
BA_DEF_ SG_  "SignalLongName" STRING ;
BA_DEF_ BO_  "GenMsgCycleTime" INT 0 10000;
BA_DEF_ BO_  "GenMsgSendType" ENUM "cyclicX","spontanX","cyclicIfActiveX","spontanWithDelay","cyclicAndSpontanX","cyclicAndSpontanWithDelay","spontanWithRepetition","cyclicIfActiveAndSpontanWD";
BA_DEF_ BO_  "VFrameFormat" ENUM  "StandardCAN","ExtendedCAN","reserved","reserved","reserved","reserved","reserved","reserved","reserved","reserved","reserved","reserved","reserved","reserved","StandardCAN_FD","ExtendedCAN_FD";
BA_DEF_DEF_  "SignalType" "";
BA_DEF_DEF_  "SignalLongName" "";
BA_DEF_DEF_  "GenMsgCycleTime" 0;
BA_DEF_DEF_  "GenMsgSendType" "cyclicX";
BA_DEF_DEF_  "VFrameFormat" "StandardCAN";
BA_ "VFrameFormat" BO_ 149 14;
BA_ "VFrameFormat" BO_ 225 14;
BA_ "VFrameFormat" BO_ 226 14;
BA_ "VFrameFormat" BO_ 142 14;
BA_ "VFrameFormat" BO_ 239 14;
BA_ "VFrameFormat" BO_ 153 14;
BA_ "VFrameFormat" BO_ 154 14;
BA_ "VFrameFormat" BO_ 155 14;
BA_ "SignalLongName" SG_ 149 FCODPB8P_FVLBTk8CrvAuth "Front Camera Object Detection and Processing Burst 8 Protected : Forward Vision Lane Boundary Track 8 Curvature Authenticated";
BA_ "SignalType" SG_ 149 FCODPB8P_FVLBTk8ClrAuth "ENM";
BA_ "SignalLongName" SG_ 149 FCODPB8P_FVLBTk8ClrAuth "Front Camera Object Detection and Processing Burst 8 Protected : Forward Vision Lane Boundary Track 8 Color Authenticated";
BA_ "SignalLongName" SG_ 149 FCODPB8P_BrstID "Front Camera Object Detection and Processing Burst 8 Protected : Burst ID";
BA_ "SignalLongName" SG_ 149 FCODPB8P_FVLBTk8CrvDrvtAuth "Front Camera Object Detection and Processing Burst 8 Protected : Forward Vision Lane Boundary Track 8 Curvature Derivative Authenticated";
BA_ "SignalLongName" SG_ 149 FCODPB8P_FVLBTk8FPSABCQOvrAuth "Front Camera Object Detection and Processing Burst 8 Protected : Forward Vision Lane Boundary Track 8 First Polynomial Segment ABC Quality Overall Authenticated";
BA_ "SignalLongName" SG_ 149 FCODPB8P_FVLBTk8FPSAQAuth "Front Camera Object Detection and Processing Burst 8 Protected : Forward Vision Lane Boundary Track 8 First Polynomial Segment A Quality Authenticated";
BA_ "SignalLongName" SG_ 149 FCODPB8P_FVLBTk8FPSBQAuth "Front Camera Object Detection and Processing Burst 8 Protected : Forward Vision Lane Boundary Track 8 First Polynomial Segment B Quality Authenticated";
BA_ "SignalLongName" SG_ 149 FCODPB8P_FVLBTk8FPSCQAuth "Front Camera Object Detection and Processing Burst 8 Protected : Forward Vision Lane Boundary Track 8 First Polynomial Segment C Quality Authenticated";
BA_ "SignalLongName" SG_ 149 FCODPB8P_FVLBTk8HdgAuth "Front Camera Object Detection and Processing Burst 8 Protected : Forward Vision Lane Boundary Track 8 Heading Authenticated";
BA_ "SignalLongName" SG_ 149 FCODPB8P_FVLBTk8OfstAuth "Front Camera Object Detection and Processing Burst 8 Protected : Forward Vision Lane Boundary Track 8 Offset Authenticated";
BA_ "SignalType" SG_ 149 FCODPB8P_FVLBTk8PstnTypAuth "ENM";
BA_ "SignalLongName" SG_ 149 FCODPB8P_FVLBTk8PstnTypAuth "Front Camera Object Detection and Processing Burst 8 Protected : Forward Vision Lane Boundary Track 8 Position Type Authenticated";
BA_ "SignalType" SG_ 149 FCODPB8P_FVLBTk8TypAuth "ENM";
BA_ "SignalLongName" SG_ 149 FCODPB8P_FVLBTk8TypAuth "Front Camera Object Detection and Processing Burst 8 Protected : Forward Vision Lane Boundary Track 8 Type Authenticated";
BA_ "SignalType" SG_ 149 FCODPB8P_FVLBTk8QltyAuth "ENM";
BA_ "SignalLongName" SG_ 149 FCODPB8P_FVLBTk8QltyAuth "Front Camera Object Detection and Processing Burst 8 Protected : Forward Vision Lane Boundary Track 8 Quality Authenticated";
BA_ "SignalLongName" SG_ 149 FCODPB8P_FVLBTk8VSLgDistAuth "Front Camera Object Detection and Processing Burst 8 Protected : Forward Vision Lane Boundary Track 8 View Start Longitudinal Distance Authenticated";
BA_ "SignalLongName" SG_ 149 FCODPB8P_FVLBTk8VRLgDistAuth "Front Camera Object Detection and Processing Burst 8 Protected : Forward Vision Lane Boundary Track 8 View Range Longitudinal Distance Authenticated";
BA_ "SignalLongName" SG_ 149 FCODPB8P_FVLBTk8WdthAuth "Front Camera Object Detection and Processing Burst 8 Protected : Forward Vision Lane Boundary Track 8 Width Authenticated";
BA_ "SignalLongName" SG_ 149 FCODPB8P_FVVOTk8CICOPotAuth "Front Camera Object Detection and Processing Burst 8 Protected : Forward Vision Vehicle Object Track 8 Cut In Cut Out Potential Authenticated";
BA_ "SignalType" SG_ 149 FCODPB8P_FVVOTk8BrkLgtStsAuth "ENM";
BA_ "SignalLongName" SG_ 149 FCODPB8P_FVVOTk8BrkLgtStsAuth "Front Camera Object Detection and Processing Burst 8 Protected : Forward Vision Vehicle Object Track 8 Brake Light Status Authenticated";
BA_ "SignalType" SG_ 149 FCODPB8P_FVVOTk8DynPrpAuth "ENM";
BA_ "SignalLongName" SG_ 149 FCODPB8P_FVVOTk8DynPrpAuth "Front Camera Object Detection and Processing Burst 8 Protected : Forward Vision Vehicle Object Track 8 Dynamic Property Authenticated";
BA_ "SignalType" SG_ 149 FCODPB8P_FVVOTk8CnfdStsAuth "ENM";
BA_ "SignalLongName" SG_ 149 FCODPB8P_FVVOTk8CnfdStsAuth "Front Camera Object Detection and Processing Burst 8 Protected : Forward Vision Vehicle Object Track 8 Confidence Status Authenticated";
BA_ "SignalLongName" SG_ 149 FCODPB8P_FVVOTk8HdgAngAuth "Front Camera Object Detection and Processing Burst 8 Protected : Forward Vision Vehicle Object Track 8 Heading Angle Authenticated";
BA_ "SignalType" SG_ 149 FCODPB8P_FVVOTk8DynPrpStsAuth "ENM";
BA_ "SignalLongName" SG_ 149 FCODPB8P_FVVOTk8DynPrpStsAuth "Front Camera Object Detection and Processing Burst 8 Protected : Forward Vision Vehicle Object Track 8 Dynamic Property Status Authenticated";
BA_ "SignalLongName" SG_ 149 FCODPB8P_FVVOTk8HdgAngCAuth "Front Camera Object Detection and Processing Burst 8 Protected : Forward Vision Vehicle Object Track 8 Heading Angle Covariance Authenticated";
BA_ "SignalLongName" SG_ 149 FCODPB8P_FVVOTk8IDAuth "Front Camera Object Detection and Processing Burst 8 Protected : Forward Vision Vehicle Object Track 8 ID Authenticated";
BA_ "SignalLongName" SG_ 149 FCODPB8P_FVVOTk8PoILAAuth "Front Camera Object Detection and Processing Burst 8 Protected : Forward Vision Vehicle Object Track 8 Point of Interest Lateral Acceleration Authenticated";
BA_ "SignalType" SG_ 149 FCODPB8P_FVVOTk8MStsAuth "ENM";
BA_ "SignalLongName" SG_ 149 FCODPB8P_FVVOTk8MStsAuth "Front Camera Object Detection and Processing Burst 8 Protected : Forward Vision Vehicle Object Track 8 Measurement Status Authenticated";
BA_ "SignalType" SG_ 149 FCODPB8P_FVVOTk8LnAsmtAuth "ENM";
BA_ "SignalLongName" SG_ 149 FCODPB8P_FVVOTk8LnAsmtAuth "Front Camera Object Detection and Processing Burst 8 Protected : Forward Vision Vehicle Object Track 8 Lane Assignment Authenticated";
BA_ "SignalLongName" SG_ 149 FCODPB8P_FVVOTk8PoILgAAuth "Front Camera Object Detection and Processing Burst 8 Protected : Forward Vision Vehicle Object Track 8 Point of Interest Longitudinal Acceleration Authenticated";
BA_ "SignalLongName" SG_ 149 FCODPB8P_FVVOTk8PoILgPsAuth "Front Camera Object Detection and Processing Burst 8 Protected : Forward Vision Vehicle Object Track 8 Point of Interest Longitudinal Position Authenticated";
BA_ "SignalLongName" SG_ 149 FCODPB8P_FVVOTk8PoILgPsCAuth "Front Camera Object Detection and Processing Burst 8 Protected : Forward Vision Vehicle Object Track 8 Point of Interest Longitudinal Position Covariance Authenticated";
BA_ "SignalLongName" SG_ 149 FCODPB8P_FVVOTk8PoILgVAuth "Front Camera Object Detection and Processing Burst 8 Protected : Forward Vision Vehicle Object Track 8 Point of Interest Longitudinal Velocity Authenticated";
BA_ "SignalLongName" SG_ 149 FCODPB8P_FVVOTk8PoILgVCAuth "Front Camera Object Detection and Processing Burst 8 Protected : Forward Vision Vehicle Object Track 8 Point of Interest Longitudinal Velocity Covariance Authenticated";
BA_ "SignalLongName" SG_ 149 FCODPB8P_FVVOTk8PoILPsAuth "Front Camera Object Detection and Processing Burst 8 Protected : Forward Vision Vehicle Object Track 8 Point of Interest Lateral Position Authenticated";
BA_ "SignalLongName" SG_ 149 FCODPB8P_FVVOTk8PoILPsCAuth "Front Camera Object Detection and Processing Burst 8 Protected : Forward Vision Vehicle Object Track 8 Point of Interest Lateral Position Covariance Authenticated";
BA_ "SignalLongName" SG_ 149 FCODPB8P_FVVOTk8PoILVAuth "Front Camera Object Detection and Processing Burst 8 Protected : Forward Vision Vehicle Object Track 8 Point of Interest Lateral Velocity Authenticated";
BA_ "SignalLongName" SG_ 149 FCODPB8P_FVVOTk8PoILVCAuth "Front Camera Object Detection and Processing Burst 8 Protected : Forward Vision Vehicle Object Track 8 Point of Interest Lateral Velocity Covariance Authenticated";
BA_ "SignalLongName" SG_ 149 FCODPB8P_FVVOTk8PoIWAuth "Front Camera Object Detection and Processing Burst 8 Protected : Forward Vision Vehicle Object Track 8 Point of Interest Width Authenticated";
BA_ "SignalType" SG_ 149 FCODPB8P_FVVOTk9BrkLgtStsAuth "ENM";
BA_ "SignalLongName" SG_ 149 FCODPB8P_FVVOTk9BrkLgtStsAuth "Front Camera Object Detection and Processing Burst 8 Protected : Forward Vision Vehicle Object Track 9 Brake Light Status Authenticated";
BA_ "SignalType" SG_ 149 FCODPB8P_FVVOTk8TypCnfdAuth "ENM";
BA_ "SignalLongName" SG_ 149 FCODPB8P_FVVOTk8TypCnfdAuth "Front Camera Object Detection and Processing Burst 8 Protected : Forward Vision Vehicle Object Track 8 Type Confidence Authenticated";
BA_ "SignalType" SG_ 149 FCODPB8P_FVVOTk8TypAuth "ENM";
BA_ "SignalLongName" SG_ 149 FCODPB8P_FVVOTk8TypAuth "Front Camera Object Detection and Processing Burst 8 Protected : Forward Vision Vehicle Object Track 8 Type Authenticated";
BA_ "SignalType" SG_ 149 FCODPB8P_FVVOTk8TSLgtStsAuth "ENM";
BA_ "SignalLongName" SG_ 149 FCODPB8P_FVVOTk8TSLgtStsAuth "Front Camera Object Detection and Processing Burst 8 Protected : Forward Vision Vehicle Object Track 8 Turn Signal Light Status Authenticated";
BA_ "SignalType" SG_ 149 FCODPB8P_FVVOTk9CnfdStsAuth "ENM";
BA_ "SignalLongName" SG_ 149 FCODPB8P_FVVOTk9CnfdStsAuth "Front Camera Object Detection and Processing Burst 8 Protected : Forward Vision Vehicle Object Track 9 Confidence Status Authenticated";
BA_ "SignalLongName" SG_ 149 FCODPB8P_FVVOTk9CICOPotAuth "Front Camera Object Detection and Processing Burst 8 Protected : Forward Vision Vehicle Object Track 9 Cut In Cut Out Potential Authenticated";
BA_ "SignalLongName" SG_ 149 FCODPB8P_FVVOTk9HdgAngAuth "Front Camera Object Detection and Processing Burst 8 Protected : Forward Vision Vehicle Object Track 9 Heading Angle Authenticated";
BA_ "SignalType" SG_ 149 FCODPB8P_FVVOTk9DynPrpStsAuth "ENM";
BA_ "SignalLongName" SG_ 149 FCODPB8P_FVVOTk9DynPrpStsAuth "Front Camera Object Detection and Processing Burst 8 Protected : Forward Vision Vehicle Object Track 9 Dynamic Property Status Authenticated";
BA_ "SignalType" SG_ 149 FCODPB8P_FVVOTk9DynPrpAuth "ENM";
BA_ "SignalLongName" SG_ 149 FCODPB8P_FVVOTk9DynPrpAuth "Front Camera Object Detection and Processing Burst 8 Protected : Forward Vision Vehicle Object Track 9 Dynamic Property Authenticated";
BA_ "SignalLongName" SG_ 149 FCODPB8P_FVVOTk9HdgAngCAuth "Front Camera Object Detection and Processing Burst 8 Protected : Forward Vision Vehicle Object Track 9 Heading Angle Covariance Authenticated";
BA_ "SignalLongName" SG_ 149 FCODPB8P_FVVOTk9IDAuth "Front Camera Object Detection and Processing Burst 8 Protected : Forward Vision Vehicle Object Track 9 ID Authenticated";
BA_ "SignalType" SG_ 149 FCODPB8P_FVVOTk9MStsAuth "ENM";
BA_ "SignalLongName" SG_ 149 FCODPB8P_FVVOTk9MStsAuth "Front Camera Object Detection and Processing Burst 8 Protected : Forward Vision Vehicle Object Track 9 Measurement Status Authenticated";
BA_ "SignalType" SG_ 149 FCODPB8P_FVVOTk9LnAsmtAuth "ENM";
BA_ "SignalLongName" SG_ 149 FCODPB8P_FVVOTk9LnAsmtAuth "Front Camera Object Detection and Processing Burst 8 Protected : Forward Vision Vehicle Object Track 9 Lane Assignment Authenticated";
BA_ "SignalLongName" SG_ 149 FCODPB8P_FVVOTk9PoILAAuth "Front Camera Object Detection and Processing Burst 8 Protected : Forward Vision Vehicle Object Track 9 Point of Interest Lateral Acceleration Authenticated";
BA_ "SignalLongName" SG_ 149 FCODPB8P_FVVOTk9PoILgAAuth "Front Camera Object Detection and Processing Burst 8 Protected : Forward Vision Vehicle Object Track 9 Point of Interest Longitudinal Acceleration Authenticated";
BA_ "SignalLongName" SG_ 149 FCODPB8P_FVVOTk9PoILgPsAuth "Front Camera Object Detection and Processing Burst 8 Protected : Forward Vision Vehicle Object Track 9 Point of Interest Longitudinal Position Authenticated";
BA_ "SignalLongName" SG_ 149 FCODPB8P_FVVOTk9PoILgPsCAuth "Front Camera Object Detection and Processing Burst 8 Protected : Forward Vision Vehicle Object Track 9 Point of Interest Longitudinal Position Covariance Authenticated";
BA_ "SignalLongName" SG_ 149 FCODPB8P_FVVOTk9PoILgVAuth "Front Camera Object Detection and Processing Burst 8 Protected : Forward Vision Vehicle Object Track 9 Point of Interest Longitudinal Velocity Authenticated";
BA_ "SignalLongName" SG_ 149 FCODPB8P_FVVOTk9PoILgVCAuth "Front Camera Object Detection and Processing Burst 8 Protected : Forward Vision Vehicle Object Track 9 Point of Interest Longitudinal Velocity Covariance Authenticated";
BA_ "SignalLongName" SG_ 149 FCODPB8P_FVVOTk9PoILPsAuth "Front Camera Object Detection and Processing Burst 8 Protected : Forward Vision Vehicle Object Track 9 Point of Interest Lateral Position Authenticated";
BA_ "SignalLongName" SG_ 149 FCODPB8P_FVVOTk9PoILPsCAuth "Front Camera Object Detection and Processing Burst 8 Protected : Forward Vision Vehicle Object Track 9 Point of Interest Lateral Position Covariance Authenticated";
BA_ "SignalLongName" SG_ 149 FCODPB8P_FVVOTk9PoILVAuth "Front Camera Object Detection and Processing Burst 8 Protected : Forward Vision Vehicle Object Track 9 Point of Interest Lateral Velocity Authenticated";
BA_ "SignalLongName" SG_ 149 FCODPB8P_FVVOTk9PoILVCAuth "Front Camera Object Detection and Processing Burst 8 Protected : Forward Vision Vehicle Object Track 9 Point of Interest Lateral Velocity Covariance Authenticated";
BA_ "SignalLongName" SG_ 149 FCODPB8P_FVVOTk9PoIWAuth "Front Camera Object Detection and Processing Burst 8 Protected : Forward Vision Vehicle Object Track 9 Point of Interest Width Authenticated";
BA_ "SignalType" SG_ 149 FCODPB8P_FVVOTk9TypAuth "ENM";
BA_ "SignalLongName" SG_ 149 FCODPB8P_FVVOTk9TypAuth "Front Camera Object Detection and Processing Burst 8 Protected : Forward Vision Vehicle Object Track 9 Type Authenticated";
BA_ "SignalType" SG_ 149 FCODPB8P_FVVOTk9TSLgtStsAuth "ENM";
BA_ "SignalLongName" SG_ 149 FCODPB8P_FVVOTk9TSLgtStsAuth "Front Camera Object Detection and Processing Burst 8 Protected : Forward Vision Vehicle Object Track 9 Turn Signal Light Status Authenticated";
BA_ "SignalType" SG_ 149 FCODPB8P_FVVOTk9TypCnfdAuth "ENM";
BA_ "SignalLongName" SG_ 149 FCODPB8P_FVVOTk9TypCnfdAuth "Front Camera Object Detection and Processing Burst 8 Protected : Forward Vision Vehicle Object Track 9 Type Confidence Authenticated";
BA_ "SignalType" SG_ 225 FCODPB9P_FVCIPthVehAlrtNwAuth "ENM";
BA_ "SignalLongName" SG_ 225 FCODPB9P_FVCIPthVehAlrtNwAuth "Front Camera Object Detection and Processing Burst 9 Protected : Forward Vision Closest In Path Vehicle Alert Now Authenticated";
BA_ "SignalType" SG_ 225 FCODPB9P_FVCIPthVehAhdNwAuth "ENM";
BA_ "SignalLongName" SG_ 225 FCODPB9P_FVCIPthVehAhdNwAuth "Front Camera Object Detection and Processing Burst 9 Protected : Forward Vision Closest In Path Vehicle Ahead Now Authenticated";
BA_ "SignalType" SG_ 225 FCODPB9P_FrwdDistIndDgrdAuth "ENM";
BA_ "SignalLongName" SG_ 225 FCODPB9P_FrwdDistIndDgrdAuth "Front Camera Object Detection and Processing Burst 9 Protected : Forward Distance Indication Degraded Authenticated";
BA_ "SignalType" SG_ 225 FCODPB9P_FrwdClsnAlrtDgrdAuth "ENM";
BA_ "SignalLongName" SG_ 225 FCODPB9P_FrwdClsnAlrtDgrdAuth "Front Camera Object Detection and Processing Burst 9 Protected : Forward Collision Alert Degraded Authenticated";
BA_ "SignalType" SG_ 225 FCODPB9P_ClsnImntBrkgDgrdAuth "ENM";
BA_ "SignalLongName" SG_ 225 FCODPB9P_ClsnImntBrkgDgrdAuth "Front Camera Object Detection and Processing Burst 9 Protected : Collision Imminent Braking Degraded Authenticated";
BA_ "SignalType" SG_ 225 FCODPB9P_AdpCruzCtlDgrdAuth "ENM";
BA_ "SignalLongName" SG_ 225 FCODPB9P_AdpCruzCtlDgrdAuth "Front Camera Object Detection and Processing Burst 9 Protected : Adaptive Cruise Control Degraded Authenticated";
BA_ "SignalLongName" SG_ 225 FCODPB9P_BrstID "Front Camera Object Detection and Processing Burst 9 Protected : Burst ID";
BA_ "SignalLongName" SG_ 225 FCODPB9P_FVL1DrivableCnfdAuth "Front Camera Object Detection and Processing Burst 9 Protected : Forward Vision Lane 1 Drivable Confidence Authenticated";
BA_ "SignalType" SG_ 225 FCODPB9P_FVHTPNtfyNwAuth "ENM";
BA_ "SignalLongName" SG_ 225 FCODPB9P_FVHTPNtfyNwAuth "Front Camera Object Detection and Processing Burst 9 Protected : Forward Vision Highest Threat Pedestrian Notify Now Authenticated";
BA_ "SignalType" SG_ 225 FCODPB9P_FVHTPBrkNwAuth "ENM";
BA_ "SignalLongName" SG_ 225 FCODPB9P_FVHTPBrkNwAuth "Front Camera Object Detection and Processing Burst 9 Protected : Forward Vision Highest Threat Pedestrian Brake Now Authenticated";
BA_ "SignalType" SG_ 225 FCODPB9P_FVHTPAlrtNwAuth "ENM";
BA_ "SignalLongName" SG_ 225 FCODPB9P_FVHTPAlrtNwAuth "Front Camera Object Detection and Processing Burst 9 Protected : Forward Vision Highest Threat Pedestrian Alert Now Authenticated";
BA_ "SignalType" SG_ 225 FCODPB9P_FVCIPthVehBrkNwAuth "ENM";
BA_ "SignalLongName" SG_ 225 FCODPB9P_FVCIPthVehBrkNwAuth "Front Camera Object Detection and Processing Burst 9 Protected : Forward Vision Closest In Path Vehicle Brake Now Authenticated";
BA_ "SignalLongName" SG_ 225 FCODPB9P_FVL2DrivableCnfdAuth "Front Camera Object Detection and Processing Burst 9 Protected : Forward Vision Lane 2 Drivable Confidence Authenticated";
BA_ "SignalLongName" SG_ 225 FCODPB9P_FVL3DrivableCnfdAuth "Front Camera Object Detection and Processing Burst 9 Protected : Forward Vision Lane 3 Drivable Confidence Authenticated";
BA_ "SignalLongName" SG_ 225 FCODPB9P_FVL4DrivableCnfdAuth "Front Camera Object Detection and Processing Burst 9 Protected : Forward Vision Lane 4 Drivable Confidence Authenticated";
BA_ "SignalLongName" SG_ 225 FCODPB9P_FVLFTk1FPCrvCoefAuth "Front Camera Object Detection and Processing Burst 9 Protected : Forward Vision Lane Fusion Track 1 First Polynomial Curvature Coefficient Authenticated";
BA_ "SignalLongName" SG_ 225 FCODPB9P_FVL5DrivableCnfdAuth "Front Camera Object Detection and Processing Burst 9 Protected : Forward Vision Lane 5 Drivable Confidence Authenticated";
BA_ "SignalLongName" SG_ 225 FCODPB9P_FVLFTk1FPCrvDrvtCAuth "Front Camera Object Detection and Processing Burst 9 Protected : Forward Vision Lane Fusion Track 1 First Polynomial Curvature Derivative Coefficient Authenticated";
BA_ "SignalLongName" SG_ 225 FCODPB9P_FVLFTk1FPHdgCoefAuth "Front Camera Object Detection and Processing Burst 9 Protected : Forward Vision Lane Fusion Track 1 First Polynomial Heading Coefficient Authenticated";
BA_ "SignalLongName" SG_ 225 FCODPB9P_FVLFTk1FPOfstCoefAuth "Front Camera Object Detection and Processing Burst 9 Protected : Forward Vision Lane Fusion Track 1 First Polynomial Offset Coefficient Authenticated";
BA_ "SignalLongName" SG_ 225 FCODPB9P_FVLFTk1FPSegQltyAuth "Front Camera Object Detection and Processing Burst 9 Protected : Forward Vision Lane Fusion Track 1 First Polynomial Segment Quality Authenticated";
BA_ "SignalLongName" SG_ 225 FCODPB9P_FVLFTk1FPVRLgDistAuth "Front Camera Object Detection and Processing Burst 9 Protected : Forward Vision Lane Fusion Track 1 First Polynomial View Range Longitudinal Distance Authenticated";
BA_ "SignalLongName" SG_ 225 FCODPB9P_FVLFTk1FPVSLgDistAuth "Front Camera Object Detection and Processing Burst 9 Protected : Forward Vision Lane Fusion Track 1 First Polynomial View Start Longitudinal Distance Authenticated";
BA_ "SignalLongName" SG_ 225 FCODPB9P_FVLFTk2FPCrvCoefAuth "Front Camera Object Detection and Processing Burst 9 Protected : Forward Vision Lane Fusion Track 2 First Polynomial Curvature Coefficient Authenticated";
BA_ "SignalType" SG_ 225 FCODPB9P_FVLFTk1TypAuth "ENM";
BA_ "SignalLongName" SG_ 225 FCODPB9P_FVLFTk1TypAuth "Front Camera Object Detection and Processing Burst 9 Protected : Forward Vision Lane Fusion Track 1 Type Authenticated";
BA_ "SignalLongName" SG_ 225 FCODPB9P_FVLFTk2FPCrvDrvtCAuth "Front Camera Object Detection and Processing Burst 9 Protected : Forward Vision Lane Fusion Track 2 First Polynomial Curvature Derivative Coefficient Authenticated";
BA_ "SignalLongName" SG_ 225 FCODPB9P_FVLFTk2FPHdgCoefAuth "Front Camera Object Detection and Processing Burst 9 Protected : Forward Vision Lane Fusion Track 2 First Polynomial Heading Coefficient Authenticated";
BA_ "SignalLongName" SG_ 225 FCODPB9P_FVLFTk2FPOfstCoefAuth "Front Camera Object Detection and Processing Burst 9 Protected : Forward Vision Lane Fusion Track 2 First Polynomial Offset Coefficient Authenticated";
BA_ "SignalLongName" SG_ 225 FCODPB9P_FVLFTk2FPSegQltyAuth "Front Camera Object Detection and Processing Burst 9 Protected : Forward Vision Lane Fusion Track 2 First Polynomial Segment Quality Authenticated";
BA_ "SignalLongName" SG_ 225 FCODPB9P_FVLFTk2FPVRLgDistAuth "Front Camera Object Detection and Processing Burst 9 Protected : Forward Vision Lane Fusion Track 2 First Polynomial View Range Longitudinal Distance Authenticated";
BA_ "SignalType" SG_ 225 FCODPB9P_FVLFTk2TypAuth "ENM";
BA_ "SignalLongName" SG_ 225 FCODPB9P_FVLFTk2TypAuth "Front Camera Object Detection and Processing Burst 9 Protected : Forward Vision Lane Fusion Track 2 Type Authenticated";
BA_ "SignalLongName" SG_ 225 FCODPB9P_FVLFTk2FPVSLgDistAuth "Front Camera Object Detection and Processing Burst 9 Protected : Forward Vision Lane Fusion Track 2 First Polynomial View Start Longitudinal Distance Authenticated";
BA_ "SignalLongName" SG_ 225 FCODPB9P_FVLFTk3FPCrvCoefAuth "Front Camera Object Detection and Processing Burst 9 Protected : Forward Vision Lane Fusion Track 3 First Polynomial Curvature Coefficient Authenticated";
BA_ "SignalLongName" SG_ 225 FCODPB9P_FVLFTk3FPCrvDrvtCAuth "Front Camera Object Detection and Processing Burst 9 Protected : Forward Vision Lane Fusion Track 3 First Polynomial Curvature Derivative Coefficient Authenticated";
BA_ "SignalLongName" SG_ 225 FCODPB9P_FVLFTk3FPHdgCoefAuth "Front Camera Object Detection and Processing Burst 9 Protected : Forward Vision Lane Fusion Track 3 First Polynomial Heading Coefficient Authenticated";
BA_ "SignalLongName" SG_ 225 FCODPB9P_FVLFTk3FPOfstCoefAuth "Front Camera Object Detection and Processing Burst 9 Protected : Forward Vision Lane Fusion Track 3 First Polynomial Offset Coefficient Authenticated";
BA_ "SignalLongName" SG_ 225 FCODPB9P_FVLFTk3FPSegQltyAuth "Front Camera Object Detection and Processing Burst 9 Protected : Forward Vision Lane Fusion Track 3 First Polynomial Segment Quality Authenticated";
BA_ "SignalLongName" SG_ 225 FCODPB9P_FVLFTk3FPVRLgDistAuth "Front Camera Object Detection and Processing Burst 9 Protected : Forward Vision Lane Fusion Track 3 First Polynomial View Range Longitudinal Distance Authenticated";
BA_ "SignalLongName" SG_ 225 FCODPB9P_FVLFTk3FPVSLgDistAuth "Front Camera Object Detection and Processing Burst 9 Protected : Forward Vision Lane Fusion Track 3 First Polynomial View Start Longitudinal Distance Authenticated";
BA_ "SignalLongName" SG_ 225 FCODPB9P_FVLFTk4FPCrvCoefAuth "Front Camera Object Detection and Processing Burst 9 Protected : Forward Vision Lane Fusion Track 4 First Polynomial Curvature Coefficient Authenticated";
BA_ "SignalType" SG_ 225 FCODPB9P_FVLFTk3TypAuth "ENM";
BA_ "SignalLongName" SG_ 225 FCODPB9P_FVLFTk3TypAuth "Front Camera Object Detection and Processing Burst 9 Protected : Forward Vision Lane Fusion Track 3 Type Authenticated";
BA_ "SignalLongName" SG_ 225 FCODPB9P_FVLFTk4FPCrvDrvtCAuth "Front Camera Object Detection and Processing Burst 9 Protected : Forward Vision Lane Fusion Track 4 First Polynomial Curvature Derivative Coefficient Authenticated";
BA_ "SignalLongName" SG_ 225 FCODPB9P_FVLFTk4FPHdgCoefAuth "Front Camera Object Detection and Processing Burst 9 Protected : Forward Vision Lane Fusion Track 4 First Polynomial Heading Coefficient Authenticated";
BA_ "SignalLongName" SG_ 225 FCODPB9P_FVLFTk4FPOfstCoefAuth "Front Camera Object Detection and Processing Burst 9 Protected : Forward Vision Lane Fusion Track 4 First Polynomial Offset Coefficient Authenticated";
BA_ "SignalLongName" SG_ 225 FCODPB9P_FVLFTk4FPSegQltyAuth "Front Camera Object Detection and Processing Burst 9 Protected : Forward Vision Lane Fusion Track 4 First Polynomial Segment Quality Authenticated";
BA_ "SignalLongName" SG_ 225 FCODPB9P_FVLFTk4FPVRLgDistAuth "Front Camera Object Detection and Processing Burst 9 Protected : Forward Vision Lane Fusion Track 4 First Polynomial View Range Longitudinal Distance Authenticated";
BA_ "SignalLongName" SG_ 225 FCODPB9P_FVLFTk4FPVSLgDistAuth "Front Camera Object Detection and Processing Burst 9 Protected : Forward Vision Lane Fusion Track 4 First Polynomial View Start Longitudinal Distance Authenticated";
BA_ "SignalType" SG_ 225 FCODPB9P_PedtrnClsnBrkgDgrdAuth "ENM";
BA_ "SignalLongName" SG_ 225 FCODPB9P_PedtrnClsnBrkgDgrdAuth "Front Camera Object Detection and Processing Burst 9 Protected : Pedestrian Collision Braking Degraded Authenticated";
BA_ "SignalType" SG_ 225 FCODPB9P_PedtrnClsnAlrtDgrdAuth "ENM";
BA_ "SignalLongName" SG_ 225 FCODPB9P_PedtrnClsnAlrtDgrdAuth "Front Camera Object Detection and Processing Burst 9 Protected : Pedestrian Collision Alert Degraded Authenticated";
BA_ "SignalType" SG_ 225 FCODPB9P_LnKeepAsstDgrdAuth "ENM";
BA_ "SignalLongName" SG_ 225 FCODPB9P_LnKeepAsstDgrdAuth "Front Camera Object Detection and Processing Burst 9 Protected : Lane Keep Assist Degraded Authenticated";
BA_ "SignalType" SG_ 225 FCODPB9P_LnCntrDgrdAuth "ENM";
BA_ "SignalLongName" SG_ 225 FCODPB9P_LnCntrDgrdAuth "Front Camera Object Detection and Processing Burst 9 Protected : Lane Centering Degraded Authenticated";
BA_ "SignalType" SG_ 225 FCODPB9P_IntsctClsnMtgnDgrdAuth "ENM";
BA_ "SignalLongName" SG_ 225 FCODPB9P_IntsctClsnMtgnDgrdAuth "Front Camera Object Detection and Processing Burst 9 Protected : Intersection Collision Mitigation Degraded Authenticated";
BA_ "SignalType" SG_ 225 FCODPB9P_FVLFTk4TypAuth "ENM";
BA_ "SignalLongName" SG_ 225 FCODPB9P_FVLFTk4TypAuth "Front Camera Object Detection and Processing Burst 9 Protected : Forward Vision Lane Fusion Track 4 Type Authenticated";
BA_ "SignalType" SG_ 225 FCODPB9P_PedtrnNtfnDgrdAuth "ENM";
BA_ "SignalLongName" SG_ 225 FCODPB9P_PedtrnNtfnDgrdAuth "Front Camera Object Detection and Processing Burst 9 Protected : Pedestrian Notification Degraded Authenticated";
BA_ "SignalLongName" SG_ 226 FCODPB10P_FVVOTk10PoI2LgPsAuth "Front Camera Object Detection and Processing Burst 10 Protected : Forward Vision Vehicle Object Track 10 Point of Interest 2nd Longitudinal Position Authenticated";
BA_ "SignalType" SG_ 226 FCODPB10P_FVVOTk10PoI1PsVisAuth "ENM";
BA_ "SignalLongName" SG_ 226 FCODPB10P_FVVOTk10PoI1PsVisAuth "Front Camera Object Detection and Processing Burst 10 Protected : Forward Vision Vehicle Object Track 10 Point of Interest First Position Visibility Authenticated";
BA_ "SignalLongName" SG_ 226 FCODPB10P_BrstID "Front Camera Object Detection and Processing Burst 10 Protected : Burst ID";
BA_ "SignalLongName" SG_ 226 FCODPB10P_FVVOTk10PoI2LPsAuth "Front Camera Object Detection and Processing Burst 10 Protected : Forward Vision Vehicle Object Track 10 Point of Interest 2nd Lateral Position Authenticated";
BA_ "SignalLongName" SG_ 226 FCODPB10P_FVVOTk10PoI3LgPsAuth "Front Camera Object Detection and Processing Burst 10 Protected : Forward Vision Vehicle Object Track 10 Point of Interest 3rd Longitudinal Position Authenticated";
BA_ "SignalType" SG_ 226 FCODPB10P_FVVOTk10PoI2PsVisAuth "ENM";
BA_ "SignalLongName" SG_ 226 FCODPB10P_FVVOTk10PoI2PsVisAuth "Front Camera Object Detection and Processing Burst 10 Protected : Forward Vision Vehicle Object Track 10 Point of Interest 2nd Position Visibility Authenticated";
BA_ "SignalLongName" SG_ 226 FCODPB10P_FVVOTk10PoI3LPsAuth "Front Camera Object Detection and Processing Burst 10 Protected : Forward Vision Vehicle Object Track 10 Point of Interest 3rd Lateral Position Authenticated";
BA_ "SignalLongName" SG_ 226 FCODPB10P_FVVOTk1PoI2LgPsAuth "Front Camera Object Detection and Processing Burst 10 Protected : Forward Vision Vehicle Object Track 1 Point of Interest 2nd Longitudinal Position Authenticated";
BA_ "SignalType" SG_ 226 FCODPB10P_FVVOTk1PoI1PsVisAuth "ENM";
BA_ "SignalLongName" SG_ 226 FCODPB10P_FVVOTk1PoI1PsVisAuth "Front Camera Object Detection and Processing Burst 10 Protected : Forward Vision Vehicle Object Track 1 Point of Interest 1st Position Visibility Authenticated";
BA_ "SignalType" SG_ 226 FCODPB10P_FVVOTk10PoI3PsVisAuth "ENM";
BA_ "SignalLongName" SG_ 226 FCODPB10P_FVVOTk10PoI3PsVisAuth "Front Camera Object Detection and Processing Burst 10 Protected : Forward Vision Vehicle Object Track 10 Point of Interest 3rd Position Visibility Authenticated";
BA_ "SignalLongName" SG_ 226 FCODPB10P_FVVOTk1PoI2LPsAuth "Front Camera Object Detection and Processing Burst 10 Protected : Forward Vision Vehicle Object Track 1 Point of Interest 2nd Lateral Position Authenticated";
BA_ "SignalLongName" SG_ 226 FCODPB10P_FVVOTk1PoI3LgPsAuth "Front Camera Object Detection and Processing Burst 10 Protected : Forward Vision Vehicle Object Track 1 Point of Interest 3rd Longitudinal Position Authenticated";
BA_ "SignalType" SG_ 226 FCODPB10P_FVVOTk1PoI2PsVisAuth "ENM";
BA_ "SignalLongName" SG_ 226 FCODPB10P_FVVOTk1PoI2PsVisAuth "Front Camera Object Detection and Processing Burst 10 Protected : Forward Vision Vehicle Object Track 1 Point of Interest 2nd Position Visibility Authenticated";
BA_ "SignalLongName" SG_ 226 FCODPB10P_FVVOTk1PoI3LPsAuth "Front Camera Object Detection and Processing Burst 10 Protected : Forward Vision Vehicle Object Track 1 Point of Interest 3rd Lateral Position Authenticated";
BA_ "SignalLongName" SG_ 226 FCODPB10P_FVVOTk2PoI2LgPsAuth "Front Camera Object Detection and Processing Burst 10 Protected : Forward Vision Vehicle Object Track 2 Point of Interest 2nd Longitudinal Position Authenticated";
BA_ "SignalType" SG_ 226 FCODPB10P_FVVOTk2PoI1PsVisAuth "ENM";
BA_ "SignalLongName" SG_ 226 FCODPB10P_FVVOTk2PoI1PsVisAuth "Front Camera Object Detection and Processing Burst 10 Protected : Forward Vision Vehicle Object Track 2 Point of Interest 1st Position Visibility Authenticated";
BA_ "SignalType" SG_ 226 FCODPB10P_FVVOTk1PoI3PsVisAuth "ENM";
BA_ "SignalLongName" SG_ 226 FCODPB10P_FVVOTk1PoI3PsVisAuth "Front Camera Object Detection and Processing Burst 10 Protected : Forward Vision Vehicle Object Track 1 Point of Interest 3rd Position Visibility Authenticated";
BA_ "SignalLongName" SG_ 226 FCODPB10P_FVVOTk2PoI2LPsAuth "Front Camera Object Detection and Processing Burst 10 Protected : Forward Vision Vehicle Object Track 2 Point of Interest 2nd Lateral Position Authenticated";
BA_ "SignalLongName" SG_ 226 FCODPB10P_FVVOTk2PoI3LgPsAuth "Front Camera Object Detection and Processing Burst 10 Protected : Forward Vision Vehicle Object Track 2 Point of Interest 3rd Longitudinal Position Authenticated";
BA_ "SignalType" SG_ 226 FCODPB10P_FVVOTk2PoI2PsVisAuth "ENM";
BA_ "SignalLongName" SG_ 226 FCODPB10P_FVVOTk2PoI2PsVisAuth "Front Camera Object Detection and Processing Burst 10 Protected : Forward Vision Vehicle Object Track 2 Point of Interest 2nd Position Visibility Authenticated";
BA_ "SignalLongName" SG_ 226 FCODPB10P_FVVOTk2PoI3LPsAuth "Front Camera Object Detection and Processing Burst 10 Protected : Forward Vision Vehicle Object Track 2 Point of Interest 3rd Lateral Position Authenticated";
BA_ "SignalLongName" SG_ 226 FCODPB10P_FVVOTk3PoI2LgPsAuth "Front Camera Object Detection and Processing Burst 10 Protected : Forward Vision Vehicle Object Track 3 Point of Interest 2nd Longitudinal Position Authenticated";
BA_ "SignalType" SG_ 226 FCODPB10P_FVVOTk3PoI1PsVisAuth "ENM";
BA_ "SignalLongName" SG_ 226 FCODPB10P_FVVOTk3PoI1PsVisAuth "Front Camera Object Detection and Processing Burst 10 Protected : Forward Vision Vehicle Object Track 3 Point of Interest 1st Position Visibility Authenticated";
BA_ "SignalType" SG_ 226 FCODPB10P_FVVOTk2PoI3PsVisAuth "ENM";
BA_ "SignalLongName" SG_ 226 FCODPB10P_FVVOTk2PoI3PsVisAuth "Front Camera Object Detection and Processing Burst 10 Protected : Forward Vision Vehicle Object Track 2 Point of Interest 3rd Position Visibility Authenticated";
BA_ "SignalLongName" SG_ 226 FCODPB10P_FVVOTk3PoI2LPsAuth "Front Camera Object Detection and Processing Burst 10 Protected : Forward Vision Vehicle Object Track 3 Point of Interest 2nd Lateral Position Authenticated";
BA_ "SignalLongName" SG_ 226 FCODPB10P_FVVOTk3PoI3LgPsAuth "Front Camera Object Detection and Processing Burst 10 Protected : Forward Vision Vehicle Object Track 3 Point of Interest 3rd Longitudinal Position Authenticated";
BA_ "SignalType" SG_ 226 FCODPB10P_FVVOTk3PoI2PsVisAuth "ENM";
BA_ "SignalLongName" SG_ 226 FCODPB10P_FVVOTk3PoI2PsVisAuth "Front Camera Object Detection and Processing Burst 10 Protected : Forward Vision Vehicle Object Track 3 Point of Interest 2nd Position Visibility Authenticated";
BA_ "SignalLongName" SG_ 226 FCODPB10P_FVVOTk3PoI3LPsAuth "Front Camera Object Detection and Processing Burst 10 Protected : Forward Vision Vehicle Object Track 3 Point of Interest 3rd Lateral Position Authenticated";
BA_ "SignalLongName" SG_ 226 FCODPB10P_FVVOTk4PoI2LgPsAuth "Front Camera Object Detection and Processing Burst 10 Protected : Forward Vision Vehicle Object Track 4 Point of Interest 2nd Longitudinal Position Authenticated";
BA_ "SignalType" SG_ 226 FCODPB10P_FVVOTk4PoI1PsVisAuth "ENM";
BA_ "SignalLongName" SG_ 226 FCODPB10P_FVVOTk4PoI1PsVisAuth "Front Camera Object Detection and Processing Burst 10 Protected : Forward Vision Vehicle Object Track 4 Point of Interest 1st Position Visibility Authenticated";
BA_ "SignalType" SG_ 226 FCODPB10P_FVVOTk3PoI3PsVisAuth "ENM";
BA_ "SignalLongName" SG_ 226 FCODPB10P_FVVOTk3PoI3PsVisAuth "Front Camera Object Detection and Processing Burst 10 Protected : Forward Vision Vehicle Object Track 3 Point of Interest 3rd Position Visibility Authenticated";
BA_ "SignalLongName" SG_ 226 FCODPB10P_FVVOTk4PoI2LPsAuth "Front Camera Object Detection and Processing Burst 10 Protected : Forward Vision Vehicle Object Track 4 Point of Interest 2nd Lateral Position Authenticated";
BA_ "SignalLongName" SG_ 226 FCODPB10P_FVVOTk4PoI3LgPsAuth "Front Camera Object Detection and Processing Burst 10 Protected : Forward Vision Vehicle Object Track 4 Point of Interest 3rd Longitudinal Position Authenticated";
BA_ "SignalType" SG_ 226 FCODPB10P_FVVOTk4PoI2PsVisAuth "ENM";
BA_ "SignalLongName" SG_ 226 FCODPB10P_FVVOTk4PoI2PsVisAuth "Front Camera Object Detection and Processing Burst 10 Protected : Forward Vision Vehicle Object Track 4 Point of Interest 2nd Position Visibility Authenticated";
BA_ "SignalLongName" SG_ 226 FCODPB10P_FVVOTk4PoI3LPsAuth "Front Camera Object Detection and Processing Burst 10 Protected : Forward Vision Vehicle Object Track 4 Point of Interest 3rd Lateral Position Authenticated";
BA_ "SignalLongName" SG_ 226 FCODPB10P_FVVOTk5PoI2LgPsAuth "Front Camera Object Detection and Processing Burst 10 Protected : Forward Vision Vehicle Object Track 5 Point of Interest 2nd Longitudinal Position Authenticated";
BA_ "SignalType" SG_ 226 FCODPB10P_FVVOTk5PoI1PsVisAuth "ENM";
BA_ "SignalLongName" SG_ 226 FCODPB10P_FVVOTk5PoI1PsVisAuth "Front Camera Object Detection and Processing Burst 10 Protected : Forward Vision Vehicle Object Track 5 Point of Interest 1st Position Visibility Authenticated";
BA_ "SignalType" SG_ 226 FCODPB10P_FVVOTk4PoI3PsVisAuth "ENM";
BA_ "SignalLongName" SG_ 226 FCODPB10P_FVVOTk4PoI3PsVisAuth "Front Camera Object Detection and Processing Burst 10 Protected : Forward Vision Vehicle Object Track 4 Point of Interest 3rd Position Visibility Authenticated";
BA_ "SignalLongName" SG_ 226 FCODPB10P_FVVOTk5PoI2LPsAuth "Front Camera Object Detection and Processing Burst 10 Protected : Forward Vision Vehicle Object Track 5 Point of Interest 2nd Lateral Position Authenticated";
BA_ "SignalLongName" SG_ 226 FCODPB10P_FVVOTk5PoI3LgPsAuth "Front Camera Object Detection and Processing Burst 10 Protected : Forward Vision Vehicle Object Track 5 Point of Interest 3rd Longitudinal Position Authenticated";
BA_ "SignalType" SG_ 226 FCODPB10P_FVVOTk5PoI2PsVisAuth "ENM";
BA_ "SignalLongName" SG_ 226 FCODPB10P_FVVOTk5PoI2PsVisAuth "Front Camera Object Detection and Processing Burst 10 Protected : Forward Vision Vehicle Object Track 5 Point of Interest 2nd Position Visibility Authenticated";
BA_ "SignalLongName" SG_ 226 FCODPB10P_FVVOTk5PoI3LPsAuth "Front Camera Object Detection and Processing Burst 10 Protected : Forward Vision Vehicle Object Track 5 Point of Interest 3rd Lateral Position Authenticated";
BA_ "SignalLongName" SG_ 226 FCODPB10P_FVVOTk6PoI2LgPsAuth "Front Camera Object Detection and Processing Burst 10 Protected : Forward Vision Vehicle Object Track 6 Point of Interest 2nd Longitudinal Position Authenticated";
BA_ "SignalType" SG_ 226 FCODPB10P_FVVOTk6PoI1PsVisAuth "ENM";
BA_ "SignalLongName" SG_ 226 FCODPB10P_FVVOTk6PoI1PsVisAuth "Front Camera Object Detection and Processing Burst 10 Protected : Forward Vision Vehicle Object Track 6 Point of Interest 1st Position Visibility Authenticated";
BA_ "SignalType" SG_ 226 FCODPB10P_FVVOTk5PoI3PsVisAuth "ENM";
BA_ "SignalLongName" SG_ 226 FCODPB10P_FVVOTk5PoI3PsVisAuth "Front Camera Object Detection and Processing Burst 10 Protected : Forward Vision Vehicle Object Track 5 Point of Interest 3rd Position Visibility Authenticated";
BA_ "SignalLongName" SG_ 226 FCODPB10P_FVVOTk6PoI2LPsAuth "Front Camera Object Detection and Processing Burst 10 Protected : Forward Vision Vehicle Object Track 6 Point of Interest 2nd Lateral Position Authenticated";
BA_ "SignalLongName" SG_ 226 FCODPB10P_FVVOTk6PoI3LgPsAuth "Front Camera Object Detection and Processing Burst 10 Protected : Forward Vision Vehicle Object Track 6 Point of Interest 3rd Longitudinal Position Authenticated";
BA_ "SignalType" SG_ 226 FCODPB10P_FVVOTk6PoI2PsVisAuth "ENM";
BA_ "SignalLongName" SG_ 226 FCODPB10P_FVVOTk6PoI2PsVisAuth "Front Camera Object Detection and Processing Burst 10 Protected : Forward Vision Vehicle Object Track 6 Point of Interest 2nd Position Visibility Authenticated";
BA_ "SignalLongName" SG_ 226 FCODPB10P_FVVOTk6PoI3LPsAuth "Front Camera Object Detection and Processing Burst 10 Protected : Forward Vision Vehicle Object Track 6 Point of Interest 3rd Lateral Position Authenticated";
BA_ "SignalLongName" SG_ 226 FCODPB10P_FVVOTk7PoI2LgPsAuth "Front Camera Object Detection and Processing Burst 10 Protected : Forward Vision Vehicle Object Track 7 Point of Interest 2nd Longitudinal Position Authenticated";
BA_ "SignalType" SG_ 226 FCODPB10P_FVVOTk7PoI1PsVisAuth "ENM";
BA_ "SignalLongName" SG_ 226 FCODPB10P_FVVOTk7PoI1PsVisAuth "Front Camera Object Detection and Processing Burst 10 Protected : Forward Vision Vehicle Object Track 7 Point of Interest 1st Position Visibility Authenticated";
BA_ "SignalType" SG_ 226 FCODPB10P_FVVOTk6PoI3PsVisAuth "ENM";
BA_ "SignalLongName" SG_ 226 FCODPB10P_FVVOTk6PoI3PsVisAuth "Front Camera Object Detection and Processing Burst 10 Protected : Forward Vision Vehicle Object Track 6 Point of Interest 3rd Position Visibility Authenticated";
BA_ "SignalLongName" SG_ 226 FCODPB10P_FVVOTk7PoI2LPsAuth "Front Camera Object Detection and Processing Burst 10 Protected : Forward Vision Vehicle Object Track 7 Point of Interest 2nd Lateral Position Authenticated";
BA_ "SignalLongName" SG_ 226 FCODPB10P_FVVOTk7PoI3LgPsAuth "Front Camera Object Detection and Processing Burst 10 Protected : Forward Vision Vehicle Object Track 7 Point of Interest 3rd Longitudinal Position Authenticated";
BA_ "SignalType" SG_ 226 FCODPB10P_FVVOTk7PoI2PsVisAuth "ENM";
BA_ "SignalLongName" SG_ 226 FCODPB10P_FVVOTk7PoI2PsVisAuth "Front Camera Object Detection and Processing Burst 10 Protected : Forward Vision Vehicle Object Track 7 Point of Interest 2nd Position Visibility Authenticated";
BA_ "SignalLongName" SG_ 226 FCODPB10P_FVVOTk7PoI3LPsAuth "Front Camera Object Detection and Processing Burst 10 Protected : Forward Vision Vehicle Object Track 7 Point of Interest 3rd Lateral Position Authenticated";
BA_ "SignalLongName" SG_ 226 FCODPB10P_FVVOTk8PoI2LgPsAuth "Front Camera Object Detection and Processing Burst 10 Protected : Forward Vision Vehicle Object Track 8 Point of Interest 2nd Longitudinal Position Authenticated";
BA_ "SignalType" SG_ 226 FCODPB10P_FVVOTk8PoI1PsVisAuth "ENM";
BA_ "SignalLongName" SG_ 226 FCODPB10P_FVVOTk8PoI1PsVisAuth "Front Camera Object Detection and Processing Burst 10 Protected : Forward Vision Vehicle Object Track 8 Point of Interest 1st Position Visibility Authenticated";
BA_ "SignalType" SG_ 226 FCODPB10P_FVVOTk7PoI3PsVisAuth "ENM";
BA_ "SignalLongName" SG_ 226 FCODPB10P_FVVOTk7PoI3PsVisAuth "Front Camera Object Detection and Processing Burst 10 Protected : Forward Vision Vehicle Object Track 7 Point of Interest 3rd Position Visibility Authenticated";
BA_ "SignalLongName" SG_ 226 FCODPB10P_FVVOTk8PoI2LPsAuth "Front Camera Object Detection and Processing Burst 10 Protected : Forward Vision Vehicle Object Track 8 Point of Interest 2nd Lateral Position Authenticated";
BA_ "SignalLongName" SG_ 226 FCODPB10P_FVVOTk8PoI3LgPsAuth "Front Camera Object Detection and Processing Burst 10 Protected : Forward Vision Vehicle Object Track 8 Point of Interest 3rd Longitudinal Position Authenticated";
BA_ "SignalType" SG_ 226 FCODPB10P_FVVOTk8PoI2PsVisAuth "ENM";
BA_ "SignalLongName" SG_ 226 FCODPB10P_FVVOTk8PoI2PsVisAuth "Front Camera Object Detection and Processing Burst 10 Protected : Forward Vision Vehicle Object Track 8 Point of Interest 2nd Position Visibility Authenticated";
BA_ "SignalLongName" SG_ 226 FCODPB10P_FVVOTk8PoI3LPsAuth "Front Camera Object Detection and Processing Burst 10 Protected : Forward Vision Vehicle Object Track 8 Point of Interest 3rd Lateral Position Authenticated";
BA_ "SignalLongName" SG_ 226 FCODPB10P_FVVOTk9PoI2LgPsAuth "Front Camera Object Detection and Processing Burst 10 Protected : Forward Vision Vehicle Object Track 9 Point of Interest 2nd Longitudinal Position Authenticated";
BA_ "SignalType" SG_ 226 FCODPB10P_FVVOTk9PoI1PsVisAuth "ENM";
BA_ "SignalLongName" SG_ 226 FCODPB10P_FVVOTk9PoI1PsVisAuth "Front Camera Object Detection and Processing Burst 10 Protected : Forward Vision Vehicle Object Track 9 Point of Interest 1st Position Visibility Authenticated";
BA_ "SignalType" SG_ 226 FCODPB10P_FVVOTk8PoI3PsVisAuth "ENM";
BA_ "SignalLongName" SG_ 226 FCODPB10P_FVVOTk8PoI3PsVisAuth "Front Camera Object Detection and Processing Burst 10 Protected : Forward Vision Vehicle Object Track 8 Point of Interest 3rd Position Visibility Authenticated";
BA_ "SignalLongName" SG_ 226 FCODPB10P_FVVOTk9PoI2LPsAuth "Front Camera Object Detection and Processing Burst 10 Protected : Forward Vision Vehicle Object Track 9 Point of Interest 2nd Lateral Position Authenticated";
BA_ "SignalLongName" SG_ 226 FCODPB10P_FVVOTk9PoI3LgPsAuth "Front Camera Object Detection and Processing Burst 10 Protected : Forward Vision Vehicle Object Track 9 Point of Interest 3rd Longitudinal Position Authenticated";
BA_ "SignalType" SG_ 226 FCODPB10P_FVVOTk9PoI2PsVisAuth "ENM";
BA_ "SignalLongName" SG_ 226 FCODPB10P_FVVOTk9PoI2PsVisAuth "Front Camera Object Detection and Processing Burst 10 Protected : Forward Vision Vehicle Object Track 9 Point of Interest 2nd Position Visibility Authenticated";
BA_ "SignalLongName" SG_ 226 FCODPB10P_FVVOTk9PoI3LPsAuth "Front Camera Object Detection and Processing Burst 10 Protected : Forward Vision Vehicle Object Track 9 Point of Interest 3rd Lateral Position Authenticated";
BA_ "SignalType" SG_ 226 FCODPB10P_FVVOTk9PoI3PsVisAuth "ENM";
BA_ "SignalLongName" SG_ 226 FCODPB10P_FVVOTk9PoI3PsVisAuth "Front Camera Object Detection and Processing Burst 10 Protected : Forward Vision Vehicle Object Track 9 Point of Interest 3rd Position Visibility Authenticated";
BA_ "SignalLongName" SG_ 142 FCODPB1P_MAC "Front Camera Object Detection and Processing Burst 1 Protected : MAC";
BA_ "SignalLongName" SG_ 142 FCODPB1P_FCnt "Front Camera Object Detection and Processing Burst 1 Protected : Freshness Counter";
BA_ "SignalLongName" SG_ 142 FCODPB1P_FVLBTk1CrvAuth "Front Camera Object Detection and Processing Burst 1 Protected : Forward Vision Lane Boundary Track 1 Curvature Authenticated";
BA_ "SignalType" SG_ 142 FCODPB1P_FVLBTk1ClrAuth "ENM";
BA_ "SignalLongName" SG_ 142 FCODPB1P_FVLBTk1ClrAuth "Front Camera Object Detection and Processing Burst 1 Protected : Forward Vision Lane Boundary Track 1 Color Authenticated";
BA_ "SignalLongName" SG_ 142 FCODPB1P_BrstID "Front Camera Object Detection and Processing Burst 1 Protected : Burst ID";
BA_ "SignalLongName" SG_ 142 FCODPB1P_FVLBTk1CrvDrvtAuth "Front Camera Object Detection and Processing Burst 1 Protected : Forward Vision Lane Boundary Track 1 Curvature Derivative Authenticated";
BA_ "SignalLongName" SG_ 142 FCODPB1P_FVLBTk1FPSABCQOvrAuth "Front Camera Object Detection and Processing Burst 1 Protected : Forward Vision Lane Boundary Track 1 First Polynomial Segment ABC Quality Overall Authenticated";
BA_ "SignalLongName" SG_ 142 FCODPB1P_FVLBTk1FPSAQAuth "Front Camera Object Detection and Processing Burst 1 Protected : Forward Vision Lane Boundary Track 1 First Polynomial Segment A Quality Authenticated";
BA_ "SignalLongName" SG_ 142 FCODPB1P_FVLBTk1FPSBQAuth "Front Camera Object Detection and Processing Burst 1 Protected : Forward Vision Lane Boundary Track 1 First Polynomial Segment B Quality Authenticated";
BA_ "SignalLongName" SG_ 142 FCODPB1P_FVLBTk1FPSCQAuth "Front Camera Object Detection and Processing Burst 1 Protected : Forward Vision Lane Boundary Track 1 First Polynomial Segment C Quality Authenticated";
BA_ "SignalLongName" SG_ 142 FCODPB1P_FVLBTk1HdgAuth "Front Camera Object Detection and Processing Burst 1 Protected : Forward Vision Lane Boundary Track 1 Heading Authenticated";
BA_ "SignalLongName" SG_ 142 FCODPB1P_FVLBTk1OfstAuth "Front Camera Object Detection and Processing Burst 1 Protected : Forward Vision Lane Boundary Track 1 Offset Authenticated";
BA_ "SignalType" SG_ 142 FCODPB1P_FVLBTk1PstnTypAuth "ENM";
BA_ "SignalLongName" SG_ 142 FCODPB1P_FVLBTk1PstnTypAuth "Front Camera Object Detection and Processing Burst 1 Protected : Forward Vision Lane Boundary Track 1 Position Type Authenticated";
BA_ "SignalType" SG_ 142 FCODPB1P_FVLBTk1TypAuth "ENM";
BA_ "SignalLongName" SG_ 142 FCODPB1P_FVLBTk1TypAuth "Front Camera Object Detection and Processing Burst 1 Protected : Forward Vision Lane Boundary Track 1 Type Authenticated";
BA_ "SignalType" SG_ 142 FCODPB1P_FVLBTk1QltyAuth "ENM";
BA_ "SignalLongName" SG_ 142 FCODPB1P_FVLBTk1QltyAuth "Front Camera Object Detection and Processing Burst 1 Protected : Forward Vision Lane Boundary Track 1 Quality Authenticated";
BA_ "SignalLongName" SG_ 142 FCODPB1P_FVLBTk1VSLgDistAuth "Front Camera Object Detection and Processing Burst 1 Protected : Forward Vision Lane Boundary Track 1 View Start Longitudinal Distance Authenticated";
BA_ "SignalLongName" SG_ 142 FCODPB1P_FVLBTk1VRLgDistAuth "Front Camera Object Detection and Processing Burst 1 Protected : Forward Vision Lane Boundary Track 1 View Range Longitudinal Distance Authenticated";
BA_ "SignalLongName" SG_ 142 FCODPB1P_FVLBTk1WdthAuth "Front Camera Object Detection and Processing Burst 1 Protected : Forward Vision Lane Boundary Track 1 Width Authenticated";
BA_ "SignalType" SG_ 142 FCODPB1P_FVPOTk1DynPrpAuth "ENM";
BA_ "SignalLongName" SG_ 142 FCODPB1P_FVPOTk1DynPrpAuth "Front Camera Object Detection and Processing Burst 1 Protected : Forward Vision Pedestrian Object Track 1 Dynamic Property Authenticated";
BA_ "SignalType" SG_ 142 FCODPB1P_FVPOTk1CnfdStsAuth "ENM";
BA_ "SignalLongName" SG_ 142 FCODPB1P_FVPOTk1CnfdStsAuth "Front Camera Object Detection and Processing Burst 1 Protected : Forward Vision Pedestrian Object Track 1 Confidence Status Authenticated";
BA_ "SignalLongName" SG_ 142 FCODPB1P_FVPOTk1InPthPotAuth "Front Camera Object Detection and Processing Burst 1 Protected : Forward Vision Pedestrian Object Track 1 In Path Potential Authenticated";
BA_ "SignalLongName" SG_ 142 FCODPB1P_FVPOTk1IDAuth "Front Camera Object Detection and Processing Burst 1 Protected : Forward Vision Pedestrian Object Track 1 ID Authenticated";
BA_ "SignalLongName" SG_ 142 FCODPB1P_FVPOTk1PoILAAuth "Front Camera Object Detection and Processing Burst 1 Protected : Forward Vision Pedestrian Object Track 1 Point of Interest Lateral Acceleration Authenticated";
BA_ "SignalType" SG_ 142 FCODPB1P_FVPOTk1MStsAuth "ENM";
BA_ "SignalLongName" SG_ 142 FCODPB1P_FVPOTk1MStsAuth "Front Camera Object Detection and Processing Burst 1 Protected : Forward Vision Pedestrian Object Track 1 Measurement Status Authenticated";
BA_ "SignalLongName" SG_ 142 FCODPB1P_FVPOTk1PoILgAAuth "Front Camera Object Detection and Processing Burst 1 Protected : Forward Vision Pedestrian Object Track 1 Point of Interest Longitudinal Acceleration Authenticated";
BA_ "SignalLongName" SG_ 142 FCODPB1P_FVPOTk1PoILgPsAuth "Front Camera Object Detection and Processing Burst 1 Protected : Forward Vision Pedestrian Object Track 1 Point of Interest Longitudinal Position Authenticated";
BA_ "SignalLongName" SG_ 142 FCODPB1P_FVPOTk1PoILgVAuth "Front Camera Object Detection and Processing Burst 1 Protected : Forward Vision Pedestrian Object Track 1 Point of Interest Longitudinal Velocity Authenticated";
BA_ "SignalLongName" SG_ 142 FCODPB1P_FVPOTk1PoILPsAuth "Front Camera Object Detection and Processing Burst 1 Protected : Forward Vision Pedestrian Object Track 1 Point of Interest Lateral Position Authenticated";
BA_ "SignalLongName" SG_ 142 FCODPB1P_FVPOTk1PoILVAuth "Front Camera Object Detection and Processing Burst 1 Protected : Forward Vision Pedestrian Object Track 1 Point of Interest Lateral Velocity Authenticated";
BA_ "SignalLongName" SG_ 142 FCODPB1P_FVVOTk1CICOPotAuth "Front Camera Object Detection and Processing Burst 1 Protected : Forward Vision Vehicle Object Track 1 Cut In Cut Out Potential Authenticated";
BA_ "SignalType" SG_ 142 FCODPB1P_FVVOTk1BrkLgtStsAuth "ENM";
BA_ "SignalLongName" SG_ 142 FCODPB1P_FVVOTk1BrkLgtStsAuth "Front Camera Object Detection and Processing Burst 1 Protected : Forward Vision Vehicle Object Track 1 Brake Light Status Authenticated";
BA_ "SignalType" SG_ 142 FCODPB1P_FVPOTk1TypCnfdAuth "ENM";
BA_ "SignalLongName" SG_ 142 FCODPB1P_FVPOTk1TypCnfdAuth "Front Camera Object Detection and Processing Burst 1 Protected : Forward Vision Pedestrian Object Track 1 Type Confidence Authenticated";
BA_ "SignalType" SG_ 142 FCODPB1P_FVPOTk1TypAuth "ENM";
BA_ "SignalLongName" SG_ 142 FCODPB1P_FVPOTk1TypAuth "Front Camera Object Detection and Processing Burst 1 Protected : Forward Vision Pedestrian Object Track 1 Type Authenticated";
BA_ "SignalType" SG_ 142 FCODPB1P_FVVOTk1DynPrpAuth "ENM";
BA_ "SignalLongName" SG_ 142 FCODPB1P_FVVOTk1DynPrpAuth "Front Camera Object Detection and Processing Burst 1 Protected : Forward Vision Vehicle Object Track 1 Dynamic Property Authenticated";
BA_ "SignalType" SG_ 142 FCODPB1P_FVVOTk1CnfdStsAuth "ENM";
BA_ "SignalLongName" SG_ 142 FCODPB1P_FVVOTk1CnfdStsAuth "Front Camera Object Detection and Processing Burst 1 Protected : Forward Vision Vehicle Object Track 1 Confidence Status Authenticated";
BA_ "SignalLongName" SG_ 142 FCODPB1P_FVVOTk1HdgAngAuth "Front Camera Object Detection and Processing Burst 1 Protected : Forward Vision Vehicle Object Track 1 Heading Angle Authenticated";
BA_ "SignalType" SG_ 142 FCODPB1P_FVVOTk1DynPrpStsAuth "ENM";
BA_ "SignalLongName" SG_ 142 FCODPB1P_FVVOTk1DynPrpStsAuth "Front Camera Object Detection and Processing Burst 1 Protected : Forward Vision Vehicle Object Track 1 Dynamic Property Status Authenticated";
BA_ "SignalLongName" SG_ 142 FCODPB1P_FVVOTk1HdgAngCAuth "Front Camera Object Detection and Processing Burst 1 Protected : Forward Vision Vehicle Object Track 1 Heading Angle Covariance Authenticated";
BA_ "SignalLongName" SG_ 142 FCODPB1P_FVVOTk1IDAuth "Front Camera Object Detection and Processing Burst 1 Protected : Forward Vision Vehicle Object Track 1 ID Authenticated";
BA_ "SignalLongName" SG_ 142 FCODPB1P_FVVOTk1PoILAAuth "Front Camera Object Detection and Processing Burst 1 Protected : Forward Vision Vehicle Object Track 1 Point of Interest Lateral Acceleration Authenticated";
BA_ "SignalType" SG_ 142 FCODPB1P_FVVOTk1MStsAuth "ENM";
BA_ "SignalLongName" SG_ 142 FCODPB1P_FVVOTk1MStsAuth "Front Camera Object Detection and Processing Burst 1 Protected : Forward Vision Vehicle Object Track 1 Measurement Status Authenticated";
BA_ "SignalType" SG_ 142 FCODPB1P_FVVOTk1LnAsmtAuth "ENM";
BA_ "SignalLongName" SG_ 142 FCODPB1P_FVVOTk1LnAsmtAuth "Front Camera Object Detection and Processing Burst 1 Protected : Forward Vision Vehicle Object Track 1 Lane Assignment Authenticated";
BA_ "SignalLongName" SG_ 142 FCODPB1P_FVVOTk1PoILgAAuth "Front Camera Object Detection and Processing Burst 1 Protected : Forward Vision Vehicle Object Track 1 Point of Interest Longitudinal Acceleration Authenticated";
BA_ "SignalLongName" SG_ 142 FCODPB1P_FVVOTk1PoILgPsAuth "Front Camera Object Detection and Processing Burst 1 Protected : Forward Vision Vehicle Object Track 1 Point of Interest Longitudinal Position Authenticated";
BA_ "SignalLongName" SG_ 142 FCODPB1P_FVVOTk1PoILgPsCAuth "Front Camera Object Detection and Processing Burst 1 Protected : Forward Vision Vehicle Object Track 1 Point of Interest Longitudinal Position Covariance Authenticated";
BA_ "SignalLongName" SG_ 142 FCODPB1P_FVVOTk1PoILgVAuth "Front Camera Object Detection and Processing Burst 1 Protected : Forward Vision Vehicle Object Track 1 Point of Interest Longitudinal Velocity Authenticated";
BA_ "SignalLongName" SG_ 142 FCODPB1P_FVVOTk1PoILgVCAuth "Front Camera Object Detection and Processing Burst 1 Protected : Forward Vision Vehicle Object Track 1 Point of Interest Longitudinal Velocity Covariance Authenticated";
BA_ "SignalLongName" SG_ 142 FCODPB1P_FVVOTk1PoILPsAuth "Front Camera Object Detection and Processing Burst 1 Protected : Forward Vision Vehicle Object Track 1 Point of Interest Lateral Position Authenticated";
BA_ "SignalLongName" SG_ 142 FCODPB1P_FVVOTk1PoILPsCAuth "Front Camera Object Detection and Processing Burst 1 Protected : Forward Vision Vehicle Object Track 1 Point of Interest Lateral Position Covariance Authenticated";
BA_ "SignalLongName" SG_ 142 FCODPB1P_FVVOTk1PoILVAuth "Front Camera Object Detection and Processing Burst 1 Protected : Forward Vision Vehicle Object Track 1 Point of Interest Lateral Velocity Authenticated";
BA_ "SignalLongName" SG_ 142 FCODPB1P_FVVOTk1PoILVCAuth "Front Camera Object Detection and Processing Burst 1 Protected : Forward Vision Vehicle Object Track 1 Point of Interest Lateral Velocity Covariance Authenticated";
BA_ "SignalLongName" SG_ 142 FCODPB1P_FVVOTk1PoIWAuth "Front Camera Object Detection and Processing Burst 1 Protected : Forward Vision Vehicle Object Track 1 Point of Interest Width Authenticated";
BA_ "SignalType" SG_ 142 FCODPB1P_FVVOTk1TypCnfdAuth "ENM";
BA_ "SignalLongName" SG_ 142 FCODPB1P_FVVOTk1TypCnfdAuth "Front Camera Object Detection and Processing Burst 1 Protected : Forward Vision Vehicle Object Track 1 Type Confidence Authenticated";
BA_ "SignalType" SG_ 142 FCODPB1P_FVVOTk1TypAuth "ENM";
BA_ "SignalLongName" SG_ 142 FCODPB1P_FVVOTk1TypAuth "Front Camera Object Detection and Processing Burst 1 Protected : Forward Vision Vehicle Object Track 1 Type Authenticated";
BA_ "SignalType" SG_ 142 FCODPB1P_FVVOTk1TSLgtStsAuth "ENM";
BA_ "SignalLongName" SG_ 142 FCODPB1P_FVVOTk1TSLgtStsAuth "Front Camera Object Detection and Processing Burst 1 Protected : Forward Vision Vehicle Object Track 1 Turn Signal Light Status Authenticated";
BA_ "SignalLongName" SG_ 142 FCODPB1P_FVVOTk10VehLnCrsTmAuth "Front Camera Object Detection and Processing Burst 1 Protected : Forward Vision Vehicle Object Track 10 Vehicle Lane Cross Time Authenticated";
BA_ "SignalLongName" SG_ 142 FCODPB1P_ARC "Front Camera Object Detection and Processing Burst 1 Protected : Alive Rolling Count";
BA_ "SignalLongName" SG_ 142 FCODPB1P_FVVOTk1VehLnCrsTmAuth "Front Camera Object Detection and Processing Burst 1 Protected : Forward Vision Vehicle Object Track 1 Vehicle Lane Cross Time Authenticated";
BA_ "SignalLongName" SG_ 142 FCODPB1P_FVVOTk2VehLnCrsTmAuth "Front Camera Object Detection and Processing Burst 1 Protected : Forward Vision Vehicle Object Track 2 Vehicle Lane Cross Time Authenticated";
BA_ "SignalLongName" SG_ 142 FCODPB1P_FVVOTk3VehLnCrsTmAuth "Front Camera Object Detection and Processing Burst 1 Protected : Forward Vision Vehicle Object Track 3 Vehicle Lane Cross Time Authenticated";
BA_ "SignalLongName" SG_ 142 FCODPB1P_FVVOTk4VehLnCrsTmAuth "Front Camera Object Detection and Processing Burst 1 Protected : Forward Vision Vehicle Object Track 4 Vehicle Lane Cross Time Authenticated";
BA_ "SignalLongName" SG_ 142 FCODPB1P_FVVOTk5VehLnCrsTmAuth "Front Camera Object Detection and Processing Burst 1 Protected : Forward Vision Vehicle Object Track 5 Vehicle Lane Cross Time Authenticated";
BA_ "SignalLongName" SG_ 142 FCODPB1P_FVVOTk6VehLnCrsTmAuth "Front Camera Object Detection and Processing Burst 1 Protected : Forward Vision Vehicle Object Track 6 Vehicle Lane Cross Time Authenticated";
BA_ "SignalLongName" SG_ 142 FCODPB1P_FVVOTk7VehLnCrsTmAuth "Front Camera Object Detection and Processing Burst 1 Protected : Forward Vision Vehicle Object Track 7 Vehicle Lane Cross Time Authenticated";
BA_ "SignalLongName" SG_ 142 FCODPB1P_FVVOTk8VehLnCrsTmAuth "Front Camera Object Detection and Processing Burst 1 Protected : Forward Vision Vehicle Object Track 8 Vehicle Lane Cross Time Authenticated";
BA_ "SignalLongName" SG_ 142 FCODPB1P_FVVOTk9VehLnCrsTmAuth "Front Camera Object Detection and Processing Burst 1 Protected : Forward Vision Vehicle Object Track 9 Vehicle Lane Cross Time Authenticated";
BA_ "SignalLongName" SG_ 239 FCODPB15P_CnstrObj10LngDistAuth "Front Camera Object Detection and Processing Burst 15 Protected : Construction Object 10 Longitudinal Distance Authenticated";
BA_ "SignalLongName" SG_ 239 FCODPB15P_BrstID "Front Camera Object Detection and Processing Burst 15 Protected : Burst ID";
BA_ "SignalLongName" SG_ 239 FCODPB15P_CnstrObj11LngDistAuth "Front Camera Object Detection and Processing Burst 15 Protected : Construction Object 11 Longitudinal Distance Authenticated";
BA_ "SignalLongName" SG_ 239 FCODPB15P_CnstrObj12LngDistAuth "Front Camera Object Detection and Processing Burst 15 Protected : Construction Object 12 Longitudinal Distance Authenticated";
BA_ "SignalLongName" SG_ 239 FCODPB15P_CnstrObj13LngDistAuth "Front Camera Object Detection and Processing Burst 15 Protected : Construction Object 13 Longitudinal Distance Authenticated";
BA_ "SignalLongName" SG_ 239 FCODPB15P_CnstrObj14LngDistAuth "Front Camera Object Detection and Processing Burst 15 Protected : Construction Object 14 Longitudinal Distance Authenticated";
BA_ "SignalLongName" SG_ 239 FCODPB15P_CnstrObj15LngDistAuth "Front Camera Object Detection and Processing Burst 15 Protected : Construction Object 15 Longitudinal Distance Authenticated";
BA_ "SignalLongName" SG_ 239 FCODPB15P_CnstrObj1LngDistAuth "Front Camera Object Detection and Processing Burst 15 Protected : Construction Object 1 Longitudinal Distance Authenticated";
BA_ "SignalLongName" SG_ 239 FCODPB15P_CnstrObj2LngDistAuth "Front Camera Object Detection and Processing Burst 15 Protected : Construction Object 2 Longitudinal Distance Authenticated";
BA_ "SignalLongName" SG_ 239 FCODPB15P_CnstrObj3LngDistAuth "Front Camera Object Detection and Processing Burst 15 Protected : Construction Object 3 Longitudinal Distance Authenticated";
BA_ "SignalLongName" SG_ 239 FCODPB15P_CnstrObj4LngDistAuth "Front Camera Object Detection and Processing Burst 15 Protected : Construction Object 4 Longitudinal Distance Authenticated";
BA_ "SignalLongName" SG_ 239 FCODPB15P_CnstrObj5LngDistAuth "Front Camera Object Detection and Processing Burst 15 Protected : Construction Object 5 Longitudinal Distance Authenticated";
BA_ "SignalLongName" SG_ 239 FCODPB15P_CnstrObj6LngDistAuth "Front Camera Object Detection and Processing Burst 15 Protected : Construction Object 6 Longitudinal Distance Authenticated";
BA_ "SignalLongName" SG_ 239 FCODPB15P_CnstrObj7LngDistAuth "Front Camera Object Detection and Processing Burst 15 Protected : Construction Object 7 Longitudinal Distance Authenticated";
BA_ "SignalLongName" SG_ 239 FCODPB15P_CnstrObj8LngDistAuth "Front Camera Object Detection and Processing Burst 15 Protected : Construction Object 8 Longitudinal Distance Authenticated";
BA_ "SignalLongName" SG_ 239 FCODPB15P_CnstrObj9LngDistAuth "Front Camera Object Detection and Processing Burst 15 Protected : Construction Object 9 Longitudinal Distance Authenticated";
BA_ "SignalLongName" SG_ 153 LRRODPB2P_POTk2IDAuth "Long Range Radar Object Detection and Processing Burst 2 Protected : Pedestrian Object Track 2 ID Authenticated";
BA_ "SignalType" SG_ 153 LRRODPB2P_POTk2DynPrpAuth "ENM";
BA_ "SignalLongName" SG_ 153 LRRODPB2P_POTk2DynPrpAuth "Long Range Radar Object Detection and Processing Burst 2 Protected : Pedestrian Object Track 2 Dynamic Property Authenticated";
BA_ "SignalType" SG_ 153 LRRODPB2P_POTk2CnfdStsAuth "ENM";
BA_ "SignalLongName" SG_ 153 LRRODPB2P_POTk2CnfdStsAuth "Long Range Radar Object Detection and Processing Burst 2 Protected : Pedestrian Object Track 2 Confidence Status Authenticated";
BA_ "SignalLongName" SG_ 153 LRRODPB2P_BrstID "Long Range Radar Object Detection and Processing Burst 2 Protected : Burst ID";
BA_ "SignalLongName" SG_ 153 LRRODPB2P_POTk2InPthPotAuth "Long Range Radar Object Detection and Processing Burst 2 Protected : Pedestrian Object Track 2 In Path Potential Authenticated";
BA_ "SignalLongName" SG_ 153 LRRODPB2P_POTk2PoILAAuth "Long Range Radar Object Detection and Processing Burst 2 Protected : Pedestrian Object Track 2 Point of Interest Lateral Acceleration Authenticated";
BA_ "SignalType" SG_ 153 LRRODPB2P_POTk2MStsAuth "ENM";
BA_ "SignalLongName" SG_ 153 LRRODPB2P_POTk2MStsAuth "Long Range Radar Object Detection and Processing Burst 2 Protected : Pedestrian Object Track 2 Measurement Status Authenticated";
BA_ "SignalLongName" SG_ 153 LRRODPB2P_POTk2PoILgAAuth "Long Range Radar Object Detection and Processing Burst 2 Protected : Pedestrian Object Track 2 Point of Interest Longitudinal Acceleration Authenticated";
BA_ "SignalLongName" SG_ 153 LRRODPB2P_POTk2PoILgPsAuth "Long Range Radar Object Detection and Processing Burst 2 Protected : Pedestrian Object Track 2 Point of Interest Longitudinal Position Authenticated";
BA_ "SignalLongName" SG_ 153 LRRODPB2P_POTk2PoILgVAuth "Long Range Radar Object Detection and Processing Burst 2 Protected : Pedestrian Object Track 2 Point of Interest Longitudinal Velocity Authenticated";
BA_ "SignalLongName" SG_ 153 LRRODPB2P_POTk2PoILPsAuth "Long Range Radar Object Detection and Processing Burst 2 Protected : Pedestrian Object Track 2 Point of Interest Lateral Position Authenticated";
BA_ "SignalLongName" SG_ 153 LRRODPB2P_POTk2PoILVAuth "Long Range Radar Object Detection and Processing Burst 2 Protected : Pedestrian Object Track 2 Point of Interest Lateral Velocity Authenticated";
BA_ "SignalLongName" SG_ 153 LRRODPB2P_VOTk3CICOPotAuth "Long Range Radar Object Detection and Processing Burst 2 Protected : Vehicle Object Track 3 Cut In Cut Out Potential Authenticated";
BA_ "SignalType" SG_ 153 LRRODPB2P_POTk2TypCnfdAuth "ENM";
BA_ "SignalLongName" SG_ 153 LRRODPB2P_POTk2TypCnfdAuth "Long Range Radar Object Detection and Processing Burst 2 Protected : Pedestrian Object Track 2 Type Confidence Authenticated";
BA_ "SignalType" SG_ 153 LRRODPB2P_POTk2TypAuth "ENM";
BA_ "SignalLongName" SG_ 153 LRRODPB2P_POTk2TypAuth "Long Range Radar Object Detection and Processing Burst 2 Protected : Pedestrian Object Track 2 Type Authenticated";
BA_ "SignalType" SG_ 153 LRRODPB2P_VOTk3DynPrpStsAuth "ENM";
BA_ "SignalLongName" SG_ 153 LRRODPB2P_VOTk3DynPrpStsAuth "Long Range Radar Object Detection and Processing Burst 2 Protected : Vehicle Object Track 3 Dynamic Property Status Authenticated";
BA_ "SignalType" SG_ 153 LRRODPB2P_VOTk3DynPrpAuth "ENM";
BA_ "SignalLongName" SG_ 153 LRRODPB2P_VOTk3DynPrpAuth "Long Range Radar Object Detection and Processing Burst 2 Protected : Vehicle Object Track 3 Dynamic Property Authenticated";
BA_ "SignalType" SG_ 153 LRRODPB2P_VOTk3CnfdStsAuth "ENM";
BA_ "SignalLongName" SG_ 153 LRRODPB2P_VOTk3CnfdStsAuth "Long Range Radar Object Detection and Processing Burst 2 Protected : Vehicle Object Track 3 Confidence Status Authenticated";
BA_ "SignalType" SG_ 153 LRRODPB2P_VOTk3MStsAuth "ENM";
BA_ "SignalLongName" SG_ 153 LRRODPB2P_VOTk3MStsAuth "Long Range Radar Object Detection and Processing Burst 2 Protected : Vehicle Object Track 3 Measurement Status Authenticated";
BA_ "SignalLongName" SG_ 153 LRRODPB2P_VOTk3IDAuth "Long Range Radar Object Detection and Processing Burst 2 Protected : Vehicle Object Track 3 ID Authenticated";
BA_ "SignalLongName" SG_ 153 LRRODPB2P_VOTk3PoILAAuth "Long Range Radar Object Detection and Processing Burst 2 Protected : Vehicle Object Track 3 Point of Interest Lateral Acceleration Authenticated";
BA_ "SignalLongName" SG_ 153 LRRODPB2P_VOTk3PoILgAAuth "Long Range Radar Object Detection and Processing Burst 2 Protected : Vehicle Object Track 3 Point of Interest Longitudinal Acceleration Authenticated";
BA_ "SignalLongName" SG_ 153 LRRODPB2P_VOTk3PoILgPsAuth "Long Range Radar Object Detection and Processing Burst 2 Protected : Vehicle Object Track 3 Point of Interest Longitudinal Position Authenticated";
BA_ "SignalLongName" SG_ 153 LRRODPB2P_VOTk3PoILgPsCAuth "Long Range Radar Object Detection and Processing Burst 2 Protected : Vehicle Object Track 3 Point of Interest Longitudinal Position Covariance Authenticated";
BA_ "SignalLongName" SG_ 153 LRRODPB2P_VOTk3PoILgthAuth "Long Range Radar Object Detection and Processing Burst 2 Protected : Vehicle Object Track 3 Point of Interest Length Authenticated";
BA_ "SignalLongName" SG_ 153 LRRODPB2P_VOTk3PoILgVAuth "Long Range Radar Object Detection and Processing Burst 2 Protected : Vehicle Object Track 3 Point of Interest Longitudinal Velocity Authenticated";
BA_ "SignalLongName" SG_ 153 LRRODPB2P_VOTk3PoILgVCAuth "Long Range Radar Object Detection and Processing Burst 2 Protected : Vehicle Object Track 3 Point of Interest Longitudinal Velocity Covariance Authenticated";
BA_ "SignalLongName" SG_ 153 LRRODPB2P_VOTk3PoILPsAuth "Long Range Radar Object Detection and Processing Burst 2 Protected : Vehicle Object Track 3 Point of Interest Lateral Position Authenticated";
BA_ "SignalLongName" SG_ 153 LRRODPB2P_VOTk3PoILPsCAuth "Long Range Radar Object Detection and Processing Burst 2 Protected : Vehicle Object Track 3 Point of Interest Lateral Position Covariance Authenticated";
BA_ "SignalLongName" SG_ 153 LRRODPB2P_VOTk3PoILVAuth "Long Range Radar Object Detection and Processing Burst 2 Protected : Vehicle Object Track 3 Point of Interest Lateral Velocity Authenticated";
BA_ "SignalLongName" SG_ 153 LRRODPB2P_VOTk3PoILVCAuth "Long Range Radar Object Detection and Processing Burst 2 Protected : Vehicle Object Track 3 Point of Interest Lateral Velocity Covariance Authenticated";
BA_ "SignalLongName" SG_ 153 LRRODPB2P_VOTk4CICOPotAuth "Long Range Radar Object Detection and Processing Burst 2 Protected : Vehicle Object Track 4 Cut In Cut Out Potential Authenticated";
BA_ "SignalType" SG_ 153 LRRODPB2P_VOTk3TypCnfdAuth "ENM";
BA_ "SignalLongName" SG_ 153 LRRODPB2P_VOTk3TypCnfdAuth "Long Range Radar Object Detection and Processing Burst 2 Protected : Vehicle Object Track 3 Type Confidence Authenticated";
BA_ "SignalLongName" SG_ 153 LRRODPB2P_VOTk4IDAuth "Long Range Radar Object Detection and Processing Burst 2 Protected : Vehicle Object Track 4 ID Authenticated";
BA_ "SignalType" SG_ 153 LRRODPB2P_VOTk4DynPrpStsAuth "ENM";
BA_ "SignalLongName" SG_ 153 LRRODPB2P_VOTk4DynPrpStsAuth "Long Range Radar Object Detection and Processing Burst 2 Protected : Vehicle Object Track 4 Dynamic Property Status Authenticated";
BA_ "SignalType" SG_ 153 LRRODPB2P_VOTk4DynPrpAuth "ENM";
BA_ "SignalLongName" SG_ 153 LRRODPB2P_VOTk4DynPrpAuth "Long Range Radar Object Detection and Processing Burst 2 Protected : Vehicle Object Track 4 Dynamic Property Authenticated";
BA_ "SignalType" SG_ 153 LRRODPB2P_VOTk4CnfdStsAuth "ENM";
BA_ "SignalLongName" SG_ 153 LRRODPB2P_VOTk4CnfdStsAuth "Long Range Radar Object Detection and Processing Burst 2 Protected : Vehicle Object Track 4 Confidence Status Authenticated";
BA_ "SignalLongName" SG_ 153 LRRODPB2P_VOTk4PoILAAuth "Long Range Radar Object Detection and Processing Burst 2 Protected : Vehicle Object Track 4 Point of Interest Lateral Acceleration Authenticated";
BA_ "SignalType" SG_ 153 LRRODPB2P_VOTk4MStsAuth "ENM";
BA_ "SignalLongName" SG_ 153 LRRODPB2P_VOTk4MStsAuth "Long Range Radar Object Detection and Processing Burst 2 Protected : Vehicle Object Track 4 Measurement Status Authenticated";
BA_ "SignalLongName" SG_ 153 LRRODPB2P_VOTk4PoILgAAuth "Long Range Radar Object Detection and Processing Burst 2 Protected : Vehicle Object Track 4 Point of Interest Longitudinal Acceleration Authenticated";
BA_ "SignalLongName" SG_ 153 LRRODPB2P_VOTk4PoILgPsAuth "Long Range Radar Object Detection and Processing Burst 2 Protected : Vehicle Object Track 4 Point of Interest Longitudinal Position Authenticated";
BA_ "SignalLongName" SG_ 153 LRRODPB2P_VOTk4PoILgPsCAuth "Long Range Radar Object Detection and Processing Burst 2 Protected : Vehicle Object Track 4 Point of Interest Longitudinal Position Covariance Authenticated";
BA_ "SignalLongName" SG_ 153 LRRODPB2P_VOTk4PoILgthAuth "Long Range Radar Object Detection and Processing Burst 2 Protected : Vehicle Object Track 4 Point of Interest Length Authenticated";
BA_ "SignalLongName" SG_ 153 LRRODPB2P_VOTk4PoILgVAuth "Long Range Radar Object Detection and Processing Burst 2 Protected : Vehicle Object Track 4 Point of Interest Longitudinal Velocity Authenticated";
BA_ "SignalLongName" SG_ 153 LRRODPB2P_VOTk4PoILgVCAuth "Long Range Radar Object Detection and Processing Burst 2 Protected : Vehicle Object Track 4 Point of Interest Longitudinal Velocity Covariance Authenticated";
BA_ "SignalLongName" SG_ 153 LRRODPB2P_VOTk4PoILPsAuth "Long Range Radar Object Detection and Processing Burst 2 Protected : Vehicle Object Track 4 Point of Interest Lateral Position Authenticated";
BA_ "SignalLongName" SG_ 153 LRRODPB2P_VOTk4PoILPsCAuth "Long Range Radar Object Detection and Processing Burst 2 Protected : Vehicle Object Track 4 Point of Interest Lateral Position Covariance Authenticated";
BA_ "SignalLongName" SG_ 153 LRRODPB2P_VOTk4PoILVAuth "Long Range Radar Object Detection and Processing Burst 2 Protected : Vehicle Object Track 4 Point of Interest Lateral Velocity Authenticated";
BA_ "SignalLongName" SG_ 153 LRRODPB2P_VOTk4PoILVCAuth "Long Range Radar Object Detection and Processing Burst 2 Protected : Vehicle Object Track 4 Point of Interest Lateral Velocity Covariance Authenticated";
BA_ "SignalType" SG_ 153 LRRODPB2P_VOTk4TypCnfdAuth "ENM";
BA_ "SignalLongName" SG_ 153 LRRODPB2P_VOTk4TypCnfdAuth "Long Range Radar Object Detection and Processing Burst 2 Protected : Vehicle Object Track 4 Type Confidence Authenticated";
BA_ "SignalType" SG_ 153 LRRODPB2P_VOTk5CnfdStsAuth "ENM";
BA_ "SignalLongName" SG_ 153 LRRODPB2P_VOTk5CnfdStsAuth "Long Range Radar Object Detection and Processing Burst 2 Protected : Vehicle Object Track 5 Confidence Status Authenticated";
BA_ "SignalLongName" SG_ 153 LRRODPB2P_VOTk5CICOPotAuth "Long Range Radar Object Detection and Processing Burst 2 Protected : Vehicle Object Track 5 Cut In Cut Out Potential Authenticated";
BA_ "SignalLongName" SG_ 153 LRRODPB2P_VOTk5IDAuth "Long Range Radar Object Detection and Processing Burst 2 Protected : Vehicle Object Track 5 ID Authenticated";
BA_ "SignalType" SG_ 153 LRRODPB2P_VOTk5DynPrpStsAuth "ENM";
BA_ "SignalLongName" SG_ 153 LRRODPB2P_VOTk5DynPrpStsAuth "Long Range Radar Object Detection and Processing Burst 2 Protected : Vehicle Object Track 5 Dynamic Property Status Authenticated";
BA_ "SignalType" SG_ 153 LRRODPB2P_VOTk5DynPrpAuth "ENM";
BA_ "SignalLongName" SG_ 153 LRRODPB2P_VOTk5DynPrpAuth "Long Range Radar Object Detection and Processing Burst 2 Protected : Vehicle Object Track 5 Dynamic Property Authenticated";
BA_ "SignalLongName" SG_ 153 LRRODPB2P_VOTk5LgthdthAuth "Long Range Radar Object Detection and Processing Burst 2 Protected : Vehicle Object Track 5 Point of Interest Length Authenticated";
BA_ "SignalType" SG_ 153 LRRODPB2P_VOTk5MStsAuth "ENM";
BA_ "SignalLongName" SG_ 153 LRRODPB2P_VOTk5MStsAuth "Long Range Radar Object Detection and Processing Burst 2 Protected : Vehicle Object Track 5 Measurement Status Authenticated";
BA_ "SignalLongName" SG_ 153 LRRODPB2P_VOTk5PoILAAuth "Long Range Radar Object Detection and Processing Burst 2 Protected : Vehicle Object Track 5 Point of Interest Lateral Acceleration Authenticated";
BA_ "SignalLongName" SG_ 153 LRRODPB2P_VOTk5PoILgAAuth "Long Range Radar Object Detection and Processing Burst 2 Protected : Vehicle Object Track 5 Point of Interest Longitudinal Acceleration Authenticated";
BA_ "SignalLongName" SG_ 153 LRRODPB2P_VOTk5PoILgPsAuth "Long Range Radar Object Detection and Processing Burst 2 Protected : Vehicle Object Track 5 Point of Interest Longitudinal Position Authenticated";
BA_ "SignalLongName" SG_ 153 LRRODPB2P_VOTk5PoILgPsCAuth "Long Range Radar Object Detection and Processing Burst 2 Protected : Vehicle Object Track 5 Point of Interest Longitudinal Position Covariance Authenticated";
BA_ "SignalLongName" SG_ 153 LRRODPB2P_VOTk5PoILgVAuth "Long Range Radar Object Detection and Processing Burst 2 Protected : Vehicle Object Track 5 Point of Interest Longitudinal Velocity Authenticated";
BA_ "SignalLongName" SG_ 153 LRRODPB2P_VOTk5PoILgVCAuth "Long Range Radar Object Detection and Processing Burst 2 Protected : Vehicle Object Track 5 Point of Interest Longitudinal Velocity Covariance Authenticated";
BA_ "SignalLongName" SG_ 153 LRRODPB2P_VOTk5PoILPsAuth "Long Range Radar Object Detection and Processing Burst 2 Protected : Vehicle Object Track 5 Point of Interest Lateral Position Authenticated";
BA_ "SignalLongName" SG_ 153 LRRODPB2P_VOTk5PoILPsCAuth "Long Range Radar Object Detection and Processing Burst 2 Protected : Vehicle Object Track 5 Point of Interest Lateral Position Covariance Authenticated";
BA_ "SignalLongName" SG_ 153 LRRODPB2P_VOTk5PoILVAuth "Long Range Radar Object Detection and Processing Burst 2 Protected : Vehicle Object Track 5 Point of Interest Lateral Velocity Authenticated";
BA_ "SignalLongName" SG_ 153 LRRODPB2P_VOTk5PoILVCAuth "Long Range Radar Object Detection and Processing Burst 2 Protected : Vehicle Object Track 5 Point of Interest Lateral Velocity Covariance Authenticated";
BA_ "SignalType" SG_ 153 LRRODPB2P_VOTk5TypCnfdAuth "ENM";
BA_ "SignalLongName" SG_ 153 LRRODPB2P_VOTk5TypCnfdAuth "Long Range Radar Object Detection and Processing Burst 2 Protected : Vehicle Object Track 5 Type Confidence Authenticated";
BA_ "SignalLongName" SG_ 154 LRRODPB3P_POTk3IDAuth "Long Range Radar Object Detection and Processing Burst 3 Protected : Pedestrian Object Track 3 ID Authenticated";
BA_ "SignalType" SG_ 154 LRRODPB3P_POTk3DynPrpAuth "ENM";
BA_ "SignalLongName" SG_ 154 LRRODPB3P_POTk3DynPrpAuth "Long Range Radar Object Detection and Processing Burst 3 Protected : Pedestrian Object Track 3 Dynamic Property Authenticated";
BA_ "SignalType" SG_ 154 LRRODPB3P_POTk3CnfdStsAuth "ENM";
BA_ "SignalLongName" SG_ 154 LRRODPB3P_POTk3CnfdStsAuth "Long Range Radar Object Detection and Processing Burst 3 Protected : Pedestrian Object Track 3 Confidence Status Authenticated";
BA_ "SignalLongName" SG_ 154 LRRODPB3P_BrstID "Long Range Radar Object Detection and Processing Burst 3 Protected : Burst ID";
BA_ "SignalLongName" SG_ 154 LRRODPB3P_POTk3InPthPotAuth "Long Range Radar Object Detection and Processing Burst 3 Protected : Pedestrian Object Track 3 In Path Potential Authenticated";
BA_ "SignalLongName" SG_ 154 LRRODPB3P_POTk3PoILAAuth "Long Range Radar Object Detection and Processing Burst 3 Protected : Pedestrian Object Track 3 Point of Interest Lateral Acceleration Authenticated";
BA_ "SignalType" SG_ 154 LRRODPB3P_POTk3MStsAuth "ENM";
BA_ "SignalLongName" SG_ 154 LRRODPB3P_POTk3MStsAuth "Long Range Radar Object Detection and Processing Burst 3 Protected : Pedestrian Object Track 3 Measurement Status Authenticated";
BA_ "SignalLongName" SG_ 154 LRRODPB3P_POTk3PoILgAAuth "Long Range Radar Object Detection and Processing Burst 3 Protected : Pedestrian Object Track 3 Point of Interest Longitudinal Acceleration Authenticated";
BA_ "SignalLongName" SG_ 154 LRRODPB3P_POTk3PoILgPsAuth "Long Range Radar Object Detection and Processing Burst 3 Protected : Pedestrian Object Track 3 Point of Interest Longitudinal Position Authenticated";
BA_ "SignalLongName" SG_ 154 LRRODPB3P_POTk3PoILgVAuth "Long Range Radar Object Detection and Processing Burst 3 Protected : Pedestrian Object Track 3 Point of Interest Longitudinal Velocity Authenticated";
BA_ "SignalLongName" SG_ 154 LRRODPB3P_POTk3PoILPsAuth "Long Range Radar Object Detection and Processing Burst 3 Protected : Pedestrian Object Track 3 Point of Interest Lateral Position Authenticated";
BA_ "SignalLongName" SG_ 154 LRRODPB3P_POTk3PoILVAuth "Long Range Radar Object Detection and Processing Burst 3 Protected : Pedestrian Object Track 3 Point of Interest Lateral Velocity Authenticated";
BA_ "SignalLongName" SG_ 154 LRRODPB3P_VOTk6CICOPotAuth "Long Range Radar Object Detection and Processing Burst 3 Protected : Vehicle Object Track 6 Cut In Cut Out Potential Authenticated";
BA_ "SignalType" SG_ 154 LRRODPB3P_POTk3TypCnfdAuth "ENM";
BA_ "SignalLongName" SG_ 154 LRRODPB3P_POTk3TypCnfdAuth "Long Range Radar Object Detection and Processing Burst 3 Protected : Pedestrian Object Track 3 Type Confidence Authenticated";
BA_ "SignalType" SG_ 154 LRRODPB3P_POTk3TypAuth "ENM";
BA_ "SignalLongName" SG_ 154 LRRODPB3P_POTk3TypAuth "Long Range Radar Object Detection and Processing Burst 3 Protected : Pedestrian Object Track 3 Type Authenticated";
BA_ "SignalType" SG_ 154 LRRODPB3P_VOTk6DynPrpStsAuth "ENM";
BA_ "SignalLongName" SG_ 154 LRRODPB3P_VOTk6DynPrpStsAuth "Long Range Radar Object Detection and Processing Burst 3 Protected : Vehicle Object Track 6 Dynamic Property Status Authenticated";
BA_ "SignalType" SG_ 154 LRRODPB3P_VOTk6DynPrpAuth "ENM";
BA_ "SignalLongName" SG_ 154 LRRODPB3P_VOTk6DynPrpAuth "Long Range Radar Object Detection and Processing Burst 3 Protected : Vehicle Object Track 6 Dynamic Property Authenticated";
BA_ "SignalType" SG_ 154 LRRODPB3P_VOTk6CnfdStsAuth "ENM";
BA_ "SignalLongName" SG_ 154 LRRODPB3P_VOTk6CnfdStsAuth "Long Range Radar Object Detection and Processing Burst 3 Protected : Vehicle Object Track 6 Confidence Status Authenticated";
BA_ "SignalType" SG_ 154 LRRODPB3P_VOTk6MStsAuth "ENM";
BA_ "SignalLongName" SG_ 154 LRRODPB3P_VOTk6MStsAuth "Long Range Radar Object Detection and Processing Burst 3 Protected : Vehicle Object Track 6 Measurement Status Authenticated";
BA_ "SignalLongName" SG_ 154 LRRODPB3P_VOTk6IDAuth "Long Range Radar Object Detection and Processing Burst 3 Protected : Vehicle Object Track 6 ID Authenticated";
BA_ "SignalLongName" SG_ 154 LRRODPB3P_VOTk6PoILAAuth "Long Range Radar Object Detection and Processing Burst 3 Protected : Vehicle Object Track 6 Point of Interest Lateral Acceleration Authenticated";
BA_ "SignalLongName" SG_ 154 LRRODPB3P_VOTk6PoILgAAuth "Long Range Radar Object Detection and Processing Burst 3 Protected : Vehicle Object Track 6 Point of Interest Longitudinal Acceleration Authenticated";
BA_ "SignalLongName" SG_ 154 LRRODPB3P_VOTk6PoILgPsAuth "Long Range Radar Object Detection and Processing Burst 3 Protected : Vehicle Object Track 6 Point of Interest Longitudinal Position Authenticated";
BA_ "SignalLongName" SG_ 154 LRRODPB3P_VOTk6PoILgPsCAuth "Long Range Radar Object Detection and Processing Burst 3 Protected : Vehicle Object Track 6 Point of Interest Longitudinal Position Covariance Authenticated";
BA_ "SignalLongName" SG_ 154 LRRODPB3P_VOTk6PoILgthAuth "Long Range Radar Object Detection and Processing Burst 3 Protected : Vehicle Object Track 6 Point of Interest Length Authenticated";
BA_ "SignalLongName" SG_ 154 LRRODPB3P_VOTk6PoILgVAuth "Long Range Radar Object Detection and Processing Burst 3 Protected : Vehicle Object Track 6 Point of Interest Longitudinal Velocity Authenticated";
BA_ "SignalLongName" SG_ 154 LRRODPB3P_VOTk6PoILgVCAuth "Long Range Radar Object Detection and Processing Burst 3 Protected : Vehicle Object Track 6 Point of Interest Longitudinal Velocity Covariance Authenticated";
BA_ "SignalLongName" SG_ 154 LRRODPB3P_VOTk6PoILPsAuth "Long Range Radar Object Detection and Processing Burst 3 Protected : Vehicle Object Track 6 Point of Interest Lateral Position Authenticated";
BA_ "SignalLongName" SG_ 154 LRRODPB3P_VOTk6PoILPsCAuth "Long Range Radar Object Detection and Processing Burst 3 Protected : Vehicle Object Track 6 Point of Interest Lateral Position Covariance Authenticated";
BA_ "SignalLongName" SG_ 154 LRRODPB3P_VOTk6PoILVAuth "Long Range Radar Object Detection and Processing Burst 3 Protected : Vehicle Object Track 6 Point of Interest Lateral Velocity Authenticated";
BA_ "SignalLongName" SG_ 154 LRRODPB3P_VOTk6PoILVCAuth "Long Range Radar Object Detection and Processing Burst 3 Protected : Vehicle Object Track 6 Point of Interest Lateral Velocity Covariance Authenticated";
BA_ "SignalLongName" SG_ 154 LRRODPB3P_VOTk7CICOPotAuth "Long Range Radar Object Detection and Processing Burst 3 Protected : Vehicle Object Track 7 Cut In Cut Out Potential Authenticated";
BA_ "SignalType" SG_ 154 LRRODPB3P_VOTk6TypCnfdAuth "ENM";
BA_ "SignalLongName" SG_ 154 LRRODPB3P_VOTk6TypCnfdAuth "Long Range Radar Object Detection and Processing Burst 3 Protected : Vehicle Object Track 6 Type Confidence Authenticated";
BA_ "SignalLongName" SG_ 154 LRRODPB3P_VOTk7IDAuth "Long Range Radar Object Detection and Processing Burst 3 Protected : Vehicle Object Track 7 ID Authenticated";
BA_ "SignalType" SG_ 154 LRRODPB3P_VOTk7DynPrpStsAuth "ENM";
BA_ "SignalLongName" SG_ 154 LRRODPB3P_VOTk7DynPrpStsAuth "Long Range Radar Object Detection and Processing Burst 3 Protected : Vehicle Object Track 7 Dynamic Property Status Authenticated";
BA_ "SignalType" SG_ 154 LRRODPB3P_VOTk7DynPrpAuth "ENM";
BA_ "SignalLongName" SG_ 154 LRRODPB3P_VOTk7DynPrpAuth "Long Range Radar Object Detection and Processing Burst 3 Protected : Vehicle Object Track 7 Dynamic Property Authenticated";
BA_ "SignalType" SG_ 154 LRRODPB3P_VOTk7CnfdStsAuth "ENM";
BA_ "SignalLongName" SG_ 154 LRRODPB3P_VOTk7CnfdStsAuth "Long Range Radar Object Detection and Processing Burst 3 Protected : Vehicle Object Track 7 Confidence Status Authenticated";
BA_ "SignalLongName" SG_ 154 LRRODPB3P_VOTk7PoILAAuth "Long Range Radar Object Detection and Processing Burst 3 Protected : Vehicle Object Track 7 Point of Interest Lateral Acceleration Authenticated";
BA_ "SignalType" SG_ 154 LRRODPB3P_VOTk7MStsAuth "ENM";
BA_ "SignalLongName" SG_ 154 LRRODPB3P_VOTk7MStsAuth "Long Range Radar Object Detection and Processing Burst 3 Protected : Vehicle Object Track 7 Measurement Status Authenticated";
BA_ "SignalLongName" SG_ 154 LRRODPB3P_VOTk7PoILgAAuth "Long Range Radar Object Detection and Processing Burst 3 Protected : Vehicle Object Track 7 Point of Interest Longitudinal Acceleration Authenticated";
BA_ "SignalLongName" SG_ 154 LRRODPB3P_VOTk7PoILgPsAuth "Long Range Radar Object Detection and Processing Burst 3 Protected : Vehicle Object Track 7 Point of Interest Longitudinal Position Authenticated";
BA_ "SignalLongName" SG_ 154 LRRODPB3P_VOTk7PoILgPsCAuth "Long Range Radar Object Detection and Processing Burst 3 Protected : Vehicle Object Track 7 Point of Interest Longitudinal Position Covariance Authenticated";
BA_ "SignalLongName" SG_ 154 LRRODPB3P_VOTk7PoILgthAuth "Long Range Radar Object Detection and Processing Burst 3 Protected : Vehicle Object Track 7 Point of Interest Length Authenticated";
BA_ "SignalLongName" SG_ 154 LRRODPB3P_VOTk7PoILgVAuth "Long Range Radar Object Detection and Processing Burst 3 Protected : Vehicle Object Track 7 Point of Interest Longitudinal Velocity Authenticated";
BA_ "SignalLongName" SG_ 154 LRRODPB3P_VOTk7PoILgVCAuth "Long Range Radar Object Detection and Processing Burst 3 Protected : Vehicle Object Track 7 Point of Interest Longitudinal Velocity Covariance Authenticated";
BA_ "SignalLongName" SG_ 154 LRRODPB3P_VOTk7PoILPsAuth "Long Range Radar Object Detection and Processing Burst 3 Protected : Vehicle Object Track 7 Point of Interest Lateral Position Authenticated";
BA_ "SignalLongName" SG_ 154 LRRODPB3P_VOTk7PoILPsCAuth "Long Range Radar Object Detection and Processing Burst 3 Protected : Vehicle Object Track 7 Point of Interest Lateral Position Covariance Authenticated";
BA_ "SignalLongName" SG_ 154 LRRODPB3P_VOTk7PoILVAuth "Long Range Radar Object Detection and Processing Burst 3 Protected : Vehicle Object Track 7 Point of Interest Lateral Velocity Authenticated";
BA_ "SignalLongName" SG_ 154 LRRODPB3P_VOTk7PoILVCAuth "Long Range Radar Object Detection and Processing Burst 3 Protected : Vehicle Object Track 7 Point of Interest Lateral Velocity Covariance Authenticated";
BA_ "SignalType" SG_ 154 LRRODPB3P_VOTk7TypCnfdAuth "ENM";
BA_ "SignalLongName" SG_ 154 LRRODPB3P_VOTk7TypCnfdAuth "Long Range Radar Object Detection and Processing Burst 3 Protected : Vehicle Object Track 7 Type Confidence Authenticated";
BA_ "SignalType" SG_ 154 LRRODPB3P_VOTk8CnfdStsAuth "ENM";
BA_ "SignalLongName" SG_ 154 LRRODPB3P_VOTk8CnfdStsAuth "Long Range Radar Object Detection and Processing Burst 3 Protected : Vehicle Object Track 8 Confidence Status Authenticated";
BA_ "SignalLongName" SG_ 154 LRRODPB3P_VOTk8CICOPotAuth "Long Range Radar Object Detection and Processing Burst 3 Protected : Vehicle Object Track 8 Cut In Cut Out Potential Authenticated";
BA_ "SignalLongName" SG_ 154 LRRODPB3P_VOTk8IDAuth "Long Range Radar Object Detection and Processing Burst 3 Protected : Vehicle Object Track 8 ID Authenticated";
BA_ "SignalType" SG_ 154 LRRODPB3P_VOTk8DynPrpStsAuth "ENM";
BA_ "SignalLongName" SG_ 154 LRRODPB3P_VOTk8DynPrpStsAuth "Long Range Radar Object Detection and Processing Burst 3 Protected : Vehicle Object Track 8 Dynamic Property Status Authenticated";
BA_ "SignalType" SG_ 154 LRRODPB3P_VOTk8DynPrpAuth "ENM";
BA_ "SignalLongName" SG_ 154 LRRODPB3P_VOTk8DynPrpAuth "Long Range Radar Object Detection and Processing Burst 3 Protected : Vehicle Object Track 8 Dynamic Property Authenticated";
BA_ "SignalLongName" SG_ 154 LRRODPB3P_VOTk8PoILAAuth "Long Range Radar Object Detection and Processing Burst 3 Protected : Vehicle Object Track 8 Point of Interest Lateral Acceleration Authenticated";
BA_ "SignalType" SG_ 154 LRRODPB3P_VOTk8MStsAuth "ENM";
BA_ "SignalLongName" SG_ 154 LRRODPB3P_VOTk8MStsAuth "Long Range Radar Object Detection and Processing Burst 3 Protected : Vehicle Object Track 8 Measurement Status Authenticated";
BA_ "SignalLongName" SG_ 154 LRRODPB3P_VOTk8PoILgAAuth "Long Range Radar Object Detection and Processing Burst 3 Protected : Vehicle Object Track 8 Point of Interest Longitudinal Acceleration Authenticated";
BA_ "SignalLongName" SG_ 154 LRRODPB3P_VOTk8PoILgPsAuth "Long Range Radar Object Detection and Processing Burst 3 Protected : Vehicle Object Track 8 Point of Interest Longitudinal Position Authenticated";
BA_ "SignalLongName" SG_ 154 LRRODPB3P_VOTk8PoILgPsCAuth "Long Range Radar Object Detection and Processing Burst 3 Protected : Vehicle Object Track 8 Point of Interest Longitudinal Position Covariance Authenticated";
BA_ "SignalLongName" SG_ 154 LRRODPB3P_VOTk8PoILgthAuth "Long Range Radar Object Detection and Processing Burst 3 Protected : Vehicle Object Track 8 Point of Interest Length Authenticated";
BA_ "SignalLongName" SG_ 154 LRRODPB3P_VOTk8PoILgVAuth "Long Range Radar Object Detection and Processing Burst 3 Protected : Vehicle Object Track 8 Point of Interest Longitudinal Velocity Authenticated";
BA_ "SignalLongName" SG_ 154 LRRODPB3P_VOTk8PoILgVCAuth "Long Range Radar Object Detection and Processing Burst 3 Protected : Vehicle Object Track 8 Point of Interest Longitudinal Velocity Covariance Authenticated";
BA_ "SignalLongName" SG_ 154 LRRODPB3P_VOTk8PoILPsAuth "Long Range Radar Object Detection and Processing Burst 3 Protected : Vehicle Object Track 8 Point of Interest Lateral Position Authenticated";
BA_ "SignalLongName" SG_ 154 LRRODPB3P_VOTk8PoILPsCAuth "Long Range Radar Object Detection and Processing Burst 3 Protected : Vehicle Object Track 8 Point of Interest Lateral Position Covariance Authenticated";
BA_ "SignalLongName" SG_ 154 LRRODPB3P_VOTk8PoILVAuth "Long Range Radar Object Detection and Processing Burst 3 Protected : Vehicle Object Track 8 Point of Interest Lateral Velocity Authenticated";
BA_ "SignalLongName" SG_ 154 LRRODPB3P_VOTk8PoILVCAuth "Long Range Radar Object Detection and Processing Burst 3 Protected : Vehicle Object Track 8 Point of Interest Lateral Velocity Covariance Authenticated";
BA_ "SignalType" SG_ 154 LRRODPB3P_VOTk8TypCnfdAuth "ENM";
BA_ "SignalLongName" SG_ 154 LRRODPB3P_VOTk8TypCnfdAuth "Long Range Radar Object Detection and Processing Burst 3 Protected : Vehicle Object Track 8 Type Confidence Authenticated";
BA_ "SignalLongName" SG_ 155 LRRODPB4P_POTk4IDAuth "Long Range Radar Object Detection and Processing Burst 4 Protected : Pedestrian Object Track 4 ID Authenticated";
BA_ "SignalType" SG_ 155 LRRODPB4P_POTk4DynPrpAuth "ENM";
BA_ "SignalLongName" SG_ 155 LRRODPB4P_POTk4DynPrpAuth "Long Range Radar Object Detection and Processing Burst 4 Protected : Pedestrian Object Track 4 Dynamic Property Authenticated";
BA_ "SignalType" SG_ 155 LRRODPB4P_POTk4CnfdStsAuth "ENM";
BA_ "SignalLongName" SG_ 155 LRRODPB4P_POTk4CnfdStsAuth "Long Range Radar Object Detection and Processing Burst 4 Protected : Pedestrian Object Track 4 Confidence Status Authenticated";
BA_ "SignalLongName" SG_ 155 LRRODPB4P_BrstID "Long Range Radar Object Detection and Processing Burst 4 Protected : Burst ID";
BA_ "SignalLongName" SG_ 155 LRRODPB4P_POTk4InPthPotAuth "Long Range Radar Object Detection and Processing Burst 4 Protected : Pedestrian Object Track 4 In Path Potential Authenticated";
BA_ "SignalLongName" SG_ 155 LRRODPB4P_POTk4PoILAAuth "Long Range Radar Object Detection and Processing Burst 4 Protected : Pedestrian Object Track 4 Point of Interest Lateral Acceleration Authenticated";
BA_ "SignalType" SG_ 155 LRRODPB4P_POTk4MStsAuth "ENM";
BA_ "SignalLongName" SG_ 155 LRRODPB4P_POTk4MStsAuth "Long Range Radar Object Detection and Processing Burst 4 Protected : Pedestrian Object Track 4 Measurement Status Authenticated";
BA_ "SignalLongName" SG_ 155 LRRODPB4P_POTk4PoILgAAuth "Long Range Radar Object Detection and Processing Burst 4 Protected : Pedestrian Object Track 4 Point of Interest Longitudinal Acceleration Authenticated";
BA_ "SignalLongName" SG_ 155 LRRODPB4P_POTk4PoILgPsAuth "Long Range Radar Object Detection and Processing Burst 4 Protected : Pedestrian Object Track 4 Point of Interest Longitudinal Position Authenticated";
BA_ "SignalLongName" SG_ 155 LRRODPB4P_POTk4PoILgVAuth "Long Range Radar Object Detection and Processing Burst 4 Protected : Pedestrian Object Track 4 Point of Interest Longitudinal Velocity Authenticated";
BA_ "SignalLongName" SG_ 155 LRRODPB4P_POTk4PoILPsAuth "Long Range Radar Object Detection and Processing Burst 4 Protected : Pedestrian Object Track 4 Point of Interest Lateral Position Authenticated";
BA_ "SignalLongName" SG_ 155 LRRODPB4P_POTk4PoILVAuth "Long Range Radar Object Detection and Processing Burst 4 Protected : Pedestrian Object Track 4 Point of Interest Lateral Velocity Authenticated";
BA_ "SignalType" SG_ 155 LRRODPB4P_POTk5DynPrpAuth "ENM";
BA_ "SignalLongName" SG_ 155 LRRODPB4P_POTk5DynPrpAuth "Long Range Radar Object Detection and Processing Burst 4 Protected : Pedestrian Object Track 5 Dynamic Property Authenticated";
BA_ "SignalType" SG_ 155 LRRODPB4P_POTk5CnfdStsAuth "ENM";
BA_ "SignalLongName" SG_ 155 LRRODPB4P_POTk5CnfdStsAuth "Long Range Radar Object Detection and Processing Burst 4 Protected : Pedestrian Object Track 5 Confidence Status Authenticated";
BA_ "SignalType" SG_ 155 LRRODPB4P_POTk4TypCnfdAuth "ENM";
BA_ "SignalLongName" SG_ 155 LRRODPB4P_POTk4TypCnfdAuth "Long Range Radar Object Detection and Processing Burst 4 Protected : Pedestrian Object Track 4 Type Confidence Authenticated";
BA_ "SignalType" SG_ 155 LRRODPB4P_POTk4TypAuth "ENM";
BA_ "SignalLongName" SG_ 155 LRRODPB4P_POTk4TypAuth "Long Range Radar Object Detection and Processing Burst 4 Protected : Pedestrian Object Track 4 Type Authenticated";
BA_ "SignalLongName" SG_ 155 LRRODPB4P_POTk5IDAuth "Long Range Radar Object Detection and Processing Burst 4 Protected : Pedestrian Object Track 5 ID Authenticated";
BA_ "SignalType" SG_ 155 LRRODPB4P_POTk5MStsAuth "ENM";
BA_ "SignalLongName" SG_ 155 LRRODPB4P_POTk5MStsAuth "Long Range Radar Object Detection and Processing Burst 4 Protected : Pedestrian Object Track 5 Measurement Status Authenticated";
BA_ "SignalLongName" SG_ 155 LRRODPB4P_POTk5InPthPotAuth "Long Range Radar Object Detection and Processing Burst 4 Protected : Pedestrian Object Track 5 In Path Potential Authenticated";
BA_ "SignalLongName" SG_ 155 LRRODPB4P_POTk5PoILAAuth "Long Range Radar Object Detection and Processing Burst 4 Protected : Pedestrian Object Track 5 Point of Interest Lateral Acceleration Authenticated";
BA_ "SignalLongName" SG_ 155 LRRODPB4P_POTk5PoILgAAuth "Long Range Radar Object Detection and Processing Burst 4 Protected : Pedestrian Object Track 5 Point of Interest Longitudinal Acceleration Authenticated";
BA_ "SignalLongName" SG_ 155 LRRODPB4P_POTk5PoILgPsAuth "Long Range Radar Object Detection and Processing Burst 4 Protected : Pedestrian Object Track 5 Point of Interest Longitudinal Position Authenticated";
BA_ "SignalLongName" SG_ 155 LRRODPB4P_POTk5PoILgVAuth "Long Range Radar Object Detection and Processing Burst 4 Protected : Pedestrian Object Track 5 Point of Interest Longitudinal Velocity Authenticated";
BA_ "SignalLongName" SG_ 155 LRRODPB4P_POTk5PoILPsAuth "Long Range Radar Object Detection and Processing Burst 4 Protected : Pedestrian Object Track 5 Point of Interest Lateral Position Authenticated";
BA_ "SignalLongName" SG_ 155 LRRODPB4P_POTk5PoILVAuth "Long Range Radar Object Detection and Processing Burst 4 Protected : Pedestrian Object Track 5 Point of Interest Lateral Velocity Authenticated";
BA_ "SignalLongName" SG_ 155 LRRODPB4P_VOTk10CICOPotAuth "Long Range Radar Object Detection and Processing Burst 4 Protected : Vehicle Object Track 10 Cut In Cut Out Potential Authenticated";
BA_ "SignalType" SG_ 155 LRRODPB4P_POTk5TypCnfdAuth "ENM";
BA_ "SignalLongName" SG_ 155 LRRODPB4P_POTk5TypCnfdAuth "Long Range Radar Object Detection and Processing Burst 4 Protected : Pedestrian Object Track 5 Type Confidence Authenticated";
BA_ "SignalType" SG_ 155 LRRODPB4P_POTk5TypAuth "ENM";
BA_ "SignalLongName" SG_ 155 LRRODPB4P_POTk5TypAuth "Long Range Radar Object Detection and Processing Burst 4 Protected : Pedestrian Object Track 5 Type Authenticated";
BA_ "SignalType" SG_ 155 LRRODPB4P_VOTk10DynPrpAuth "ENM";
BA_ "SignalLongName" SG_ 155 LRRODPB4P_VOTk10DynPrpAuth "Long Range Radar Object Detection and Processing Burst 4 Protected : Vehicle Object Track 10 Dynamic Property Authenticated";
BA_ "SignalType" SG_ 155 LRRODPB4P_VOTk10CnfdStsAuth "ENM";
BA_ "SignalLongName" SG_ 155 LRRODPB4P_VOTk10CnfdStsAuth "Long Range Radar Object Detection and Processing Burst 4 Protected : Vehicle Object Track 10 Confidence Status Authenticated";
BA_ "SignalLongName" SG_ 155 LRRODPB4P_VOTk10IDAuth "Long Range Radar Object Detection and Processing Burst 4 Protected : Vehicle Object Track 10 ID Authenticated";
BA_ "SignalType" SG_ 155 LRRODPB4P_VOTk10DynPrpStsAuth "ENM";
BA_ "SignalLongName" SG_ 155 LRRODPB4P_VOTk10DynPrpStsAuth "Long Range Radar Object Detection and Processing Burst 4 Protected : Vehicle Object Track 10 Dynamic Property Status Authenticated";
BA_ "SignalLongName" SG_ 155 LRRODPB4P_VOTk10PoILAAuth "Long Range Radar Object Detection and Processing Burst 4 Protected : Vehicle Object Track 10 Point of Interest Lateral Acceleration Authenticated";
BA_ "SignalType" SG_ 155 LRRODPB4P_VOTk10MStsAuth "ENM";
BA_ "SignalLongName" SG_ 155 LRRODPB4P_VOTk10MStsAuth "Long Range Radar Object Detection and Processing Burst 4 Protected : Vehicle Object Track 10 Measurement Status Authenticated";
BA_ "SignalLongName" SG_ 155 LRRODPB4P_VOTk10PoILgAAuth "Long Range Radar Object Detection and Processing Burst 4 Protected : Vehicle Object Track 10 Point of Interest Longitudinal Acceleration Authenticated";
BA_ "SignalLongName" SG_ 155 LRRODPB4P_VOTk10PoILgPsAuth "Long Range Radar Object Detection and Processing Burst 4 Protected : Vehicle Object Track 10 Point of Interest Longitudinal Position Authenticated";
BA_ "SignalLongName" SG_ 155 LRRODPB4P_VOTk10PoILgPsCAuth "Long Range Radar Object Detection and Processing Burst 4 Protected : Vehicle Object Track 10 Point of Interest Longitudinal Position Covariance Authenticated";
BA_ "SignalLongName" SG_ 155 LRRODPB4P_VOTk10PoILgthAuth "Long Range Radar Object Detection and Processing Burst 4 Protected : Vehicle Object Track 10 Point of Interest Length Authenticated";
BA_ "SignalLongName" SG_ 155 LRRODPB4P_VOTk10PoILgVAuth "Long Range Radar Object Detection and Processing Burst 4 Protected : Vehicle Object Track 10 Point of Interest Longitudinal Velocity Authenticated";
BA_ "SignalLongName" SG_ 155 LRRODPB4P_VOTk10PoILgVCAuth "Long Range Radar Object Detection and Processing Burst 4 Protected : Vehicle Object Track 10 Point of Interest Longitudinal Velocity Covariance Authenticated";
BA_ "SignalLongName" SG_ 155 LRRODPB4P_VOTk10PoILPsAuth "Long Range Radar Object Detection and Processing Burst 4 Protected : Vehicle Object Track 10 Point of Interest Lateral Position Authenticated";
BA_ "SignalLongName" SG_ 155 LRRODPB4P_VOTk10PoILPsCAuth "Long Range Radar Object Detection and Processing Burst 4 Protected : Vehicle Object Track 10 Point of Interest Lateral Position Covariance Authenticated";
BA_ "SignalLongName" SG_ 155 LRRODPB4P_VOTk10PoILVAuth "Long Range Radar Object Detection and Processing Burst 4 Protected : Vehicle Object Track 10 Point of Interest Lateral Velocity Authenticated";
BA_ "SignalLongName" SG_ 155 LRRODPB4P_VOTk10PoILVCAuth "Long Range Radar Object Detection and Processing Burst 4 Protected : Vehicle Object Track 10 Point of Interest Lateral Velocity Covariance Authenticated";
BA_ "SignalLongName" SG_ 155 LRRODPB4P_VOTk9CICOPotAuth "Long Range Radar Object Detection and Processing Burst 4 Protected : Vehicle Object Track 9 Cut In Cut Out Potential Authenticated";
BA_ "SignalType" SG_ 155 LRRODPB4P_VOTk10TypCnfdAuth "ENM";
BA_ "SignalLongName" SG_ 155 LRRODPB4P_VOTk10TypCnfdAuth "Long Range Radar Object Detection and Processing Burst 4 Protected : Vehicle Object Track 10 Type Confidence Authenticated";
BA_ "SignalType" SG_ 155 LRRODPB4P_VOTk9DynPrpStsAuth "ENM";
BA_ "SignalLongName" SG_ 155 LRRODPB4P_VOTk9DynPrpStsAuth "Long Range Radar Object Detection and Processing Burst 4 Protected : Vehicle Object Track 9 Dynamic Property Status Authenticated";
BA_ "SignalType" SG_ 155 LRRODPB4P_VOTk9DynPrpAuth "ENM";
BA_ "SignalLongName" SG_ 155 LRRODPB4P_VOTk9DynPrpAuth "Long Range Radar Object Detection and Processing Burst 4 Protected : Vehicle Object Track 9 Dynamic Property Authenticated";
BA_ "SignalType" SG_ 155 LRRODPB4P_VOTk9CnfdStsAuth "ENM";
BA_ "SignalLongName" SG_ 155 LRRODPB4P_VOTk9CnfdStsAuth "Long Range Radar Object Detection and Processing Burst 4 Protected : Vehicle Object Track 9 Confidence Status Authenticated";
BA_ "SignalType" SG_ 155 LRRODPB4P_VOTk9MStsAuth "ENM";
BA_ "SignalLongName" SG_ 155 LRRODPB4P_VOTk9MStsAuth "Long Range Radar Object Detection and Processing Burst 4 Protected : Vehicle Object Track 9 Measurement Status Authenticated";
BA_ "SignalLongName" SG_ 155 LRRODPB4P_VOTk9IDAuth "Long Range Radar Object Detection and Processing Burst 4 Protected : Vehicle Object Track 9 ID Authenticated";
BA_ "SignalLongName" SG_ 155 LRRODPB4P_VOTk9PoILAAuth "Long Range Radar Object Detection and Processing Burst 4 Protected : Vehicle Object Track 9 Point of Interest Lateral Acceleration Authenticated";
BA_ "SignalLongName" SG_ 155 LRRODPB4P_VOTk9PoILgAAuth "Long Range Radar Object Detection and Processing Burst 4 Protected : Vehicle Object Track 9 Point of Interest Longitudinal Acceleration Authenticated";
BA_ "SignalLongName" SG_ 155 LRRODPB4P_VOTk9PoILgPsAuth "Long Range Radar Object Detection and Processing Burst 4 Protected : Vehicle Object Track 9 Point of Interest Longitudinal Position Authenticated";
BA_ "SignalLongName" SG_ 155 LRRODPB4P_VOTk9PoILgPsCAuth "Long Range Radar Object Detection and Processing Burst 4 Protected : Vehicle Object Track 9 Point of Interest Longitudinal Position Covariance Authenticated";
BA_ "SignalLongName" SG_ 155 LRRODPB4P_VOTk9PoILgthAuth "Long Range Radar Object Detection and Processing Burst 4 Protected : Vehicle Object Track 9 Point of Interest Length Authenticated";
BA_ "SignalLongName" SG_ 155 LRRODPB4P_VOTk9PoILgVAuth "Long Range Radar Object Detection and Processing Burst 4 Protected : Vehicle Object Track 9 Point of Interest Longitudinal Velocity Authenticated";
BA_ "SignalLongName" SG_ 155 LRRODPB4P_VOTk9PoILgVCAuth "Long Range Radar Object Detection and Processing Burst 4 Protected : Vehicle Object Track 9 Point of Interest Longitudinal Velocity Covariance Authenticated";
BA_ "SignalLongName" SG_ 155 LRRODPB4P_VOTk9PoILPsAuth "Long Range Radar Object Detection and Processing Burst 4 Protected : Vehicle Object Track 9 Point of Interest Lateral Position Authenticated";
BA_ "SignalLongName" SG_ 155 LRRODPB4P_VOTk9PoILPsCAuth "Long Range Radar Object Detection and Processing Burst 4 Protected : Vehicle Object Track 9 Point of Interest Lateral Position Covariance Authenticated";
BA_ "SignalLongName" SG_ 155 LRRODPB4P_VOTk9PoILVAuth "Long Range Radar Object Detection and Processing Burst 4 Protected : Vehicle Object Track 9 Point of Interest Lateral Velocity Authenticated";
BA_ "SignalLongName" SG_ 155 LRRODPB4P_VOTk9PoILVCAuth "Long Range Radar Object Detection and Processing Burst 4 Protected : Vehicle Object Track 9 Point of Interest Lateral Velocity Covariance Authenticated";
BA_ "SignalType" SG_ 155 LRRODPB4P_VOTk9TypCnfdAuth "ENM";
BA_ "SignalLongName" SG_ 155 LRRODPB4P_VOTk9TypCnfdAuth "Long Range Radar Object Detection and Processing Burst 4 Protected : Vehicle Object Track 9 Type Confidence Authenticated";
VAL_ 149 FCODPB8P_FVLBTk8ClrAuth 0 "UNKNOWN" 1 "WHITE" 2 "YELLOW/ORANGE" 3 "OTHER" ;
VAL_ 149 FCODPB8P_FVLBTk8PstnTypAuth 0 "Unknown" 1 "Host Left Lane" 2 "Host Right Lane" 3 "Next Left Lane" 4 "Next Right Lane" 5 "Second Next Left Lane" 6 "Second Next Right Lane" 7 "Third Next Left Lane" 8 "Third Next Right Lane" 9 "Fourth Next Left Lane" 10 "Fourth Next Right Lane" 11 "Fifth Next Left Lane" 12 "Fifth Next Right Lane" ;
VAL_ 149 FCODPB8P_FVLBTk8TypAuth 0 "UNDECIDED" 1 "SOLID" 2 "DASHED" 3 "ROAD EDGE" 4 "DOUBLE LINE" 5 "BOTTS DOTS" 6 "VIRTUAL" 7 "TRIPLE LINE" ;
VAL_ 149 FCODPB8P_FVLBTk8QltyAuth 0 "VERY LOW QUALITY" 1 "LOW QUALITY" 2 "PREDICTION" 3 "HIGH QUALITY" ;
VAL_ 149 FCODPB8P_FVVOTk8BrkLgtStsAuth 0 "UNKNOWN" 1 "OFF" 2 "ON" 3 "FLASHING" ;
VAL_ 149 FCODPB8P_FVVOTk8DynPrpAuth 0 "Has Never Moved" 1 "Has Moved But Currently Stopped" 2 "Moving In Same Direction As Host" 3 "Moving In Opposite Direction As Host" 4 "Crossing From Left To Right" 5 "Crossing From Right To Left" 6 "Unknown" ;
VAL_ 149 FCODPB8P_FVVOTk8CnfdStsAuth 0 "Highly Speculative" 1 "Speculative" 2 "Confident" 3 "Highly Confident" ;
VAL_ 149 FCODPB8P_FVVOTk8DynPrpStsAuth 0 "Stopped" 1 "Not Stopped" ;
VAL_ 149 FCODPB8P_FVVOTk8MStsAuth 0 "No Object" 1 "New Object" 2 "Latent Track Not Detected this Cycle" 3 "Measured this Cycle" ;
VAL_ 149 FCODPB8P_FVVOTk8LnAsmtAuth 0 "UNKNOWN" 1 "HOST LANE" 2 "RIGHT LANE" 3 "LEFT LANE" 4 "2nd RIGHT LANE" 5 "2nd LEFT LANE" ;
VAL_ 149 FCODPB8P_FVVOTk9BrkLgtStsAuth 0 "UNKNOWN" 1 "OFF" 2 "ON" 3 "FLASHING" ;
VAL_ 149 FCODPB8P_FVVOTk8TypCnfdAuth 0 "Highly Speculative" 1 "Speculative" 2 "Confident" 3 "Highly Confident" ;
VAL_ 149 FCODPB8P_FVVOTk8TypAuth 0 "Unknown" 1 "Motorcycle" 2 "Vehicle" 3 "Truck" ;
VAL_ 149 FCODPB8P_FVVOTk8TSLgtStsAuth 0 "UNKNOWN" 1 "OFF" 2 "LEFT" 3 "RIGHT" 4 "BOTH" ;
VAL_ 149 FCODPB8P_FVVOTk9CnfdStsAuth 0 "Highly Speculative" 1 "Speculative" 2 "Confident" 3 "Highly Confident" ;
VAL_ 149 FCODPB8P_FVVOTk9DynPrpStsAuth 0 "Stopped" 1 "Not Stopped" ;
VAL_ 149 FCODPB8P_FVVOTk9DynPrpAuth 0 "Has Never Moved" 1 "Has Moved But Currently Stopped" 2 "Moving In Same Direction As Host" 3 "Moving In Opposite Direction As Host" 4 "Crossing From Left To Right" 5 "Crossing From Right To Left" 6 "Unknown" ;
VAL_ 149 FCODPB8P_FVVOTk9MStsAuth 0 "No Object" 1 "New Object" 2 "Latent Track Not Detected this Cycle" 3 "Measured this Cycle" ;
VAL_ 149 FCODPB8P_FVVOTk9LnAsmtAuth 0 "UNKNOWN" 1 "HOST LANE" 2 "RIGHT LANE" 3 "LEFT LANE" 4 "2nd RIGHT LANE" 5 "2nd LEFT LANE" ;
VAL_ 149 FCODPB8P_FVVOTk9TypAuth 0 "Unknown" 1 "Motorcycle" 2 "Vehicle" 3 "Truck" ;
VAL_ 149 FCODPB8P_FVVOTk9TSLgtStsAuth 0 "UNKNOWN" 1 "OFF" 2 "LEFT" 3 "RIGHT" 4 "BOTH" ;
VAL_ 149 FCODPB8P_FVVOTk9TypCnfdAuth 0 "Highly Speculative" 1 "Speculative" 2 "Confident" 3 "Highly Confident" ;
VAL_ 225 FCODPB9P_FVCIPthVehAlrtNwAuth 0 "FALSE" 1 "TRUE" ;
VAL_ 225 FCODPB9P_FVCIPthVehAhdNwAuth 0 "FALSE" 1 "TRUE" ;
VAL_ 225 FCODPB9P_FrwdDistIndDgrdAuth 0 "FALSE" 1 "TRUE" ;
VAL_ 225 FCODPB9P_FrwdClsnAlrtDgrdAuth 0 "FALSE" 1 "TRUE" ;
VAL_ 225 FCODPB9P_ClsnImntBrkgDgrdAuth 0 "FALSE" 1 "TRUE" ;
VAL_ 225 FCODPB9P_AdpCruzCtlDgrdAuth 0 "FALSE" 1 "TRUE" ;
VAL_ 225 FCODPB9P_FVHTPNtfyNwAuth 0 "FALSE" 1 "TRUE" ;
VAL_ 225 FCODPB9P_FVHTPBrkNwAuth 0 "FALSE" 1 "TRUE" ;
VAL_ 225 FCODPB9P_FVHTPAlrtNwAuth 0 "FALSE" 1 "TRUE" ;
VAL_ 225 FCODPB9P_FVCIPthVehBrkNwAuth 0 "FALSE" 1 "TRUE" ;
VAL_ 225 FCODPB9P_FVLFTk1TypAuth 0 "Lane Fusion" 1 "HPP Left" 2 "HPP Center" 3 "HPP Right" ;
VAL_ 225 FCODPB9P_FVLFTk2TypAuth 0 "Lane Fusion" 1 "HPP Left" 2 "HPP Center" 3 "HPP Right" ;
VAL_ 225 FCODPB9P_FVLFTk3TypAuth 0 "Lane Fusion" 1 "HPP Left" 2 "HPP Center" 3 "HPP Right" ;
VAL_ 225 FCODPB9P_PedtrnClsnBrkgDgrdAuth 0 "FALSE" 1 "TRUE" ;
VAL_ 225 FCODPB9P_PedtrnClsnAlrtDgrdAuth 0 "FALSE" 1 "TRUE" ;
VAL_ 225 FCODPB9P_LnKeepAsstDgrdAuth 0 "FALSE" 1 "TRUE" ;
VAL_ 225 FCODPB9P_LnCntrDgrdAuth 0 "FALSE" 1 "TRUE" ;
VAL_ 225 FCODPB9P_IntsctClsnMtgnDgrdAuth 0 "FALSE" 1 "TRUE" ;
VAL_ 225 FCODPB9P_FVLFTk4TypAuth 0 "Lane Fusion" 1 "HPP Left" 2 "HPP Center" 3 "HPP Right" ;
VAL_ 225 FCODPB9P_PedtrnNtfnDgrdAuth 0 "FALSE" 1 "TRUE" ;
VAL_ 226 FCODPB10P_FVVOTk10PoI1PsVisAuth 0 "Unknown" 1 "Visible" 2 "Projected" ;
VAL_ 226 FCODPB10P_FVVOTk10PoI2PsVisAuth 0 "Unknown" 1 "Visible" 2 "Projected" ;
VAL_ 226 FCODPB10P_FVVOTk1PoI1PsVisAuth 0 "Unknown" 1 "Visible" 2 "Projected" ;
VAL_ 226 FCODPB10P_FVVOTk10PoI3PsVisAuth 0 "Unknown" 1 "Visible" 2 "Projected" ;
VAL_ 226 FCODPB10P_FVVOTk1PoI2PsVisAuth 0 "Unknown" 1 "Visible" 2 "Projected" ;
VAL_ 226 FCODPB10P_FVVOTk2PoI1PsVisAuth 0 "Unknown" 1 "Visible" 2 "Projected" ;
VAL_ 226 FCODPB10P_FVVOTk1PoI3PsVisAuth 0 "Unknown" 1 "Visible" 2 "Projected" ;
VAL_ 226 FCODPB10P_FVVOTk2PoI2PsVisAuth 0 "Unknown" 1 "Visible" 2 "Projected" ;
VAL_ 226 FCODPB10P_FVVOTk3PoI1PsVisAuth 0 "Unknown" 1 "Visible" 2 "Projected" ;
VAL_ 226 FCODPB10P_FVVOTk2PoI3PsVisAuth 0 "Unknown" 1 "Visible" 2 "Projected" ;
VAL_ 226 FCODPB10P_FVVOTk3PoI2PsVisAuth 0 "Unknown" 1 "Visible" 2 "Projected" ;
VAL_ 226 FCODPB10P_FVVOTk4PoI1PsVisAuth 0 "Unknown" 1 "Visible" 2 "Projected" ;
VAL_ 226 FCODPB10P_FVVOTk3PoI3PsVisAuth 0 "Unknown" 1 "Visible" 2 "Projected" ;
VAL_ 226 FCODPB10P_FVVOTk4PoI2PsVisAuth 0 "Unknown" 1 "Visible" 2 "Projected" ;
VAL_ 226 FCODPB10P_FVVOTk5PoI1PsVisAuth 0 "Unknown" 1 "Visible" 2 "Projected" ;
VAL_ 226 FCODPB10P_FVVOTk4PoI3PsVisAuth 0 "Unknown" 1 "Visible" 2 "Projected" ;
VAL_ 226 FCODPB10P_FVVOTk5PoI2PsVisAuth 0 "Unknown" 1 "Visible" 2 "Projected" ;
VAL_ 226 FCODPB10P_FVVOTk6PoI1PsVisAuth 0 "Unknown" 1 "Visible" 2 "Projected" ;
VAL_ 226 FCODPB10P_FVVOTk5PoI3PsVisAuth 0 "Unknown" 1 "Visible" 2 "Projected" ;
VAL_ 226 FCODPB10P_FVVOTk6PoI2PsVisAuth 0 "Unknown" 1 "Visible" 2 "Projected" ;
VAL_ 226 FCODPB10P_FVVOTk7PoI1PsVisAuth 0 "Unknown" 1 "Visible" 2 "Projected" ;
VAL_ 226 FCODPB10P_FVVOTk6PoI3PsVisAuth 0 "Unknown" 1 "Visible" 2 "Projected" ;
VAL_ 226 FCODPB10P_FVVOTk7PoI2PsVisAuth 0 "Unknown" 1 "Visible" 2 "Projected" ;
VAL_ 226 FCODPB10P_FVVOTk8PoI1PsVisAuth 0 "Unknown" 1 "Visible" 2 "Projected" ;
VAL_ 226 FCODPB10P_FVVOTk7PoI3PsVisAuth 0 "Unknown" 1 "Visible" 2 "Projected" ;
VAL_ 226 FCODPB10P_FVVOTk8PoI2PsVisAuth 0 "Unknown" 1 "Visible" 2 "Projected" ;
VAL_ 226 FCODPB10P_FVVOTk9PoI1PsVisAuth 0 "Unknown" 1 "Visible" 2 "Projected" ;
VAL_ 226 FCODPB10P_FVVOTk8PoI3PsVisAuth 0 "Unknown" 1 "Visible" 2 "Projected" ;
VAL_ 226 FCODPB10P_FVVOTk9PoI2PsVisAuth 0 "Unknown" 1 "Visible" 2 "Projected" ;
VAL_ 226 FCODPB10P_FVVOTk9PoI3PsVisAuth 0 "Unknown" 1 "Visible" 2 "Projected" ;
VAL_ 142 FCODPB1P_FVLBTk1ClrAuth 0 "UNKNOWN" 1 "WHITE" 2 "YELLOW/ORANGE" 3 "OTHER" ;
VAL_ 142 FCODPB1P_FVLBTk1PstnTypAuth 0 "Unknown" 1 "Host Left Lane" 2 "Host Right Lane" 3 "Next Left Lane" 4 "Next Right Lane" 5 "Second Next Left Lane" 6 "Second Next Right Lane" 7 "Third Next Left Lane" 8 "Third Next Right Lane" 9 "Fourth Next Left Lane" 10 "Fourth Next Right Lane" 11 "Fifth Next Left Lane" 12 "Fifth Next Right Lane" ;
VAL_ 142 FCODPB1P_FVLBTk1TypAuth 0 "UNDECIDED" 1 "SOLID" 2 "DASHED" 3 "ROAD EDGE" 4 "DOUBLE LINE" 5 "BOTTS DOTS" 6 "VIRTUAL" 7 "TRIPLE LINE" ;
VAL_ 142 FCODPB1P_FVLBTk1QltyAuth 0 "VERY LOW QUALITY" 1 "LOW QUALITY" 2 "PREDICTION" 3 "HIGH QUALITY" ;
VAL_ 142 FCODPB1P_FVPOTk1DynPrpAuth 0 "Has Never Moved" 1 "Has Moved But Currently Stopped" 2 "Moving In Same Direction As Host" 3 "Moving In Opposite Direction As Host" 4 "Crossing Path" ;
VAL_ 142 FCODPB1P_FVPOTk1CnfdStsAuth 0 "Highly Speculative" 1 "Speculative" 2 "Confident" 3 "Highly Confident" ;
VAL_ 142 FCODPB1P_FVPOTk1MStsAuth 0 "No Object" 1 "New Object" 2 "Latent Track Not Detected this Cycle" 3 "Measured this Cycle" ;
VAL_ 142 FCODPB1P_FVVOTk1BrkLgtStsAuth 0 "UNKNOWN" 1 "OFF" 2 "ON" 3 "FLASHING" ;
VAL_ 142 FCODPB1P_FVPOTk1TypCnfdAuth 0 "Highly Speculative" 1 "Speculative" 2 "Confident" 3 "Highly Confident" ;
VAL_ 142 FCODPB1P_FVPOTk1TypAuth 0 "Unknown" 1 "Pedestrian" 2 "Bicycle" ;
VAL_ 142 FCODPB1P_FVVOTk1DynPrpAuth 0 "Has Never Moved" 1 "Has Moved But Currently Stopped" 2 "Moving In Same Direction As Host" 3 "Moving In Opposite Direction As Host" 4 "Crossing From Left To Right" 5 "Crossing From Right To Left" 6 "Unknown" ;
VAL_ 142 FCODPB1P_FVVOTk1CnfdStsAuth 0 "Highly Speculative" 1 "Speculative" 2 "Confident" 3 "Highly Confident" ;
VAL_ 142 FCODPB1P_FVVOTk1DynPrpStsAuth 0 "Stopped" 1 "Not Stopped" ;
VAL_ 142 FCODPB1P_FVVOTk1MStsAuth 0 "No Object" 1 "New Object" 2 "Latent Track Not Detected this Cycle" 3 "Measured this Cycle" ;
VAL_ 142 FCODPB1P_FVVOTk1LnAsmtAuth 0 "UNKNOWN" 1 "HOST LANE" 2 "RIGHT LANE" 3 "LEFT LANE" 4 "2nd RIGHT LANE" 5 "2nd LEFT LANE" ;
VAL_ 142 FCODPB1P_FVVOTk1TypCnfdAuth 0 "Highly Speculative" 1 "Speculative" 2 "Confident" 3 "Highly Confident" ;
VAL_ 142 FCODPB1P_FVVOTk1TypAuth 0 "Unknown" 1 "Motorcycle" 2 "Vehicle" 3 "Truck" ;
VAL_ 142 FCODPB1P_FVVOTk1TSLgtStsAuth 0 "UNKNOWN" 1 "OFF" 2 "LEFT" 3 "RIGHT" 4 "BOTH" ;
VAL_ 153 LRRODPB2P_POTk2DynPrpAuth 0 "Has Never Moved" 1 "Has Moved But Currently Stopped" 2 "Moving In Same Direction As Host" 3 "Moving In Opposite Direction As Host" 4 "Crossing Path" ;
VAL_ 153 LRRODPB2P_POTk2CnfdStsAuth 0 "Highly Speculative" 1 "Speculative" 2 "Confident" 3 "Highly Confident" ;
VAL_ 153 LRRODPB2P_POTk2MStsAuth 0 "No Object" 1 "New Object" 2 "Latent Track Not Detected this Cycle" 3 "Measured this Cycle" ;
VAL_ 153 LRRODPB2P_POTk2TypCnfdAuth 0 "Highly Speculative" 1 "Speculative" 2 "Confident" 3 "Highly Confident" ;
VAL_ 153 LRRODPB2P_POTk2TypAuth 0 "Unknown" 1 "Pedestrian" 2 "Bicycle" ;
VAL_ 153 LRRODPB2P_VOTk3DynPrpStsAuth 0 "Stopped" 1 "Not Stopped" ;
VAL_ 153 LRRODPB2P_VOTk3DynPrpAuth 0 "Has Never Moved" 1 "Moving In Same Direction As Host" 2 "Moving In Opposite Direction As Host" 3 "Crossing From Left To Right" 4 "Crossing From Right To Left" ;
VAL_ 153 LRRODPB2P_VOTk3CnfdStsAuth 0 "Highly Speculative" 1 "Speculative" 2 "Confident" 3 "Highly Confident" ;
VAL_ 153 LRRODPB2P_VOTk3MStsAuth 0 "No Object" 1 "New Object" 2 "Latent Track Not Detected this Cycle" 3 "Measured this Cycle" ;
VAL_ 153 LRRODPB2P_VOTk3TypCnfdAuth 0 "Highly Speculative" 1 "Speculative" 2 "Confident" 3 "Highly Confident" ;
VAL_ 153 LRRODPB2P_VOTk4DynPrpStsAuth 0 "Stopped" 1 "Not Stopped" ;
VAL_ 153 LRRODPB2P_VOTk4DynPrpAuth 0 "Has Never Moved" 1 "Moving In Same Direction As Host" 2 "Moving In Opposite Direction As Host" 3 "Crossing From Left To Right" 4 "Crossing From Right To Left" ;
VAL_ 153 LRRODPB2P_VOTk4CnfdStsAuth 0 "Highly Speculative" 1 "Speculative" 2 "Confident" 3 "Highly Confident" ;
VAL_ 153 LRRODPB2P_VOTk4MStsAuth 0 "No Object" 1 "New Object" 2 "Latent Track Not Detected this Cycle" 3 "Measured this Cycle" ;
VAL_ 153 LRRODPB2P_VOTk4TypCnfdAuth 0 "Highly Speculative" 1 "Speculative" 2 "Confident" 3 "Highly Confident" ;
VAL_ 153 LRRODPB2P_VOTk5CnfdStsAuth 0 "Highly Speculative" 1 "Speculative" 2 "Confident" 3 "Highly Confident" ;
VAL_ 153 LRRODPB2P_VOTk5DynPrpStsAuth 0 "Stopped" 1 "Not Stopped" ;
VAL_ 153 LRRODPB2P_VOTk5DynPrpAuth 0 "Has Never Moved" 1 "Moving In Same Direction As Host" 2 "Moving In Opposite Direction As Host" 3 "Crossing From Left To Right" 4 "Crossing From Right To Left" ;
VAL_ 153 LRRODPB2P_VOTk5MStsAuth 0 "No Object" 1 "New Object" 2 "Latent Track Not Detected this Cycle" 3 "Measured this Cycle" ;
VAL_ 153 LRRODPB2P_VOTk5TypCnfdAuth 0 "Highly Speculative" 1 "Speculative" 2 "Confident" 3 "Highly Confident" ;
VAL_ 154 LRRODPB3P_POTk3DynPrpAuth 0 "Has Never Moved" 1 "Has Moved But Currently Stopped" 2 "Moving In Same Direction As Host" 3 "Moving In Opposite Direction As Host" 4 "Crossing Path" ;
VAL_ 154 LRRODPB3P_POTk3CnfdStsAuth 0 "Highly Speculative" 1 "Speculative" 2 "Confident" 3 "Highly Confident" ;
VAL_ 154 LRRODPB3P_POTk3MStsAuth 0 "No Object" 1 "New Object" 2 "Latent Track Not Detected this Cycle" 3 "Measured this Cycle" ;
VAL_ 154 LRRODPB3P_POTk3TypCnfdAuth 0 "Highly Speculative" 1 "Speculative" 2 "Confident" 3 "Highly Confident" ;
VAL_ 154 LRRODPB3P_POTk3TypAuth 0 "Unknown" 1 "Pedestrian" 2 "Bicycle" ;
VAL_ 154 LRRODPB3P_VOTk6DynPrpStsAuth 0 "Stopped" 1 "Not Stopped" ;
VAL_ 154 LRRODPB3P_VOTk6DynPrpAuth 0 "Has Never Moved" 1 "Moving In Same Direction As Host" 2 "Moving In Opposite Direction As Host" 3 "Crossing From Left To Right" 4 "Crossing From Right To Left" ;
VAL_ 154 LRRODPB3P_VOTk6CnfdStsAuth 0 "Highly Speculative" 1 "Speculative" 2 "Confident" 3 "Highly Confident" ;
VAL_ 154 LRRODPB3P_VOTk6MStsAuth 0 "No Object" 1 "New Object" 2 "Latent Track Not Detected this Cycle" 3 "Measured this Cycle" ;
VAL_ 154 LRRODPB3P_VOTk6TypCnfdAuth 0 "Highly Speculative" 1 "Speculative" 2 "Confident" 3 "Highly Confident" ;
VAL_ 154 LRRODPB3P_VOTk7DynPrpStsAuth 0 "Stopped" 1 "Not Stopped" ;
VAL_ 154 LRRODPB3P_VOTk7DynPrpAuth 0 "Has Never Moved" 1 "Moving In Same Direction As Host" 2 "Moving In Opposite Direction As Host" 3 "Crossing From Left To Right" 4 "Crossing From Right To Left" ;
VAL_ 154 LRRODPB3P_VOTk7CnfdStsAuth 0 "Highly Speculative" 1 "Speculative" 2 "Confident" 3 "Highly Confident" ;
VAL_ 154 LRRODPB3P_VOTk7MStsAuth 0 "No Object" 1 "New Object" 2 "Latent Track Not Detected this Cycle" 3 "Measured this Cycle" ;
VAL_ 154 LRRODPB3P_VOTk7TypCnfdAuth 0 "Highly Speculative" 1 "Speculative" 2 "Confident" 3 "Highly Confident" ;
VAL_ 154 LRRODPB3P_VOTk8CnfdStsAuth 0 "Highly Speculative" 1 "Speculative" 2 "Confident" 3 "Highly Confident" ;
VAL_ 154 LRRODPB3P_VOTk8DynPrpStsAuth 0 "Stopped" 1 "Not Stopped" ;
VAL_ 154 LRRODPB3P_VOTk8DynPrpAuth 0 "Has Never Moved" 1 "Moving In Same Direction As Host" 2 "Moving In Opposite Direction As Host" 3 "Crossing From Left To Right" 4 "Crossing From Right To Left" ;
VAL_ 154 LRRODPB3P_VOTk8MStsAuth 0 "No Object" 1 "New Object" 2 "Latent Track Not Detected this Cycle" 3 "Measured this Cycle" ;
VAL_ 154 LRRODPB3P_VOTk8TypCnfdAuth 0 "Highly Speculative" 1 "Speculative" 2 "Confident" 3 "Highly Confident" ;
VAL_ 155 LRRODPB4P_POTk4DynPrpAuth 0 "Has Never Moved" 1 "Has Moved But Currently Stopped" 2 "Moving In Same Direction As Host" 3 "Moving In Opposite Direction As Host" 4 "Crossing Path" ;
VAL_ 155 LRRODPB4P_POTk4CnfdStsAuth 0 "Highly Speculative" 1 "Speculative" 2 "Confident" 3 "Highly Confident" ;
VAL_ 155 LRRODPB4P_POTk4MStsAuth 0 "No Object" 1 "New Object" 2 "Latent Track Not Detected this Cycle" 3 "Measured this Cycle" ;
VAL_ 155 LRRODPB4P_POTk5DynPrpAuth 0 "Has Never Moved" 1 "Has Moved But Currently Stopped" 2 "Moving In Same Direction As Host" 3 "Moving In Opposite Direction As Host" 4 "Crossing Path" ;
VAL_ 155 LRRODPB4P_POTk5CnfdStsAuth 0 "Highly Speculative" 1 "Speculative" 2 "Confident" 3 "Highly Confident" ;
VAL_ 155 LRRODPB4P_POTk4TypCnfdAuth 0 "Highly Speculative" 1 "Speculative" 2 "Confident" 3 "Highly Confident" ;
VAL_ 155 LRRODPB4P_POTk4TypAuth 0 "Unknown" 1 "Pedestrian" 2 "Bicycle" ;
VAL_ 155 LRRODPB4P_POTk5MStsAuth 0 "No Object" 1 "New Object" 2 "Latent Track Not Detected this Cycle" 3 "Measured this Cycle" ;
VAL_ 155 LRRODPB4P_POTk5TypCnfdAuth 0 "Highly Speculative" 1 "Speculative" 2 "Confident" 3 "Highly Confident" ;
VAL_ 155 LRRODPB4P_POTk5TypAuth 0 "Unknown" 1 "Pedestrian" 2 "Bicycle" ;
VAL_ 155 LRRODPB4P_VOTk10DynPrpAuth 0 "Has Never Moved" 1 "Moving In Same Direction As Host" 2 "Moving In Opposite Direction As Host" 3 "Crossing From Left To Right" 4 "Crossing From Right To Left" ;
VAL_ 155 LRRODPB4P_VOTk10CnfdStsAuth 0 "Highly Speculative" 1 "Speculative" 2 "Confident" 3 "Highly Confident" ;
VAL_ 155 LRRODPB4P_VOTk10DynPrpStsAuth 0 "Stopped" 1 "Not Stopped" ;
VAL_ 155 LRRODPB4P_VOTk10MStsAuth 0 "No Object" 1 "New Object" 2 "Latent Track Not Detected this Cycle" 3 "Measured this Cycle" ;
VAL_ 155 LRRODPB4P_VOTk10TypCnfdAuth 0 "Highly Speculative" 1 "Speculative" 2 "Confident" 3 "Highly Confident" ;
VAL_ 155 LRRODPB4P_VOTk9DynPrpStsAuth 0 "Stopped" 1 "Not Stopped" ;
VAL_ 155 LRRODPB4P_VOTk9DynPrpAuth 0 "Has Never Moved" 1 "Moving In Same Direction As Host" 2 "Moving In Opposite Direction As Host" 3 "Crossing From Left To Right" 4 "Crossing From Right To Left" ;
VAL_ 155 LRRODPB4P_VOTk9CnfdStsAuth 0 "Highly Speculative" 1 "Speculative" 2 "Confident" 3 "Highly Confident" ;
VAL_ 155 LRRODPB4P_VOTk9MStsAuth 0 "No Object" 1 "New Object" 2 "Latent Track Not Detected this Cycle" 3 "Measured this Cycle" ;
VAL_ 155 LRRODPB4P_VOTk9TypCnfdAuth 0 "Highly Speculative" 1 "Speculative" 2 "Confident" 3 "Highly Confident" ;
