VERSION ""

NS_ :

BS_:

BU_: WCM4 WCM3 WCM2 WCM VPM VLM VKM VICM VECM VDM VCU_RTOS_ETH VCU_ENTRY_ETH VCU_AGVM_ETH VCU UVM UPM TIM TEST_TOOL_1 TCP_ETH TCP TCM TCCM SRR_SRR_ETH SRR_SRR SRR_SLR_ETH SRR_SLR SRR_RR SRR_RF_ETH SRR_RF SRR_LR_CR SRR_LF_ETH SRR_LF SIB SDM SCL SBZA_R SBZA_L SBM SAM_RR SAM_RF SAM_LR SAM_LF SAM_BH SADS RadioLow_ETH RadioLow RSI_RTOS_ETH RSI RDCM PTM PLCM PFCM PDR_ETH PDR PCM PA ODS2 ODS NVM MTCM_R MTCM_L MSM_RR MSM_P MSM_LR MSM_D MSB2 MSB1 MRCM_R MRCM_L MFC LRR_RR_ETH LRR_LR_ETH LRR_CF_ETH LRR LRL_CF_ETH LIB_48V LIB1 IPC_INT IPC_GP IPC ICS_Info ICCM HVAC_FP_R HVAC_FP_F HUD_CAN HDLM FPI_RTOS_ETH FPI FOPM FCM_LC FCM EPSb EPS_1 EPSRAb EPSRAa EPS EOCM_HC_Superset EOCM_HCP2 EOCM ELM ECP_X1 ECP_S2 ECP_S ECP_MC ECP_H3 ECP_H2 ECP_H1 ECP_E ECM EBCM DMS DEFC DCM CSM_ETH CSM_AV CSM CGM_OTA_ETH CGM BSM_MH BSM_HEV BSM BCM ARS ARB APA AOS AMP ALC AHS AHL_AFL ADIMb ADIMa ACP2_MCU
VAL_TABLE_ APASP_APAStsAuth 0 "Off" 1 "Standby" 2 "Search_Phase" 3 "Exit_Park" 4 "Enabled" 5 "Guidance_Phase" 6 "Finished" 7 "Error" ;
VAL_TABLE_ APASP_APATransRngReqAuth 0 "No_Request" 1 "Park" 2 "Reverse" 3 "Neutral" 4 "Drive" ;
VAL_TABLE_ APASP_APATransRngActvnReqdAuth 0 "FALSE" 1 "TRUE" ;
VAL_TABLE_ HndsOnLnCntrAsstWrnIndReq 0 "No Indication" 1 "Disabled and Locked out" 2 "Steering Input Not Detected" 3 "Steering Assist Features Unavailable in Selected Driver Mode" 4 "Unavailable" 5 "Driver Attention Alert" 6 "Can't See Face" ;
VAL_TABLE_ SuprRmtPrkPwrModeReq 0 "No Request" 1 "Off" 2 "Propulsion" ;
VAL_TABLE_ SuprRmtPrkDrLckReq 0 "No Request" 1 "Lock" 2 "Unlock" ;
VAL_TABLE_ ASOCNP_LKATakeStrgIndOnAuth 0 "FALSE" 1 "TRUE" ;
VAL_TABLE_ BGI2P_WshFldLvlIndOnAuth 0 "FALSE" 1 "TRUE" ;
VAL_TABLE_ BGI2P_ServWprSysDrvIndOnAuth 0 "FALSE" 1 "TRUE" ;
VAL_TABLE_ BSPMP_BkupSysPwrModeAuth_Inv 0 "FALSE" 1 "TRUE" ;
VAL_TABLE_ BSPMP_BkupSysPwrModeAuth 0 "Off" 1 "Accessory" 2 "Run" 3 "Start Request" 4 "Propulsion" ;
VAL_TABLE_ BSPMP_SecRunCrnkCmdActvAuth_Inv 0 "FALSE" 1 "TRUE" ;
VAL_TABLE_ BSPMP_SecRunCrnkCmdActvAuth 0 "FALSE" 1 "TRUE" ;
VAL_TABLE_ BSPMP_SecPwrModePBActvAuth_Inv 0 "FALSE" 1 "TRUE" ;
VAL_TABLE_ BSPMP_SecPwrModePBActvAuth 0 "FALSE" 1 "TRUE" ;
VAL_TABLE_ BSPMP_RmtProgmActvAuth 0 "FALSE" 1 "TRUE" ;
VAL_TABLE_ BSDIP_ESCOffVisIndOnAuth 0 "FALSE" 1 "TRUE" ;
VAL_TABLE_ BSDIP_EPBSysWrnIndReqAuth 0 "Off" 1 "On" 2 "0.5_Hz" 3 "1_Hz" 4 "2_Hz" 5 "4_Hz" ;
VAL_TABLE_ BSDIP_EPBSysStsIndReqAuth 0 "Off" 1 "On" 2 "0.5_Hz" 3 "1_Hz" 4 "2_Hz" 5 "4_Hz" ;
VAL_TABLE_ BSDIP_ABSIndOnAuth 0 "FALSE" 1 "TRUE" ;
VAL_TABLE_ BSDIP_TracCtlOffVisIndOnAuth 0 "FALSE" 1 "TRUE" ;
VAL_TABLE_ BSDIP_SrvBrkRdBrkTTShrtChIOAuth 0 "FALSE" 1 "TRUE" ;
VAL_TABLE_ BSDIP_ServBrkRdBrkTTLngChIOAuth 0 "FALSE" 1 "TRUE" ;
VAL_TABLE_ BSDIP_ServBrkBstSrvBrkAssIOAuth 0 "FALSE" 1 "TRUE" ;
VAL_TABLE_ BSDIP_ESCVisIndReqAuth 0 "OFF" 1 "ON" 2 "2_Hz" ;
VAL_TABLE_ BrkSysBstWrnIndReq 0 "No Indication" 1 "Service Brake Boost" 2 "Brake Assist Failure" 3 "Brake System Failure" ;
VAL_TABLE_ DTCI_ACP2_MCU_CnfrmdDTC 0 "FALSE" 1 "TRUE" ;
VAL_TABLE_ DTCI_ACP2_MCU_DTCFaultType 0 "Not Supported" 1 "Type A" 2 "Type B" 3 "Type C" ;
VAL_TABLE_ DTCI_ACP2_MCU_TstNCmpltdOpCyc 0 "FALSE" 1 "TRUE" ;
VAL_TABLE_ DTCI_ACP2_MCU_TstNCmpltdLstClr 0 "FALSE" 1 "TRUE" ;
VAL_TABLE_ DTCI_ACP2_MCU_TstFldOpCyc 0 "FALSE" 1 "TRUE" ;
VAL_TABLE_ DTCI_ACP2_MCU_TstFldLstClr 0 "FALSE" 1 "TRUE" ;
VAL_TABLE_ DTCI_ACP2_MCU_TstFld 0 "FALSE" 1 "TRUE" ;
VAL_TABLE_ DTCI_ACP2_MCU_PndngDTC 0 "FALSE" 1 "TRUE" ;
VAL_TABLE_ DTCI_ACP2_MCU_DTCTriggered 0 "FALSE" 1 "TRUE" ;
VAL_TABLE_ DTCI_ACP2_MCU_WrnIndTrggrd 0 "FALSE" 1 "TRUE" ;
VAL_TABLE_ DTCI_ACP2_MCU_WrnIndRqd 0 "FALSE" 1 "TRUE" ;
VAL_TABLE_ DTCI_ACP3_MCU_CnfrmdDTC 0 "FALSE" 1 "TRUE" ;
VAL_TABLE_ DTCI_ACP3_MCU_DTCFaultType 0 "Not Supported" 1 "Type A" 2 "Type B" 3 "Type C" ;
VAL_TABLE_ DTCI_ACP3_MCU_TstNCmpltdOpCyc 0 "FALSE" 1 "TRUE" ;
VAL_TABLE_ DTCI_ACP3_MCU_TstNCmpltdLstClr 0 "FALSE" 1 "TRUE" ;
VAL_TABLE_ DTCI_ACP3_MCU_TstFldOpCyc 0 "FALSE" 1 "TRUE" ;
VAL_TABLE_ DTCI_ACP3_MCU_TstFldLstClr 0 "FALSE" 1 "TRUE" ;
VAL_TABLE_ DTCI_ACP3_MCU_TstFld 0 "FALSE" 1 "TRUE" ;
VAL_TABLE_ DTCI_ACP3_MCU_PndngDTC 0 "FALSE" 1 "TRUE" ;
VAL_TABLE_ DTCI_ACP3_MCU_DTCTriggered 0 "FALSE" 1 "TRUE" ;
VAL_TABLE_ DTCI_ACP3_MCU_WrnIndTrggrd 0 "FALSE" 1 "TRUE" ;
VAL_TABLE_ DTCI_ACP3_MCU_WrnIndRqd 0 "FALSE" 1 "TRUE" ;
VAL_TABLE_ DTCI_ACP4_MCU_CnfrmdDTC 0 "FALSE" 1 "TRUE" ;
VAL_TABLE_ DTCI_ACP4_MCU_DTCFaultType 0 "Not Supported" 1 "Type A" 2 "Type B" 3 "Type C" ;
VAL_TABLE_ DTCI_ACP4_MCU_TstNCmpltdOpCyc 0 "FALSE" 1 "TRUE" ;
VAL_TABLE_ DTCI_ACP4_MCU_TstNCmpltdLstClr 0 "FALSE" 1 "TRUE" ;
VAL_TABLE_ DTCI_ACP4_MCU_TstFldOpCyc 0 "FALSE" 1 "TRUE" ;
VAL_TABLE_ DTCI_ACP4_MCU_TstFldLstClr 0 "FALSE" 1 "TRUE" ;
VAL_TABLE_ DTCI_ACP4_MCU_TstFld 0 "FALSE" 1 "TRUE" ;
VAL_TABLE_ DTCI_ACP4_MCU_PndngDTC 0 "FALSE" 1 "TRUE" ;
VAL_TABLE_ DTCI_ACP4_MCU_DTCTriggered 0 "FALSE" 1 "TRUE" ;
VAL_TABLE_ DTCI_ACP4_MCU_WrnIndTrggrd 0 "FALSE" 1 "TRUE" ;
VAL_TABLE_ DTCI_ACP4_MCU_WrnIndRqd 0 "FALSE" 1 "TRUE" ;
VAL_TABLE_ DTCI_AHL_AFL_CnfrmdDTC 0 "FALSE" 1 "TRUE" ;
VAL_TABLE_ DTCI_AHL_AFL_DTCFaultType 0 "Not Supported" 1 "Type A" 2 "Type B" 3 "Type C" ;
VAL_TABLE_ DTCI_AHL_AFL_TstNCmpltdOpCyc 0 "FALSE" 1 "TRUE" ;
VAL_TABLE_ DTCI_AHL_AFL_TstNCmpltdLstClr 0 "FALSE" 1 "TRUE" ;
VAL_TABLE_ DTCI_AHL_AFL_TstFldOpCyc 0 "FALSE" 1 "TRUE" ;
VAL_TABLE_ DTCI_AHL_AFL_TstFldLstClr 0 "FALSE" 1 "TRUE" ;
VAL_TABLE_ DTCI_AHL_AFL_TstFld 0 "FALSE" 1 "TRUE" ;
VAL_TABLE_ DTCI_AHL_AFL_PndngDTC 0 "FALSE" 1 "TRUE" ;
VAL_TABLE_ DTCI_AHL_AFL_DTCTriggered 0 "FALSE" 1 "TRUE" ;
VAL_TABLE_ DTCI_AHL_AFL_WrnIndTrggrd 0 "FALSE" 1 "TRUE" ;
VAL_TABLE_ DTCI_AHL_AFL_WrnIndRqd 0 "FALSE" 1 "TRUE" ;
VAL_TABLE_ DTCI_AHS_CnfrmdDTC 0 "FALSE" 1 "TRUE" ;
VAL_TABLE_ DTCI_AHS_DTCFaultType 0 "Not Supported" 1 "Type A" 2 "Type B" 3 "Type C" ;
VAL_TABLE_ DTCI_AHS_TstNCmpltdOpCyc 0 "FALSE" 1 "TRUE" ;
VAL_TABLE_ DTCI_AHS_TstNCmpltdLstClr 0 "FALSE" 1 "TRUE" ;
VAL_TABLE_ DTCI_AHS_TstFldOpCyc 0 "FALSE" 1 "TRUE" ;
VAL_TABLE_ DTCI_AHS_TstFldLstClr 0 "FALSE" 1 "TRUE" ;
VAL_TABLE_ DTCI_AHS_TstFld 0 "FALSE" 1 "TRUE" ;
VAL_TABLE_ DTCI_AHS_PndngDTC 0 "FALSE" 1 "TRUE" ;
VAL_TABLE_ DTCI_AHS_DTCTriggered 0 "FALSE" 1 "TRUE" ;
VAL_TABLE_ DTCI_AHS_WrnIndTrggrd 0 "FALSE" 1 "TRUE" ;
VAL_TABLE_ DTCI_AHS_WrnIndRqd 0 "FALSE" 1 "TRUE" ;
VAL_TABLE_ DTCI_ALC_CnfrmdDTC 0 "FALSE" 1 "TRUE" ;
VAL_TABLE_ DTCI_ALC_DTCFaultType 0 "Not Supported" 1 "Type A" 2 "Type B" 3 "Type C" ;
VAL_TABLE_ DTCI_ALC_TstNCmpltdOpCyc 0 "FALSE" 1 "TRUE" ;
VAL_TABLE_ DTCI_ALC_TstNCmpltdLstClr 0 "FALSE" 1 "TRUE" ;
VAL_TABLE_ DTCI_ALC_TstFldOpCyc 0 "FALSE" 1 "TRUE" ;
VAL_TABLE_ DTCI_ALC_TstFldLstClr 0 "FALSE" 1 "TRUE" ;
VAL_TABLE_ DTCI_ALC_TstFld 0 "FALSE" 1 "TRUE" ;
VAL_TABLE_ DTCI_ALC_PndngDTC 0 "FALSE" 1 "TRUE" ;
VAL_TABLE_ DTCI_ALC_DTCTriggered 0 "FALSE" 1 "TRUE" ;
VAL_TABLE_ DTCI_ALC_WrnIndTrggrd 0 "FALSE" 1 "TRUE" ;
VAL_TABLE_ DTCI_ALC_WrnIndRqd 0 "FALSE" 1 "TRUE" ;
VAL_TABLE_ DTCI_AMP_CnfrmdDTC 0 "FALSE" 1 "TRUE" ;
VAL_TABLE_ DTCI_AMP_DTCFaultType 0 "Not Supported" 1 "Type A" 2 "Type B" 3 "Type C" ;
VAL_TABLE_ DTCI_AMP_TstNCmpltdOpCyc 0 "FALSE" 1 "TRUE" ;
VAL_TABLE_ DTCI_AMP_TstNCmpltdLstClr 0 "FALSE" 1 "TRUE" ;
VAL_TABLE_ DTCI_AMP_TstFldOpCyc 0 "FALSE" 1 "TRUE" ;
VAL_TABLE_ DTCI_AMP_TstFldLstClr 0 "FALSE" 1 "TRUE" ;
VAL_TABLE_ DTCI_AMP_TstFld 0 "FALSE" 1 "TRUE" ;
VAL_TABLE_ DTCI_AMP_PndngDTC 0 "FALSE" 1 "TRUE" ;
VAL_TABLE_ DTCI_AMP_DTCTriggered 0 "FALSE" 1 "TRUE" ;
VAL_TABLE_ DTCI_AMP_WrnIndTrggrd 0 "FALSE" 1 "TRUE" ;
VAL_TABLE_ DTCI_AMP_WrnIndRqd 0 "FALSE" 1 "TRUE" ;
VAL_TABLE_ DTCI_AOS_CnfrmdDTC 0 "FALSE" 1 "TRUE" ;
VAL_TABLE_ DTCI_AOS_DTCFaultType 0 "Not Supported" 1 "Type A" 2 "Type B" 3 "Type C" ;
VAL_TABLE_ DTCI_AOS_TstNCmpltdOpCyc 0 "FALSE" 1 "TRUE" ;
VAL_TABLE_ DTCI_AOS_TstNCmpltdLstClr 0 "FALSE" 1 "TRUE" ;
VAL_TABLE_ DTCI_AOS_TstFldOpCyc 0 "FALSE" 1 "TRUE" ;
VAL_TABLE_ DTCI_AOS_TstFldLstClr 0 "FALSE" 1 "TRUE" ;
VAL_TABLE_ DTCI_AOS_TstFld 0 "FALSE" 1 "TRUE" ;
VAL_TABLE_ DTCI_AOS_PndngDTC 0 "FALSE" 1 "TRUE" ;
VAL_TABLE_ DTCI_AOS_DTCTriggered 0 "FALSE" 1 "TRUE" ;
VAL_TABLE_ DTCI_AOS_WrnIndTrggrd 0 "FALSE" 1 "TRUE" ;
VAL_TABLE_ DTCI_AOS_WrnIndRqd 0 "FALSE" 1 "TRUE" ;
VAL_TABLE_ DTCI_APA_CnfrmdDTC 0 "FALSE" 1 "TRUE" ;
VAL_TABLE_ DTCI_APA_DTCFaultType 0 "Not Supported" 1 "Type A" 2 "Type B" 3 "Type C" ;
VAL_TABLE_ DTCI_APA_TstNCmpltdOpCyc 0 "FALSE" 1 "TRUE" ;
VAL_TABLE_ DTCI_APA_TstNCmpltdLstClr 0 "FALSE" 1 "TRUE" ;
VAL_TABLE_ DTCI_APA_TstFldOpCyc 0 "FALSE" 1 "TRUE" ;
VAL_TABLE_ DTCI_APA_TstFldLstClr 0 "FALSE" 1 "TRUE" ;
VAL_TABLE_ DTCI_APA_TstFld 0 "FALSE" 1 "TRUE" ;
VAL_TABLE_ DTCI_APA_PndngDTC 0 "FALSE" 1 "TRUE" ;
VAL_TABLE_ DTCI_APA_DTCTriggered 0 "FALSE" 1 "TRUE" ;
VAL_TABLE_ DTCI_APA_WrnIndTrggrd 0 "FALSE" 1 "TRUE" ;
VAL_TABLE_ DTCI_APA_WrnIndRqd 0 "FALSE" 1 "TRUE" ;
VAL_TABLE_ DTCI_ARB_CnfrmdDTC 0 "FALSE" 1 "TRUE" ;
VAL_TABLE_ DTCI_ARB_DTCFaultType 0 "Not Supported" 1 "Type A" 2 "Type B" 3 "Type C" ;
VAL_TABLE_ DTCI_ARB_TstNCmpltdOpCyc 0 "FALSE" 1 "TRUE" ;
VAL_TABLE_ DTCI_ARB_TstNCmpltdLstClr 0 "FALSE" 1 "TRUE" ;
VAL_TABLE_ DTCI_ARB_TstFldOpCyc 0 "FALSE" 1 "TRUE" ;
VAL_TABLE_ DTCI_ARB_TstFldLstClr 0 "FALSE" 1 "TRUE" ;
VAL_TABLE_ DTCI_ARB_TstFld 0 "FALSE" 1 "TRUE" ;
VAL_TABLE_ DTCI_ARB_PndngDTC 0 "FALSE" 1 "TRUE" ;
VAL_TABLE_ DTCI_ARB_DTCTriggered 0 "FALSE" 1 "TRUE" ;
VAL_TABLE_ DTCI_ARB_WrnIndTrggrd 0 "FALSE" 1 "TRUE" ;
VAL_TABLE_ DTCI_ARB_WrnIndRqd 0 "FALSE" 1 "TRUE" ;
VAL_TABLE_ DTCI_ARS_CnfrmdDTC 0 "FALSE" 1 "TRUE" ;
VAL_TABLE_ DTCI_ARS_DTCFaultType 0 "Not Supported" 1 "Type A" 2 "Type B" 3 "Type C" ;
VAL_TABLE_ DTCI_ARS_TstNCmpltdOpCyc 0 "FALSE" 1 "TRUE" ;
VAL_TABLE_ DTCI_ARS_TstNCmpltdLstClr 0 "FALSE" 1 "TRUE" ;
VAL_TABLE_ DTCI_ARS_TstFldOpCyc 0 "FALSE" 1 "TRUE" ;
VAL_TABLE_ DTCI_ARS_TstFldLstClr 0 "FALSE" 1 "TRUE" ;
VAL_TABLE_ DTCI_ARS_TstFld 0 "FALSE" 1 "TRUE" ;
VAL_TABLE_ DTCI_ARS_PndngDTC 0 "FALSE" 1 "TRUE" ;
VAL_TABLE_ DTCI_ARS_DTCTriggered 0 "FALSE" 1 "TRUE" ;
VAL_TABLE_ DTCI_ARS_WrnIndTrggrd 0 "FALSE" 1 "TRUE" ;
VAL_TABLE_ DTCI_ARS_WrnIndRqd 0 "FALSE" 1 "TRUE" ;
VAL_TABLE_ DTCI_BCM_CnfrmdDTC 0 "FALSE" 1 "TRUE" ;
VAL_TABLE_ DTCI_BCM_DTCFaultType 0 "Not Supported" 1 "Type A" 2 "Type B" 3 "Type C" ;
VAL_TABLE_ DTCI_BCM_TstNCmpltdOpCyc 0 "FALSE" 1 "TRUE" ;
VAL_TABLE_ DTCI_BCM_TstNCmpltdLstClr 0 "FALSE" 1 "TRUE" ;
VAL_TABLE_ DTCI_BCM_TstFldOpCyc 0 "FALSE" 1 "TRUE" ;
VAL_TABLE_ DTCI_BCM_TstFldLstClr 0 "FALSE" 1 "TRUE" ;
VAL_TABLE_ DTCI_BCM_TstFld 0 "FALSE" 1 "TRUE" ;
VAL_TABLE_ DTCI_BCM_PndngDTC 0 "FALSE" 1 "TRUE" ;
VAL_TABLE_ DTCI_BCM_DTCTriggered 0 "FALSE" 1 "TRUE" ;
VAL_TABLE_ DTCI_BCM_WrnIndTrggrd 0 "FALSE" 1 "TRUE" ;
VAL_TABLE_ DTCI_BCM_WrnIndRqd 0 "FALSE" 1 "TRUE" ;
VAL_TABLE_ DTCI_BSM_HEV_CnfrmdDTC 0 "FALSE" 1 "TRUE" ;
VAL_TABLE_ DTCI_BSM_HEV_DTCFaultType 0 "Not Supported" 1 "Type A" 2 "Type B" 3 "Type C" ;
VAL_TABLE_ DTCI_BSM_HEV_TstNCmpltdOpCyc 0 "FALSE" 1 "TRUE" ;
VAL_TABLE_ DTCI_BSM_HEV_TstNCmpltdLstClr 0 "FALSE" 1 "TRUE" ;
VAL_TABLE_ DTCI_BSM_HEV_TstFldOpCyc 0 "FALSE" 1 "TRUE" ;
VAL_TABLE_ DTCI_BSM_HEV_TstFldLstClr 0 "FALSE" 1 "TRUE" ;
VAL_TABLE_ DTCI_BSM_HEV_TstFld 0 "FALSE" 1 "TRUE" ;
VAL_TABLE_ DTCI_BSM_HEV_PndngDTC 0 "FALSE" 1 "TRUE" ;
VAL_TABLE_ DTCI_BSM_HEV_DTCTriggered 0 "FALSE" 1 "TRUE" ;
VAL_TABLE_ DTCI_BSM_HEV_WrnIndTrggrd 0 "FALSE" 1 "TRUE" ;
VAL_TABLE_ DTCI_BSM_HEV_WrnIndRqd 0 "FALSE" 1 "TRUE" ;
VAL_TABLE_ DTCI_BSM_MH_CnfrmdDTC 0 "FALSE" 1 "TRUE" ;
VAL_TABLE_ DTCI_BSM_MH_DTCFaultType 0 "Not Supported" 1 "Type A" 2 "Type B" 3 "Type C" ;
VAL_TABLE_ DTCI_BSM_MH_TstNCmpltdOpCyc 0 "FALSE" 1 "TRUE" ;
VAL_TABLE_ DTCI_BSM_MH_TstNCmpltdLstClr 0 "FALSE" 1 "TRUE" ;
VAL_TABLE_ DTCI_BSM_MH_TstFldOpCyc 0 "FALSE" 1 "TRUE" ;
VAL_TABLE_ DTCI_BSM_MH_TstFldLstClr 0 "FALSE" 1 "TRUE" ;
VAL_TABLE_ DTCI_BSM_MH_TstFld 0 "FALSE" 1 "TRUE" ;
VAL_TABLE_ DTCI_BSM_MH_PndngDTC 0 "FALSE" 1 "TRUE" ;
VAL_TABLE_ DTCI_BSM_MH_DTCTriggered 0 "FALSE" 1 "TRUE" ;
VAL_TABLE_ DTCI_BSM_MH_WrnIndTrggrd 0 "FALSE" 1 "TRUE" ;
VAL_TABLE_ DTCI_BSM_MH_WrnIndRqd 0 "FALSE" 1 "TRUE" ;
VAL_TABLE_ DTCI_BSM_CnfrmdDTC 0 "FALSE" 1 "TRUE" ;
VAL_TABLE_ DTCI_BSM_DTCFaultType 0 "Not Supported" 1 "Type A" 2 "Type B" 3 "Type C" ;
VAL_TABLE_ DTCI_BSM_TstNCmpltdOpCyc 0 "FALSE" 1 "TRUE" ;
VAL_TABLE_ DTCI_BSM_TstNCmpltdLstClr 0 "FALSE" 1 "TRUE" ;
VAL_TABLE_ DTCI_BSM_TstFldOpCyc 0 "FALSE" 1 "TRUE" ;
VAL_TABLE_ DTCI_BSM_TstFldLstClr 0 "FALSE" 1 "TRUE" ;
VAL_TABLE_ DTCI_BSM_TstFld 0 "FALSE" 1 "TRUE" ;
VAL_TABLE_ DTCI_BSM_PndngDTC 0 "FALSE" 1 "TRUE" ;
VAL_TABLE_ DTCI_BSM_DTCTriggered 0 "FALSE" 1 "TRUE" ;
VAL_TABLE_ DTCI_BSM_WrnIndTrggrd 0 "FALSE" 1 "TRUE" ;
VAL_TABLE_ DTCI_BSM_WrnIndRqd 0 "FALSE" 1 "TRUE" ;
VAL_TABLE_ DTCI_CGM_CnfrmdDTC 0 "FALSE" 1 "TRUE" ;
VAL_TABLE_ DTCI_CGM_DTCFaultType 0 "Not Supported" 1 "Type A" 2 "Type B" 3 "Type C" ;
VAL_TABLE_ DTCI_CGM_TstNCmpltdOpCyc 0 "FALSE" 1 "TRUE" ;
VAL_TABLE_ DTCI_CGM_TstNCmpltdLstClr 0 "FALSE" 1 "TRUE" ;
VAL_TABLE_ DTCI_CGM_TstFldOpCyc 0 "FALSE" 1 "TRUE" ;
VAL_TABLE_ DTCI_CGM_TstFldLstClr 0 "FALSE" 1 "TRUE" ;
VAL_TABLE_ DTCI_CGM_TstFld 0 "FALSE" 1 "TRUE" ;
VAL_TABLE_ DTCI_CGM_PndngDTC 0 "FALSE" 1 "TRUE" ;
VAL_TABLE_ DTCI_CGM_DTCTriggered 0 "FALSE" 1 "TRUE" ;
VAL_TABLE_ DTCI_CGM_WrnIndTrggrd 0 "FALSE" 1 "TRUE" ;
VAL_TABLE_ DTCI_CGM_WrnIndRqd 0 "FALSE" 1 "TRUE" ;
VAL_TABLE_ DTCI_CSM_AV_CnfrmdDTC 0 "FALSE" 1 "TRUE" ;
VAL_TABLE_ DTCI_CSM_AV_DTCFaultType 0 "Not Supported" 1 "Type A" 2 "Type B" 3 "Type C" ;
VAL_TABLE_ DTCI_CSM_AV_TstNCmpltdOpCyc 0 "FALSE" 1 "TRUE" ;
VAL_TABLE_ DTCI_CSM_AV_TstNCmpltdLstClr 0 "FALSE" 1 "TRUE" ;
VAL_TABLE_ DTCI_CSM_AV_TstFldOpCyc 0 "FALSE" 1 "TRUE" ;
VAL_TABLE_ DTCI_CSM_AV_TstFldLstClr 0 "FALSE" 1 "TRUE" ;
VAL_TABLE_ DTCI_CSM_AV_TstFld 0 "FALSE" 1 "TRUE" ;
VAL_TABLE_ DTCI_CSM_AV_PndngDTC 0 "FALSE" 1 "TRUE" ;
VAL_TABLE_ DTCI_CSM_AV_DTCTriggered 0 "FALSE" 1 "TRUE" ;
VAL_TABLE_ DTCI_CSM_AV_WrnIndTrggrd 0 "FALSE" 1 "TRUE" ;
VAL_TABLE_ DTCI_CSM_AV_WrnIndRqd 0 "FALSE" 1 "TRUE" ;
VAL_TABLE_ DTCI_CSM_CnfrmdDTC 0 "FALSE" 1 "TRUE" ;
VAL_TABLE_ DTCI_CSM_DTCFaultType 0 "Not Supported" 1 "Type A" 2 "Type B" 3 "Type C" ;
VAL_TABLE_ DTCI_CSM_TstNCmpltdOpCyc 0 "FALSE" 1 "TRUE" ;
VAL_TABLE_ DTCI_CSM_TstNCmpltdLstClr 0 "FALSE" 1 "TRUE" ;
VAL_TABLE_ DTCI_CSM_TstFldOpCyc 0 "FALSE" 1 "TRUE" ;
VAL_TABLE_ DTCI_CSM_TstFldLstClr 0 "FALSE" 1 "TRUE" ;
VAL_TABLE_ DTCI_CSM_TstFld 0 "FALSE" 1 "TRUE" ;
VAL_TABLE_ DTCI_CSM_PndngDTC 0 "FALSE" 1 "TRUE" ;
VAL_TABLE_ DTCI_CSM_DTCTriggered 0 "FALSE" 1 "TRUE" ;
VAL_TABLE_ DTCI_CSM_WrnIndTrggrd 0 "FALSE" 1 "TRUE" ;
VAL_TABLE_ DTCI_CSM_WrnIndRqd 0 "FALSE" 1 "TRUE" ;
VAL_TABLE_ DTCI_DCM_CnfrmdDTC 0 "FALSE" 1 "TRUE" ;
VAL_TABLE_ DTCI_DCM_DTCFaultType 0 "Not Supported" 1 "Type A" 2 "Type B" 3 "Type C" ;
VAL_TABLE_ DTCI_DCM_TstNCmpltdOpCyc 0 "FALSE" 1 "TRUE" ;
VAL_TABLE_ DTCI_DCM_TstNCmpltdLstClr 0 "FALSE" 1 "TRUE" ;
VAL_TABLE_ DTCI_DCM_TstFldOpCyc 0 "FALSE" 1 "TRUE" ;
VAL_TABLE_ DTCI_DCM_TstFldLstClr 0 "FALSE" 1 "TRUE" ;
VAL_TABLE_ DTCI_DCM_TstFld 0 "FALSE" 1 "TRUE" ;
VAL_TABLE_ DTCI_DCM_PndngDTC 0 "FALSE" 1 "TRUE" ;
VAL_TABLE_ DTCI_DCM_DTCTriggered 0 "FALSE" 1 "TRUE" ;
VAL_TABLE_ DTCI_DCM_WrnIndTrggrd 0 "FALSE" 1 "TRUE" ;
VAL_TABLE_ DTCI_DCM_WrnIndRqd 0 "FALSE" 1 "TRUE" ;
VAL_TABLE_ DTCI_DMS_CnfrmdDTC 0 "FALSE" 1 "TRUE" ;
VAL_TABLE_ DTCI_DMS_DTCFaultType 0 "Not Supported" 1 "Type A" 2 "Type B" 3 "Type C" ;
VAL_TABLE_ DTCI_DMS_TstNCmpltdOpCyc 0 "FALSE" 1 "TRUE" ;
VAL_TABLE_ DTCI_DMS_TstNCmpltdLstClr 0 "FALSE" 1 "TRUE" ;
VAL_TABLE_ DTCI_DMS_TstFldOpCyc 0 "FALSE" 1 "TRUE" ;
VAL_TABLE_ DTCI_DMS_TstFldLstClr 0 "FALSE" 1 "TRUE" ;
VAL_TABLE_ DTCI_DMS_TstFld 0 "FALSE" 1 "TRUE" ;
VAL_TABLE_ DTCI_DMS_PndngDTC 0 "FALSE" 1 "TRUE" ;
VAL_TABLE_ DTCI_DMS_DTCTriggered 0 "FALSE" 1 "TRUE" ;
VAL_TABLE_ DTCI_DMS_WrnIndTrggrd 0 "FALSE" 1 "TRUE" ;
VAL_TABLE_ DTCI_DMS_WrnIndRqd 0 "FALSE" 1 "TRUE" ;
VAL_TABLE_ DTCI_EBCM_CnfrmdDTC 0 "FALSE" 1 "TRUE" ;
VAL_TABLE_ DTCI_EBCM_DTCFaultType 0 "Not Supported" 1 "Type A" 2 "Type B" 3 "Type C" ;
VAL_TABLE_ DTCI_EBCM_TstNCmpltdOpCyc 0 "FALSE" 1 "TRUE" ;
VAL_TABLE_ DTCI_EBCM_TstNCmpltdLstClr 0 "FALSE" 1 "TRUE" ;
VAL_TABLE_ DTCI_EBCM_TstFldOpCyc 0 "FALSE" 1 "TRUE" ;
VAL_TABLE_ DTCI_EBCM_TstFldLstClr 0 "FALSE" 1 "TRUE" ;
VAL_TABLE_ DTCI_EBCM_TstFld 0 "FALSE" 1 "TRUE" ;
VAL_TABLE_ DTCI_EBCM_PndngDTC 0 "FALSE" 1 "TRUE" ;
VAL_TABLE_ DTCI_EBCM_DTCTriggered 0 "FALSE" 1 "TRUE" ;
VAL_TABLE_ DTCI_EBCM_WrnIndTrggrd 0 "FALSE" 1 "TRUE" ;
VAL_TABLE_ DTCI_EBCM_WrnIndRqd 0 "FALSE" 1 "TRUE" ;
VAL_TABLE_ DTCI_ECM_CnfrmdDTC 0 "FALSE" 1 "TRUE" ;
VAL_TABLE_ DTCI_ECM_DTCFaultType 0 "Not Supported" 1 "Type A" 2 "Type B" 3 "Type C" ;
VAL_TABLE_ DTCI_ECM_TstNCmpltdOpCyc 0 "FALSE" 1 "TRUE" ;
VAL_TABLE_ DTCI_ECM_TstNCmpltdLstClr 0 "FALSE" 1 "TRUE" ;
VAL_TABLE_ DTCI_ECM_TstFldOpCyc 0 "FALSE" 1 "TRUE" ;
VAL_TABLE_ DTCI_ECM_TstFldLstClr 0 "FALSE" 1 "TRUE" ;
VAL_TABLE_ DTCI_ECM_TstFld 0 "FALSE" 1 "TRUE" ;
VAL_TABLE_ DTCI_ECM_PndngDTC 0 "FALSE" 1 "TRUE" ;
VAL_TABLE_ DTCI_ECM_DTCTriggered 0 "FALSE" 1 "TRUE" ;
VAL_TABLE_ DTCI_ECM_WrnIndTrggrd 0 "FALSE" 1 "TRUE" ;
VAL_TABLE_ DTCI_ECM_WrnIndRqd 0 "FALSE" 1 "TRUE" ;
VAL_TABLE_ DTCI_ECP_E_CnfrmdDTC 0 "FALSE" 1 "TRUE" ;
VAL_TABLE_ DTCI_ECP_E_DTCFaultType 0 "Not Supported" 1 "Type A" 2 "Type B" 3 "Type C" ;
VAL_TABLE_ DTCI_ECP_E_TstNCmpltdOpCyc 0 "FALSE" 1 "TRUE" ;
VAL_TABLE_ DTCI_ECP_E_TstNCmpltdLstClr 0 "FALSE" 1 "TRUE" ;
VAL_TABLE_ DTCI_ECP_E_TstFldOpCyc 0 "FALSE" 1 "TRUE" ;
VAL_TABLE_ DTCI_ECP_E_TstFldLstClr 0 "FALSE" 1 "TRUE" ;
VAL_TABLE_ DTCI_ECP_E_TstFld 0 "FALSE" 1 "TRUE" ;
VAL_TABLE_ DTCI_ECP_E_PndngDTC 0 "FALSE" 1 "TRUE" ;
VAL_TABLE_ DTCI_ECP_E_DTCTriggered 0 "FALSE" 1 "TRUE" ;
VAL_TABLE_ DTCI_ECP_E_WrnIndTrggrd 0 "FALSE" 1 "TRUE" ;
VAL_TABLE_ DTCI_ECP_E_WrnIndRqd 0 "FALSE" 1 "TRUE" ;
VAL_TABLE_ DTCI_ECP_H1_CnfrmdDTC 0 "FALSE" 1 "TRUE" ;
VAL_TABLE_ DTCI_ECP_H1_DTCFaultType 0 "Not Supported" 1 "Type A" 2 "Type B" 3 "Type C" ;
VAL_TABLE_ DTCI_ECP_H1_TstNCmpltdOpCyc 0 "FALSE" 1 "TRUE" ;
VAL_TABLE_ DTCI_ECP_H1_TstNCmpltdLstClr 0 "FALSE" 1 "TRUE" ;
VAL_TABLE_ DTCI_ECP_H1_TstFldOpCyc 0 "FALSE" 1 "TRUE" ;
VAL_TABLE_ DTCI_ECP_H1_TstFldLstClr 0 "FALSE" 1 "TRUE" ;
VAL_TABLE_ DTCI_ECP_H1_TstFld 0 "FALSE" 1 "TRUE" ;
VAL_TABLE_ DTCI_ECP_H1_PndngDTC 0 "FALSE" 1 "TRUE" ;
VAL_TABLE_ DTCI_ECP_H1_DTCTriggered 0 "FALSE" 1 "TRUE" ;
VAL_TABLE_ DTCI_ECP_H1_WrnIndTrggrd 0 "FALSE" 1 "TRUE" ;
VAL_TABLE_ DTCI_ECP_H1_WrnIndRqd 0 "FALSE" 1 "TRUE" ;
VAL_TABLE_ DTCI_ECP_H2_CnfrmdDTC 0 "FALSE" 1 "TRUE" ;
VAL_TABLE_ DTCI_ECP_H2_DTCFaultType 0 "Not Supported" 1 "Type A" 2 "Type B" 3 "Type C" ;
VAL_TABLE_ DTCI_ECP_H2_TstNCmpltdOpCyc 0 "FALSE" 1 "TRUE" ;
VAL_TABLE_ DTCI_ECP_H2_TstNCmpltdLstClr 0 "FALSE" 1 "TRUE" ;
VAL_TABLE_ DTCI_ECP_H2_TstFldOpCyc 0 "FALSE" 1 "TRUE" ;
VAL_TABLE_ DTCI_ECP_H2_TstFldLstClr 0 "FALSE" 1 "TRUE" ;
VAL_TABLE_ DTCI_ECP_H2_TstFld 0 "FALSE" 1 "TRUE" ;
VAL_TABLE_ DTCI_ECP_H2_PndngDTC 0 "FALSE" 1 "TRUE" ;
VAL_TABLE_ DTCI_ECP_H2_DTCTriggered 0 "FALSE" 1 "TRUE" ;
VAL_TABLE_ DTCI_ECP_H2_WrnIndTrggrd 0 "FALSE" 1 "TRUE" ;
VAL_TABLE_ DTCI_ECP_H2_WrnIndRqd 0 "FALSE" 1 "TRUE" ;
VAL_TABLE_ DTCI_ECP_H3_CnfrmdDTC 0 "FALSE" 1 "TRUE" ;
VAL_TABLE_ DTCI_ECP_H3_DTCFaultType 0 "Not Supported" 1 "Type A" 2 "Type B" 3 "Type C" ;
VAL_TABLE_ DTCI_ECP_H3_TstNCmpltdOpCyc 0 "FALSE" 1 "TRUE" ;
VAL_TABLE_ DTCI_ECP_H3_TstNCmpltdLstClr 0 "FALSE" 1 "TRUE" ;
VAL_TABLE_ DTCI_ECP_H3_TstFldOpCyc 0 "FALSE" 1 "TRUE" ;
VAL_TABLE_ DTCI_ECP_H3_TstFldLstClr 0 "FALSE" 1 "TRUE" ;
VAL_TABLE_ DTCI_ECP_H3_TstFld 0 "FALSE" 1 "TRUE" ;
VAL_TABLE_ DTCI_ECP_H3_PndngDTC 0 "FALSE" 1 "TRUE" ;
VAL_TABLE_ DTCI_ECP_H3_DTCTriggered 0 "FALSE" 1 "TRUE" ;
VAL_TABLE_ DTCI_ECP_H3_WrnIndTrggrd 0 "FALSE" 1 "TRUE" ;
VAL_TABLE_ DTCI_ECP_H3_WrnIndRqd 0 "FALSE" 1 "TRUE" ;
VAL_TABLE_ DTCI_ECP_MC_CnfrmdDTC 0 "FALSE" 1 "TRUE" ;
VAL_TABLE_ DTCI_ECP_MC_DTCFaultType 0 "Not Supported" 1 "Type A" 2 "Type B" 3 "Type C" ;
VAL_TABLE_ DTCI_ECP_MC_TstNCmpltdOpCyc 0 "FALSE" 1 "TRUE" ;
VAL_TABLE_ DTCI_ECP_MC_TstNCmpltdLstClr 0 "FALSE" 1 "TRUE" ;
VAL_TABLE_ DTCI_ECP_MC_TstFldOpCyc 0 "FALSE" 1 "TRUE" ;
VAL_TABLE_ DTCI_ECP_MC_TstFldLstClr 0 "FALSE" 1 "TRUE" ;
VAL_TABLE_ DTCI_ECP_MC_TstFld 0 "FALSE" 1 "TRUE" ;
VAL_TABLE_ DTCI_ECP_MC_PndngDTC 0 "FALSE" 1 "TRUE" ;
VAL_TABLE_ DTCI_ECP_MC_DTCTriggered 0 "FALSE" 1 "TRUE" ;
VAL_TABLE_ DTCI_ECP_MC_WrnIndTrggrd 0 "FALSE" 1 "TRUE" ;
VAL_TABLE_ DTCI_ECP_MC_WrnIndRqd 0 "FALSE" 1 "TRUE" ;
VAL_TABLE_ DTCI_ECP_S2_CnfrmdDTC 0 "FALSE" 1 "TRUE" ;
VAL_TABLE_ DTCI_ECP_S2_DTCFaultType 0 "Not Supported" 1 "Type A" 2 "Type B" 3 "Type C" ;
VAL_TABLE_ DTCI_ECP_S2_TstNCmpltdOpCyc 0 "FALSE" 1 "TRUE" ;
VAL_TABLE_ DTCI_ECP_S2_TstNCmpltdLstClr 0 "FALSE" 1 "TRUE" ;
VAL_TABLE_ DTCI_ECP_S2_TstFldOpCyc 0 "FALSE" 1 "TRUE" ;
VAL_TABLE_ DTCI_ECP_S2_TstFldLstClr 0 "FALSE" 1 "TRUE" ;
VAL_TABLE_ DTCI_ECP_S2_TstFld 0 "FALSE" 1 "TRUE" ;
VAL_TABLE_ DTCI_ECP_S2_PndngDTC 0 "FALSE" 1 "TRUE" ;
VAL_TABLE_ DTCI_ECP_S2_DTCTriggered 0 "FALSE" 1 "TRUE" ;
VAL_TABLE_ DTCI_ECP_S2_WrnIndTrggrd 0 "FALSE" 1 "TRUE" ;
VAL_TABLE_ DTCI_ECP_S2_WrnIndRqd 0 "FALSE" 1 "TRUE" ;
VAL_TABLE_ DTCI_ECP_S_CnfrmdDTC 0 "FALSE" 1 "TRUE" ;
VAL_TABLE_ DTCI_ECP_S_DTCFaultType 0 "Not Supported" 1 "Type A" 2 "Type B" 3 "Type C" ;
VAL_TABLE_ DTCI_ECP_S_TstNCmpltdOpCyc 0 "FALSE" 1 "TRUE" ;
VAL_TABLE_ DTCI_ECP_S_TstNCmpltdLstClr 0 "FALSE" 1 "TRUE" ;
VAL_TABLE_ DTCI_ECP_S_TstFldOpCyc 0 "FALSE" 1 "TRUE" ;
VAL_TABLE_ DTCI_ECP_S_TstFldLstClr 0 "FALSE" 1 "TRUE" ;
VAL_TABLE_ DTCI_ECP_S_TstFld 0 "FALSE" 1 "TRUE" ;
VAL_TABLE_ DTCI_ECP_S_PndngDTC 0 "FALSE" 1 "TRUE" ;
VAL_TABLE_ DTCI_ECP_S_DTCTriggered 0 "FALSE" 1 "TRUE" ;
VAL_TABLE_ DTCI_ECP_S_WrnIndTrggrd 0 "FALSE" 1 "TRUE" ;
VAL_TABLE_ DTCI_ECP_S_WrnIndRqd 0 "FALSE" 1 "TRUE" ;
VAL_TABLE_ DTCI_ECP_X1_CnfrmdDTC 0 "FALSE" 1 "TRUE" ;
VAL_TABLE_ DTCI_ECP_X1_DTCFaultType 0 "Not Supported" 1 "Type A" 2 "Type B" 3 "Type C" ;
VAL_TABLE_ DTCI_ECP_X1_TstNCmpltdOpCyc 0 "FALSE" 1 "TRUE" ;
VAL_TABLE_ DTCI_ECP_X1_TstNCmpltdLstClr 0 "FALSE" 1 "TRUE" ;
VAL_TABLE_ DTCI_ECP_X1_TstFldOpCyc 0 "FALSE" 1 "TRUE" ;
VAL_TABLE_ DTCI_ECP_X1_TstFldLstClr 0 "FALSE" 1 "TRUE" ;
VAL_TABLE_ DTCI_ECP_X1_TstFld 0 "FALSE" 1 "TRUE" ;
VAL_TABLE_ DTCI_ECP_X1_PndngDTC 0 "FALSE" 1 "TRUE" ;
VAL_TABLE_ DTCI_ECP_X1_DTCTriggered 0 "FALSE" 1 "TRUE" ;
VAL_TABLE_ DTCI_ECP_X1_WrnIndTrggrd 0 "FALSE" 1 "TRUE" ;
VAL_TABLE_ DTCI_ECP_X1_WrnIndRqd 0 "FALSE" 1 "TRUE" ;
VAL_TABLE_ DTCI_ELM_CnfrmdDTC 0 "FALSE" 1 "TRUE" ;
VAL_TABLE_ DTCI_ELM_DTCFaultType 0 "Not Supported" 1 "Type A" 2 "Type B" 3 "Type C" ;
VAL_TABLE_ DTCI_ELM_TstNCmpltdOpCyc 0 "FALSE" 1 "TRUE" ;
VAL_TABLE_ DTCI_ELM_TstNCmpltdLstClr 0 "FALSE" 1 "TRUE" ;
VAL_TABLE_ DTCI_ELM_TstFldOpCyc 0 "FALSE" 1 "TRUE" ;
VAL_TABLE_ DTCI_ELM_TstFldLstClr 0 "FALSE" 1 "TRUE" ;
VAL_TABLE_ DTCI_ELM_TstFld 0 "FALSE" 1 "TRUE" ;
VAL_TABLE_ DTCI_ELM_PndngDTC 0 "FALSE" 1 "TRUE" ;
VAL_TABLE_ DTCI_ELM_DTCTriggered 0 "FALSE" 1 "TRUE" ;
VAL_TABLE_ DTCI_ELM_WrnIndTrggrd 0 "FALSE" 1 "TRUE" ;
VAL_TABLE_ DTCI_ELM_WrnIndRqd 0 "FALSE" 1 "TRUE" ;
VAL_TABLE_ DTCI_EOCM_HCP1_CnfrmdDTC 0 "FALSE" 1 "TRUE" ;
VAL_TABLE_ DTCI_EOCM_HCP1_DTCFaultType 0 "Not Supported" 1 "Type A" 2 "Type B" 3 "Type C" ;
VAL_TABLE_ DTCI_EOCM_HCP1_TstNCmpltdOpCyc 0 "FALSE" 1 "TRUE" ;
VAL_TABLE_ DTCI_EOCM_HCP1_TstNCmpltdLstClr 0 "FALSE" 1 "TRUE" ;
VAL_TABLE_ DTCI_EOCM_HCP1_TstFldOpCyc 0 "FALSE" 1 "TRUE" ;
VAL_TABLE_ DTCI_EOCM_HCP1_TstFldLstClr 0 "FALSE" 1 "TRUE" ;
VAL_TABLE_ DTCI_EOCM_HCP1_TstFld 0 "FALSE" 1 "TRUE" ;
VAL_TABLE_ DTCI_EOCM_HCP1_PndngDTC 0 "FALSE" 1 "TRUE" ;
VAL_TABLE_ DTCI_EOCM_HCP1_DTCTriggered 0 "FALSE" 1 "TRUE" ;
VAL_TABLE_ DTCI_EOCM_HCP1_WrnIndTrggrd 0 "FALSE" 1 "TRUE" ;
VAL_TABLE_ DTCI_EOCM_HCP1_WrnIndRqd 0 "FALSE" 1 "TRUE" ;
VAL_TABLE_ DTCI_EOCM_HCP2_CnfrmdDTC 0 "FALSE" 1 "TRUE" ;
VAL_TABLE_ DTCI_EOCM_HCP2_DTCFaultType 0 "Not Supported" 1 "Type A" 2 "Type B" 3 "Type C" ;
VAL_TABLE_ DTCI_EOCM_HCP2_TstNCmpltdOpCyc 0 "FALSE" 1 "TRUE" ;
VAL_TABLE_ DTCI_EOCM_HCP2_TstNCmpltdLstClr 0 "FALSE" 1 "TRUE" ;
VAL_TABLE_ DTCI_EOCM_HCP2_TstFldOpCyc 0 "FALSE" 1 "TRUE" ;
VAL_TABLE_ DTCI_EOCM_HCP2_TstFldLstClr 0 "FALSE" 1 "TRUE" ;
VAL_TABLE_ DTCI_EOCM_HCP2_TstFld 0 "FALSE" 1 "TRUE" ;
VAL_TABLE_ DTCI_EOCM_HCP2_PndngDTC 0 "FALSE" 1 "TRUE" ;
VAL_TABLE_ DTCI_EOCM_HCP2_DTCTriggered 0 "FALSE" 1 "TRUE" ;
VAL_TABLE_ DTCI_EOCM_HCP2_WrnIndTrggrd 0 "FALSE" 1 "TRUE" ;
VAL_TABLE_ DTCI_EOCM_HCP2_WrnIndRqd 0 "FALSE" 1 "TRUE" ;
VAL_TABLE_ DTCI_EOCM_CnfrmdDTC 0 "FALSE" 1 "TRUE" ;
VAL_TABLE_ DTCI_EOCM_DTCFaultType 0 "Not Supported" 1 "Type A" 2 "Type B" 3 "Type C" ;
VAL_TABLE_ DTCI_EOCM_TstNCmpltdOpCyc 0 "FALSE" 1 "TRUE" ;
VAL_TABLE_ DTCI_EOCM_TstNCmpltdLstClr 0 "FALSE" 1 "TRUE" ;
VAL_TABLE_ DTCI_EOCM_TstFldOpCyc 0 "FALSE" 1 "TRUE" ;
VAL_TABLE_ DTCI_EOCM_TstFldLstClr 0 "FALSE" 1 "TRUE" ;
VAL_TABLE_ DTCI_EOCM_TstFld 0 "FALSE" 1 "TRUE" ;
VAL_TABLE_ DTCI_EOCM_PndngDTC 0 "FALSE" 1 "TRUE" ;
VAL_TABLE_ DTCI_EOCM_DTCTriggered 0 "FALSE" 1 "TRUE" ;
VAL_TABLE_ DTCI_EOCM_WrnIndTrggrd 0 "FALSE" 1 "TRUE" ;
VAL_TABLE_ DTCI_EOCM_WrnIndRqd 0 "FALSE" 1 "TRUE" ;
VAL_TABLE_ DTCI_EPS_1_CnfrmdDTC 0 "FALSE" 1 "TRUE" ;
VAL_TABLE_ DTCI_EPS_1_DTCFaultType 0 "Not Supported" 1 "Type A" 2 "Type B" 3 "Type C" ;
VAL_TABLE_ DTCI_EPS_1_TstNCmpltdOpCyc 0 "FALSE" 1 "TRUE" ;
VAL_TABLE_ DTCI_EPS_1_TstNCmpltdLstClr 0 "FALSE" 1 "TRUE" ;
VAL_TABLE_ DTCI_EPS_1_TstFldOpCyc 0 "FALSE" 1 "TRUE" ;
VAL_TABLE_ DTCI_EPS_1_TstFldLstClr 0 "FALSE" 1 "TRUE" ;
VAL_TABLE_ DTCI_EPS_1_TstFld 0 "FALSE" 1 "TRUE" ;
VAL_TABLE_ DTCI_EPS_1_PndngDTC 0 "FALSE" 1 "TRUE" ;
VAL_TABLE_ DTCI_EPS_1_DTCTriggered 0 "FALSE" 1 "TRUE" ;
VAL_TABLE_ DTCI_EPS_1_WrnIndTrggrd 0 "FALSE" 1 "TRUE" ;
VAL_TABLE_ DTCI_EPS_1_WrnIndRqd 0 "FALSE" 1 "TRUE" ;
VAL_TABLE_ DTCI_EPS_CnfrmdDTC 0 "FALSE" 1 "TRUE" ;
VAL_TABLE_ DTCI_EPS_DTCFaultType 0 "Not Supported" 1 "Type A" 2 "Type B" 3 "Type C" ;
VAL_TABLE_ DTCI_EPS_TstNCmpltdOpCyc 0 "FALSE" 1 "TRUE" ;
VAL_TABLE_ DTCI_EPS_TstNCmpltdLstClr 0 "FALSE" 1 "TRUE" ;
VAL_TABLE_ DTCI_EPS_TstFldOpCyc 0 "FALSE" 1 "TRUE" ;
VAL_TABLE_ DTCI_EPS_TstFldLstClr 0 "FALSE" 1 "TRUE" ;
VAL_TABLE_ DTCI_EPS_TstFld 0 "FALSE" 1 "TRUE" ;
VAL_TABLE_ DTCI_EPS_PndngDTC 0 "FALSE" 1 "TRUE" ;
VAL_TABLE_ DTCI_EPS_DTCTriggered 0 "FALSE" 1 "TRUE" ;
VAL_TABLE_ DTCI_EPS_WrnIndTrggrd 0 "FALSE" 1 "TRUE" ;
VAL_TABLE_ DTCI_EPS_WrnIndRqd 0 "FALSE" 1 "TRUE" ;
VAL_TABLE_ DTCI_EPSb_CnfrmdDTC 0 "FALSE" 1 "TRUE" ;
VAL_TABLE_ DTCI_EPSb_DTCFaultType 0 "Not Supported" 1 "Type A" 2 "Type B" 3 "Type C" ;
VAL_TABLE_ DTCI_EPSb_TstNCmpltdOpCyc 0 "FALSE" 1 "TRUE" ;
VAL_TABLE_ DTCI_EPSb_TstNCmpltdLstClr 0 "FALSE" 1 "TRUE" ;
VAL_TABLE_ DTCI_EPSb_TstFldOpCyc 0 "FALSE" 1 "TRUE" ;
VAL_TABLE_ DTCI_EPSb_TstFldLstClr 0 "FALSE" 1 "TRUE" ;
VAL_TABLE_ DTCI_EPSb_TstFld 0 "FALSE" 1 "TRUE" ;
VAL_TABLE_ DTCI_EPSb_PndngDTC 0 "FALSE" 1 "TRUE" ;
VAL_TABLE_ DTCI_EPSb_DTCTriggered 0 "FALSE" 1 "TRUE" ;
VAL_TABLE_ DTCI_EPSb_WrnIndTrggrd 0 "FALSE" 1 "TRUE" ;
VAL_TABLE_ DTCI_EPSb_WrnIndRqd 0 "FALSE" 1 "TRUE" ;
VAL_TABLE_ DTCI_FCM_LC_CnfrmdDTC 0 "FALSE" 1 "TRUE" ;
VAL_TABLE_ DTCI_FCM_LC_DTCFaultType 0 "Not Supported" 1 "Type A" 2 "Type B" 3 "Type C" ;
VAL_TABLE_ DTCI_FCM_LC_TstNCmpltdOpCyc 0 "FALSE" 1 "TRUE" ;
VAL_TABLE_ DTCI_FCM_LC_TstNCmpltdLstClr 0 "FALSE" 1 "TRUE" ;
VAL_TABLE_ DTCI_FCM_LC_TstFldOpCyc 0 "FALSE" 1 "TRUE" ;
VAL_TABLE_ DTCI_FCM_LC_TstFldLstClr 0 "FALSE" 1 "TRUE" ;
VAL_TABLE_ DTCI_FCM_LC_TstFld 0 "FALSE" 1 "TRUE" ;
VAL_TABLE_ DTCI_FCM_LC_PndngDTC 0 "FALSE" 1 "TRUE" ;
VAL_TABLE_ DTCI_FCM_LC_DTCTriggered 0 "FALSE" 1 "TRUE" ;
VAL_TABLE_ DTCI_FCM_LC_WrnIndTrggrd 0 "FALSE" 1 "TRUE" ;
VAL_TABLE_ DTCI_FCM_LC_WrnIndRqd 0 "FALSE" 1 "TRUE" ;
VAL_TABLE_ DTCI_FCM_CnfrmdDTC 0 "FALSE" 1 "TRUE" ;
VAL_TABLE_ DTCI_FCM_DTCFaultType 0 "Not Supported" 1 "Type A" 2 "Type B" 3 "Type C" ;
VAL_TABLE_ DTCI_FCM_TstNCmpltdOpCyc 0 "FALSE" 1 "TRUE" ;
VAL_TABLE_ DTCI_FCM_TstNCmpltdLstClr 0 "FALSE" 1 "TRUE" ;
VAL_TABLE_ DTCI_FCM_TstFldOpCyc 0 "FALSE" 1 "TRUE" ;
VAL_TABLE_ DTCI_FCM_TstFldLstClr 0 "FALSE" 1 "TRUE" ;
VAL_TABLE_ DTCI_FCM_TstFld 0 "FALSE" 1 "TRUE" ;
VAL_TABLE_ DTCI_FCM_PndngDTC 0 "FALSE" 1 "TRUE" ;
VAL_TABLE_ DTCI_FCM_DTCTriggered 0 "FALSE" 1 "TRUE" ;
VAL_TABLE_ DTCI_FCM_WrnIndTrggrd 0 "FALSE" 1 "TRUE" ;
VAL_TABLE_ DTCI_FCM_WrnIndRqd 0 "FALSE" 1 "TRUE" ;
VAL_TABLE_ DTCI_FOPM_CnfrmdDTC 0 "FALSE" 1 "TRUE" ;
VAL_TABLE_ DTCI_FOPM_DTCFaultType 0 "Not Supported" 1 "Type A" 2 "Type B" 3 "Type C" ;
VAL_TABLE_ DTCI_FOPM_TstNCmpltdOpCyc 0 "FALSE" 1 "TRUE" ;
VAL_TABLE_ DTCI_FOPM_TstNCmpltdLstClr 0 "FALSE" 1 "TRUE" ;
VAL_TABLE_ DTCI_FOPM_TstFldOpCyc 0 "FALSE" 1 "TRUE" ;
VAL_TABLE_ DTCI_FOPM_TstFldLstClr 0 "FALSE" 1 "TRUE" ;
VAL_TABLE_ DTCI_FOPM_TstFld 0 "FALSE" 1 "TRUE" ;
VAL_TABLE_ DTCI_FOPM_PndngDTC 0 "FALSE" 1 "TRUE" ;
VAL_TABLE_ DTCI_FOPM_DTCTriggered 0 "FALSE" 1 "TRUE" ;
VAL_TABLE_ DTCI_FOPM_WrnIndTrggrd 0 "FALSE" 1 "TRUE" ;
VAL_TABLE_ DTCI_FOPM_WrnIndRqd 0 "FALSE" 1 "TRUE" ;
VAL_TABLE_ DTCI_FPI_CnfrmdDTC 0 "FALSE" 1 "TRUE" ;
VAL_TABLE_ DTCI_FPI_DTCFaultType 0 "Not Supported" 1 "Type A" 2 "Type B" 3 "Type C" ;
VAL_TABLE_ DTCI_FPI_TstNCmpltdOpCyc 0 "FALSE" 1 "TRUE" ;
VAL_TABLE_ DTCI_FPI_TstNCmpltdLstClr 0 "FALSE" 1 "TRUE" ;
VAL_TABLE_ DTCI_FPI_TstFldOpCyc 0 "FALSE" 1 "TRUE" ;
VAL_TABLE_ DTCI_FPI_TstFldLstClr 0 "FALSE" 1 "TRUE" ;
VAL_TABLE_ DTCI_FPI_TstFld 0 "FALSE" 1 "TRUE" ;
VAL_TABLE_ DTCI_FPI_PndngDTC 0 "FALSE" 1 "TRUE" ;
VAL_TABLE_ DTCI_FPI_DTCTriggered 0 "FALSE" 1 "TRUE" ;
VAL_TABLE_ DTCI_FPI_WrnIndTrggrd 0 "FALSE" 1 "TRUE" ;
VAL_TABLE_ DTCI_FPI_WrnIndRqd 0 "FALSE" 1 "TRUE" ;
VAL_TABLE_ DTCI_HDLM_CnfrmdDTC 0 "FALSE" 1 "TRUE" ;
VAL_TABLE_ DTCI_HDLM_DTCFaultType 0 "Not Supported" 1 "Type A" 2 "Type B" 3 "Type C" ;
VAL_TABLE_ DTCI_HDLM_TstNCmpltdOpCyc 0 "FALSE" 1 "TRUE" ;
VAL_TABLE_ DTCI_HDLM_TstNCmpltdLstClr 0 "FALSE" 1 "TRUE" ;
VAL_TABLE_ DTCI_HDLM_TstFldOpCyc 0 "FALSE" 1 "TRUE" ;
VAL_TABLE_ DTCI_HDLM_TstFldLstClr 0 "FALSE" 1 "TRUE" ;
VAL_TABLE_ DTCI_HDLM_TstFld 0 "FALSE" 1 "TRUE" ;
VAL_TABLE_ DTCI_HDLM_PndngDTC 0 "FALSE" 1 "TRUE" ;
VAL_TABLE_ DTCI_HDLM_DTCTriggered 0 "FALSE" 1 "TRUE" ;
VAL_TABLE_ DTCI_HDLM_WrnIndTrggrd 0 "FALSE" 1 "TRUE" ;
VAL_TABLE_ DTCI_HDLM_WrnIndRqd 0 "FALSE" 1 "TRUE" ;
VAL_TABLE_ DTCI_HUD_CAN_CnfrmdDTC 0 "FALSE" 1 "TRUE" ;
VAL_TABLE_ DTCI_HUD_CAN_DTCFaultType 0 "Not Supported" 1 "Type A" 2 "Type B" 3 "Type C" ;
VAL_TABLE_ DTCI_HUD_CAN_TstNCmpltdOpCyc 0 "FALSE" 1 "TRUE" ;
VAL_TABLE_ DTCI_HUD_CAN_TstNCmpltdLstClr 0 "FALSE" 1 "TRUE" ;
VAL_TABLE_ DTCI_HUD_CAN_TstFldOpCyc 0 "FALSE" 1 "TRUE" ;
VAL_TABLE_ DTCI_HUD_CAN_TstFldLstClr 0 "FALSE" 1 "TRUE" ;
VAL_TABLE_ DTCI_HUD_CAN_TstFld 0 "FALSE" 1 "TRUE" ;
VAL_TABLE_ DTCI_HUD_CAN_PndngDTC 0 "FALSE" 1 "TRUE" ;
VAL_TABLE_ DTCI_HUD_CAN_DTCTriggered 0 "FALSE" 1 "TRUE" ;
VAL_TABLE_ DTCI_HUD_CAN_WrnIndTrggrd 0 "FALSE" 1 "TRUE" ;
VAL_TABLE_ DTCI_HUD_CAN_WrnIndRqd 0 "FALSE" 1 "TRUE" ;
VAL_TABLE_ DTCI_HVAC_FP_F_CnfrmdDTC 0 "FALSE" 1 "TRUE" ;
VAL_TABLE_ DTCI_HVAC_FP_F_DTCFaultType 0 "Not Supported" 1 "Type A" 2 "Type B" 3 "Type C" ;
VAL_TABLE_ DTCI_HVAC_FP_F_TstNCmpltdOpCyc 0 "FALSE" 1 "TRUE" ;
VAL_TABLE_ DTCI_HVAC_FP_F_TstNCmpltdLstClr 0 "FALSE" 1 "TRUE" ;
VAL_TABLE_ DTCI_HVAC_FP_F_TstFldOpCyc 0 "FALSE" 1 "TRUE" ;
VAL_TABLE_ DTCI_HVAC_FP_F_TstFldLstClr 0 "FALSE" 1 "TRUE" ;
VAL_TABLE_ DTCI_HVAC_FP_F_TstFld 0 "FALSE" 1 "TRUE" ;
VAL_TABLE_ DTCI_HVAC_FP_F_PndngDTC 0 "FALSE" 1 "TRUE" ;
VAL_TABLE_ DTCI_HVAC_FP_F_DTCTriggered 0 "FALSE" 1 "TRUE" ;
VAL_TABLE_ DTCI_HVAC_FP_F_WrnIndTrggrd 0 "FALSE" 1 "TRUE" ;
VAL_TABLE_ DTCI_HVAC_FP_F_WrnIndRqd 0 "FALSE" 1 "TRUE" ;
VAL_TABLE_ DTCI_HVAC_FP_R_CnfrmdDTC 0 "FALSE" 1 "TRUE" ;
VAL_TABLE_ DTCI_HVAC_FP_R_DTCFaultType 0 "Not Supported" 1 "Type A" 2 "Type B" 3 "Type C" ;
VAL_TABLE_ DTCI_HVAC_FP_R_TstNCmpltdOpCyc 0 "FALSE" 1 "TRUE" ;
VAL_TABLE_ DTCI_HVAC_FP_R_TstNCmpltdLstClr 0 "FALSE" 1 "TRUE" ;
VAL_TABLE_ DTCI_HVAC_FP_R_TstFldOpCyc 0 "FALSE" 1 "TRUE" ;
VAL_TABLE_ DTCI_HVAC_FP_R_TstFldLstClr 0 "FALSE" 1 "TRUE" ;
VAL_TABLE_ DTCI_HVAC_FP_R_TstFld 0 "FALSE" 1 "TRUE" ;
VAL_TABLE_ DTCI_HVAC_FP_R_PndngDTC 0 "FALSE" 1 "TRUE" ;
VAL_TABLE_ DTCI_HVAC_FP_R_DTCTriggered 0 "FALSE" 1 "TRUE" ;
VAL_TABLE_ DTCI_HVAC_FP_R_WrnIndTrggrd 0 "FALSE" 1 "TRUE" ;
VAL_TABLE_ DTCI_HVAC_FP_R_WrnIndRqd 0 "FALSE" 1 "TRUE" ;
VAL_TABLE_ DTCI_ICCM_CnfrmdDTC 0 "FALSE" 1 "TRUE" ;
VAL_TABLE_ DTCI_ICCM_DTCFaultType 0 "Not Supported" 1 "Type A" 2 "Type B" 3 "Type C" ;
VAL_TABLE_ DTCI_ICCM_TstNCmpltdOpCyc 0 "FALSE" 1 "TRUE" ;
VAL_TABLE_ DTCI_ICCM_TstNCmpltdLstClr 0 "FALSE" 1 "TRUE" ;
VAL_TABLE_ DTCI_ICCM_TstFldOpCyc 0 "FALSE" 1 "TRUE" ;
VAL_TABLE_ DTCI_ICCM_TstFldLstClr 0 "FALSE" 1 "TRUE" ;
VAL_TABLE_ DTCI_ICCM_TstFld 0 "FALSE" 1 "TRUE" ;
VAL_TABLE_ DTCI_ICCM_PndngDTC 0 "FALSE" 1 "TRUE" ;
VAL_TABLE_ DTCI_ICCM_DTCTriggered 0 "FALSE" 1 "TRUE" ;
VAL_TABLE_ DTCI_ICCM_WrnIndTrggrd 0 "FALSE" 1 "TRUE" ;
VAL_TABLE_ DTCI_ICCM_WrnIndRqd 0 "FALSE" 1 "TRUE" ;
VAL_TABLE_ DTCI_ICS_Info_CnfrmdDTC 0 "FALSE" 1 "TRUE" ;
VAL_TABLE_ DTCI_ICS_Info_DTCFaultType 0 "Not Supported" 1 "Type A" 2 "Type B" 3 "Type C" ;
VAL_TABLE_ DTCI_ICS_Info_TstNCmpltdOpCyc 0 "FALSE" 1 "TRUE" ;
VAL_TABLE_ DTCI_ICS_Info_TstNCmpltdLstClr 0 "FALSE" 1 "TRUE" ;
VAL_TABLE_ DTCI_ICS_Info_TstFldOpCyc 0 "FALSE" 1 "TRUE" ;
VAL_TABLE_ DTCI_ICS_Info_TstFldLstClr 0 "FALSE" 1 "TRUE" ;
VAL_TABLE_ DTCI_ICS_Info_TstFld 0 "FALSE" 1 "TRUE" ;
VAL_TABLE_ DTCI_ICS_Info_PndngDTC 0 "FALSE" 1 "TRUE" ;
VAL_TABLE_ DTCI_ICS_Info_DTCTriggered 0 "FALSE" 1 "TRUE" ;
VAL_TABLE_ DTCI_ICS_Info_WrnIndTrggrd 0 "FALSE" 1 "TRUE" ;
VAL_TABLE_ DTCI_ICS_Info_WrnIndRqd 0 "FALSE" 1 "TRUE" ;
VAL_TABLE_ DTCI_IPC_CnfrmdDTC 0 "FALSE" 1 "TRUE" ;
VAL_TABLE_ DTCI_IPC_DTCFaultType 0 "Not Supported" 1 "Type A" 2 "Type B" 3 "Type C" ;
VAL_TABLE_ DTCI_IPC_TstNCmpltdOpCyc 0 "FALSE" 1 "TRUE" ;
VAL_TABLE_ DTCI_IPC_TstNCmpltdLstClr 0 "FALSE" 1 "TRUE" ;
VAL_TABLE_ DTCI_IPC_TstFldOpCyc 0 "FALSE" 1 "TRUE" ;
VAL_TABLE_ DTCI_IPC_TstFldLstClr 0 "FALSE" 1 "TRUE" ;
VAL_TABLE_ DTCI_IPC_TstFld 0 "FALSE" 1 "TRUE" ;
VAL_TABLE_ DTCI_IPC_PndngDTC 0 "FALSE" 1 "TRUE" ;
VAL_TABLE_ DTCI_IPC_DTCTriggered 0 "FALSE" 1 "TRUE" ;
VAL_TABLE_ DTCI_IPC_WrnIndTrggrd 0 "FALSE" 1 "TRUE" ;
VAL_TABLE_ DTCI_IPC_WrnIndRqd 0 "FALSE" 1 "TRUE" ;
VAL_TABLE_ DTCI_LIB1_CnfrmdDTC 0 "FALSE" 1 "TRUE" ;
VAL_TABLE_ DTCI_LIB1_DTCFaultType 0 "Not Supported" 1 "Type A" 2 "Type B" 3 "Type C" ;
VAL_TABLE_ DTCI_LIB1_TstNCmpltdOpCyc 0 "FALSE" 1 "TRUE" ;
VAL_TABLE_ DTCI_LIB1_TstNCmpltdLstClr 0 "FALSE" 1 "TRUE" ;
VAL_TABLE_ DTCI_LIB1_TstFldOpCyc 0 "FALSE" 1 "TRUE" ;
VAL_TABLE_ DTCI_LIB1_TstFldLstClr 0 "FALSE" 1 "TRUE" ;
VAL_TABLE_ DTCI_LIB1_TstFld 0 "FALSE" 1 "TRUE" ;
VAL_TABLE_ DTCI_LIB1_PndngDTC 0 "FALSE" 1 "TRUE" ;
VAL_TABLE_ DTCI_LIB1_DTCTriggered 0 "FALSE" 1 "TRUE" ;
VAL_TABLE_ DTCI_LIB1_WrnIndTrggrd 0 "FALSE" 1 "TRUE" ;
VAL_TABLE_ DTCI_LIB1_WrnIndRqd 0 "FALSE" 1 "TRUE" ;
VAL_TABLE_ DTCI_LIB_48V_CnfrmdDTC 0 "FALSE" 1 "TRUE" ;
VAL_TABLE_ DTCI_LIB_48V_DTCFaultType 0 "Not Supported" 1 "Type A" 2 "Type B" 3 "Type C" ;
VAL_TABLE_ DTCI_LIB_48V_TstNCmpltdOpCyc 0 "FALSE" 1 "TRUE" ;
VAL_TABLE_ DTCI_LIB_48V_TstNCmpltdLstClr 0 "FALSE" 1 "TRUE" ;
VAL_TABLE_ DTCI_LIB_48V_TstFldOpCyc 0 "FALSE" 1 "TRUE" ;
VAL_TABLE_ DTCI_LIB_48V_TstFldLstClr 0 "FALSE" 1 "TRUE" ;
VAL_TABLE_ DTCI_LIB_48V_TstFld 0 "FALSE" 1 "TRUE" ;
VAL_TABLE_ DTCI_LIB_48V_PndngDTC 0 "FALSE" 1 "TRUE" ;
VAL_TABLE_ DTCI_LIB_48V_DTCTriggered 0 "FALSE" 1 "TRUE" ;
VAL_TABLE_ DTCI_LIB_48V_WrnIndTrggrd 0 "FALSE" 1 "TRUE" ;
VAL_TABLE_ DTCI_LIB_48V_WrnIndRqd 0 "FALSE" 1 "TRUE" ;
VAL_TABLE_ DTCI_LRR_CnfrmdDTC 0 "FALSE" 1 "TRUE" ;
VAL_TABLE_ DTCI_LRR_DTCFaultType 0 "Not Supported" 1 "Type A" 2 "Type B" 3 "Type C" ;
VAL_TABLE_ DTCI_LRR_TstNCmpltdOpCyc 0 "FALSE" 1 "TRUE" ;
VAL_TABLE_ DTCI_LRR_TstNCmpltdLstClr 0 "FALSE" 1 "TRUE" ;
VAL_TABLE_ DTCI_LRR_TstFldOpCyc 0 "FALSE" 1 "TRUE" ;
VAL_TABLE_ DTCI_LRR_TstFldLstClr 0 "FALSE" 1 "TRUE" ;
VAL_TABLE_ DTCI_LRR_TstFld 0 "FALSE" 1 "TRUE" ;
VAL_TABLE_ DTCI_LRR_PndngDTC 0 "FALSE" 1 "TRUE" ;
VAL_TABLE_ DTCI_LRR_DTCTriggered 0 "FALSE" 1 "TRUE" ;
VAL_TABLE_ DTCI_LRR_WrnIndTrggrd 0 "FALSE" 1 "TRUE" ;
VAL_TABLE_ DTCI_LRR_WrnIndRqd 0 "FALSE" 1 "TRUE" ;
VAL_TABLE_ DTCI_MFC_CnfrmdDTC 0 "FALSE" 1 "TRUE" ;
VAL_TABLE_ DTCI_MFC_DTCFaultType 0 "Not Supported" 1 "Type A" 2 "Type B" 3 "Type C" ;
VAL_TABLE_ DTCI_MFC_TstNCmpltdOpCyc 0 "FALSE" 1 "TRUE" ;
VAL_TABLE_ DTCI_MFC_TstNCmpltdLstClr 0 "FALSE" 1 "TRUE" ;
VAL_TABLE_ DTCI_MFC_TstFldOpCyc 0 "FALSE" 1 "TRUE" ;
VAL_TABLE_ DTCI_MFC_TstFldLstClr 0 "FALSE" 1 "TRUE" ;
VAL_TABLE_ DTCI_MFC_TstFld 0 "FALSE" 1 "TRUE" ;
VAL_TABLE_ DTCI_MFC_PndngDTC 0 "FALSE" 1 "TRUE" ;
VAL_TABLE_ DTCI_MFC_DTCTriggered 0 "FALSE" 1 "TRUE" ;
VAL_TABLE_ DTCI_MFC_WrnIndTrggrd 0 "FALSE" 1 "TRUE" ;
VAL_TABLE_ DTCI_MFC_WrnIndRqd 0 "FALSE" 1 "TRUE" ;
VAL_TABLE_ DTCI_MRCM_L_CnfrmdDTC 0 "FALSE" 1 "TRUE" ;
VAL_TABLE_ DTCI_MRCM_L_DTCFaultType 0 "Not Supported" 1 "Type A" 2 "Type B" 3 "Type C" ;
VAL_TABLE_ DTCI_MRCM_L_TstNCmpltdOpCyc 0 "FALSE" 1 "TRUE" ;
VAL_TABLE_ DTCI_MRCM_L_TstNCmpltdLstClr 0 "FALSE" 1 "TRUE" ;
VAL_TABLE_ DTCI_MRCM_L_TstFldOpCyc 0 "FALSE" 1 "TRUE" ;
VAL_TABLE_ DTCI_MRCM_L_TstFldLstClr 0 "FALSE" 1 "TRUE" ;
VAL_TABLE_ DTCI_MRCM_L_TstFld 0 "FALSE" 1 "TRUE" ;
VAL_TABLE_ DTCI_MRCM_L_PndngDTC 0 "FALSE" 1 "TRUE" ;
VAL_TABLE_ DTCI_MRCM_L_DTCTriggered 0 "FALSE" 1 "TRUE" ;
VAL_TABLE_ DTCI_MRCM_L_WrnIndTrggrd 0 "FALSE" 1 "TRUE" ;
VAL_TABLE_ DTCI_MRCM_L_WrnIndRqd 0 "FALSE" 1 "TRUE" ;
VAL_TABLE_ DTCI_MRCM_R_CnfrmdDTC 0 "FALSE" 1 "TRUE" ;
VAL_TABLE_ DTCI_MRCM_R_DTCFaultType 0 "Not Supported" 1 "Type A" 2 "Type B" 3 "Type C" ;
VAL_TABLE_ DTCI_MRCM_R_TstNCmpltdOpCyc 0 "FALSE" 1 "TRUE" ;
VAL_TABLE_ DTCI_MRCM_R_TstNCmpltdLstClr 0 "FALSE" 1 "TRUE" ;
VAL_TABLE_ DTCI_MRCM_R_TstFldOpCyc 0 "FALSE" 1 "TRUE" ;
VAL_TABLE_ DTCI_MRCM_R_TstFldLstClr 0 "FALSE" 1 "TRUE" ;
VAL_TABLE_ DTCI_MRCM_R_TstFld 0 "FALSE" 1 "TRUE" ;
VAL_TABLE_ DTCI_MRCM_R_PndngDTC 0 "FALSE" 1 "TRUE" ;
VAL_TABLE_ DTCI_MRCM_R_DTCTriggered 0 "FALSE" 1 "TRUE" ;
VAL_TABLE_ DTCI_MRCM_R_WrnIndTrggrd 0 "FALSE" 1 "TRUE" ;
VAL_TABLE_ DTCI_MRCM_R_WrnIndRqd 0 "FALSE" 1 "TRUE" ;
VAL_TABLE_ DTCI_MSB1_CnfrmdDTC 0 "FALSE" 1 "TRUE" ;
VAL_TABLE_ DTCI_MSB1_DTCFaultType 0 "Not Supported" 1 "Type A" 2 "Type B" 3 "Type C" ;
VAL_TABLE_ DTCI_MSB1_TstNCmpltdOpCyc 0 "FALSE" 1 "TRUE" ;
VAL_TABLE_ DTCI_MSB1_TstNCmpltdLstClr 0 "FALSE" 1 "TRUE" ;
VAL_TABLE_ DTCI_MSB1_TstFldOpCyc 0 "FALSE" 1 "TRUE" ;
VAL_TABLE_ DTCI_MSB1_TstFldLstClr 0 "FALSE" 1 "TRUE" ;
VAL_TABLE_ DTCI_MSB1_TstFld 0 "FALSE" 1 "TRUE" ;
VAL_TABLE_ DTCI_MSB1_PndngDTC 0 "FALSE" 1 "TRUE" ;
VAL_TABLE_ DTCI_MSB1_DTCTriggered 0 "FALSE" 1 "TRUE" ;
VAL_TABLE_ DTCI_MSB1_WrnIndTrggrd 0 "FALSE" 1 "TRUE" ;
VAL_TABLE_ DTCI_MSB1_WrnIndRqd 0 "FALSE" 1 "TRUE" ;
VAL_TABLE_ DTCI_MSB2_CnfrmdDTC 0 "FALSE" 1 "TRUE" ;
VAL_TABLE_ DTCI_MSB2_DTCFaultType 0 "Not Supported" 1 "Type A" 2 "Type B" 3 "Type C" ;
VAL_TABLE_ DTCI_MSB2_TstNCmpltdOpCyc 0 "FALSE" 1 "TRUE" ;
VAL_TABLE_ DTCI_MSB2_TstNCmpltdLstClr 0 "FALSE" 1 "TRUE" ;
VAL_TABLE_ DTCI_MSB2_TstFldOpCyc 0 "FALSE" 1 "TRUE" ;
VAL_TABLE_ DTCI_MSB2_TstFldLstClr 0 "FALSE" 1 "TRUE" ;
VAL_TABLE_ DTCI_MSB2_TstFld 0 "FALSE" 1 "TRUE" ;
VAL_TABLE_ DTCI_MSB2_PndngDTC 0 "FALSE" 1 "TRUE" ;
VAL_TABLE_ DTCI_MSB2_DTCTriggered 0 "FALSE" 1 "TRUE" ;
VAL_TABLE_ DTCI_MSB2_WrnIndTrggrd 0 "FALSE" 1 "TRUE" ;
VAL_TABLE_ DTCI_MSB2_WrnIndRqd 0 "FALSE" 1 "TRUE" ;
VAL_TABLE_ DTCI_MSM_D_CnfrmdDTC 0 "FALSE" 1 "TRUE" ;
VAL_TABLE_ DTCI_MSM_D_DTCFaultType 0 "Not Supported" 1 "Type A" 2 "Type B" 3 "Type C" ;
VAL_TABLE_ DTCI_MSM_D_TstNCmpltdOpCyc 0 "FALSE" 1 "TRUE" ;
VAL_TABLE_ DTCI_MSM_D_TstNCmpltdLstClr 0 "FALSE" 1 "TRUE" ;
VAL_TABLE_ DTCI_MSM_D_TstFldOpCyc 0 "FALSE" 1 "TRUE" ;
VAL_TABLE_ DTCI_MSM_D_TstFldLstClr 0 "FALSE" 1 "TRUE" ;
VAL_TABLE_ DTCI_MSM_D_TstFld 0 "FALSE" 1 "TRUE" ;
VAL_TABLE_ DTCI_MSM_D_PndngDTC 0 "FALSE" 1 "TRUE" ;
VAL_TABLE_ DTCI_MSM_D_DTCTriggered 0 "FALSE" 1 "TRUE" ;
VAL_TABLE_ DTCI_MSM_D_WrnIndTrggrd 0 "FALSE" 1 "TRUE" ;
VAL_TABLE_ DTCI_MSM_D_WrnIndRqd 0 "FALSE" 1 "TRUE" ;
VAL_TABLE_ DTCI_MSM_LR_CnfrmdDTC 0 "FALSE" 1 "TRUE" ;
VAL_TABLE_ DTCI_MSM_LR_DTCFaultType 0 "Not Supported" 1 "Type A" 2 "Type B" 3 "Type C" ;
VAL_TABLE_ DTCI_MSM_LR_TstNCmpltdOpCyc 0 "FALSE" 1 "TRUE" ;
VAL_TABLE_ DTCI_MSM_LR_TstNCmpltdLstClr 0 "FALSE" 1 "TRUE" ;
VAL_TABLE_ DTCI_MSM_LR_TstFldOpCyc 0 "FALSE" 1 "TRUE" ;
VAL_TABLE_ DTCI_MSM_LR_TstFldLstClr 0 "FALSE" 1 "TRUE" ;
VAL_TABLE_ DTCI_MSM_LR_TstFld 0 "FALSE" 1 "TRUE" ;
VAL_TABLE_ DTCI_MSM_LR_PndngDTC 0 "FALSE" 1 "TRUE" ;
VAL_TABLE_ DTCI_MSM_LR_DTCTriggered 0 "FALSE" 1 "TRUE" ;
VAL_TABLE_ DTCI_MSM_LR_WrnIndTrggrd 0 "FALSE" 1 "TRUE" ;
VAL_TABLE_ DTCI_MSM_LR_WrnIndRqd 0 "FALSE" 1 "TRUE" ;
VAL_TABLE_ DTCI_MSM_P_CnfrmdDTC 0 "FALSE" 1 "TRUE" ;
VAL_TABLE_ DTCI_MSM_P_DTCFaultType 0 "Not Supported" 1 "Type A" 2 "Type B" 3 "Type C" ;
VAL_TABLE_ DTCI_MSM_P_TstNCmpltdOpCyc 0 "FALSE" 1 "TRUE" ;
VAL_TABLE_ DTCI_MSM_P_TstNCmpltdLstClr 0 "FALSE" 1 "TRUE" ;
VAL_TABLE_ DTCI_MSM_P_TstFldOpCyc 0 "FALSE" 1 "TRUE" ;
VAL_TABLE_ DTCI_MSM_P_TstFldLstClr 0 "FALSE" 1 "TRUE" ;
VAL_TABLE_ DTCI_MSM_P_TstFld 0 "FALSE" 1 "TRUE" ;
VAL_TABLE_ DTCI_MSM_P_PndngDTC 0 "FALSE" 1 "TRUE" ;
VAL_TABLE_ DTCI_MSM_P_DTCTriggered 0 "FALSE" 1 "TRUE" ;
VAL_TABLE_ DTCI_MSM_P_WrnIndTrggrd 0 "FALSE" 1 "TRUE" ;
VAL_TABLE_ DTCI_MSM_P_WrnIndRqd 0 "FALSE" 1 "TRUE" ;
VAL_TABLE_ DTCI_MSM_RR_CnfrmdDTC 0 "FALSE" 1 "TRUE" ;
VAL_TABLE_ DTCI_MSM_RR_DTCFaultType 0 "Not Supported" 1 "Type A" 2 "Type B" 3 "Type C" ;
VAL_TABLE_ DTCI_MSM_RR_TstNCmpltdOpCyc 0 "FALSE" 1 "TRUE" ;
VAL_TABLE_ DTCI_MSM_RR_TstNCmpltdLstClr 0 "FALSE" 1 "TRUE" ;
VAL_TABLE_ DTCI_MSM_RR_TstFldOpCyc 0 "FALSE" 1 "TRUE" ;
VAL_TABLE_ DTCI_MSM_RR_TstFldLstClr 0 "FALSE" 1 "TRUE" ;
VAL_TABLE_ DTCI_MSM_RR_TstFld 0 "FALSE" 1 "TRUE" ;
VAL_TABLE_ DTCI_MSM_RR_PndngDTC 0 "FALSE" 1 "TRUE" ;
VAL_TABLE_ DTCI_MSM_RR_DTCTriggered 0 "FALSE" 1 "TRUE" ;
VAL_TABLE_ DTCI_MSM_RR_WrnIndTrggrd 0 "FALSE" 1 "TRUE" ;
VAL_TABLE_ DTCI_MSM_RR_WrnIndRqd 0 "FALSE" 1 "TRUE" ;
VAL_TABLE_ DTCI_MTCM_L_CnfrmdDTC 0 "FALSE" 1 "TRUE" ;
VAL_TABLE_ DTCI_MTCM_L_DTCFaultType 0 "Not Supported" 1 "Type A" 2 "Type B" 3 "Type C" ;
VAL_TABLE_ DTCI_MTCM_L_TstNCmpltdOpCyc 0 "FALSE" 1 "TRUE" ;
VAL_TABLE_ DTCI_MTCM_L_TstNCmpltdLstClr 0 "FALSE" 1 "TRUE" ;
VAL_TABLE_ DTCI_MTCM_L_TstFldOpCyc 0 "FALSE" 1 "TRUE" ;
VAL_TABLE_ DTCI_MTCM_L_TstFldLstClr 0 "FALSE" 1 "TRUE" ;
VAL_TABLE_ DTCI_MTCM_L_TstFld 0 "FALSE" 1 "TRUE" ;
VAL_TABLE_ DTCI_MTCM_L_PndngDTC 0 "FALSE" 1 "TRUE" ;
VAL_TABLE_ DTCI_MTCM_L_DTCTriggered 0 "FALSE" 1 "TRUE" ;
VAL_TABLE_ DTCI_MTCM_L_WrnIndTrggrd 0 "FALSE" 1 "TRUE" ;
VAL_TABLE_ DTCI_MTCM_L_WrnIndRqd 0 "FALSE" 1 "TRUE" ;
VAL_TABLE_ DTCI_MTCM_R_CnfrmdDTC 0 "FALSE" 1 "TRUE" ;
VAL_TABLE_ DTCI_MTCM_R_DTCFaultType 0 "Not Supported" 1 "Type A" 2 "Type B" 3 "Type C" ;
VAL_TABLE_ DTCI_MTCM_R_TstNCmpltdOpCyc 0 "FALSE" 1 "TRUE" ;
VAL_TABLE_ DTCI_MTCM_R_TstNCmpltdLstClr 0 "FALSE" 1 "TRUE" ;
VAL_TABLE_ DTCI_MTCM_R_TstFldOpCyc 0 "FALSE" 1 "TRUE" ;
VAL_TABLE_ DTCI_MTCM_R_TstFldLstClr 0 "FALSE" 1 "TRUE" ;
VAL_TABLE_ DTCI_MTCM_R_TstFld 0 "FALSE" 1 "TRUE" ;
VAL_TABLE_ DTCI_MTCM_R_PndngDTC 0 "FALSE" 1 "TRUE" ;
VAL_TABLE_ DTCI_MTCM_R_DTCTriggered 0 "FALSE" 1 "TRUE" ;
VAL_TABLE_ DTCI_MTCM_R_WrnIndTrggrd 0 "FALSE" 1 "TRUE" ;
VAL_TABLE_ DTCI_MTCM_R_WrnIndRqd 0 "FALSE" 1 "TRUE" ;
VAL_TABLE_ DTCI_NVM_CnfrmdDTC 0 "FALSE" 1 "TRUE" ;
VAL_TABLE_ DTCI_NVM_DTCFaultType 0 "Not Supported" 1 "Type A" 2 "Type B" 3 "Type C" ;
VAL_TABLE_ DTCI_NVM_TstNCmpltdOpCyc 0 "FALSE" 1 "TRUE" ;
VAL_TABLE_ DTCI_NVM_TstNCmpltdLstClr 0 "FALSE" 1 "TRUE" ;
VAL_TABLE_ DTCI_NVM_TstFldOpCyc 0 "FALSE" 1 "TRUE" ;
VAL_TABLE_ DTCI_NVM_TstFldLstClr 0 "FALSE" 1 "TRUE" ;
VAL_TABLE_ DTCI_NVM_TstFld 0 "FALSE" 1 "TRUE" ;
VAL_TABLE_ DTCI_NVM_PndngDTC 0 "FALSE" 1 "TRUE" ;
VAL_TABLE_ DTCI_NVM_DTCTriggered 0 "FALSE" 1 "TRUE" ;
VAL_TABLE_ DTCI_NVM_WrnIndTrggrd 0 "FALSE" 1 "TRUE" ;
VAL_TABLE_ DTCI_NVM_WrnIndRqd 0 "FALSE" 1 "TRUE" ;
VAL_TABLE_ DTCI_ODS2_CnfrmdDTC 0 "FALSE" 1 "TRUE" ;
VAL_TABLE_ DTCI_ODS2_DTCFaultType 0 "Not Supported" 1 "Type A" 2 "Type B" 3 "Type C" ;
VAL_TABLE_ DTCI_ODS2_TstNCmpltdOpCyc 0 "FALSE" 1 "TRUE" ;
VAL_TABLE_ DTCI_ODS2_TstNCmpltdLstClr 0 "FALSE" 1 "TRUE" ;
VAL_TABLE_ DTCI_ODS2_TstFldOpCyc 0 "FALSE" 1 "TRUE" ;
VAL_TABLE_ DTCI_ODS2_TstFldLstClr 0 "FALSE" 1 "TRUE" ;
VAL_TABLE_ DTCI_ODS2_TstFld 0 "FALSE" 1 "TRUE" ;
VAL_TABLE_ DTCI_ODS2_PndngDTC 0 "FALSE" 1 "TRUE" ;
VAL_TABLE_ DTCI_ODS2_DTCTriggered 0 "FALSE" 1 "TRUE" ;
VAL_TABLE_ DTCI_ODS2_WrnIndTrggrd 0 "FALSE" 1 "TRUE" ;
VAL_TABLE_ DTCI_ODS2_WrnIndRqd 0 "FALSE" 1 "TRUE" ;
VAL_TABLE_ DTCI_ODS_CnfrmdDTC 0 "FALSE" 1 "TRUE" ;
VAL_TABLE_ DTCI_ODS_DTCFaultType 0 "Not Supported" 1 "Type A" 2 "Type B" 3 "Type C" ;
VAL_TABLE_ DTCI_ODS_TstNCmpltdOpCyc 0 "FALSE" 1 "TRUE" ;
VAL_TABLE_ DTCI_ODS_TstNCmpltdLstClr 0 "FALSE" 1 "TRUE" ;
VAL_TABLE_ DTCI_ODS_TstFldOpCyc 0 "FALSE" 1 "TRUE" ;
VAL_TABLE_ DTCI_ODS_TstFldLstClr 0 "FALSE" 1 "TRUE" ;
VAL_TABLE_ DTCI_ODS_TstFld 0 "FALSE" 1 "TRUE" ;
VAL_TABLE_ DTCI_ODS_PndngDTC 0 "FALSE" 1 "TRUE" ;
VAL_TABLE_ DTCI_ODS_DTCTriggered 0 "FALSE" 1 "TRUE" ;
VAL_TABLE_ DTCI_ODS_WrnIndTrggrd 0 "FALSE" 1 "TRUE" ;
VAL_TABLE_ DTCI_ODS_WrnIndRqd 0 "FALSE" 1 "TRUE" ;
VAL_TABLE_ DTCI_PA_CnfrmdDTC 0 "FALSE" 1 "TRUE" ;
VAL_TABLE_ DTCI_PA_DTCFaultType 0 "Not Supported" 1 "Type A" 2 "Type B" 3 "Type C" ;
VAL_TABLE_ DTCI_PA_TstNCmpltdOpCyc 0 "FALSE" 1 "TRUE" ;
VAL_TABLE_ DTCI_PA_TstNCmpltdLstClr 0 "FALSE" 1 "TRUE" ;
VAL_TABLE_ DTCI_PA_TstFldOpCyc 0 "FALSE" 1 "TRUE" ;
VAL_TABLE_ DTCI_PA_TstFldLstClr 0 "FALSE" 1 "TRUE" ;
VAL_TABLE_ DTCI_PA_TstFld 0 "FALSE" 1 "TRUE" ;
VAL_TABLE_ DTCI_PA_PndngDTC 0 "FALSE" 1 "TRUE" ;
VAL_TABLE_ DTCI_PA_DTCTriggered 0 "FALSE" 1 "TRUE" ;
VAL_TABLE_ DTCI_PA_WrnIndTrggrd 0 "FALSE" 1 "TRUE" ;
VAL_TABLE_ DTCI_PA_WrnIndRqd 0 "FALSE" 1 "TRUE" ;
VAL_TABLE_ DTCI_PCM_CnfrmdDTC 0 "FALSE" 1 "TRUE" ;
VAL_TABLE_ DTCI_PCM_DTCFaultType 0 "Not Supported" 1 "Type A" 2 "Type B" 3 "Type C" ;
VAL_TABLE_ DTCI_PCM_TstNCmpltdOpCyc 0 "FALSE" 1 "TRUE" ;
VAL_TABLE_ DTCI_PCM_TstNCmpltdLstClr 0 "FALSE" 1 "TRUE" ;
VAL_TABLE_ DTCI_PCM_TstFldOpCyc 0 "FALSE" 1 "TRUE" ;
VAL_TABLE_ DTCI_PCM_TstFldLstClr 0 "FALSE" 1 "TRUE" ;
VAL_TABLE_ DTCI_PCM_TstFld 0 "FALSE" 1 "TRUE" ;
VAL_TABLE_ DTCI_PCM_PndngDTC 0 "FALSE" 1 "TRUE" ;
VAL_TABLE_ DTCI_PCM_DTCTriggered 0 "FALSE" 1 "TRUE" ;
VAL_TABLE_ DTCI_PCM_WrnIndTrggrd 0 "FALSE" 1 "TRUE" ;
VAL_TABLE_ DTCI_PCM_WrnIndRqd 0 "FALSE" 1 "TRUE" ;
VAL_TABLE_ DTCI_PDR_CnfrmdDTC 0 "FALSE" 1 "TRUE" ;
VAL_TABLE_ DTCI_PDR_DTCFaultType 0 "Not Supported" 1 "Type A" 2 "Type B" 3 "Type C" ;
VAL_TABLE_ DTCI_PDR_TstNCmpltdOpCyc 0 "FALSE" 1 "TRUE" ;
VAL_TABLE_ DTCI_PDR_TstNCmpltdLstClr 0 "FALSE" 1 "TRUE" ;
VAL_TABLE_ DTCI_PDR_TstFldOpCyc 0 "FALSE" 1 "TRUE" ;
VAL_TABLE_ DTCI_PDR_TstFldLstClr 0 "FALSE" 1 "TRUE" ;
VAL_TABLE_ DTCI_PDR_TstFld 0 "FALSE" 1 "TRUE" ;
VAL_TABLE_ DTCI_PDR_PndngDTC 0 "FALSE" 1 "TRUE" ;
VAL_TABLE_ DTCI_PDR_DTCTriggered 0 "FALSE" 1 "TRUE" ;
VAL_TABLE_ DTCI_PDR_WrnIndTrggrd 0 "FALSE" 1 "TRUE" ;
VAL_TABLE_ DTCI_PDR_WrnIndRqd 0 "FALSE" 1 "TRUE" ;
VAL_TABLE_ DTCI_PFCM_CnfrmdDTC 0 "FALSE" 1 "TRUE" ;
VAL_TABLE_ DTCI_PFCM_DTCFaultType 0 "Not Supported" 1 "Type A" 2 "Type B" 3 "Type C" ;
VAL_TABLE_ DTCI_PFCM_TstNCmpltdOpCyc 0 "FALSE" 1 "TRUE" ;
VAL_TABLE_ DTCI_PFCM_TstNCmpltdLstClr 0 "FALSE" 1 "TRUE" ;
VAL_TABLE_ DTCI_PFCM_TstFldOpCyc 0 "FALSE" 1 "TRUE" ;
VAL_TABLE_ DTCI_PFCM_TstFldLstClr 0 "FALSE" 1 "TRUE" ;
VAL_TABLE_ DTCI_PFCM_TstFld 0 "FALSE" 1 "TRUE" ;
VAL_TABLE_ DTCI_PFCM_PndngDTC 0 "FALSE" 1 "TRUE" ;
VAL_TABLE_ DTCI_PFCM_DTCTriggered 0 "FALSE" 1 "TRUE" ;
VAL_TABLE_ DTCI_PFCM_WrnIndTrggrd 0 "FALSE" 1 "TRUE" ;
VAL_TABLE_ DTCI_PFCM_WrnIndRqd 0 "FALSE" 1 "TRUE" ;
VAL_TABLE_ DTCI_PLCM_CnfrmdDTC 0 "FALSE" 1 "TRUE" ;
VAL_TABLE_ DTCI_PLCM_DTCFaultType 0 "Not Supported" 1 "Type A" 2 "Type B" 3 "Type C" ;
VAL_TABLE_ DTCI_PLCM_TstNCmpltdOpCyc 0 "FALSE" 1 "TRUE" ;
VAL_TABLE_ DTCI_PLCM_TstNCmpltdLstClr 0 "FALSE" 1 "TRUE" ;
VAL_TABLE_ DTCI_PLCM_TstFldOpCyc 0 "FALSE" 1 "TRUE" ;
VAL_TABLE_ DTCI_PLCM_TstFldLstClr 0 "FALSE" 1 "TRUE" ;
VAL_TABLE_ DTCI_PLCM_TstFld 0 "FALSE" 1 "TRUE" ;
VAL_TABLE_ DTCI_PLCM_PndngDTC 0 "FALSE" 1 "TRUE" ;
VAL_TABLE_ DTCI_PLCM_DTCTriggered 0 "FALSE" 1 "TRUE" ;
VAL_TABLE_ DTCI_PLCM_WrnIndTrggrd 0 "FALSE" 1 "TRUE" ;
VAL_TABLE_ DTCI_PLCM_WrnIndRqd 0 "FALSE" 1 "TRUE" ;
VAL_TABLE_ DTCI_PTM_CnfrmdDTC 0 "FALSE" 1 "TRUE" ;
VAL_TABLE_ DTCI_PTM_DTCFaultType 0 "Not Supported" 1 "Type A" 2 "Type B" 3 "Type C" ;
VAL_TABLE_ DTCI_PTM_TstNCmpltdOpCyc 0 "FALSE" 1 "TRUE" ;
VAL_TABLE_ DTCI_PTM_TstNCmpltdLstClr 0 "FALSE" 1 "TRUE" ;
VAL_TABLE_ DTCI_PTM_TstFldOpCyc 0 "FALSE" 1 "TRUE" ;
VAL_TABLE_ DTCI_PTM_TstFldLstClr 0 "FALSE" 1 "TRUE" ;
VAL_TABLE_ DTCI_PTM_TstFld 0 "FALSE" 1 "TRUE" ;
VAL_TABLE_ DTCI_PTM_PndngDTC 0 "FALSE" 1 "TRUE" ;
VAL_TABLE_ DTCI_PTM_DTCTriggered 0 "FALSE" 1 "TRUE" ;
VAL_TABLE_ DTCI_PTM_WrnIndTrggrd 0 "FALSE" 1 "TRUE" ;
VAL_TABLE_ DTCI_PTM_WrnIndRqd 0 "FALSE" 1 "TRUE" ;
VAL_TABLE_ DTCI_RDCM_CnfrmdDTC 0 "FALSE" 1 "TRUE" ;
VAL_TABLE_ DTCI_RDCM_DTCFaultType 0 "Not Supported" 1 "Type A" 2 "Type B" 3 "Type C" ;
VAL_TABLE_ DTCI_RDCM_TstNCmpltdOpCyc 0 "FALSE" 1 "TRUE" ;
VAL_TABLE_ DTCI_RDCM_TstNCmpltdLstClr 0 "FALSE" 1 "TRUE" ;
VAL_TABLE_ DTCI_RDCM_TstFldOpCyc 0 "FALSE" 1 "TRUE" ;
VAL_TABLE_ DTCI_RDCM_TstFldLstClr 0 "FALSE" 1 "TRUE" ;
VAL_TABLE_ DTCI_RDCM_TstFld 0 "FALSE" 1 "TRUE" ;
VAL_TABLE_ DTCI_RDCM_PndngDTC 0 "FALSE" 1 "TRUE" ;
VAL_TABLE_ DTCI_RDCM_DTCTriggered 0 "FALSE" 1 "TRUE" ;
VAL_TABLE_ DTCI_RDCM_WrnIndTrggrd 0 "FALSE" 1 "TRUE" ;
VAL_TABLE_ DTCI_RDCM_WrnIndRqd 0 "FALSE" 1 "TRUE" ;
VAL_TABLE_ DTCI_RSI_CnfrmdDTC 0 "FALSE" 1 "TRUE" ;
VAL_TABLE_ DTCI_RSI_DTCFaultType 0 "Not Supported" 1 "Type A" 2 "Type B" 3 "Type C" ;
VAL_TABLE_ DTCI_RSI_TstNCmpltdOpCyc 0 "FALSE" 1 "TRUE" ;
VAL_TABLE_ DTCI_RSI_TstNCmpltdLstClr 0 "FALSE" 1 "TRUE" ;
VAL_TABLE_ DTCI_RSI_TstFldOpCyc 0 "FALSE" 1 "TRUE" ;
VAL_TABLE_ DTCI_RSI_TstFldLstClr 0 "FALSE" 1 "TRUE" ;
VAL_TABLE_ DTCI_RSI_TstFld 0 "FALSE" 1 "TRUE" ;
VAL_TABLE_ DTCI_RSI_PndngDTC 0 "FALSE" 1 "TRUE" ;
VAL_TABLE_ DTCI_RSI_DTCTriggered 0 "FALSE" 1 "TRUE" ;
VAL_TABLE_ DTCI_RSI_WrnIndTrggrd 0 "FALSE" 1 "TRUE" ;
VAL_TABLE_ DTCI_RSI_WrnIndRqd 0 "FALSE" 1 "TRUE" ;
VAL_TABLE_ DTCI_RadioLow_CnfrmdDTC 0 "FALSE" 1 "TRUE" ;
VAL_TABLE_ DTCI_RadioLow_DTCFaultType 0 "Not Supported" 1 "Type A" 2 "Type B" 3 "Type C" ;
VAL_TABLE_ DTCI_RadioLow_TstNCmpltdOpCyc 0 "FALSE" 1 "TRUE" ;
VAL_TABLE_ DTCI_RadioLow_TstNCmpltdLstClr 0 "FALSE" 1 "TRUE" ;
VAL_TABLE_ DTCI_RadioLow_TstFldOpCyc 0 "FALSE" 1 "TRUE" ;
VAL_TABLE_ DTCI_RadioLow_TstFldLstClr 0 "FALSE" 1 "TRUE" ;
VAL_TABLE_ DTCI_RadioLow_TstFld 0 "FALSE" 1 "TRUE" ;
VAL_TABLE_ DTCI_RadioLow_PndngDTC 0 "FALSE" 1 "TRUE" ;
VAL_TABLE_ DTCI_RadioLow_DTCTriggered 0 "FALSE" 1 "TRUE" ;
VAL_TABLE_ DTCI_RadioLow_WrnIndTrggrd 0 "FALSE" 1 "TRUE" ;
VAL_TABLE_ DTCI_RadioLow_WrnIndRqd 0 "FALSE" 1 "TRUE" ;
VAL_TABLE_ DTCI_SADS_CnfrmdDTC 0 "FALSE" 1 "TRUE" ;
VAL_TABLE_ DTCI_SADS_DTCFaultType 0 "Not Supported" 1 "Type A" 2 "Type B" 3 "Type C" ;
VAL_TABLE_ DTCI_SADS_TstNCmpltdOpCyc 0 "FALSE" 1 "TRUE" ;
VAL_TABLE_ DTCI_SADS_TstNCmpltdLstClr 0 "FALSE" 1 "TRUE" ;
VAL_TABLE_ DTCI_SADS_TstFldOpCyc 0 "FALSE" 1 "TRUE" ;
VAL_TABLE_ DTCI_SADS_TstFldLstClr 0 "FALSE" 1 "TRUE" ;
VAL_TABLE_ DTCI_SADS_TstFld 0 "FALSE" 1 "TRUE" ;
VAL_TABLE_ DTCI_SADS_PndngDTC 0 "FALSE" 1 "TRUE" ;
VAL_TABLE_ DTCI_SADS_DTCTriggered 0 "FALSE" 1 "TRUE" ;
VAL_TABLE_ DTCI_SADS_WrnIndTrggrd 0 "FALSE" 1 "TRUE" ;
VAL_TABLE_ DTCI_SADS_WrnIndRqd 0 "FALSE" 1 "TRUE" ;
VAL_TABLE_ DTCI_SAM_BH_CnfrmdDTC 0 "FALSE" 1 "TRUE" ;
VAL_TABLE_ DTCI_SAM_BH_DTCFaultType 0 "Not Supported" 1 "Type A" 2 "Type B" 3 "Type C" ;
VAL_TABLE_ DTCI_SAM_BH_TstNCmpltdOpCyc 0 "FALSE" 1 "TRUE" ;
VAL_TABLE_ DTCI_SAM_BH_TstNCmpltdLstClr 0 "FALSE" 1 "TRUE" ;
VAL_TABLE_ DTCI_SAM_BH_TstFldOpCyc 0 "FALSE" 1 "TRUE" ;
VAL_TABLE_ DTCI_SAM_BH_TstFldLstClr 0 "FALSE" 1 "TRUE" ;
VAL_TABLE_ DTCI_SAM_BH_TstFld 0 "FALSE" 1 "TRUE" ;
VAL_TABLE_ DTCI_SAM_BH_PndngDTC 0 "FALSE" 1 "TRUE" ;
VAL_TABLE_ DTCI_SAM_BH_DTCTriggered 0 "FALSE" 1 "TRUE" ;
VAL_TABLE_ DTCI_SAM_BH_WrnIndTrggrd 0 "FALSE" 1 "TRUE" ;
VAL_TABLE_ DTCI_SAM_BH_WrnIndRqd 0 "FALSE" 1 "TRUE" ;
VAL_TABLE_ DTCI_SAM_LF_CnfrmdDTC 0 "FALSE" 1 "TRUE" ;
VAL_TABLE_ DTCI_SAM_LF_DTCFaultType 0 "Not Supported" 1 "Type A" 2 "Type B" 3 "Type C" ;
VAL_TABLE_ DTCI_SAM_LF_TstNCmpltdOpCyc 0 "FALSE" 1 "TRUE" ;
VAL_TABLE_ DTCI_SAM_LF_TstNCmpltdLstClr 0 "FALSE" 1 "TRUE" ;
VAL_TABLE_ DTCI_SAM_LF_TstFldOpCyc 0 "FALSE" 1 "TRUE" ;
VAL_TABLE_ DTCI_SAM_LF_TstFldLstClr 0 "FALSE" 1 "TRUE" ;
VAL_TABLE_ DTCI_SAM_LF_TstFld 0 "FALSE" 1 "TRUE" ;
VAL_TABLE_ DTCI_SAM_LF_PndngDTC 0 "FALSE" 1 "TRUE" ;
VAL_TABLE_ DTCI_SAM_LF_DTCTriggered 0 "FALSE" 1 "TRUE" ;
VAL_TABLE_ DTCI_SAM_LF_WrnIndTrggrd 0 "FALSE" 1 "TRUE" ;
VAL_TABLE_ DTCI_SAM_LF_WrnIndRqd 0 "FALSE" 1 "TRUE" ;
VAL_TABLE_ DTCI_SAM_LR_CnfrmdDTC 0 "FALSE" 1 "TRUE" ;
VAL_TABLE_ DTCI_SAM_LR_DTCFaultType 0 "Not Supported" 1 "Type A" 2 "Type B" 3 "Type C" ;
VAL_TABLE_ DTCI_SAM_LR_TstNCmpltdOpCyc 0 "FALSE" 1 "TRUE" ;
VAL_TABLE_ DTCI_SAM_LR_TstNCmpltdLstClr 0 "FALSE" 1 "TRUE" ;
VAL_TABLE_ DTCI_SAM_LR_TstFldOpCyc 0 "FALSE" 1 "TRUE" ;
VAL_TABLE_ DTCI_SAM_LR_TstFldLstClr 0 "FALSE" 1 "TRUE" ;
VAL_TABLE_ DTCI_SAM_LR_TstFld 0 "FALSE" 1 "TRUE" ;
VAL_TABLE_ DTCI_SAM_LR_PndngDTC 0 "FALSE" 1 "TRUE" ;
VAL_TABLE_ DTCI_SAM_LR_DTCTriggered 0 "FALSE" 1 "TRUE" ;
VAL_TABLE_ DTCI_SAM_LR_WrnIndTrggrd 0 "FALSE" 1 "TRUE" ;
VAL_TABLE_ DTCI_SAM_LR_WrnIndRqd 0 "FALSE" 1 "TRUE" ;
VAL_TABLE_ DTCI_SAM_RF_CnfrmdDTC 0 "FALSE" 1 "TRUE" ;
VAL_TABLE_ DTCI_SAM_RF_DTCFaultType 0 "Not Supported" 1 "Type A" 2 "Type B" 3 "Type C" ;
VAL_TABLE_ DTCI_SAM_RF_TstNCmpltdOpCyc 0 "FALSE" 1 "TRUE" ;
VAL_TABLE_ DTCI_SAM_RF_TstNCmpltdLstClr 0 "FALSE" 1 "TRUE" ;
VAL_TABLE_ DTCI_SAM_RF_TstFldOpCyc 0 "FALSE" 1 "TRUE" ;
VAL_TABLE_ DTCI_SAM_RF_TstFldLstClr 0 "FALSE" 1 "TRUE" ;
VAL_TABLE_ DTCI_SAM_RF_TstFld 0 "FALSE" 1 "TRUE" ;
VAL_TABLE_ DTCI_SAM_RF_PndngDTC 0 "FALSE" 1 "TRUE" ;
VAL_TABLE_ DTCI_SAM_RF_DTCTriggered 0 "FALSE" 1 "TRUE" ;
VAL_TABLE_ DTCI_SAM_RF_WrnIndTrggrd 0 "FALSE" 1 "TRUE" ;
VAL_TABLE_ DTCI_SAM_RF_WrnIndRqd 0 "FALSE" 1 "TRUE" ;
VAL_TABLE_ DTCI_SAM_RR_CnfrmdDTC 0 "FALSE" 1 "TRUE" ;
VAL_TABLE_ DTCI_SAM_RR_DTCFaultType 0 "Not Supported" 1 "Type A" 2 "Type B" 3 "Type C" ;
VAL_TABLE_ DTCI_SAM_RR_TstNCmpltdOpCyc 0 "FALSE" 1 "TRUE" ;
VAL_TABLE_ DTCI_SAM_RR_TstNCmpltdLstClr 0 "FALSE" 1 "TRUE" ;
VAL_TABLE_ DTCI_SAM_RR_TstFldOpCyc 0 "FALSE" 1 "TRUE" ;
VAL_TABLE_ DTCI_SAM_RR_TstFldLstClr 0 "FALSE" 1 "TRUE" ;
VAL_TABLE_ DTCI_SAM_RR_TstFld 0 "FALSE" 1 "TRUE" ;
VAL_TABLE_ DTCI_SAM_RR_PndngDTC 0 "FALSE" 1 "TRUE" ;
VAL_TABLE_ DTCI_SAM_RR_DTCTriggered 0 "FALSE" 1 "TRUE" ;
VAL_TABLE_ DTCI_SAM_RR_WrnIndTrggrd 0 "FALSE" 1 "TRUE" ;
VAL_TABLE_ DTCI_SAM_RR_WrnIndRqd 0 "FALSE" 1 "TRUE" ;
VAL_TABLE_ DTCI_SBM_CnfrmdDTC 0 "FALSE" 1 "TRUE" ;
VAL_TABLE_ DTCI_SBM_DTCFaultType 0 "Not Supported" 1 "Type A" 2 "Type B" 3 "Type C" ;
VAL_TABLE_ DTCI_SBM_TstNCmpltdOpCyc 0 "FALSE" 1 "TRUE" ;
VAL_TABLE_ DTCI_SBM_TstNCmpltdLstClr 0 "FALSE" 1 "TRUE" ;
VAL_TABLE_ DTCI_SBM_TstFldOpCyc 0 "FALSE" 1 "TRUE" ;
VAL_TABLE_ DTCI_SBM_TstFldLstClr 0 "FALSE" 1 "TRUE" ;
VAL_TABLE_ DTCI_SBM_TstFld 0 "FALSE" 1 "TRUE" ;
VAL_TABLE_ DTCI_SBM_PndngDTC 0 "FALSE" 1 "TRUE" ;
VAL_TABLE_ DTCI_SBM_DTCTriggered 0 "FALSE" 1 "TRUE" ;
VAL_TABLE_ DTCI_SBM_WrnIndTrggrd 0 "FALSE" 1 "TRUE" ;
VAL_TABLE_ DTCI_SBM_WrnIndRqd 0 "FALSE" 1 "TRUE" ;
VAL_TABLE_ DTCI_SBZA_L_CnfrmdDTC 0 "FALSE" 1 "TRUE" ;
VAL_TABLE_ DTCI_SBZA_L_DTCFaultType 0 "Not Supported" 1 "Type A" 2 "Type B" 3 "Type C" ;
VAL_TABLE_ DTCI_SBZA_L_TstNCmpltdOpCyc 0 "FALSE" 1 "TRUE" ;
VAL_TABLE_ DTCI_SBZA_L_TstNCmpltdLstClr 0 "FALSE" 1 "TRUE" ;
VAL_TABLE_ DTCI_SBZA_L_TstFldOpCyc 0 "FALSE" 1 "TRUE" ;
VAL_TABLE_ DTCI_SBZA_L_TstFldLstClr 0 "FALSE" 1 "TRUE" ;
VAL_TABLE_ DTCI_SBZA_L_TstFld 0 "FALSE" 1 "TRUE" ;
VAL_TABLE_ DTCI_SBZA_L_PndngDTC 0 "FALSE" 1 "TRUE" ;
VAL_TABLE_ DTCI_SBZA_L_DTCTriggered 0 "FALSE" 1 "TRUE" ;
VAL_TABLE_ DTCI_SBZA_L_WrnIndTrggrd 0 "FALSE" 1 "TRUE" ;
VAL_TABLE_ DTCI_SBZA_L_WrnIndRqd 0 "FALSE" 1 "TRUE" ;
VAL_TABLE_ DTCI_SBZA_R_CnfrmdDTC 0 "FALSE" 1 "TRUE" ;
VAL_TABLE_ DTCI_SBZA_R_DTCFaultType 0 "Not Supported" 1 "Type A" 2 "Type B" 3 "Type C" ;
VAL_TABLE_ DTCI_SBZA_R_TstNCmpltdOpCyc 0 "FALSE" 1 "TRUE" ;
VAL_TABLE_ DTCI_SBZA_R_TstNCmpltdLstClr 0 "FALSE" 1 "TRUE" ;
VAL_TABLE_ DTCI_SBZA_R_TstFldOpCyc 0 "FALSE" 1 "TRUE" ;
VAL_TABLE_ DTCI_SBZA_R_TstFldLstClr 0 "FALSE" 1 "TRUE" ;
VAL_TABLE_ DTCI_SBZA_R_TstFld 0 "FALSE" 1 "TRUE" ;
VAL_TABLE_ DTCI_SBZA_R_PndngDTC 0 "FALSE" 1 "TRUE" ;
VAL_TABLE_ DTCI_SBZA_R_DTCTriggered 0 "FALSE" 1 "TRUE" ;
VAL_TABLE_ DTCI_SBZA_R_WrnIndTrggrd 0 "FALSE" 1 "TRUE" ;
VAL_TABLE_ DTCI_SBZA_R_WrnIndRqd 0 "FALSE" 1 "TRUE" ;
VAL_TABLE_ DTCI_SCL_CnfrmdDTC 0 "FALSE" 1 "TRUE" ;
VAL_TABLE_ DTCI_SCL_DTCFaultType 0 "Not Supported" 1 "Type A" 2 "Type B" 3 "Type C" ;
VAL_TABLE_ DTCI_SCL_TstNCmpltdOpCyc 0 "FALSE" 1 "TRUE" ;
VAL_TABLE_ DTCI_SCL_TstNCmpltdLstClr 0 "FALSE" 1 "TRUE" ;
VAL_TABLE_ DTCI_SCL_TstFldOpCyc 0 "FALSE" 1 "TRUE" ;
VAL_TABLE_ DTCI_SCL_TstFldLstClr 0 "FALSE" 1 "TRUE" ;
VAL_TABLE_ DTCI_SCL_TstFld 0 "FALSE" 1 "TRUE" ;
VAL_TABLE_ DTCI_SCL_PndngDTC 0 "FALSE" 1 "TRUE" ;
VAL_TABLE_ DTCI_SCL_DTCTriggered 0 "FALSE" 1 "TRUE" ;
VAL_TABLE_ DTCI_SCL_WrnIndTrggrd 0 "FALSE" 1 "TRUE" ;
VAL_TABLE_ DTCI_SCL_WrnIndRqd 0 "FALSE" 1 "TRUE" ;
VAL_TABLE_ DTCI_SDM_AV_CnfrmdDTC 0 "FALSE" 1 "TRUE" ;
VAL_TABLE_ DTCI_SDM_AV_DTCFaultType 0 "Not Supported" 1 "Type A" 2 "Type B" 3 "Type C" ;
VAL_TABLE_ DTCI_SDM_AV_TstNCmpltdOpCyc 0 "FALSE" 1 "TRUE" ;
VAL_TABLE_ DTCI_SDM_AV_TstNCmpltdLstClr 0 "FALSE" 1 "TRUE" ;
VAL_TABLE_ DTCI_SDM_AV_TstFldOpCyc 0 "FALSE" 1 "TRUE" ;
VAL_TABLE_ DTCI_SDM_AV_TstFldLstClr 0 "FALSE" 1 "TRUE" ;
VAL_TABLE_ DTCI_SDM_AV_TstFld 0 "FALSE" 1 "TRUE" ;
VAL_TABLE_ DTCI_SDM_AV_PndngDTC 0 "FALSE" 1 "TRUE" ;
VAL_TABLE_ DTCI_SDM_AV_DTCTriggered 0 "FALSE" 1 "TRUE" ;
VAL_TABLE_ DTCI_SDM_AV_WrnIndTrggrd 0 "FALSE" 1 "TRUE" ;
VAL_TABLE_ DTCI_SDM_AV_WrnIndRqd 0 "FALSE" 1 "TRUE" ;
VAL_TABLE_ DTCI_SDM_CnfrmdDTC 0 "FALSE" 1 "TRUE" ;
VAL_TABLE_ DTCI_SDM_DTCFaultType 0 "Not Supported" 1 "Type A" 2 "Type B" 3 "Type C" ;
VAL_TABLE_ DTCI_SDM_TstNCmpltdOpCyc 0 "FALSE" 1 "TRUE" ;
VAL_TABLE_ DTCI_SDM_TstNCmpltdLstClr 0 "FALSE" 1 "TRUE" ;
VAL_TABLE_ DTCI_SDM_TstFldOpCyc 0 "FALSE" 1 "TRUE" ;
VAL_TABLE_ DTCI_SDM_TstFldLstClr 0 "FALSE" 1 "TRUE" ;
VAL_TABLE_ DTCI_SDM_TstFld 0 "FALSE" 1 "TRUE" ;
VAL_TABLE_ DTCI_SDM_PndngDTC 0 "FALSE" 1 "TRUE" ;
VAL_TABLE_ DTCI_SDM_DTCTriggered 0 "FALSE" 1 "TRUE" ;
VAL_TABLE_ DTCI_SDM_WrnIndTrggrd 0 "FALSE" 1 "TRUE" ;
VAL_TABLE_ DTCI_SDM_WrnIndRqd 0 "FALSE" 1 "TRUE" ;
VAL_TABLE_ DTCI_SIB_CnfrmdDTC 0 "FALSE" 1 "TRUE" ;
VAL_TABLE_ DTCI_SIB_DTCFaultType 0 "Not Supported" 1 "Type A" 2 "Type B" 3 "Type C" ;
VAL_TABLE_ DTCI_SIB_TstNCmpltdOpCyc 0 "FALSE" 1 "TRUE" ;
VAL_TABLE_ DTCI_SIB_TstNCmpltdLstClr 0 "FALSE" 1 "TRUE" ;
VAL_TABLE_ DTCI_SIB_TstFldOpCyc 0 "FALSE" 1 "TRUE" ;
VAL_TABLE_ DTCI_SIB_TstFldLstClr 0 "FALSE" 1 "TRUE" ;
VAL_TABLE_ DTCI_SIB_TstFld 0 "FALSE" 1 "TRUE" ;
VAL_TABLE_ DTCI_SIB_PndngDTC 0 "FALSE" 1 "TRUE" ;
VAL_TABLE_ DTCI_SIB_DTCTriggered 0 "FALSE" 1 "TRUE" ;
VAL_TABLE_ DTCI_SIB_WrnIndTrggrd 0 "FALSE" 1 "TRUE" ;
VAL_TABLE_ DTCI_SIB_WrnIndRqd 0 "FALSE" 1 "TRUE" ;
VAL_TABLE_ DTCI_SRR_LF_CnfrmdDTC 0 "FALSE" 1 "TRUE" ;
VAL_TABLE_ DTCI_SRR_LF_DTCFaultType 0 "Not Supported" 1 "Type A" 2 "Type B" 3 "Type C" ;
VAL_TABLE_ DTCI_SRR_LF_TstNCmpltdOpCyc 0 "FALSE" 1 "TRUE" ;
VAL_TABLE_ DTCI_SRR_LF_TstNCmpltdLstClr 0 "FALSE" 1 "TRUE" ;
VAL_TABLE_ DTCI_SRR_LF_TstFldOpCyc 0 "FALSE" 1 "TRUE" ;
VAL_TABLE_ DTCI_SRR_LF_TstFldLstClr 0 "FALSE" 1 "TRUE" ;
VAL_TABLE_ DTCI_SRR_LF_TstFld 0 "FALSE" 1 "TRUE" ;
VAL_TABLE_ DTCI_SRR_LF_PndngDTC 0 "FALSE" 1 "TRUE" ;
VAL_TABLE_ DTCI_SRR_LF_DTCTriggered 0 "FALSE" 1 "TRUE" ;
VAL_TABLE_ DTCI_SRR_LF_WrnIndTrggrd 0 "FALSE" 1 "TRUE" ;
VAL_TABLE_ DTCI_SRR_LF_WrnIndRqd 0 "FALSE" 1 "TRUE" ;
VAL_TABLE_ DTCI_SRR_LR_CR_CnfrmdDTC 0 "FALSE" 1 "TRUE" ;
VAL_TABLE_ DTCI_SRR_LR_CR_DTCFaultType 0 "Not Supported" 1 "Type A" 2 "Type B" 3 "Type C" ;
VAL_TABLE_ DTCI_SRR_LR_CR_TstNCmpltdOpCyc 0 "FALSE" 1 "TRUE" ;
VAL_TABLE_ DTCI_SRR_LR_CR_TstNCmpltdLstClr 0 "FALSE" 1 "TRUE" ;
VAL_TABLE_ DTCI_SRR_LR_CR_TstFldOpCyc 0 "FALSE" 1 "TRUE" ;
VAL_TABLE_ DTCI_SRR_LR_CR_TstFldLstClr 0 "FALSE" 1 "TRUE" ;
VAL_TABLE_ DTCI_SRR_LR_CR_TstFld 0 "FALSE" 1 "TRUE" ;
VAL_TABLE_ DTCI_SRR_LR_CR_PndngDTC 0 "FALSE" 1 "TRUE" ;
VAL_TABLE_ DTCI_SRR_LR_CR_DTCTriggered 0 "FALSE" 1 "TRUE" ;
VAL_TABLE_ DTCI_SRR_LR_CR_WrnIndTrggrd 0 "FALSE" 1 "TRUE" ;
VAL_TABLE_ DTCI_SRR_LR_CR_WrnIndRqd 0 "FALSE" 1 "TRUE" ;
VAL_TABLE_ DTCI_SRR_RF_CnfrmdDTC 0 "FALSE" 1 "TRUE" ;
VAL_TABLE_ DTCI_SRR_RF_DTCFaultType 0 "Not Supported" 1 "Type A" 2 "Type B" 3 "Type C" ;
VAL_TABLE_ DTCI_SRR_RF_TstNCmpltdOpCyc 0 "FALSE" 1 "TRUE" ;
VAL_TABLE_ DTCI_SRR_RF_TstNCmpltdLstClr 0 "FALSE" 1 "TRUE" ;
VAL_TABLE_ DTCI_SRR_RF_TstFldOpCyc 0 "FALSE" 1 "TRUE" ;
VAL_TABLE_ DTCI_SRR_RF_TstFldLstClr 0 "FALSE" 1 "TRUE" ;
VAL_TABLE_ DTCI_SRR_RF_TstFld 0 "FALSE" 1 "TRUE" ;
VAL_TABLE_ DTCI_SRR_RF_PndngDTC 0 "FALSE" 1 "TRUE" ;
VAL_TABLE_ DTCI_SRR_RF_DTCTriggered 0 "FALSE" 1 "TRUE" ;
VAL_TABLE_ DTCI_SRR_RF_WrnIndTrggrd 0 "FALSE" 1 "TRUE" ;
VAL_TABLE_ DTCI_SRR_RF_WrnIndRqd 0 "FALSE" 1 "TRUE" ;
VAL_TABLE_ DTCI_SRR_RR_CnfrmdDTC 0 "FALSE" 1 "TRUE" ;
VAL_TABLE_ DTCI_SRR_RR_DTCFaultType 0 "Not Supported" 1 "Type A" 2 "Type B" 3 "Type C" ;
VAL_TABLE_ DTCI_SRR_RR_TstNCmpltdOpCyc 0 "FALSE" 1 "TRUE" ;
VAL_TABLE_ DTCI_SRR_RR_TstNCmpltdLstClr 0 "FALSE" 1 "TRUE" ;
VAL_TABLE_ DTCI_SRR_RR_TstFldOpCyc 0 "FALSE" 1 "TRUE" ;
VAL_TABLE_ DTCI_SRR_RR_TstFldLstClr 0 "FALSE" 1 "TRUE" ;
VAL_TABLE_ DTCI_SRR_RR_TstFld 0 "FALSE" 1 "TRUE" ;
VAL_TABLE_ DTCI_SRR_RR_PndngDTC 0 "FALSE" 1 "TRUE" ;
VAL_TABLE_ DTCI_SRR_RR_DTCTriggered 0 "FALSE" 1 "TRUE" ;
VAL_TABLE_ DTCI_SRR_RR_WrnIndTrggrd 0 "FALSE" 1 "TRUE" ;
VAL_TABLE_ DTCI_SRR_RR_WrnIndRqd 0 "FALSE" 1 "TRUE" ;
VAL_TABLE_ DTCI_SRR_SLR_CnfrmdDTC 0 "FALSE" 1 "TRUE" ;
VAL_TABLE_ DTCI_SRR_SLR_DTCFaultType 0 "Not Supported" 1 "Type A" 2 "Type B" 3 "Type C" ;
VAL_TABLE_ DTCI_SRR_SLR_TstNCmpltdOpCyc 0 "FALSE" 1 "TRUE" ;
VAL_TABLE_ DTCI_SRR_SLR_TstNCmpltdLstClr 0 "FALSE" 1 "TRUE" ;
VAL_TABLE_ DTCI_SRR_SLR_TstFldOpCyc 0 "FALSE" 1 "TRUE" ;
VAL_TABLE_ DTCI_SRR_SLR_TstFldLstClr 0 "FALSE" 1 "TRUE" ;
VAL_TABLE_ DTCI_SRR_SLR_TstFld 0 "FALSE" 1 "TRUE" ;
VAL_TABLE_ DTCI_SRR_SLR_PndngDTC 0 "FALSE" 1 "TRUE" ;
VAL_TABLE_ DTCI_SRR_SLR_DTCTriggered 0 "FALSE" 1 "TRUE" ;
VAL_TABLE_ DTCI_SRR_SLR_WrnIndTrggrd 0 "FALSE" 1 "TRUE" ;
VAL_TABLE_ DTCI_SRR_SLR_WrnIndRqd 0 "FALSE" 1 "TRUE" ;
VAL_TABLE_ DTCI_SRR_SRR_CnfrmdDTC 0 "FALSE" 1 "TRUE" ;
VAL_TABLE_ DTCI_SRR_SRR_DTCFaultType 0 "Not Supported" 1 "Type A" 2 "Type B" 3 "Type C" ;
VAL_TABLE_ DTCI_SRR_SRR_TstNCmpltdOpCyc 0 "FALSE" 1 "TRUE" ;
VAL_TABLE_ DTCI_SRR_SRR_TstNCmpltdLstClr 0 "FALSE" 1 "TRUE" ;
VAL_TABLE_ DTCI_SRR_SRR_TstFldOpCyc 0 "FALSE" 1 "TRUE" ;
VAL_TABLE_ DTCI_SRR_SRR_TstFldLstClr 0 "FALSE" 1 "TRUE" ;
VAL_TABLE_ DTCI_SRR_SRR_TstFld 0 "FALSE" 1 "TRUE" ;
VAL_TABLE_ DTCI_SRR_SRR_PndngDTC 0 "FALSE" 1 "TRUE" ;
VAL_TABLE_ DTCI_SRR_SRR_DTCTriggered 0 "FALSE" 1 "TRUE" ;
VAL_TABLE_ DTCI_SRR_SRR_WrnIndTrggrd 0 "FALSE" 1 "TRUE" ;
VAL_TABLE_ DTCI_SRR_SRR_WrnIndRqd 0 "FALSE" 1 "TRUE" ;
VAL_TABLE_ DTCI_TCCM_CnfrmdDTC 0 "FALSE" 1 "TRUE" ;
VAL_TABLE_ DTCI_TCCM_DTCFaultType 0 "Not Supported" 1 "Type A" 2 "Type B" 3 "Type C" ;
VAL_TABLE_ DTCI_TCCM_TstNCmpltdOpCyc 0 "FALSE" 1 "TRUE" ;
VAL_TABLE_ DTCI_TCCM_TstNCmpltdLstClr 0 "FALSE" 1 "TRUE" ;
VAL_TABLE_ DTCI_TCCM_TstFldOpCyc 0 "FALSE" 1 "TRUE" ;
VAL_TABLE_ DTCI_TCCM_TstFldLstClr 0 "FALSE" 1 "TRUE" ;
VAL_TABLE_ DTCI_TCCM_TstFld 0 "FALSE" 1 "TRUE" ;
VAL_TABLE_ DTCI_TCCM_PndngDTC 0 "FALSE" 1 "TRUE" ;
VAL_TABLE_ DTCI_TCCM_DTCTriggered 0 "FALSE" 1 "TRUE" ;
VAL_TABLE_ DTCI_TCCM_WrnIndTrggrd 0 "FALSE" 1 "TRUE" ;
VAL_TABLE_ DTCI_TCCM_WrnIndRqd 0 "FALSE" 1 "TRUE" ;
VAL_TABLE_ DTCI_TCM_CnfrmdDTC 0 "FALSE" 1 "TRUE" ;
VAL_TABLE_ DTCI_TCM_DTCFaultType 0 "Not Supported" 1 "Type A" 2 "Type B" 3 "Type C" ;
VAL_TABLE_ DTCI_TCM_TstNCmpltdOpCyc 0 "FALSE" 1 "TRUE" ;
VAL_TABLE_ DTCI_TCM_TstNCmpltdLstClr 0 "FALSE" 1 "TRUE" ;
VAL_TABLE_ DTCI_TCM_TstFldOpCyc 0 "FALSE" 1 "TRUE" ;
VAL_TABLE_ DTCI_TCM_TstFldLstClr 0 "FALSE" 1 "TRUE" ;
VAL_TABLE_ DTCI_TCM_TstFld 0 "FALSE" 1 "TRUE" ;
VAL_TABLE_ DTCI_TCM_PndngDTC 0 "FALSE" 1 "TRUE" ;
VAL_TABLE_ DTCI_TCM_DTCTriggered 0 "FALSE" 1 "TRUE" ;
VAL_TABLE_ DTCI_TCM_WrnIndTrggrd 0 "FALSE" 1 "TRUE" ;
VAL_TABLE_ DTCI_TCM_WrnIndRqd 0 "FALSE" 1 "TRUE" ;
VAL_TABLE_ DTCI_TCP_CnfrmdDTC 0 "FALSE" 1 "TRUE" ;
VAL_TABLE_ DTCI_TCP_DTCFaultType 0 "Not Supported" 1 "Type A" 2 "Type B" 3 "Type C" ;
VAL_TABLE_ DTCI_TCP_TstNCmpltdOpCyc 0 "FALSE" 1 "TRUE" ;
VAL_TABLE_ DTCI_TCP_TstNCmpltdLstClr 0 "FALSE" 1 "TRUE" ;
VAL_TABLE_ DTCI_TCP_TstFldOpCyc 0 "FALSE" 1 "TRUE" ;
VAL_TABLE_ DTCI_TCP_TstFldLstClr 0 "FALSE" 1 "TRUE" ;
VAL_TABLE_ DTCI_TCP_TstFld 0 "FALSE" 1 "TRUE" ;
VAL_TABLE_ DTCI_TCP_PndngDTC 0 "FALSE" 1 "TRUE" ;
VAL_TABLE_ DTCI_TCP_DTCTriggered 0 "FALSE" 1 "TRUE" ;
VAL_TABLE_ DTCI_TCP_WrnIndTrggrd 0 "FALSE" 1 "TRUE" ;
VAL_TABLE_ DTCI_TCP_WrnIndRqd 0 "FALSE" 1 "TRUE" ;
VAL_TABLE_ DTCI_TIM_CnfrmdDTC 0 "FALSE" 1 "TRUE" ;
VAL_TABLE_ DTCI_TIM_DTCFaultType 0 "Not Supported" 1 "Type A" 2 "Type B" 3 "Type C" ;
VAL_TABLE_ DTCI_TIM_TstNCmpltdOpCyc 0 "FALSE" 1 "TRUE" ;
VAL_TABLE_ DTCI_TIM_TstNCmpltdLstClr 0 "FALSE" 1 "TRUE" ;
VAL_TABLE_ DTCI_TIM_TstFldOpCyc 0 "FALSE" 1 "TRUE" ;
VAL_TABLE_ DTCI_TIM_TstFldLstClr 0 "FALSE" 1 "TRUE" ;
VAL_TABLE_ DTCI_TIM_TstFld 0 "FALSE" 1 "TRUE" ;
VAL_TABLE_ DTCI_TIM_PndngDTC 0 "FALSE" 1 "TRUE" ;
VAL_TABLE_ DTCI_TIM_DTCTriggered 0 "FALSE" 1 "TRUE" ;
VAL_TABLE_ DTCI_TIM_WrnIndTrggrd 0 "FALSE" 1 "TRUE" ;
VAL_TABLE_ DTCI_TIM_WrnIndRqd 0 "FALSE" 1 "TRUE" ;
VAL_TABLE_ DTCI_UPM_CnfrmdDTC 0 "FALSE" 1 "TRUE" ;
VAL_TABLE_ DTCI_UPM_DTCFaultType 0 "Not Supported" 1 "Type A" 2 "Type B" 3 "Type C" ;
VAL_TABLE_ DTCI_UPM_TstNCmpltdOpCyc 0 "FALSE" 1 "TRUE" ;
VAL_TABLE_ DTCI_UPM_TstNCmpltdLstClr 0 "FALSE" 1 "TRUE" ;
VAL_TABLE_ DTCI_UPM_TstFldOpCyc 0 "FALSE" 1 "TRUE" ;
VAL_TABLE_ DTCI_UPM_TstFldLstClr 0 "FALSE" 1 "TRUE" ;
VAL_TABLE_ DTCI_UPM_TstFld 0 "FALSE" 1 "TRUE" ;
VAL_TABLE_ DTCI_UPM_PndngDTC 0 "FALSE" 1 "TRUE" ;
VAL_TABLE_ DTCI_UPM_DTCTriggered 0 "FALSE" 1 "TRUE" ;
VAL_TABLE_ DTCI_UPM_WrnIndTrggrd 0 "FALSE" 1 "TRUE" ;
VAL_TABLE_ DTCI_UPM_WrnIndRqd 0 "FALSE" 1 "TRUE" ;
VAL_TABLE_ DTCI_UVM_CnfrmdDTC 0 "FALSE" 1 "TRUE" ;
VAL_TABLE_ DTCI_UVM_DTCFaultType 0 "Not Supported" 1 "Type A" 2 "Type B" 3 "Type C" ;
VAL_TABLE_ DTCI_UVM_TstNCmpltdOpCyc 0 "FALSE" 1 "TRUE" ;
VAL_TABLE_ DTCI_UVM_TstNCmpltdLstClr 0 "FALSE" 1 "TRUE" ;
VAL_TABLE_ DTCI_UVM_TstFldOpCyc 0 "FALSE" 1 "TRUE" ;
VAL_TABLE_ DTCI_UVM_TstFldLstClr 0 "FALSE" 1 "TRUE" ;
VAL_TABLE_ DTCI_UVM_TstFld 0 "FALSE" 1 "TRUE" ;
VAL_TABLE_ DTCI_UVM_PndngDTC 0 "FALSE" 1 "TRUE" ;
VAL_TABLE_ DTCI_UVM_DTCTriggered 0 "FALSE" 1 "TRUE" ;
VAL_TABLE_ DTCI_UVM_WrnIndTrggrd 0 "FALSE" 1 "TRUE" ;
VAL_TABLE_ DTCI_UVM_WrnIndRqd 0 "FALSE" 1 "TRUE" ;
VAL_TABLE_ DTCI_VCU_CnfrmdDTC 0 "FALSE" 1 "TRUE" ;
VAL_TABLE_ DTCI_VCU_DTCFaultType 0 "Not Supported" 1 "Type A" 2 "Type B" 3 "Type C" ;
VAL_TABLE_ DTCI_VCU_TstNCmpltdOpCyc 0 "FALSE" 1 "TRUE" ;
VAL_TABLE_ DTCI_VCU_TstNCmpltdLstClr 0 "FALSE" 1 "TRUE" ;
VAL_TABLE_ DTCI_VCU_TstFldOpCyc 0 "FALSE" 1 "TRUE" ;
VAL_TABLE_ DTCI_VCU_TstFldLstClr 0 "FALSE" 1 "TRUE" ;
VAL_TABLE_ DTCI_VCU_TstFld 0 "FALSE" 1 "TRUE" ;
VAL_TABLE_ DTCI_VCU_PndngDTC 0 "FALSE" 1 "TRUE" ;
VAL_TABLE_ DTCI_VCU_DTCTriggered 0 "FALSE" 1 "TRUE" ;
VAL_TABLE_ DTCI_VCU_WrnIndTrggrd 0 "FALSE" 1 "TRUE" ;
VAL_TABLE_ DTCI_VCU_WrnIndRqd 0 "FALSE" 1 "TRUE" ;
VAL_TABLE_ DTCI_VDM_CnfrmdDTC 0 "FALSE" 1 "TRUE" ;
VAL_TABLE_ DTCI_VDM_DTCFaultType 0 "Not Supported" 1 "Type A" 2 "Type B" 3 "Type C" ;
VAL_TABLE_ DTCI_VDM_TstNCmpltdOpCyc 0 "FALSE" 1 "TRUE" ;
VAL_TABLE_ DTCI_VDM_TstNCmpltdLstClr 0 "FALSE" 1 "TRUE" ;
VAL_TABLE_ DTCI_VDM_TstFldOpCyc 0 "FALSE" 1 "TRUE" ;
VAL_TABLE_ DTCI_VDM_TstFldLstClr 0 "FALSE" 1 "TRUE" ;
VAL_TABLE_ DTCI_VDM_TstFld 0 "FALSE" 1 "TRUE" ;
VAL_TABLE_ DTCI_VDM_PndngDTC 0 "FALSE" 1 "TRUE" ;
VAL_TABLE_ DTCI_VDM_DTCTriggered 0 "FALSE" 1 "TRUE" ;
VAL_TABLE_ DTCI_VDM_WrnIndTrggrd 0 "FALSE" 1 "TRUE" ;
VAL_TABLE_ DTCI_VDM_WrnIndRqd 0 "FALSE" 1 "TRUE" ;
VAL_TABLE_ DTCI_VECM_CnfrmdDTC 0 "FALSE" 1 "TRUE" ;
VAL_TABLE_ DTCI_VECM_DTCFaultType 0 "Not Supported" 1 "Type A" 2 "Type B" 3 "Type C" ;
VAL_TABLE_ DTCI_VECM_TstNCmpltdOpCyc 0 "FALSE" 1 "TRUE" ;
VAL_TABLE_ DTCI_VECM_TstNCmpltdLstClr 0 "FALSE" 1 "TRUE" ;
VAL_TABLE_ DTCI_VECM_TstFldOpCyc 0 "FALSE" 1 "TRUE" ;
VAL_TABLE_ DTCI_VECM_TstFldLstClr 0 "FALSE" 1 "TRUE" ;
VAL_TABLE_ DTCI_VECM_TstFld 0 "FALSE" 1 "TRUE" ;
VAL_TABLE_ DTCI_VECM_PndngDTC 0 "FALSE" 1 "TRUE" ;
VAL_TABLE_ DTCI_VECM_DTCTriggered 0 "FALSE" 1 "TRUE" ;
VAL_TABLE_ DTCI_VECM_WrnIndTrggrd 0 "FALSE" 1 "TRUE" ;
VAL_TABLE_ DTCI_VECM_WrnIndRqd 0 "FALSE" 1 "TRUE" ;
VAL_TABLE_ DTCI_VICM_CnfrmdDTC 0 "FALSE" 1 "TRUE" ;
VAL_TABLE_ DTCI_VICM_DTCFaultType 0 "Not Supported" 1 "Type A" 2 "Type B" 3 "Type C" ;
VAL_TABLE_ DTCI_VICM_TstNCmpltdOpCyc 0 "FALSE" 1 "TRUE" ;
VAL_TABLE_ DTCI_VICM_TstNCmpltdLstClr 0 "FALSE" 1 "TRUE" ;
VAL_TABLE_ DTCI_VICM_TstFldOpCyc 0 "FALSE" 1 "TRUE" ;
VAL_TABLE_ DTCI_VICM_TstFldLstClr 0 "FALSE" 1 "TRUE" ;
VAL_TABLE_ DTCI_VICM_TstFld 0 "FALSE" 1 "TRUE" ;
VAL_TABLE_ DTCI_VICM_PndngDTC 0 "FALSE" 1 "TRUE" ;
VAL_TABLE_ DTCI_VICM_DTCTriggered 0 "FALSE" 1 "TRUE" ;
VAL_TABLE_ DTCI_VICM_WrnIndTrggrd 0 "FALSE" 1 "TRUE" ;
VAL_TABLE_ DTCI_VICM_WrnIndRqd 0 "FALSE" 1 "TRUE" ;
VAL_TABLE_ DTCI_VKM_CnfrmdDTC 0 "FALSE" 1 "TRUE" ;
VAL_TABLE_ DTCI_VKM_DTCFaultType 0 "Not Supported" 1 "Type A" 2 "Type B" 3 "Type C" ;
VAL_TABLE_ DTCI_VKM_TstNCmpltdOpCyc 0 "FALSE" 1 "TRUE" ;
VAL_TABLE_ DTCI_VKM_TstNCmpltdLstClr 0 "FALSE" 1 "TRUE" ;
VAL_TABLE_ DTCI_VKM_TstFldOpCyc 0 "FALSE" 1 "TRUE" ;
VAL_TABLE_ DTCI_VKM_TstFldLstClr 0 "FALSE" 1 "TRUE" ;
VAL_TABLE_ DTCI_VKM_TstFld 0 "FALSE" 1 "TRUE" ;
VAL_TABLE_ DTCI_VKM_PndngDTC 0 "FALSE" 1 "TRUE" ;
VAL_TABLE_ DTCI_VKM_DTCTriggered 0 "FALSE" 1 "TRUE" ;
VAL_TABLE_ DTCI_VKM_WrnIndTrggrd 0 "FALSE" 1 "TRUE" ;
VAL_TABLE_ DTCI_VKM_WrnIndRqd 0 "FALSE" 1 "TRUE" ;
VAL_TABLE_ DTCI_VLM_CnfrmdDTC 0 "FALSE" 1 "TRUE" ;
VAL_TABLE_ DTCI_VLM_DTCFaultType 0 "Not Supported" 1 "Type A" 2 "Type B" 3 "Type C" ;
VAL_TABLE_ DTCI_VLM_TstNCmpltdOpCyc 0 "FALSE" 1 "TRUE" ;
VAL_TABLE_ DTCI_VLM_TstNCmpltdLstClr 0 "FALSE" 1 "TRUE" ;
VAL_TABLE_ DTCI_VLM_TstFldOpCyc 0 "FALSE" 1 "TRUE" ;
VAL_TABLE_ DTCI_VLM_TstFldLstClr 0 "FALSE" 1 "TRUE" ;
VAL_TABLE_ DTCI_VLM_TstFld 0 "FALSE" 1 "TRUE" ;
VAL_TABLE_ DTCI_VLM_PndngDTC 0 "FALSE" 1 "TRUE" ;
VAL_TABLE_ DTCI_VLM_DTCTriggered 0 "FALSE" 1 "TRUE" ;
VAL_TABLE_ DTCI_VLM_WrnIndTrggrd 0 "FALSE" 1 "TRUE" ;
VAL_TABLE_ DTCI_VLM_WrnIndRqd 0 "FALSE" 1 "TRUE" ;
VAL_TABLE_ DTCI_VPM_CnfrmdDTC 0 "FALSE" 1 "TRUE" ;
VAL_TABLE_ DTCI_VPM_DTCFaultType 0 "Not Supported" 1 "Type A" 2 "Type B" 3 "Type C" ;
VAL_TABLE_ DTCI_VPM_TstNCmpltdOpCyc 0 "FALSE" 1 "TRUE" ;
VAL_TABLE_ DTCI_VPM_TstNCmpltdLstClr 0 "FALSE" 1 "TRUE" ;
VAL_TABLE_ DTCI_VPM_TstFldOpCyc 0 "FALSE" 1 "TRUE" ;
VAL_TABLE_ DTCI_VPM_TstFldLstClr 0 "FALSE" 1 "TRUE" ;
VAL_TABLE_ DTCI_VPM_TstFld 0 "FALSE" 1 "TRUE" ;
VAL_TABLE_ DTCI_VPM_PndngDTC 0 "FALSE" 1 "TRUE" ;
VAL_TABLE_ DTCI_VPM_DTCTriggered 0 "FALSE" 1 "TRUE" ;
VAL_TABLE_ DTCI_VPM_WrnIndTrggrd 0 "FALSE" 1 "TRUE" ;
VAL_TABLE_ DTCI_VPM_WrnIndRqd 0 "FALSE" 1 "TRUE" ;
VAL_TABLE_ DTCI_WCM2_CnfrmdDTC 0 "FALSE" 1 "TRUE" ;
VAL_TABLE_ DTCI_WCM2_DTCFaultType 0 "Not Supported" 1 "Type A" 2 "Type B" 3 "Type C" ;
VAL_TABLE_ DTCI_WCM2_TstNCmpltdOpCyc 0 "FALSE" 1 "TRUE" ;
VAL_TABLE_ DTCI_WCM2_TstNCmpltdLstClr 0 "FALSE" 1 "TRUE" ;
VAL_TABLE_ DTCI_WCM2_TstFldOpCyc 0 "FALSE" 1 "TRUE" ;
VAL_TABLE_ DTCI_WCM2_TstFldLstClr 0 "FALSE" 1 "TRUE" ;
VAL_TABLE_ DTCI_WCM2_TstFld 0 "FALSE" 1 "TRUE" ;
VAL_TABLE_ DTCI_WCM2_PndngDTC 0 "FALSE" 1 "TRUE" ;
VAL_TABLE_ DTCI_WCM2_DTCTriggered 0 "FALSE" 1 "TRUE" ;
VAL_TABLE_ DTCI_WCM2_WrnIndTrggrd 0 "FALSE" 1 "TRUE" ;
VAL_TABLE_ DTCI_WCM2_WrnIndRqd 0 "FALSE" 1 "TRUE" ;
VAL_TABLE_ DTCI_WCM3_CnfrmdDTC 0 "FALSE" 1 "TRUE" ;
VAL_TABLE_ DTCI_WCM3_DTCFaultType 0 "Not Supported" 1 "Type A" 2 "Type B" 3 "Type C" ;
VAL_TABLE_ DTCI_WCM3_TstNCmpltdOpCyc 0 "FALSE" 1 "TRUE" ;
VAL_TABLE_ DTCI_WCM3_TstNCmpltdLstClr 0 "FALSE" 1 "TRUE" ;
VAL_TABLE_ DTCI_WCM3_TstFldOpCyc 0 "FALSE" 1 "TRUE" ;
VAL_TABLE_ DTCI_WCM3_TstFldLstClr 0 "FALSE" 1 "TRUE" ;
VAL_TABLE_ DTCI_WCM3_TstFld 0 "FALSE" 1 "TRUE" ;
VAL_TABLE_ DTCI_WCM3_PndngDTC 0 "FALSE" 1 "TRUE" ;
VAL_TABLE_ DTCI_WCM3_DTCTriggered 0 "FALSE" 1 "TRUE" ;
VAL_TABLE_ DTCI_WCM3_WrnIndTrggrd 0 "FALSE" 1 "TRUE" ;
VAL_TABLE_ DTCI_WCM3_WrnIndRqd 0 "FALSE" 1 "TRUE" ;
VAL_TABLE_ DTCI_WCM4_CnfrmdDTC 0 "FALSE" 1 "TRUE" ;
VAL_TABLE_ DTCI_WCM4_DTCFaultType 0 "Not Supported" 1 "Type A" 2 "Type B" 3 "Type C" ;
VAL_TABLE_ DTCI_WCM4_TstNCmpltdOpCyc 0 "FALSE" 1 "TRUE" ;
VAL_TABLE_ DTCI_WCM4_TstNCmpltdLstClr 0 "FALSE" 1 "TRUE" ;
VAL_TABLE_ DTCI_WCM4_TstFldOpCyc 0 "FALSE" 1 "TRUE" ;
VAL_TABLE_ DTCI_WCM4_TstFldLstClr 0 "FALSE" 1 "TRUE" ;
VAL_TABLE_ DTCI_WCM4_TstFld 0 "FALSE" 1 "TRUE" ;
VAL_TABLE_ DTCI_WCM4_PndngDTC 0 "FALSE" 1 "TRUE" ;
VAL_TABLE_ DTCI_WCM4_DTCTriggered 0 "FALSE" 1 "TRUE" ;
VAL_TABLE_ DTCI_WCM4_WrnIndTrggrd 0 "FALSE" 1 "TRUE" ;
VAL_TABLE_ DTCI_WCM4_WrnIndRqd 0 "FALSE" 1 "TRUE" ;
VAL_TABLE_ DTCI_WCM_CnfrmdDTC 0 "FALSE" 1 "TRUE" ;
VAL_TABLE_ DTCI_WCM_DTCFaultType 0 "Not Supported" 1 "Type A" 2 "Type B" 3 "Type C" ;
VAL_TABLE_ DTCI_WCM_TstNCmpltdOpCyc 0 "FALSE" 1 "TRUE" ;
VAL_TABLE_ DTCI_WCM_TstNCmpltdLstClr 0 "FALSE" 1 "TRUE" ;
VAL_TABLE_ DTCI_WCM_TstFldOpCyc 0 "FALSE" 1 "TRUE" ;
VAL_TABLE_ DTCI_WCM_TstFldLstClr 0 "FALSE" 1 "TRUE" ;
VAL_TABLE_ DTCI_WCM_TstFld 0 "FALSE" 1 "TRUE" ;
VAL_TABLE_ DTCI_WCM_PndngDTC 0 "FALSE" 1 "TRUE" ;
VAL_TABLE_ DTCI_WCM_DTCTriggered 0 "FALSE" 1 "TRUE" ;
VAL_TABLE_ DTCI_WCM_WrnIndTrggrd 0 "FALSE" 1 "TRUE" ;
VAL_TABLE_ DTCI_WCM_WrnIndRqd 0 "FALSE" 1 "TRUE" ;
VAL_TABLE_ DDIP_SecAxl4WDAWDTmpInhbIOAuth 0 "FALSE" 1 "TRUE" ;
VAL_TABLE_ DDIP_SecAxl4WDAWDNonEmMlfIOAuth 0 "FALSE" 1 "TRUE" ;
VAL_TABLE_ DDIP_4AndAllWhlDrvIndReqAuth 0 "No Indication" 1 "Two Wheel Drive High Pending" 2 "Two Wheel Drive High Active" 3 "Four Wheel Drive High Auto Pending" 4 "Four Wheel Drive High Auto Active" 5 "Four Wheel Drive High Lock Pending" 6 "Four Wheel Drive High Lock Active" 7 "Four Wheel Drive Low Lock Pending" 8 "Four Wheel Drive Low Lock Active" 9 "Transfer Case Neutral Pending" 10 "Transfer Case Neutral Active" 11 "Position Undetermined Active" 12 "AWD Connected Mode Pending" 13 "AWD Connected Mode Active" 14 "Front Wheel Drive Mode Pending" 15 "Front Wheel Drive Mode Active" ;
VAL_TABLE_ WhlAngVelLFrtAuth_Inv 0 "FALSE" 1 "TRUE" ;
VAL_TABLE_ WhlAngVelLRrAuth_Inv 0 "FALSE" 1 "TRUE" ;
VAL_TABLE_ WhlAngVelRFrtAuth_Inv 0 "FALSE" 1 "TRUE" ;
VAL_TABLE_ WhlAngVelRRrAuth_Inv 0 "FALSE" 1 "TRUE" ;
VAL_TABLE_ CBIP_BrkPedPstnEmsRltdAuth_Inv 0 "FALSE" 1 "TRUE" ;
VAL_TABLE_ CBIP_ACCBrkgStsAuth 0 "Not Active" 1 "Active" 2 "Failed" ;
VAL_TABLE_ BSIRP_HillDscntCtlStsAuth 0 "Not Enabled" 1 "Enabled" 2 "Active" ;
VAL_TABLE_ LDGI1_LgslDiagStdCondsMet 0 "FALSE" 1 "TRUE" ;
VAL_TABLE_ FWDECP_LFAuth_Inv 0 "FALSE" 1 "TRUE" ;
VAL_TABLE_ FWDECP_RFAuth_Inv 0 "FALSE" 1 "TRUE" ;
VAL_TABLE_ RWDECP_LRAuth_Inv 0 "FALSE" 1 "TRUE" ;
VAL_TABLE_ RWDECP_RRAuth_Inv 0 "FALSE" 1 "TRUE" ;
VAL_TABLE_ RWDECP_RstOccAuth 0 "FALSE" 1 "TRUE" ;
VAL_TABLE_ FWDECP_RstOccAuth 0 "FALSE" 1 "TRUE" ;
VAL_TABLE_ PrplSysMtrBSpdAuth_Public_Inv 0 "FALSE" 1 "TRUE" ;
VAL_TABLE_ PrplSysMtrCSpdAuth_Public_Inv 0 "FALSE" 1 "TRUE" ;
VAL_TABLE_ ESRSDP_ElecShftRngSecDispAuth 0 "No Display" 1 "Park Nominal" 2 "Reverse Nominal" 3 "Neutral Nominal" 4 "Drive Nominal" 5 "Low Nominal" 6 "Manual Nominal" 7 "Park Requested And In Progress" 8 "Reverse Requested And In Progress" 9 "Neutral Requested And In Progress" 10 "Drive Requested And In Progress" 11 "Manual Requested And In Progress" 12 "Park Requested And Denied" ;
VAL_TABLE_ ESCLP_StrgColLckdIndOnAuth 0 "FALSE" 1 "TRUE" ;
VAL_TABLE_ ESCLP_ServColLckIndOnAuth 0 "FALSE" 1 "TRUE" ;
VAL_TABLE_ ESCLP_ElecStrgColLckStsAuth 0 "Locked" 1 "Inbetween" 2 "Unlocked" 3 "Unknown" ;
VAL_TABLE_ ESVTSP_EnhdSrvsVhTpSpLimReqAuth 0 "No Action" 1 "Active" 2 "Inactive" ;
VAL_TABLE_ FOMI_ACP2_MCU_DTCTriggered 0 "FALSE" 1 "TRUE" ;
VAL_TABLE_ FOMI_ACP3_MCU_DTCTriggered 0 "FALSE" 1 "TRUE" ;
VAL_TABLE_ FOMI_ACP4_MCU_DTCTriggered 0 "FALSE" 1 "TRUE" ;
VAL_TABLE_ FOMI_BCM_DTCTriggered 0 "FALSE" 1 "TRUE" ;
VAL_TABLE_ FOMI_BSM_DTCTriggered 0 "FALSE" 1 "TRUE" ;
VAL_TABLE_ FOMI_EBCM_DTCTriggered 0 "FALSE" 1 "TRUE" ;
VAL_TABLE_ FOMI_ECM_DTCTriggered 0 "FALSE" 1 "TRUE" ;
VAL_TABLE_ FOMI_ECP_E_DTCTriggered 0 "FALSE" 1 "TRUE" ;
VAL_TABLE_ FOMI_ECP_H1_DTCTriggered 0 "FALSE" 1 "TRUE" ;
VAL_TABLE_ FOMI_ECP_H2_DTCTriggered 0 "FALSE" 1 "TRUE" ;
VAL_TABLE_ FOMI_ECP_H3_DTCTriggered 0 "FALSE" 1 "TRUE" ;
VAL_TABLE_ FOMI_ECP_S2_DTCTriggered 0 "FALSE" 1 "TRUE" ;
VAL_TABLE_ FOMI_ECP_S_DTCTriggered 0 "FALSE" 1 "TRUE" ;
VAL_TABLE_ FOMI_ECP_X1_DTCTriggered 0 "FALSE" 1 "TRUE" ;
VAL_TABLE_ FOMI_ELM_DTCTriggered 0 "FALSE" 1 "TRUE" ;
VAL_TABLE_ FOMI_EOCM_HCP1_DTCTriggered 0 "FALSE" 1 "TRUE" ;
VAL_TABLE_ FOMI_EOCM_DTCTriggered 0 "FALSE" 1 "TRUE" ;
VAL_TABLE_ FOMI_ICCM_DTCTriggered 0 "FALSE" 1 "TRUE" ;
VAL_TABLE_ FOMI_PCM_DTCTriggered 0 "FALSE" 1 "TRUE" ;
VAL_TABLE_ FOMI_TCM_DTCTriggered 0 "FALSE" 1 "TRUE" ;
VAL_TABLE_ FOMI_VECM_DTCTriggered 0 "FALSE" 1 "TRUE" ;
VAL_TABLE_ FOMI_VICM_DTCTriggered 0 "FALSE" 1 "TRUE" ;
VAL_TABLE_ FI_FiltdDispTotFlLvlPct_Inv 0 "FALSE" 1 "TRUE" ;
VAL_TABLE_ FI_FiltdDispTotFlLvlTnk2Pct_Inv 0 "FALSE" 1 "TRUE" ;
VAL_TABLE_ GPSQM_PPS2DAbsPstnErrEst_Inv 0 "FALSE" 1 "TRUE" ;
VAL_TABLE_ GPSQM_PPS3DAbsPstnErrEst_Inv 0 "FALSE" 1 "TRUE" ;
VAL_TABLE_ GPSQM_PPSMode_Inv 0 "FALSE" 1 "TRUE" ;
VAL_TABLE_ GPSQM_PPSMode 0 "GNSS Standalone" 1 "GNSS and SBAS" 2 "GNSS and RTX" 3 "GNSS and DR" 4 "GNSS and SBAS and DR" 5 "GNSS and RTX and DR" 6 "DR ONLY" 7 "GNSS and RTX and DR and MM" ;
VAL_TABLE_ GPSQM_PPSAbsVelErrEst_Inv 0 "FALSE" 1 "TRUE" ;
VAL_TABLE_ GPSQM_PPSAbsHdgErrEst_Inv 0 "FALSE" 1 "TRUE" ;
VAL_TABLE_ GPSQM_PPSPstnDilutnPrcsn_Inv 0 "FALSE" 1 "TRUE" ;
VAL_TABLE_ GPSC_PPSLat_Inv 0 "FALSE" 1 "TRUE" ;
VAL_TABLE_ GPSC_PPSLong_Inv 0 "FALSE" 1 "TRUE" ;
VAL_TABLE_ GPST_PPSCldrDy_Inv 0 "FALSE" 1 "TRUE" ;
VAL_TABLE_ GPST_PPSCldrYr_Inv 0 "FALSE" 1 "TRUE" ;
VAL_TABLE_ GPST_PPSTmOfDy_Inv 0 "FALSE" 1 "TRUE" ;
VAL_TABLE_ GPSV_PPSCalcdSpd_Inv 0 "FALSE" 1 "TRUE" ;
VAL_TABLE_ GPSV_PPSElvtn_Inv 0 "FALSE" 1 "TRUE" ;
VAL_TABLE_ GPSV_PPSHdg_Inv 0 "FALSE" 1 "TRUE" ;
VAL_TABLE_ CntrStckDispFlrIndOn 0 "FALSE" 1 "TRUE" ;
VAL_TABLE_ VirtCtlAuxAlrmSnsrReqAuth 0 "No Action" 1 "On" 2 "Off" ;
VAL_TABLE_ HMIGI3P_VirtCtlHdPrkLmpsReqAuth 0 "No Action" 1 "Off" 2 "Auto" 3 "Parking" 4 "On" ;
VAL_TABLE_ InfoWndMtnRRReq 0 "No Request" 1 "Move Fully Up" 2 "Move Fully Down" 3 "Vent" ;
VAL_TABLE_ InfoWndMtnLRReq 0 "No Request" 1 "Move Fully Up" 2 "Move Fully Down" 3 "Vent" ;
VAL_TABLE_ InfoWndMtnRFReq 0 "No Request" 1 "Move Fully Up" 2 "Move Fully Down" 3 "Vent" ;
VAL_TABLE_ InfoWndMtnLFReq 0 "No Request" 1 "Move Fully Up" 2 "Move Fully Down" 3 "Vent" ;
VAL_TABLE_ VirtCtlVehOnExtModeSwReqd 0 "FALSE" 1 "TRUE" ;
VAL_TABLE_ VirtCtlVehEmrgOffSwReqd 0 "FALSE" 1 "TRUE" ;
VAL_TABLE_ VirtCtlVehOffSwReq 0 "Not Pressed" 1 "Pressed" 2 "Press and Hold" ;
VAL_TABLE_ InfoSnrfPstnReq 0 "No Request" 1 "0%" 2 "10%" 3 "20%" 4 "30%" 5 "40%" 6 "50%" 7 "60%" 8 "70%" 9 "80%" 10 "90%" 11 "100%" ;
VAL_TABLE_ InfoWndPstnRRReqActv 0 "FALSE" 1 "TRUE" ;
VAL_TABLE_ HMII1P_LnFllwgChInterFltDtdAuth 0 "FALSE" 1 "TRUE" ;
VAL_TABLE_ HMII1P_IPCDispStsAuth 0 "Unknown" 1 "Normal" 2 "Fault" ;
VAL_TABLE_ HMII1P_ChmSysSOHAuth 0 "Unknown" 1 "Healthy" 2 "Faulted" ;
VAL_TABLE_ HMII1P_AutoModeSpdLimCnfrmdAuth 0 "FALSE" 1 "TRUE" ;
VAL_TABLE_ HMII1P_ACCSetTypAuth 0 "Manual" 1 "Auto" ;
VAL_TABLE_ InfoWndPstnRFReqActv 0 "FALSE" 1 "TRUE" ;
VAL_TABLE_ InfoWndPstnLRReqActv 0 "FALSE" 1 "TRUE" ;
VAL_TABLE_ InfoWndPstnLFReqActv 0 "FALSE" 1 "TRUE" ;
VAL_TABLE_ HVACFCRADSCF_LtChgNext 0 "FALSE" 1 "TRUE" ;
VAL_TABLE_ HVACFCRADSCF_RtChgNext 0 "FALSE" 1 "TRUE" ;
VAL_TABLE_ HVACFCRADSF_LtSet 0 "NoAction" 1 "Auto" 2 "Floor" 3 "FloorAndVent" 4 "Vent" 5 "VentAndWindshield" 6 "Windshield" 7 "FloorAndWindshield" 8 "FloorAndVentAndWindshield" ;
VAL_TABLE_ HVACFCRADSF_RtSet 0 "NoAction" 1 "Auto" 2 "Floor" 3 "FloorAndVent" 4 "Vent" 5 "VentAndWindshield" 6 "Windshield" 7 "FloorAndWindshield" 8 "FloorAndVentAndWindshield" ;
VAL_TABLE_ HVACFCRBLCF_ORH1 0 "FALSE" 1 "TRUE" ;
VAL_TABLE_ HVACFCRBLCF_CktCorr 0 "Indeterminate" 1 "Pass Criteria Met" 2 "Fail Criteria Met" ;
VAL_TABLE_ HVACFCRBLCF_ORL2 0 "FALSE" 1 "TRUE" ;
VAL_TABLE_ HVACFCRBLCF_ORL1 0 "FALSE" 1 "TRUE" ;
VAL_TABLE_ HVACFCRBLCF_ORH2 0 "FALSE" 1 "TRUE" ;
VAL_TABLE_ HVACFCRBLF_LvlActv 0 "FALSE" 1 "TRUE" ;
VAL_TABLE_ HVACFCRDP_FrtPwrSetChg_Inv 0 "FALSE" 1 "TRUE" ;
VAL_TABLE_ HVACFCRDP_FrtPwrSetChg 0 "FALSE" 1 "TRUE" ;
VAL_TABLE_ HVACFCRDP_IntrnlFltSts 0 "Fault1" 1 "Fault2" 2 "Fault3" 3 "Fault4" 4 "Fault5" 5 "Fault6" 6 "Fault7" 7 "Fault8" 8 "Fault9" 9 "Fault10" 10 "Fault11" 11 "Fault12" 12 "Fault13" 13 "Fault14" 14 "Fault15" 15 "Fault16" ;
VAL_TABLE_ HVACFCRDP_InitFin 0 "FALSE" 1 "TRUE" ;
VAL_TABLE_ HVACFCRDP_HtdFrtWshldSetChgd 0 "FALSE" 1 "TRUE" ;
VAL_TABLE_ HVACFCRDP_MaxDefrSetChg 0 "FALSE" 1 "TRUE" ;
VAL_TABLE_ HVACFCRRFA_FrshAirSetChg 0 "FALSE" 1 "TRUE" ;
VAL_TABLE_ HVACFCRRFA_FrtAutoSetChg 0 "FALSE" 1 "TRUE" ;
VAL_TABLE_ HVACFCRRFA_RecircSetChg 0 "FALSE" 1 "TRUE" ;
VAL_TABLE_ HVACFCRTLCFL_CktCorr 0 "Indeterminate" 1 "Pass Criteria Met" 2 "Fail Criteria Met" ;
VAL_TABLE_ HVACFCRTLCFL_ORL3 0 "FALSE" 1 "TRUE" ;
VAL_TABLE_ HVACFCRTLCFL_ORL2 0 "FALSE" 1 "TRUE" ;
VAL_TABLE_ HVACFCRTLCFL_ORL1 0 "FALSE" 1 "TRUE" ;
VAL_TABLE_ HVACFCRTLCFL_ORH3 0 "FALSE" 1 "TRUE" ;
VAL_TABLE_ HVACFCRTLCFL_ORH2 0 "FALSE" 1 "TRUE" ;
VAL_TABLE_ HVACFCRTLCFL_ORH1 0 "FALSE" 1 "TRUE" ;
VAL_TABLE_ HVACFCRTLCFR_CktCorr 0 "Indeterminate" 1 "Pass Criteria Met" 2 "Fail Criteria Met" ;
VAL_TABLE_ HVACFCRTLCFR_ORL3 0 "FALSE" 1 "TRUE" ;
VAL_TABLE_ HVACFCRTLCFR_ORL2 0 "FALSE" 1 "TRUE" ;
VAL_TABLE_ HVACFCRTLCFR_ORL1 0 "FALSE" 1 "TRUE" ;
VAL_TABLE_ HVACFCRTLCFR_ORH3 0 "FALSE" 1 "TRUE" ;
VAL_TABLE_ HVACFCRTLCFR_ORH2 0 "FALSE" 1 "TRUE" ;
VAL_TABLE_ HVACFCRTLCFR_ORH1 0 "FALSE" 1 "TRUE" ;
VAL_TABLE_ HVACFCRTLF_LtLvlActv 0 "FALSE" 1 "TRUE" ;
VAL_TABLE_ HVACFCRTLF_RtLvlActv 0 "FALSE" 1 "TRUE" ;
VAL_TABLE_ HVACFCRTLCFLI2_ORL4 0 "FALSE" 1 "TRUE" ;
VAL_TABLE_ HVACFCRTLCFLI2_ORH4 0 "FALSE" 1 "TRUE" ;
VAL_TABLE_ HVACFCRTLCFRI2_ORL4 0 "FALSE" 1 "TRUE" ;
VAL_TABLE_ HVACFCRTLCFRI2_ORH4 0 "FALSE" 1 "TRUE" ;
VAL_TABLE_ HVACICR1_FrtRrPwrSet 0 "NoAction" 1 "FrontOFF_RearOFF" 2 "FrontON_RearON" 3 "FrontON_RearOFF" 4 "FrontOFF_RearON" ;
VAL_TABLE_ HVACICR1_FrtPwrSetChg 0 "FALSE" 1 "TRUE" ;
VAL_TABLE_ HVACICR1_FrtAutoSetChg 0 "FALSE" 1 "TRUE" ;
VAL_TABLE_ HVACICR1_CompSetChg 0 "FALSE" 1 "TRUE" ;
VAL_TABLE_ HVACICR1_CompSet 0 "NoAction" 1 "COMP_OFF" 2 "COMP_ON" 3 "COMP_ECON" ;
VAL_TABLE_ HVACICR1_BlwLvlFrtActv 0 "FALSE" 1 "TRUE" ;
VAL_TABLE_ HVACICR1_IntrnlFltSts 0 "Fault1" 1 "Fault2" 2 "Fault3" 3 "Fault4" 4 "Fault5" 5 "Fault6" 6 "Fault7" 7 "Fault8" 8 "Fault9" 9 "Fault10" 10 "Fault11" 11 "Fault12" 12 "Fault13" 13 "Fault14" 14 "Fault15" 15 "Fault16" ;
VAL_TABLE_ HVACICR1_HtrSetChg 0 "FALSE" 1 "TRUE" ;
VAL_TABLE_ HVACICR1_HtrSet 0 "NoAction" 1 "HEAT_OFF" 2 "HEAT_ON" ;
VAL_TABLE_ HVACICR1_MaxDefrSetChg 0 "FALSE" 1 "TRUE" ;
VAL_TABLE_ HVACICR1_MaxDefrSet 0 "NoAction" 1 "MaxDefrostOff" 2 "MaxDefrostOn" ;
VAL_TABLE_ HVACInfoCtlReqHtgACSetChg 0 "FALSE" 1 "TRUE" ;
VAL_TABLE_ HVACICR2_AirDstRtChgPrev 0 "FALSE" 1 "TRUE" ;
VAL_TABLE_ HVACICR2_AirDstRtChgNext 0 "FALSE" 1 "TRUE" ;
VAL_TABLE_ HVACICR2_AirDstLtSet 0 "NoAction" 1 "Auto" 2 "Floor" 3 "FloorAndVent" 4 "Vent" 5 "VentAndWindshield" 6 "Windshield" 7 "FloorAndWindshield" 8 "FloorAndVentAndWindshield" ;
VAL_TABLE_ HVACICR2_AirDstLtChgPrev 0 "FALSE" 1 "TRUE" ;
VAL_TABLE_ HVACICR2_AirDstLtChgNext 0 "FALSE" 1 "TRUE" ;
VAL_TABLE_ HVACICR2_RecircSetChg 0 "FALSE" 1 "TRUE" ;
VAL_TABLE_ HVACICR2_RecircSet 0 "NoAction" 1 "FreshAir" 2 "Recirc" ;
VAL_TABLE_ HVACICR2_AirDstRtSet 0 "NoAction" 1 "Auto" 2 "Floor" 3 "FloorAndVent" 4 "Vent" 5 "VentAndWindshield" 6 "Windshield" 7 "FloorAndWindshield" 8 "FloorAndVentAndWindshield" ;
VAL_TABLE_ HVACICR2_TempLtLvlActv 0 "FALSE" 1 "TRUE" ;
VAL_TABLE_ HVACICR2_TempRtLvlActv 0 "FALSE" 1 "TRUE" ;
VAL_TABLE_ LclTmYrVal_Inv 0 "FALSE" 1 "TRUE" ;
VAL_TABLE_ LclTmMinVal_Inv 0 "FALSE" 1 "TRUE" ;
VAL_TABLE_ LclTmDayVal_Inv 0 "FALSE" 1 "TRUE" ;
VAL_TABLE_ LclTmSecVal_Inv 0 "FALSE" 1 "TRUE" ;
VAL_TABLE_ LclTmHrVal_Inv 0 "FALSE" 1 "TRUE" ;
VAL_TABLE_ LclTmMthVal 0 "Unknown" 1 "January" 2 "February" 3 "March" 4 "April" 5 "May" 6 "June" 7 "July" 8 "August" 9 "September" 10 "October" 11 "November" 12 "December" ;
VAL_TABLE_ LclTmMthVal_Inv 0 "FALSE" 1 "TRUE" ;
VAL_TABLE_ FrtCntrStckFvrtUpSw 0 "Released" 1 "Pressed" ;
VAL_TABLE_ FrtCntrStckFvrtDnSw 0 "Released" 1 "Pressed" ;
VAL_TABLE_ FrtCntrStckEjectSw 0 "Released" 1 "Pressed" ;
VAL_TABLE_ FrtCntrStckDiscAuxSw 0 "Released" 1 "Pressed" ;
VAL_TABLE_ FrtCntrStckBndSw 0 "Released" 1 "Pressed" ;
VAL_TABLE_ FrtCntrStckBnchBtnID_VirtSw 0 "Released" 1 "Pressed" ;
VAL_TABLE_ FrtCntrStckBackSw 0 "Released" 1 "Pressed" ;
VAL_TABLE_ FrtCntrStckAllRelSw 0 "Released" 1 "Pressed" ;
VAL_TABLE_ FrtCntrStckSw24 0 "Released" 1 "Pressed" ;
VAL_TABLE_ FrtCntrStckSw23 0 "Released" 1 "Pressed" ;
VAL_TABLE_ FrtCntrStckStrgeUnlckSw 0 "Released" 1 "Pressed" ;
VAL_TABLE_ FrtCntrStckPwrSw 0 "Released" 1 "Pressed" ;
VAL_TABLE_ FrtCntrStckPrevSw 0 "Released" 1 "Pressed" ;
VAL_TABLE_ FrtCntrStckNextSw 0 "Released" 1 "Pressed" ;
VAL_TABLE_ FrtCntrStckMenuSw 0 "Released" 1 "Pressed" ;
VAL_TABLE_ FrtCntrStckHomeSw 0 "Released" 1 "Pressed" ;
VAL_TABLE_ FrtCntrStckSw32 0 "Released" 1 "Pressed" ;
VAL_TABLE_ FrtCntrStckSw31 0 "Released" 1 "Pressed" ;
VAL_TABLE_ FrtCntrStckSw30 0 "Released" 1 "Pressed" ;
VAL_TABLE_ FrtCntrStckSw29 0 "Released" 1 "Pressed" ;
VAL_TABLE_ FrtCntrStckSw28 0 "Released" 1 "Pressed" ;
VAL_TABLE_ FrtCntrStckSw27 0 "Released" 1 "Pressed" ;
VAL_TABLE_ FrtCntrStckSw26 0 "Released" 1 "Pressed" ;
VAL_TABLE_ FrtCntrStckSw25 0 "Released" 1 "Pressed" ;
VAL_TABLE_ UTCDay_Inv 0 "FALSE" 1 "TRUE" ;
VAL_TABLE_ UTCHrs_Inv 0 "FALSE" 1 "TRUE" ;
VAL_TABLE_ UTCMth_Inv 0 "FALSE" 1 "TRUE" ;
VAL_TABLE_ UTCMth 0 "Unknown" 1 "January" 2 "February" 3 "March" 4 "April" 5 "May" 6 "June" 7 "July" 8 "August" 9 "September" 10 "October" 11 "November" 12 "December" ;
VAL_TABLE_ UTCMin_Inv 0 "FALSE" 1 "TRUE" ;
VAL_TABLE_ UTCSec_Inv 0 "FALSE" 1 "TRUE" ;
VAL_TABLE_ UTCYr_Inv 0 "FALSE" 1 "TRUE" ;
VAL_TABLE_ CellNWDateTimeAvl 0 "FALSE" 1 "TRUE" ;
VAL_TABLE_ CmpsOctHding 0 "N" 1 "NE" 2 "E" 3 "SE" 4 "S" 5 "SW" 6 "W" 7 "NW" ;
VAL_TABLE_ CmpsDecZone 0 "Unknown" 1 "Zone 1" 2 "Zone 2" 3 "Zone 3" 4 "Zone 4" 5 "Zone 5" 6 "Zone 6" 7 "Zone 7" 8 "Zone 8" 9 "Zone 9" 10 "zone 10" 11 "Zone 11" 12 "Zone 12" 13 "Zone 13" 14 "Zone 14" 15 "Zone 15" ;
VAL_TABLE_ EmrgRespSysServIndOn 0 "FALSE" 1 "TRUE" ;
VAL_TABLE_ CmpsZnNvrSet 0 "False" 1 "True" ;
VAL_TABLE_ CmpsSatrtd 0 "False" 1 "True" ;
VAL_TABLE_ CmpsOctHdingDataSrc 0 "Stored Value" 1 "Calculated Value" ;
VAL_TABLE_ CmpsModManCalInPrc 0 "False" 1 "True" ;
VAL_TABLE_ CmpsModFltPrs 0 "False" 1 "True" ;
VAL_TABLE_ FrtCntrStckHptcFdbkStat 0 "FEEDBACK_OFF" 1 "TAP" 2 "LONG_PRESS" 3 "PRESS_&_HOLD_SCROLL" 4 "PRESS_&_HOLD_END" 5 "RESERVED_05" 6 "RESERVED_06" 7 "RESERVED_07" 8 "RESERVED_08" 9 "RESERVED_09" 10 "RESERVED_10" 11 "RESERVED_11" 12 "RESERVED_12" 13 "RESERVED_13" 14 "RESERVED_14" 15 "RESERVED_15" ;
VAL_TABLE_ FrtCntrStckTag2Sw 0 "Released" 1 "Pressed" ;
VAL_TABLE_ FrtCntrStckTag1Sw 0 "Released" 1 "Pressed" ;
VAL_TABLE_ FrtCntrStckPrxmtyStat 0 "FAR" 1 "NEAR" 2 "TOUCH" 3 "PRESS" 4 "PROX_STAT4" 5 "PROX_STAT5" 6 "PROX_STAT6" 7 "PROX_STAT7" ;
VAL_TABLE_ FrtCntrStckPrxmtyGstr 0 "NO_ACTION" 1 "PROX_GESTURE1" 2 "PROX_GESTURE2" 3 "PROX_GESTURE3" 4 "PROX_GESTURE4" 5 "PROX_GESTURE5" 6 "PROX_GESTURE6" 7 "PROX_GESTURE7" ;
VAL_TABLE_ FrtCntrStckVolUpSw 0 "Released" 1 "Pressed" ;
VAL_TABLE_ FrtCntrStckVolDnSw 0 "Released" 1 "Pressed" ;
VAL_TABLE_ FrtCntrStckToneSw 0 "Released" 1 "Pressed" ;
VAL_TABLE_ FrtCntrStckTag5Sw 0 "Released" 1 "Pressed" ;
VAL_TABLE_ FrtCntrStckTag4Sw 0 "Released" 1 "Pressed" ;
VAL_TABLE_ FrtCntrStckTag3Sw 0 "Released" 1 "Pressed" ;
VAL_TABLE_ SBZAlrtCstAvlFlg7 0 "FALSE" 1 "TRUE" ;
VAL_TABLE_ SBZAlrtCstAvlFlg6 0 "FALSE" 1 "TRUE" ;
VAL_TABLE_ SBZAlrtCstAvlFlg5 0 "FALSE" 1 "TRUE" ;
VAL_TABLE_ SBZAlrtCstAvlFlg4 0 "FALSE" 1 "TRUE" ;
VAL_TABLE_ SBZAlrtCstAvlFlg3 0 "FALSE" 1 "TRUE" ;
VAL_TABLE_ SBZAlrtCstAvlFlg2 0 "FALSE" 1 "TRUE" ;
VAL_TABLE_ SBZAlrtCstAvlFlg1 0 "FALSE" 1 "TRUE" ;
VAL_TABLE_ LnChgAlrtLmtdTrlrIndOn 0 "FALSE" 1 "TRUE" ;
VAL_TABLE_ ServSdDtcSysIndOn 0 "FALSE" 1 "TRUE" ;
VAL_TABLE_ SdDtcTempUnvIndOn 0 "FALSE" 1 "TRUE" ;
VAL_TABLE_ SBZAlrtOffIndOn 0 "FALSE" 1 "TRUE" ;
VAL_TABLE_ SBZAlrtCstStAvl 0 "FALSE" 1 "TRUE" ;
VAL_TABLE_ DrvrAlrtTypCstStAvl 0 "FALSE" 1 "TRUE" ;
VAL_TABLE_ DrvrAlrtTypCstAvlFlg7 0 "FALSE" 1 "TRUE" ;
VAL_TABLE_ DrvrAlrtTypCstAvlFlg6 0 "FALSE" 1 "TRUE" ;
VAL_TABLE_ DrvrAlrtTypCstAvlFlg5 0 "FALSE" 1 "TRUE" ;
VAL_TABLE_ DrvrAlrtTypCstAvlFlg4 0 "FALSE" 1 "TRUE" ;
VAL_TABLE_ DrvrAlrtTypCstAvlFlg3 0 "FALSE" 1 "TRUE" ;
VAL_TABLE_ DrvrAlrtTypCstAvlFlg2 0 "FALSE" 1 "TRUE" ;
VAL_TABLE_ DrvrAlrtTypCstAvlFlg1 0 "FALSE" 1 "TRUE" ;
VAL_TABLE_ HptcStFldIndOn 0 "FALSE" 1 "TRUE" ;
VAL_TABLE_ StrgWhlTrqIntegSts 0 "Unknown" 1 "Redundant ASIL D" 2 "Non Redundant ASIL D" 3 "Failed" ;
VAL_TABLE_ StrgWhlHndsOffDtnStat 0 "Hands On" 1 "Hands Off" 2 "Unknown" ;
VAL_TABLE_ TrffcLgtAsstWrnChmEvntStat 0 "NO_ACTION" 1 "ACTIVE" 2 "CANCEL_CHIME" 3 "RESERVED_1" ;
VAL_TABLE_ TrffcLgtAsstCstCurrSetVal 0 "SETTING_UNKNOWN" 1 "OFF" 2 "ALERT" 3 "RESERVED_3" 4 "RESERVED_4" 5 "RESERVED_5" 6 "RESERVED_6" 7 "RESERVED_7" ;
VAL_TABLE_ GlrFrHgBmRspTypCstCurSetVal 0 "SETTING_UNKNOWN" 1 "AUTOMATIC_HIGH_BEAM" 2 "GLARE_FREE_HIGH_BEAM" 3 "RESERVED_3" 4 "\?? RESERVED_4" 5 "RESERVED_5" 6 "RESERVED_6" 7 "RESERVED_7" ;
VAL_TABLE_ GlrFrHgBmRspTypCstAvlFlg7 0 "FALSE" 1 "TRUE" ;
VAL_TABLE_ GlrFrHgBmRspTypCstAvlFlg6 0 "FALSE" 1 "TRUE" ;
VAL_TABLE_ GlrFrHgBmRspTypCstAvlFlg5 0 "FALSE" 1 "TRUE" ;
VAL_TABLE_ GlrFrHgBmRspTypCstAvlFlg4 0 "FALSE" 1 "TRUE" ;
VAL_TABLE_ GlrFrHgBmRspTypCstAvlFlg3 0 "FALSE" 1 "TRUE" ;
VAL_TABLE_ GlrFrHgBmRspTypCstAvlFlg2 0 "FALSE" 1 "TRUE" ;
VAL_TABLE_ GlrFrHgBmRspTypCstAvlFlg1 0 "FALSE" 1 "TRUE" ;
VAL_TABLE_ AutoHgBmCtrlIO 0 "FALSE" 1 "TRUE" ;
VAL_TABLE_ TrffcLgtAsstCstAvlFlg7 0 "FALSE" 1 "TRUE" ;
VAL_TABLE_ TrffcLgtAsstCstAvlFlg6 0 "FALSE" 1 "TRUE" ;
VAL_TABLE_ TrffcLgtAsstCstAvlFlg5 0 "FALSE" 1 "TRUE" ;
VAL_TABLE_ TrffcLgtAsstCstAvlFlg4 0 "FALSE" 1 "TRUE" ;
VAL_TABLE_ TrffcLgtAsstCstAvlFlg3 0 "FALSE" 1 "TRUE" ;
VAL_TABLE_ TrffcLgtAsstCstAvlFlg2 0 "FALSE" 1 "TRUE" ;
VAL_TABLE_ TrffcLgtAsstCstAvlFlg1 0 "FALSE" 1 "TRUE" ;
VAL_TABLE_ GlrFrHgBmRspTypCstStAvl 0 "FALSE" 1 "TRUE" ;
VAL_TABLE_ TrffcLgtAsstCstSetAval 0 "FALSE" 1 "TRUE" ;
VAL_TABLE_ TSMEurDispSgn2Mn 0 "UnKnown" 1 "No Sign Detected" 2 "End of Speed Limit" 3 "End of All Restrictions" 4 "Begin of Motorway" 5 "End of Motorway" 6 "Begin of Expressway" 7 "End of Expressway" 8 "Begin of Play Street Zone" 9 "End of Play Street Zone" 10 "Begin of Passing Restriction" 11 "End of Passing Restriction" 12 "No Entry" 13 "Begin of City Limits" 14 "End of City Limits" 15 "Speed Limit 5" 16 "Speed Limit 10" 17 "Speed Limit 15" 18 "Speed Limit 20" 19 "Speed Limit 25" 20 "Speed Limit 30" 21 "Speed Limit 35" 22 "Speed Limit 40" 23 "Speed Limit 45" 24 "Speed Limit 50" 25 "Speed Limit 55" 26 "Speed Limit 60" 27 "Speed Limit 65" 28 "Speed Limit 70" 29 "Speed Limit 75" 30 "Speed Limit 80" 31 "Speed Limit 85" 32 "Speed Limit 90" 33 "Speed Limit 95" 34 "Speed Limit 100" 35 "Speed Limit 105" 36 "Speed Limit 110" 37 "Speed Limit 115" 38 "Speed Limit 120" 39 "Speed Limit 125" 40 "Speed Limit 130" 41 "Speed Limit 135" 42 "Speed Limit 140" 43 "Speed Limit 145" 44 "Speed Limit 150" 45 "Speed Limit 155" 46 "Speed Limit 160" 47 "Speed Limit 165" 48 "Speed Limit 170" 49 "Speed Limit 175" 50 "Speed Limit 180" 51 "Speed Limit 185" 52 "Speed Limit 190" 53 "Speed Limit 195" 54 "Speed Limit 200" ;
VAL_TABLE_ TSMEurDispSgn1Mn 0 "UnKnown" 1 "No Sign Detected" 2 "End of Speed Limit" 3 "End of All Restrictions" 4 "Begin of Motorway" 5 "End of Motorway" 6 "Begin of Expressway" 7 "End of Expressway" 8 "Begin of Play Street Zone" 9 "End of Play Street Zone" 10 "Begin of Passing Restriction" 11 "End of Passing Restriction" 12 "No Entry" 13 "Begin of City Limits" 14 "End of City Limits" 15 "Speed Limit 5" 16 "Speed Limit 10" 17 "Speed Limit 15" 18 "Speed Limit 20" 19 "Speed Limit 25" 20 "Speed Limit 30" 21 "Speed Limit 35" 22 "Speed Limit 40" 23 "Speed Limit 45" 24 "Speed Limit 50" 25 "Speed Limit 55" 26 "Speed Limit 60" 27 "Speed Limit 65" 28 "Speed Limit 70" 29 "Speed Limit 75" 30 "Speed Limit 80" 31 "Speed Limit 85" 32 "Speed Limit 90" 33 "Speed Limit 95" 34 "Speed Limit 100" 35 "Speed Limit 105" 36 "Speed Limit 110" 37 "Speed Limit 115" 38 "Speed Limit 120" 39 "Speed Limit 125" 40 "Speed Limit 130" 41 "Speed Limit 135" 42 "Speed Limit 140" 43 "Speed Limit 145" 44 "Speed Limit 150" 45 "Speed Limit 155" 46 "Speed Limit 160" 47 "Speed Limit 165" 48 "Speed Limit 170" 49 "Speed Limit 175" 50 "Speed Limit 180" 51 "Speed Limit 185" 52 "Speed Limit 190" 53 "Speed Limit 195" 54 "Speed Limit 200" ;
VAL_TABLE_ TSMUSAndCADispSgn1Mn 0 "UnKnown" 1 "No Sign Detected" 2 "Begin of Passing Restriction US" 3 "End of Passing Restriction US" 4 "Begin of Passing Restriction Canada" 5 "End of Passing Restriction Canada" 6 "Speed Limit 5" 7 "Speed Limit 10" 8 "Speed Limit 15" 9 "Speed Limit 20" 10 "Speed Limit 25" 11 "Speed Limit 30" 12 "Speed Limit 35" 13 "Speed Limit 40" 14 "Speed Limit 45" 15 "Speed Limit 50" 16 "Speed Limit 55" 17 "Speed Limit 60" 18 "Speed Limit 65" 19 "Speed Limit 70" 20 "Speed Limit 75" 21 "Speed Limit 80" 22 "Speed Limit 85" 23 "Speed Limit 90" 24 "Speed Limit 95" 25 "Speed Limit 100" 26 "Speed Limit 105" 27 "Speed Limit 110" 28 "Speed Limit 115" 29 "Speed Limit 120" 30 "Speed Limit 125" 31 "Speed Limit 130" 32 "Speed Limit 135" 33 "Speed Limit 140" 34 "Speed Limit 145" 35 "Speed Limit 150" 36 "Speed Limit 155" 37 "Speed Limit 160" 38 "Speed Limit 165" 39 "Speed Limit 170" 40 "Speed Limit 175" 41 "Speed Limit 180" 42 "Speed Limit 185" 43 "Speed Limit 190" 44 "Speed Limit 195" 45 "Speed Limit 200" ;
VAL_TABLE_ TSMUSAndCADispSgn2Mn 0 "UnKnown" 1 "No Sign Detected" 2 "Begin of Passing Restriction US" 3 "End of Passing Restriction US" 4 "Begin of Passing Restriction Canada" 5 "End of Passing Restriction Canada" 6 "Speed Limit 5" 7 "Speed Limit 10" 8 "Speed Limit 15" 9 "Speed Limit 20" 10 "Speed Limit 25" 11 "Speed Limit 30" 12 "Speed Limit 35" 13 "Speed Limit 40" 14 "Speed Limit 45" 15 "Speed Limit 50" 16 "Speed Limit 55" 17 "Speed Limit 60" 18 "Speed Limit 65" 19 "Speed Limit 70" 20 "Speed Limit 75" 21 "Speed Limit 80" 22 "Speed Limit 85" 23 "Speed Limit 90" 24 "Speed Limit 95" 25 "Speed Limit 100" 26 "Speed Limit 105" 27 "Speed Limit 110" 28 "Speed Limit 115" 29 "Speed Limit 120" 30 "Speed Limit 125" 31 "Speed Limit 130" 32 "Speed Limit 135" 33 "Speed Limit 140" 34 "Speed Limit 145" 35 "Speed Limit 150" 36 "Speed Limit 155" 37 "Speed Limit 160" 38 "Speed Limit 165" 39 "Speed Limit 170" 40 "Speed Limit 175" 41 "Speed Limit 180" 42 "Speed Limit 185" 43 "Speed Limit 190" 44 "Speed Limit 195" 45 "Speed Limit 200" ;
VAL_TABLE_ TSMEurDispSgn2AddOn 0 "UnKnown" 1 "None" 2 "Supp Sign Generic" 3 "Rain" 4 "Snow" 5 "Snow Rain" 6 "Rain Cloud" 7 "Fog" 8 "Time" 9 "Wet Conditions" 10 "Trailer" 11 "Tractor Passable" 12 "Arrow Left" 13 "Arrow Right" 14 "Distance Arrow" 15 "School" ;
VAL_TABLE_ TSMEurDispSgn1AddOn 0 "UnKnown" 1 "None" 2 "Supp Sign Generic" 3 "Rain" 4 "Snow" 5 "Snow Rain" 6 "Rain Cloud" 7 "Fog" 8 "Time" 9 "Wet Conditions" 10 "Trailer" 11 "Tractor Passable" 12 "Arrow Left" 13 "Arrow Right" 14 "Distance Arrow" 15 "School" ;
VAL_TABLE_ FrwdVsFlDtcnIndOn 0 "FALSE" 1 "TRUE" ;
VAL_TABLE_ FrwdVsAdvWthrIndOn 0 "FALSE" 1 "TRUE" ;
VAL_TABLE_ TSMUSAndCADispSgn2AddOn 0 "None" 1 "Supp Sign Generic" 2 "School" 3 "School When Flashing" 4 "End of Speed Limit" 5 "Where Workers Present" ;
VAL_TABLE_ TSMUSAndCADispSgn1AddOn 0 "None" 1 "Supp Sign Generic" 2 "School" 3 "School When Flashing" 4 "End of Speed Limit" 5 "Where Workers Present" ;
VAL_TABLE_ TrffcLgtAsstHUDWrnIndOn 0 "FALSE" 1 "TRUE" ;
VAL_TABLE_ TrffcLgtAsstClstrWrnIndOn 0 "FALSE" 1 "TRUE" ;
VAL_TABLE_ TSMSgnNtfnIndOn 0 "FALSE" 1 "TRUE" ;
VAL_TABLE_ TSMPDAMnSgnFlshgReq 0 "FALSE" 1 "TRUE" ;
VAL_TABLE_ TSMNoEntryIndOn 0 "FALSE" 1 "TRUE" ;
VAL_TABLE_ TSMIcePsblIndOn 0 "FALSE" 1 "TRUE" ;
VAL_TABLE_ TSMAddTrfSgnAvIndOn 0 "FALSE" 1 "TRUE" ;
VAL_TABLE_ FrwdVsFllBlckIndOn 0 "FALSE" 1 "TRUE" ;
VAL_TABLE_ TrffcLgtAsstRLADWrnIndOn 0 "FALSE" 1 "TRUE" ;
VAL_TABLE_ SBZALCAVisIndStatLt 0 "FLASHING" 1 "SOLID" 2 "OFF" ;
VAL_TABLE_ SBZALCAVisIndStatRt 0 "FLASHING" 1 "SOLID" 2 "OFF" ;
VAL_TABLE_ HtchVwAutoElecPrkBrkAppReqd 0 "FALSE" 1 "TRUE" ;
VAL_TABLE_ AutoHgBmActReq 0 "FALSE" 1 "TRUE" ;
VAL_TABLE_ RrCrsTrfcAlrtLftIndCtrl 0 "ON" 1 "OFF" 2 "FLASH" ;
VAL_TABLE_ RrCrsTrfcAlrtCstCrStVal 0 "SETTING_UNKNOWN" 1 "OFF" 2 "ALERT" 3 "ALERT and BRAKE" 4 "RESERVED_4" 5 "RESERVED_5" 6 "RESERVED_6" 7 "RESERVED_7" ;
VAL_TABLE_ LnChgAlrtCstCrStVal 0 "SETTING_UNKNOWN" 1 "OFF" 2 "ON" 3 "RESERVED_3" 4 "RESERVED_4" 5 "RESERVED_5" 6 "RESERVED_6" 7 "RESERVED_7" ;
VAL_TABLE_ SBZAlrtCstCrStVal 0 "SETTING_UNKNOWN" 1 "OFF" 2 "ON" 3 "RESERVED_3" 4 "RESERVED_4" 5 "RESERVED_5" 6 "RESERVED_6" 7 "RESERVED_7" ;
VAL_TABLE_ ByclDtnCstCurrSetVal 0 "Setting Unknown" 1 "Off" 2 "Alert" ;
VAL_TABLE_ ByclDtnArbdIndStat 0 "No Indication" 1 "Off" 2 "Right Level 1" 3 "Left Level 1" 4 "Right Level 2" 5 "Left Level 2" 6 "Left and Right Level 1" 7 "Left and Right Level 2" ;
VAL_TABLE_ ByclDtnCstAvlFlg1 0 "FALSE" 1 "TRUE" ;
VAL_TABLE_ RrCrsTrfcAlrtLtSdChmEvntStat 0 "NO_ACTION" 1 "ACTIVE" 2 "CANCEL_CHIME" ;
VAL_TABLE_ ByclDtnArbdLvl2ChmEvntStat 0 "No Action" 1 "Active" 2 "Cancel Chime" ;
VAL_TABLE_ ByclDtnArbdLvl1ChmEvntStat 0 "No Action" 1 "Active" 2 "Cancel Chime" ;
VAL_TABLE_ LnChgAlrtCstAvlFlg1 0 "FALSE" 1 "TRUE" ;
VAL_TABLE_ ByclDtnCstSetAval 0 "FALSE" 1 "TRUE" ;
VAL_TABLE_ ByclDtnCstAvlFlg7 0 "FALSE" 1 "TRUE" ;
VAL_TABLE_ ByclDtnCstAvlFlg6 0 "FALSE" 1 "TRUE" ;
VAL_TABLE_ ByclDtnCstAvlFlg5 0 "FALSE" 1 "TRUE" ;
VAL_TABLE_ ByclDtnCstAvlFlg4 0 "FALSE" 1 "TRUE" ;
VAL_TABLE_ ByclDtnCstAvlFlg3 0 "FALSE" 1 "TRUE" ;
VAL_TABLE_ ByclDtnCstAvlFlg2 0 "FALSE" 1 "TRUE" ;
VAL_TABLE_ LnChgAlrtSysOffIndOn 0 "FALSE" 1 "TRUE" ;
VAL_TABLE_ LnChgAlrtCstStAvl 0 "FALSE" 1 "TRUE" ;
VAL_TABLE_ LnChgAlrtCstAvlFlg7 0 "FALSE" 1 "TRUE" ;
VAL_TABLE_ LnChgAlrtCstAvlFlg6 0 "FALSE" 1 "TRUE" ;
VAL_TABLE_ LnChgAlrtCstAvlFlg5 0 "FALSE" 1 "TRUE" ;
VAL_TABLE_ LnChgAlrtCstAvlFlg4 0 "FALSE" 1 "TRUE" ;
VAL_TABLE_ LnChgAlrtCstAvlFlg3 0 "FALSE" 1 "TRUE" ;
VAL_TABLE_ LnChgAlrtCstAvlFlg2 0 "FALSE" 1 "TRUE" ;
VAL_TABLE_ RrCrsTrfcAlrtCstStAvl 0 "FALSE" 1 "TRUE" ;
VAL_TABLE_ RrCrsTrfcAlrtCstAvlFlg7 0 "FALSE" 1 "TRUE" ;
VAL_TABLE_ RrCrsTrfcAlrtCstAvlFlg6 0 "FALSE" 1 "TRUE" ;
VAL_TABLE_ RrCrsTrfcAlrtCstAvlFlg5 0 "FALSE" 1 "TRUE" ;
VAL_TABLE_ RrCrsTrfcAlrtCstAvlFlg4 0 "FALSE" 1 "TRUE" ;
VAL_TABLE_ RrCrsTrfcAlrtCstAvlFlg3 0 "FALSE" 1 "TRUE" ;
VAL_TABLE_ RrCrsTrfcAlrtCstAvlFlg2 0 "FALSE" 1 "TRUE" ;
VAL_TABLE_ RrCrsTrfcAlrtCstAvlFlg1 0 "FALSE" 1 "TRUE" ;
VAL_TABLE_ RrCrsTrfcBrkgAutoBrkgRelIndOn 0 "FALSE" 1 "TRUE" ;
VAL_TABLE_ RrCrsTrfcAutoBrkgOffIndOn 0 "FALSE" 1 "TRUE" ;
VAL_TABLE_ RrCrsTrfcAlrtOffIndOn 0 "FALSE" 1 "TRUE" ;
VAL_TABLE_ RrCrsTrfcAlrtRtSdChmEvntStat 0 "NO_ACTION" 1 "ACTIVE" 2 "CANCEL_CHIME" ;
VAL_TABLE_ RrCrsTrfcAlrtRgIndCtrl 0 "ON" 1 "OFF" 2 "FLASH" ;
VAL_TABLE_ VwgSysUndrbdyCamWshReq 0 "Unknown" 1 "Active" 2 "Inactive" ;
VAL_TABLE_ TrlrVidVwCrgLmpReq 0 "No_Action" 1 "On" 2 "Off" ;
VAL_TABLE_ TrlrVidVwBoxRailLmpReq 0 "No_Action" 1 "On" 2 "Off" ;
VAL_TABLE_ SrrndVwPudlLmpReqd 0 "FALSE" 1 "TRUE" ;
VAL_TABLE_ HndsOnLnCntrAsstIndReq 0 "Off" 1 "White" 2 "Green" 3 "Green Flashing" 4 "Amber" 5 "Amber Flashing" 6 "Red" 7 "Red Flashing" ;
VAL_TABLE_ HndsOnLnCntrAsstChmEvntStat 0 "No Action" 1 "Active" 2 "Cancel Chime" ;
VAL_TABLE_ LnFllwgFtrStat 0 "Off" 1 "Unavailable" 2 "Disabled" 3 "Enabled" 4 "Active" 5 "Cautionary" 6 "Override" 7 "Degraded" 8 "No Return" 9 "Ended" 10 "Non-Responsive Driver" ;
VAL_TABLE_ GnrcLnMrkngIndRt 0 "Off" 1 "White" 2 "Green" 3 "Green Flashing" 4 "Amber" 5 "Amber Flashing" 6 "Red" 7 "Red Flashing" ;
VAL_TABLE_ GnrcLnMrkngIndLt 0 "Off" 1 "White" 2 "Green" 3 "Green Flashing" 4 "Amber" 5 "Amber Flashing" 6 "Red" 7 "Red Flashing" ;
VAL_TABLE_ ADASSetSpdIndReq 0 "Indication Off" 1 "White Indicator" 2 "Green Indicator" 3 "Yellow Indicator" 4 "Red Indicator" 5 "Blue Indicator" ;
VAL_TABLE_ SuprRmtPrkActvnPndgIndOn 0 "FALSE" 1 "TRUE" ;
VAL_TABLE_ JckKnfDtnCstAvlFlg1 0 "FALSE" 1 "TRUE" ;
VAL_TABLE_ CrgBedVwAutoLgtCstAvlFlg7 0 "FALSE" 1 "TRUE" ;
VAL_TABLE_ CrgBedVwAutoLgtCstAvlFlg6 0 "FALSE" 1 "TRUE" ;
VAL_TABLE_ CrgBedVwAutoLgtCstAvlFlg5 0 "FALSE" 1 "TRUE" ;
VAL_TABLE_ CrgBedVwAutoLgtCstAvlFlg4 0 "FALSE" 1 "TRUE" ;
VAL_TABLE_ CrgBedVwAutoLgtCstAvlFlg3 0 "FALSE" 1 "TRUE" ;
VAL_TABLE_ CrgBedVwAutoLgtCstAvlFlg2 0 "FALSE" 1 "TRUE" ;
VAL_TABLE_ CrgBedVwAutoLgtCstAvlFlg1 0 "FALSE" 1 "TRUE" ;
VAL_TABLE_ JckKnfDtnCstAvlFlg7 0 "FALSE" 1 "TRUE" ;
VAL_TABLE_ JckKnfDtnCstAvlFlg6 0 "FALSE" 1 "TRUE" ;
VAL_TABLE_ JckKnfDtnCstAvlFlg5 0 "FALSE" 1 "TRUE" ;
VAL_TABLE_ JckKnfDtnCstAvlFlg4 0 "FALSE" 1 "TRUE" ;
VAL_TABLE_ JckKnfDtnCstAvlFlg3 0 "FALSE" 1 "TRUE" ;
VAL_TABLE_ JckKnfDtnCstAvlFlg2 0 "FALSE" 1 "TRUE" ;
VAL_TABLE_ VwgVwprtZmdVarActv 0 "FALSE" 1 "TRUE" ;
VAL_TABLE_ DlvryModeVwgCstAvlFlg7 0 "FALSE" 1 "TRUE" ;
VAL_TABLE_ DlvryModeVwgCstAvlFlg6 0 "FALSE" 1 "TRUE" ;
VAL_TABLE_ DlvryModeVwgCstAvlFlg5 0 "FALSE" 1 "TRUE" ;
VAL_TABLE_ DlvryModeVwgCstAvlFlg4 0 "FALSE" 1 "TRUE" ;
VAL_TABLE_ DlvryModeVwgCstAvlFlg3 0 "FALSE" 1 "TRUE" ;
VAL_TABLE_ DlvryModeVwgCstAvlFlg2 0 "FALSE" 1 "TRUE" ;
VAL_TABLE_ DlvryModeVwgCstAvlFlg1 0 "FALSE" 1 "TRUE" ;
VAL_TABLE_ VwgVwprtZoomBtnPrsnt 0 "FALSE" 1 "TRUE" ;
VAL_TABLE_ VwgCtlBtnPrsncBedHtch 0 "FALSE" 1 "TRUE" ;
VAL_TABLE_ VwgCtlBtnAvlUndrBdyFwdStActv 0 "FALSE" 1 "TRUE" ;
VAL_TABLE_ VwgCtlBtnAvlUndrBdyFwdRwdStActv 0 "FALSE" 1 "TRUE" ;
VAL_TABLE_ VwgCtlBtnAvlTopDnVwActv 0 "FALSE" 1 "TRUE" ;
VAL_TABLE_ DlvryModeVwgCstSetAval 0 "FALSE" 1 "TRUE" ;
VAL_TABLE_ DlvryModeVwgCstCurrSetVal 0 "Setting Unknown" 1 "Off" 2 "On" ;
VAL_TABLE_ VwgCtlBtnPrsncFrtPrspctv 0 "FALSE" 1 "TRUE" ;
VAL_TABLE_ VwgCtlBtnPrsncFrtOvrhd 0 "FALSE" 1 "TRUE" ;
VAL_TABLE_ VwgCtlBtnPrsncFrtJnctn 0 "FALSE" 1 "TRUE" ;
VAL_TABLE_ VwgCtlBtnPrsncDynGdlns 0 "FALSE" 1 "TRUE" ;
VAL_TABLE_ VwgCtlBtnPrsncCurbOvrhd 0 "FALSE" 1 "TRUE" ;
VAL_TABLE_ VwgCtlBtnPrsncCurb 0 "FALSE" 1 "TRUE" ;
VAL_TABLE_ VwgCtlBtnPrsncCrgBed 0 "FALSE" 1 "TRUE" ;
VAL_TABLE_ VwgCtlBtnPrsncBowl 0 "FALSE" 1 "TRUE" ;
VAL_TABLE_ VwgCtlBtnPrsncSdRwd 0 "FALSE" 1 "TRUE" ;
VAL_TABLE_ VwgCtlBtnPrsncSdFwd 0 "FALSE" 1 "TRUE" ;
VAL_TABLE_ VwgCtlBtnPrsncRrPrspctv 0 "FALSE" 1 "TRUE" ;
VAL_TABLE_ VwgCtlBtnPrsncRrOvrhd 0 "FALSE" 1 "TRUE" ;
VAL_TABLE_ VwgCtlBtnPrsncRrJnctn 0 "FALSE" 1 "TRUE" ;
VAL_TABLE_ VwgCtlBtnPrsncRrHtch 0 "FALSE" 1 "TRUE" ;
VAL_TABLE_ VwgCtlBtnPrsncJP 0 "FALSE" 1 "TRUE" ;
VAL_TABLE_ VwgCtlBtnPrsncInvsblTrlr 0 "FALSE" 1 "TRUE" ;
VAL_TABLE_ VwgCtlBtnPrsncUndrBdyFwdRwdSt 0 "FALSE" 1 "TRUE" ;
VAL_TABLE_ VwgCtlBtnPrsncUndrBdyFwd 0 "FALSE" 1 "TRUE" ;
VAL_TABLE_ VwgCtlBtnPrsncTrlrTowMir 0 "FALSE" 1 "TRUE" ;
VAL_TABLE_ VwgCtlBtnPrsncTrlrGdlns 0 "FALSE" 1 "TRUE" ;
VAL_TABLE_ VwgCtlBtnPrsncTrlrAux1Cmbd 0 "FALSE" 1 "TRUE" ;
VAL_TABLE_ VwgCtlBtnPrsncTrlrAux1 0 "FALSE" 1 "TRUE" ;
VAL_TABLE_ VwgCtlBtnPrsncTransparentHood 0 "FALSE" 1 "TRUE" ;
VAL_TABLE_ VwgCtlBtnPrsncTopDnSrrndVw 0 "FALSE" 1 "TRUE" ;
VAL_TABLE_ VwgVwprtStsTopDnVwActv 0 "FALSE" 1 "TRUE" ;
VAL_TABLE_ VwgVwprtNtfnActv 0 "FALSE" 1 "TRUE" ;
VAL_TABLE_ VwgCtlBtnPrsncTrlrAux2 0 "FALSE" 1 "TRUE" ;
VAL_TABLE_ VwgCtlBtnPrsncZmdBowl 0 "FALSE" 1 "TRUE" ;
VAL_TABLE_ VwgCtlBtnPrsncUndrBdyRwd 0 "FALSE" 1 "TRUE" ;
VAL_TABLE_ VwgCtlBtnPrsncUndrBdyFwdSt 0 "FALSE" 1 "TRUE" ;
VAL_TABLE_ TrlrJckKnfVisAlrtReq 0 "Unknown" 1 "No Alert" 2 "Phase 1 Alert" 3 "Phase 2 Alert" ;
VAL_TABLE_ TrlrCamCalPrgs_Inv 0 "FALSE" 1 "TRUE" ;
VAL_TABLE_ DMPDAutoClsTmLFCstSetAval 0 "FALSE" 1 "TRUE" ;
VAL_TABLE_ DMPDAutoClsTmLFCstAvlFlg7 0 "FALSE" 1 "TRUE" ;
VAL_TABLE_ DMPDAutoClsTmLFCstAvlFlg6 0 "FALSE" 1 "TRUE" ;
VAL_TABLE_ DMPDAutoClsTmLFCstAvlFlg5 0 "FALSE" 1 "TRUE" ;
VAL_TABLE_ DMPDAutoClsTmLFCstAvlFlg4 0 "FALSE" 1 "TRUE" ;
VAL_TABLE_ DMPDAutoClsTmLFCstAvlFlg3 0 "FALSE" 1 "TRUE" ;
VAL_TABLE_ DMPDAutoClsTmLFCstAvlFlg2 0 "FALSE" 1 "TRUE" ;
VAL_TABLE_ DMPDAutoClsTmLFCstAvlFlg1 0 "FALSE" 1 "TRUE" ;
VAL_TABLE_ DMPDClsOutofPrkLFCstSetAval 0 "FALSE" 1 "TRUE" ;
VAL_TABLE_ DMPDClsOutofPrkLFCstAvlFlg7 0 "FALSE" 1 "TRUE" ;
VAL_TABLE_ DMPDClsOutofPrkLFCstAvlFlg6 0 "FALSE" 1 "TRUE" ;
VAL_TABLE_ DMPDClsOutofPrkLFCstAvlFlg5 0 "FALSE" 1 "TRUE" ;
VAL_TABLE_ DMPDClsOutofPrkLFCstAvlFlg4 0 "FALSE" 1 "TRUE" ;
VAL_TABLE_ DMPDClsOutofPrkLFCstAvlFlg3 0 "FALSE" 1 "TRUE" ;
VAL_TABLE_ DMPDClsOutofPrkLFCstAvlFlg2 0 "FALSE" 1 "TRUE" ;
VAL_TABLE_ DMPDClsOutofPrkLFCstAvlFlg1 0 "FALSE" 1 "TRUE" ;
VAL_TABLE_ DMPDDOBlkhdDrOpnLFCstSetAval 0 "FALSE" 1 "TRUE" ;
VAL_TABLE_ DMPDDOBlkhdDrOpnLFCstAvlFlg7 0 "FALSE" 1 "TRUE" ;
VAL_TABLE_ DMPDDOBlkhdDrOpnLFCstAvlFlg6 0 "FALSE" 1 "TRUE" ;
VAL_TABLE_ DMPDDOBlkhdDrOpnLFCstAvlFlg5 0 "FALSE" 1 "TRUE" ;
VAL_TABLE_ DMPDDOBlkhdDrOpnLFCstAvlFlg4 0 "FALSE" 1 "TRUE" ;
VAL_TABLE_ DMPDDOBlkhdDrOpnLFCstAvlFlg3 0 "FALSE" 1 "TRUE" ;
VAL_TABLE_ DMPDDOBlkhdDrOpnLFCstAvlFlg2 0 "FALSE" 1 "TRUE" ;
VAL_TABLE_ DMPDDOBlkhdDrOpnLFCstAvlFlg1 0 "FALSE" 1 "TRUE" ;
VAL_TABLE_ SCAOOAByKeyFobLFCstSetAval 0 "FALSE" 1 "TRUE" ;
VAL_TABLE_ SCAOOAByKeyFobLFCstAvlFlg7 0 "FALSE" 1 "TRUE" ;
VAL_TABLE_ SCAOOAByKeyFobLFCstAvlFlg6 0 "FALSE" 1 "TRUE" ;
VAL_TABLE_ SCAOOAByKeyFobLFCstAvlFlg5 0 "FALSE" 1 "TRUE" ;
VAL_TABLE_ SCAOOAByKeyFobLFCstAvlFlg4 0 "FALSE" 1 "TRUE" ;
VAL_TABLE_ SCAOOAByKeyFobLFCstAvlFlg3 0 "FALSE" 1 "TRUE" ;
VAL_TABLE_ SCAOOAByKeyFobLFCstAvlFlg2 0 "FALSE" 1 "TRUE" ;
VAL_TABLE_ SCAOOAByKeyFobLFCstAvlFlg1 0 "FALSE" 1 "TRUE" ;
VAL_TABLE_ SCAOOAByVirtKeyLFCstSetAval 0 "FALSE" 1 "TRUE" ;
VAL_TABLE_ SCAOOAByVirtKeyLFCstAvlFlg7 0 "FALSE" 1 "TRUE" ;
VAL_TABLE_ SCAOOAByVirtKeyLFCstAvlFlg6 0 "FALSE" 1 "TRUE" ;
VAL_TABLE_ SCAOOAByVirtKeyLFCstAvlFlg5 0 "FALSE" 1 "TRUE" ;
VAL_TABLE_ SCAOOAByVirtKeyLFCstAvlFlg4 0 "FALSE" 1 "TRUE" ;
VAL_TABLE_ SCAOOAByVirtKeyLFCstAvlFlg3 0 "FALSE" 1 "TRUE" ;
VAL_TABLE_ SCAOOAByVirtKeyLFCstAvlFlg2 0 "FALSE" 1 "TRUE" ;
VAL_TABLE_ SCAOOAByVirtKeyLFCstAvlFlg1 0 "FALSE" 1 "TRUE" ;
VAL_TABLE_ SCAPDBrktoClsLFCstSetAval 0 "FALSE" 1 "TRUE" ;
VAL_TABLE_ SCAPDBrktoClsLFCstAvlFlg7 0 "FALSE" 1 "TRUE" ;
VAL_TABLE_ SCAPDBrktoClsLFCstAvlFlg6 0 "FALSE" 1 "TRUE" ;
VAL_TABLE_ SCAPDBrktoClsLFCstAvlFlg5 0 "FALSE" 1 "TRUE" ;
VAL_TABLE_ SCAPDBrktoClsLFCstAvlFlg4 0 "FALSE" 1 "TRUE" ;
VAL_TABLE_ SCAPDBrktoClsLFCstAvlFlg3 0 "FALSE" 1 "TRUE" ;
VAL_TABLE_ SCAPDBrktoClsLFCstAvlFlg2 0 "FALSE" 1 "TRUE" ;
VAL_TABLE_ SCAPDBrktoClsLFCstAvlFlg1 0 "FALSE" 1 "TRUE" ;
VAL_TABLE_ SCAPDOpnMaxTrvlCstSetAval 0 "FALSE" 1 "TRUE" ;
VAL_TABLE_ SCAPDOpnMaxTrvlCstAvlFlg7 0 "FALSE" 1 "TRUE" ;
VAL_TABLE_ SCAPDOpnMaxTrvlCstAvlFlg6 0 "FALSE" 1 "TRUE" ;
VAL_TABLE_ SCAPDOpnMaxTrvlCstAvlFlg5 0 "FALSE" 1 "TRUE" ;
VAL_TABLE_ SCAPDOpnMaxTrvlCstAvlFlg4 0 "FALSE" 1 "TRUE" ;
VAL_TABLE_ SCAPDOpnMaxTrvlCstAvlFlg3 0 "FALSE" 1 "TRUE" ;
VAL_TABLE_ SCAPDOpnMaxTrvlCstAvlFlg2 0 "FALSE" 1 "TRUE" ;
VAL_TABLE_ SCAPDOpnMaxTrvlCstAvlFlg1 0 "FALSE" 1 "TRUE" ;
VAL_TABLE_ DMPDClsOutofPrkLFCstCurrSetVal 0 "Setting Unknown" 1 "Off" 2 "On" ;
VAL_TABLE_ DMPDAutoClsTmLFCstCurrSetVal 0 "Setting Unknown" 1 "Standard" 2 "Extended" 3 "Keep Open" ;
VAL_TABLE_ SCAPwrDrMtnLFVirtCtlAval 0 "Not Available" 1 "Available" ;
VAL_TABLE_ PwrSdClsrLFBlckdIndOn 0 "FALSE" 1 "TRUE" ;
VAL_TABLE_ PwrSdClsrLFServIndOn 0 "FALSE" 1 "TRUE" ;
VAL_TABLE_ PwrSdClsrLRBlckdIndOn 0 "FALSE" 1 "TRUE" ;
VAL_TABLE_ PwrSdClsrLRServIndOn 0 "FALSE" 1 "TRUE" ;
VAL_TABLE_ EngOilTmp_Inv 0 "FALSE" 1 "TRUE" ;
VAL_TABLE_ FuelConsmpHvyIndReq 0 "No Indication" 1 "Range" 2 "Low Fuel and Range" ;
VAL_TABLE_ DslExFldTpWrngIndRq 0 "No Indication" 1 "Warning Level 1" 2 "Warning Level 2" 3 "Warning Level 3" 4 "Warning Level 4" 5 "Warning Level 5" 6 "Warning Level 6" 7 "Warning Level 7" 8 "Warning Level 8" 9 "Warning Level 9" 10 "Warning Level 10" 11 "Warning Level 11" 12 "Warning Level 12" 13 "Warning Level 13" 14 "Warning Level 14" 15 "Warning Level 15" ;
VAL_TABLE_ DslExFldCnWrngIndRq 0 "No Indication" 1 "Warning Level 1" 2 "Warning Level 2" 3 "Warning Level 3" 4 "Warning Level 4" 5 "Warning Level 5" 6 "Warning Level 6" 7 "Warning Level 7" 8 "Warning Level 8" 9 "Warning Level 9" 10 "Warning Level 10" 11 "Warning Level 11" 12 "Warning Level 12" 13 "Warning Level 13" 14 "Warning Level 14" 15 "Warning Level 15" ;
VAL_TABLE_ DslExhFldQlyWrngIReq 0 "No Indication" 1 "Warning Level 1" 2 "Warning Level 2" 3 "Warning Level 3" 4 "Warning Level 4" 5 "Warning Level 5" 6 "Warning Level 6" 7 "Warning Level 7" 8 "Warning Level 8" 9 "Warning Level 9" 10 "Warning Level 10" 11 "Warning Level 11" 12 "Warning Level 12" 13 "Warning Level 13" 14 "Warning Level 14" 15 "Warning Level 15" ;
VAL_TABLE_ DslExNxEmWrngIndRq 0 "No Indication" 1 "Warning Level 1" 2 "Warning Level 2" 3 "Warning Level 3" 4 "Warning Level 4" 5 "Warning Level 5" 6 "Warning Level 6" 7 "Warning Level 7" 8 "Warning Level 8" 9 "Warning Level 9" 10 "Warning Level 10" 11 "Warning Level 11" 12 "Warning Level 12" 13 "Warning Level 13" 14 "Warning Level 14" 15 "Warning Level 15" ;
VAL_TABLE_ DslExhFldRmnDist_Inv 0 "FALSE" 1 "TRUE" ;
VAL_TABLE_ DslExhFldWrngIdRqER 0 "No Indication" 1 "Warning Level 1" 2 "Warning Level 2" 3 "Warning Level 3" 4 "Warning Level 4" 5 "Warning Level 5" 6 "Warning Level 6" 7 "Warning Level 7" 8 "Warning Level 8" 9 "Warning Level 9" 10 "Warning Level 10" 11 "Warning Level 11" 12 "Warning Level 12" 13 "Warning Level 13" 14 "Warning Level 14" 15 "Warning Level 15" ;
VAL_TABLE_ ASIRI_Ind05 0 "FALSE" 1 "TRUE" ;
VAL_TABLE_ ASIRI_Ind04 0 "FALSE" 1 "TRUE" ;
VAL_TABLE_ ASIRI_Ind03 0 "FALSE" 1 "TRUE" ;
VAL_TABLE_ ASIRI_Ind02 0 "FALSE" 1 "TRUE" ;
VAL_TABLE_ ASIRI_Ind01 0 "FALSE" 1 "TRUE" ;
VAL_TABLE_ FstIdlModeIndReq 0 "No Indication" 1 "On" 2 "Off" 3 "Unavailable" ;
VAL_TABLE_ CkFlFilrCapIO 0 "FALSE" 1 "TRUE" ;
VAL_TABLE_ CbnHtrWrmUpIndOn 0 "FALSE" 1 "TRUE" ;
VAL_TABLE_ AppCltchAutSrtIO 0 "FALSE" 1 "TRUE" ;
VAL_TABLE_ ASIRI_Ind08 0 "FALSE" 1 "TRUE" ;
VAL_TABLE_ ASIRI_Ind07 0 "FALSE" 1 "TRUE" ;
VAL_TABLE_ ASIRI_Ind06 0 "FALSE" 1 "TRUE" ;
VAL_TABLE_ PTOSet1SpdCstCurrSetVal 0 "Setting Unknown" 1 "RPM 1100" 2 "RPM 1200" 3 "RPM 1300" 4 "RPM 1400" 5 "RPM 1500" 6 "RPM 1600" 7 "RPM 1700" 8 "RPM 1800" 9 "RPM 1900" 10 "RPM 2000" 11 "RPM 2100" 12 "RPM 2200" 13 "RPM 2300" 14 "RPM 2400" 15 "RPM 2500" ;
VAL_TABLE_ PTOEngRunTmrCstCurrSetVal 0 "Setting Unknown" 1 "Min 10" 2 "Min 30" 3 "Min 90" 4 "Min 120" 5 "Min 150" 6 "Min 180" 7 "Min 210" 8 "Min 240" 9 "Min 270" 10 "Min 300" 11 "Min 330" 12 "Min 360" 13 "Min 390" 14 "Min 420" 15 "Min 450" ;
VAL_TABLE_ MnlTrnsIndReq 0 "No Indication" 1 "Indication 1" 2 "Indication 2" 3 "Indication 3" ;
VAL_TABLE_ EngAirFiltMonSts 0 "OK" 1 "Replace Air Filter Soon" 2 "Replace Air Filter Now" 3 "Fault Present" 4 "Disabled" 5 "No Action" ;
VAL_TABLE_ PTOSet2SpdCstCurrSetVal 0 "Setting Unknown" 1 "RPM 1700" 2 "RPM 1800" 3 "RPM 1900" 4 "RPM 2000" 5 "RPM 2100" 6 "RPM 2200" 7 "RPM 2300" 8 "RPM 2400" 9 "RPM 2500" 10 "RPM 2600" 11 "RPM 2700" 12 "RPM 2800" 13 "RPM 2900" 14 "RPM 3000" 15 "RPM 3100" ;
VAL_TABLE_ PTOTpStpSpdCstCurrSetVal 0 "Setting Unknown" 1 "RPM 5" 2 "RPM 10" 3 "RPM 25" 4 "RPM 50" 5 "RPM 100" 6 "RPM 250" 7 "RPM 500" ;
VAL_TABLE_ PTOStndbySpdCstCurrSetVal 0 "Setting Unknown" 1 "RPM 900" 2 "RPM 1000" 3 "RPM 1100" 4 "RPM 1200" 5 "RPM 1300" 6 "RPM 1400" 7 "RPM 1500" ;
VAL_TABLE_ EngHtStpEngIO 0 "FALSE" 1 "TRUE" ;
VAL_TABLE_ EngHtFlEnrchmntIO 0 "FALSE" 1 "TRUE" ;
VAL_TABLE_ PTOModeCstCurrSetVal 0 "Setting Unknown" 1 "Standard" 2 "Remote" ;
VAL_TABLE_ PTOEngmntStsInd 0 "No Indication" 1 "Continuous Indication" 2 "Slow Flashing Indication" 3 "Fast Flashing Indication" ;
VAL_TABLE_ PTOEngSpdTypCstCurrSetVal 0 "Setting Unknown" 1 "Preset" 2 "Variable" ;
VAL_TABLE_ EngWtrInFlIO 0 "FALSE" 1 "TRUE" ;
VAL_TABLE_ EngSpdLmtnMdAct 0 "FALSE" 1 "TRUE" ;
VAL_TABLE_ EngShtdwnPndgIO 0 "FALSE" 1 "TRUE" ;
VAL_TABLE_ EngOilStrvtnIO 0 "FALSE" 1 "TRUE" ;
VAL_TABLE_ EngOilPrsLwIO 0 "FALSE" 1 "TRUE" ;
VAL_TABLE_ EngOilLvlLwIO 0 "FALSE" 1 "TRUE" ;
VAL_TABLE_ EngOilHotIO 0 "FALSE" 1 "TRUE" ;
VAL_TABLE_ EngOilChngIO 0 "FALSE" 1 "TRUE" ;
VAL_TABLE_ PTOMblModeTransInGrIndOn 0 "FALSE" 1 "TRUE" ;
VAL_TABLE_ PTOEngUpnBrkRelIndOn 0 "FALSE" 1 "TRUE" ;
VAL_TABLE_ PTOEngSpdTypCstSetAval 0 "FALSE" 1 "TRUE" ;
VAL_TABLE_ PTOEngRunTmrCstSetAval 0 "FALSE" 1 "TRUE" ;
VAL_TABLE_ PTODisengCruzCtlIndOn 0 "FALSE" 1 "TRUE" ;
VAL_TABLE_ PTOAccelUpnBrkRelIndOn 0 "FALSE" 1 "TRUE" ;
VAL_TABLE_ PTExPrtclFltrWrnIO 0 "FALSE" 1 "TRUE" ;
VAL_TABLE_ PTExPrtclFltrWrn2IO 0 "FALSE" 1 "TRUE" ;
VAL_TABLE_ PTOSet2SpdCstSetAval 0 "FALSE" 1 "TRUE" ;
VAL_TABLE_ PTOSet1SpdCstSetAval 0 "FALSE" 1 "TRUE" ;
VAL_TABLE_ PTOServIndOn 0 "FALSE" 1 "TRUE" ;
VAL_TABLE_ PTORelBrkPedIndOn 0 "FALSE" 1 "TRUE" ;
VAL_TABLE_ PTORelAccelPedIndOn 0 "FALSE" 1 "TRUE" ;
VAL_TABLE_ PTORdcEngSpdIndOn 0 "FALSE" 1 "TRUE" ;
VAL_TABLE_ PTOPrssAndRelBrkPedIndOn 0 "FALSE" 1 "TRUE" ;
VAL_TABLE_ PTOModeCstSetAval 0 "FALSE" 1 "TRUE" ;
VAL_TABLE_ TrnsSkpShftIO 0 "FALSE" 1 "TRUE" ;
VAL_TABLE_ ServFuelSysTrnsfrPmpIO 0 "FALSE" 1 "TRUE" ;
VAL_TABLE_ PTWrmgWtToShftIO 0 "FALSE" 1 "TRUE" ;
VAL_TABLE_ PTOTransInGrIndOn 0 "FALSE" 1 "TRUE" ;
VAL_TABLE_ PTOTpStpSpdCstSetAval 0 "FALSE" 1 "TRUE" ;
VAL_TABLE_ PTOStndbySpdCstSetAval 0 "FALSE" 1 "TRUE" ;
VAL_TABLE_ PTOSetPrkBrkIndOn 0 "FALSE" 1 "TRUE" ;
VAL_TABLE_ OTARC_RejCrdntnECP_X1 0 "FALSE" 1 "TRUE" ;
VAL_TABLE_ OTARC_RejCrdntnECP_S 0 "FALSE" 1 "TRUE" ;
VAL_TABLE_ OTARC_RejCrdntnECP_MC 0 "FALSE" 1 "TRUE" ;
VAL_TABLE_ OTARC_RejCrdntnECM 0 "FALSE" 1 "TRUE" ;
VAL_TABLE_ OTARC_RejCrdntnEBCM 0 "FALSE" 1 "TRUE" ;
VAL_TABLE_ OTARC_RejCrdntnBSM_MH 0 "FALSE" 1 "TRUE" ;
VAL_TABLE_ OTARC_RejCrdntnBSM 0 "FALSE" 1 "TRUE" ;
VAL_TABLE_ OTARC_RejCrdntnBCM 0 "FALSE" 1 "TRUE" ;
VAL_TABLE_ OTARC_RejCrdntnLIB_48V 0 "FALSE" 1 "TRUE" ;
VAL_TABLE_ OTARC_RejCrdntnECP_E 0 "FALSE" 1 "TRUE" ;
VAL_TABLE_ OTARC_RejCrdntnVECM 0 "FALSE" 1 "TRUE" ;
VAL_TABLE_ OTARC_RejCrdntnECP_S2 0 "FALSE" 1 "TRUE" ;
VAL_TABLE_ OTARC_RejCrdntnVICM 0 "FALSE" 1 "TRUE" ;
VAL_TABLE_ OTARC_RejCrdntnSBM 0 "FALSE" 1 "TRUE" ;
VAL_TABLE_ OTARC_RejCrdntnCGM 0 "FALSE" 1 "TRUE" ;
VAL_TABLE_ OTARC_RejCrdntnECP_X2 0 "FALSE" 1 "TRUE" ;
VAL_TABLE_ OTARC_RejCrdntnECU_27 0 "FALSE" 1 "TRUE" ;
VAL_TABLE_ OTARC_RejCrdntnECU_26 0 "FALSE" 1 "TRUE" ;
VAL_TABLE_ OTARC_RejCrdntnECU_25 0 "FALSE" 1 "TRUE" ;
VAL_TABLE_ OTARC_RejCrdntnECU_24 0 "FALSE" 1 "TRUE" ;
VAL_TABLE_ OTARC_RejCrdntnECU_23 0 "FALSE" 1 "TRUE" ;
VAL_TABLE_ OTARC_RejCrdntnECU_22 0 "FALSE" 1 "TRUE" ;
VAL_TABLE_ OTARC_RejCrdntnECU_21 0 "FALSE" 1 "TRUE" ;
VAL_TABLE_ OTARC_RejCrdntnECU_20 0 "FALSE" 1 "TRUE" ;
VAL_TABLE_ OTARC_RejCrdntnTCM 0 "FALSE" 1 "TRUE" ;
VAL_TABLE_ OTARC_RejCrdntnICCM 0 "FALSE" 1 "TRUE" ;
VAL_TABLE_ OTARC_RejCrdntnFICM 0 "FALSE" 1 "TRUE" ;
VAL_TABLE_ OTARC_RejCrdntnECU_32 0 "FALSE" 1 "TRUE" ;
VAL_TABLE_ OTARC_RejCrdntnECU_31 0 "FALSE" 1 "TRUE" ;
VAL_TABLE_ OTARC_RejCrdntnECU_30 0 "FALSE" 1 "TRUE" ;
VAL_TABLE_ OTARC_RejCrdntnECU_29 0 "FALSE" 1 "TRUE" ;
VAL_TABLE_ OTARC_RejCrdntnECU_28 0 "FALSE" 1 "TRUE" ;
VAL_TABLE_ PrplDispBatPwr_Inv 0 "FALSE" 1 "TRUE" ;
VAL_TABLE_ PrplDispBatPwr_DuD 0 "FALSE" 1 "TRUE" ;
VAL_TABLE_ PrplDispEngPwr_Inv 0 "FALSE" 1 "TRUE" ;
VAL_TABLE_ PrplDispEngPwr_DuD 0 "FALSE" 1 "TRUE" ;
VAL_TABLE_ BatPrplDispTrqLvlPct_DuD 0 "FALSE" 1 "TRUE" ;
VAL_TABLE_ PrplDispBatTrq_Inv 0 "FALSE" 1 "TRUE" ;
VAL_TABLE_ PrplDispBatTrq_DuD 0 "FALSE" 1 "TRUE" ;
VAL_TABLE_ CustNonUsblSOC_Inv 0 "FALSE" 1 "TRUE" ;
VAL_TABLE_ CustNonUsblSOC_DuD 0 "FALSE" 1 "TRUE" ;
VAL_TABLE_ CustUsblSOC_Inv 0 "FALSE" 1 "TRUE" ;
VAL_TABLE_ CustUsblSOC_DuD 0 "FALSE" 1 "TRUE" ;
VAL_TABLE_ BatPrplDispPwrLvlPct_DuD 0 "FALSE" 1 "TRUE" ;
VAL_TABLE_ ElecMtrATach_Inv 0 "FALSE" 1 "TRUE" ;
VAL_TABLE_ ElecMtrATach_DuD 0 "FALSE" 1 "TRUE" ;
VAL_TABLE_ HiVltgBatAvgTemp_DuD 0 "FALSE" 1 "TRUE" ;
VAL_TABLE_ HiVltgBatAvgTemp_Inv 0 "FALSE" 1 "TRUE" ;
VAL_TABLE_ EngPrplDispPwrLvlPct_DuD 0 "FALSE" 1 "TRUE" ;
VAL_TABLE_ EngRnngDueToVehSpdIndOn 0 "FALSE" 1 "TRUE" ;
VAL_TABLE_ ElecAllWhlDrvIndOn 0 "FALSE" 1 "TRUE" ;
VAL_TABLE_ DischrgPwrLtdIndOn 0 "FALSE" 1 "TRUE" ;
VAL_TABLE_ DischrgPwrLtdDispPctVsbl 0 "FALSE" 1 "TRUE" ;
VAL_TABLE_ HiVltgBatLmtnDueToTempInd 0 "Normal" 1 "Cold" 2 "Hot" ;
VAL_TABLE_ HybModeDisp 0 "No Action" 1 "Battery Power" 2 "Engine Power" 3 "Hybrid Power" 4 "Charging with Engine Off" 5 "Charging with Engine On" 6 "Neutral Engine On" 7 "Neutral Engine Off" 8 "Engine Charging" 9 "Engine Power Rear with Battery Front" 10 "Engine Power Rear with Front Wheel Regen" 11 "Undetermined" 12 "Default and Accessory" 13 "Engine Idle" 14 "Reserved 1" 15 "Reserved 2" 16 "Reserved 3" ;
VAL_TABLE_ HTD1_FuelAvdd_DuD 0 "FALSE" 1 "TRUE" ;
VAL_TABLE_ InstnsFuelEconHybOvrrdReq 0 "No Action" 1 "Min Fuel Economy" 2 "Max Fuel Economy" 3 "Auto Stop" 4 "EV" ;
VAL_TABLE_ HybModeDispVehCfg 0 "No Action" 1 "Not in Motion" 2 "FWD" 3 "RWD" 4 "4WD" ;
VAL_TABLE_ HiVltgChrgrSysSts 0 "Default" 1 "Idle" 2 "Initializing" 3 "Active" 4 "Complete" 5 "Aborted" 6 "Utility Override Active" 7 "Utility Override Reduced Power" 8 "Pause Due to Update" 9 "Connection Unpowered" 10 "Unconnected" 11 "Offboard Energy Transfer Active" ;
VAL_TABLE_ HybShfToPrkIndOn 0 "FALSE" 1 "TRUE" ;
VAL_TABLE_ HiVltgSysDsbld 0 "FALSE" 1 "TRUE" ;
VAL_TABLE_ JmpStrtSts 0 "Inactive" 1 "In Progress" 2 "Complete" 3 "Power Mode" 4 "Disabled" ;
VAL_TABLE_ PrplDispTotPwr_DuD 0 "FALSE" 1 "TRUE" ;
VAL_TABLE_ PrplDispTotPwr_Inv 0 "FALSE" 1 "TRUE" ;
VAL_TABLE_ ServHybSysIndOn 0 "FALSE" 1 "TRUE" ;
VAL_TABLE_ RegenPwrLimdIndOn 0 "FALSE" 1 "TRUE" ;
VAL_TABLE_ RegenPwrLimdDispPctVsbl 0 "FALSE" 1 "TRUE" ;
VAL_TABLE_ PrplDispTotPwrUntDisp 0 "kilowatt" 1 "Horsepower" ;
VAL_TABLE_ LossOfPrplIndOn 0 "FALSE" 1 "TRUE" ;
VAL_TABLE_ ServHiVltgBatIndReq 0 "No Indication" 1 "Shut Down Soon" 2 "No Restart" ;
VAL_TABLE_ BrkPadLifeFrtDistWrnIndReq 0 "No Action" 1 "Low" 2 "Display Distance" ;
VAL_TABLE_ BrkPadLifeStsIndReq 0 "No Action" 1 "Not Present" 2 "Ok" 3 "Change Soon" 4 "Change Now" 5 "Disabled" 6 "Service" ;
VAL_TABLE_ BrkPadLifeRrDistWrnIndReq 0 "No Action" 1 "Low" 2 "Display Distance" ;
VAL_TABLE_ ESCSpdLtdIndReq 0 "No Indication" 1 "Countdown" 2 "Limited" ;
VAL_TABLE_ HillDscntCtlRdcVehSpdIndOn 0 "FALSE" 1 "TRUE" ;
VAL_TABLE_ HillDscntCtlDispActvIndOn 0 "FALSE" 1 "TRUE" ;
VAL_TABLE_ BrkPadLifeFrtCnfrmRplcmtIndOn 0 "FALSE" 1 "TRUE" ;
VAL_TABLE_ BrkOvrhtdIndOn 0 "FALSE" 1 "TRUE" ;
VAL_TABLE_ AllWhlDrvRcmndIndOn 0 "FALSE" 1 "TRUE" ;
VAL_TABLE_ CrwlModeDndRsnIndReq 0 "No Indication" 1 "Unavailable" 2 "Brakes Overtemp" 3 "Shift to 4 High" 4 "Reduce Speed" ;
VAL_TABLE_ BrksOvrht 0 "FALSE" 1 "TRUE" ;
VAL_TABLE_ BrkSysTwoFtdDrvDtdIndOn 0 "FALSE" 1 "TRUE" ;
VAL_TABLE_ BrkSysHillStrtAsstAvl 0 "FALSE" 1 "TRUE" ;
VAL_TABLE_ BrkPadWrnIO 0 "FALSE" 1 "TRUE" ;
VAL_TABLE_ BrkPadLifeRrCnfrmRplcmtIndOn 0 "FALSE" 1 "TRUE" ;
VAL_TABLE_ LnchCtlWhlSlSts 0 "No Action" 1 "Five Percent" 2 "Five And A Half Percent" 3 "Six Percent" 4 "Six And A Half Percent" 5 "Seven Percent" 6 "Seven And A Half Percent" 7 "Eight Percent" 8 "Eight And A Half Percent" 9 "Nine Percent" 10 "Nine And A Half Percent" 11 "Ten Percent" 12 "Ten And A Half Percent" 13 "Eleven Percent" 14 "Eleven And a Half Percent" 15 "Twelve Percent" 16 "Twelve And A Half Percent" 17 "Thirteen Percent" 18 "Thirteen And A Half Percent" 19 "Fourteen Percent" 20 "Fourteen And A Half Percent" 21 "Fifteen Percent" ;
VAL_TABLE_ LnchCtlEngRPMSts 0 "No Action" 1 "800" 2 "900" 3 "1000" 4 "1100" 5 "1200" 6 "1300" 7 "1400" 8 "1500" 9 "1600" 10 "1700" 11 "1800" 12 "1900" 13 "2000" 14 "2100" 15 "2200" 16 "2300" 17 "2400" 18 "2500" 19 "2600" 20 "2700" 21 "2800" 22 "2900" 23 "3000" 24 "3100" 25 "3200" 26 "3300" 27 "3400" 28 "3500" 29 "3600" 30 "3700" 31 "3800" 32 "3900" 33 "4000" 34 "FlexibleRPM 1" 35 "FlexibleRPM 2" 36 "FlexibleRPM 3" 37 "FlexibleRPM 4" 38 "FlexibleRPM 5" ;
VAL_TABLE_ DrvModeVisScreenSts 0 "No_Action" 1 "Custom" 2 "Personal" 3 "Sport" 4 "Snow_Ice" 5 "Weather" 6 "Tour" 7 "Track" 8 "Offroad" 9 "TowHaul" 10 "PerformanceSportPlus" 11 "Terrain" 12 "Baja" 13 "BoatRamp" ;
VAL_TABLE_ EngSndPerfModeReq 0 "No Action" 1 "Tour" 2 "Sport_OffRoad" 3 "Track" 4 "Stealth" 5 "Max Power" 6 "Terrain" 7 "Performance Mode 7" ;
VAL_TABLE_ PerfTracMgmtMode 0 "Disabled" 1 "Wet" 2 "Dry" 3 "Sport 1" 4 "Sport 2/Race 1" 5 "Race" 6 "Inactive" 7 "Pro" ;
VAL_TABLE_ HillDscntCtlSysSts 0 "Unknown" 1 "Normal" 2 "Enabled" 3 "Active" 4 "Failed" ;
VAL_TABLE_ SprtModeDrvlineVisDispVal 0 "Setting_Unknown" 1 "Custom_Mode_1" 2 "Custom_Mode_2" 3 "Custom_Mode_3" 4 "Custom_Mode_4" 5 "Custom_Mode_5" 6 "Custom_Mode_6" 7 "Custom_Mode_7" ;
VAL_TABLE_ SprtModeBrkPedVisDispVal 0 "Setting_Unknown" 1 "Custom_Mode_1" 2 "Custom_Mode_2" 3 "Custom_Mode_3" 4 "Custom_Mode_4" 5 "Custom_Mode_5" 6 "Custom_Mode_6" 7 "Custom_Mode_7" ;
VAL_TABLE_ SprtModeActvAeroVisDispVal 0 "Setting_Unknown" 1 "Custom_Mode_1" 2 "Custom_Mode_2" 3 "Custom_Mode_3" 4 "Custom_Mode_4" 5 "Custom_Mode_5" 6 "Custom_Mode_6" 7 "Custom_Mode_7" ;
VAL_TABLE_ SprtModeRideHghtVisDispVal 0 "Setting_Unknown" 1 "Custom_Mode_1" 2 "Custom_Mode_2" 3 "Custom_Mode_3" 4 "Custom_Mode_4" 5 "Custom_Mode_5" 6 "Custom_Mode_6" 7 "Custom_Mode_7" ;
VAL_TABLE_ SprtModePwrtrnVisDispVal 0 "Setting_Unknown" 1 "Custom_Mode_1" 2 "Custom_Mode_2" 3 "Custom_Mode_3" 4 "Custom_Mode_4" 5 "Custom_Mode_5" 6 "Custom_Mode_6" 7 "Custom_Mode_7" ;
VAL_TABLE_ SprtModeESCVisDispVal 0 "Setting_Unknown" 1 "Custom_Mode_1" 2 "Custom_Mode_2" 3 "Custom_Mode_3" 4 "Custom_Mode_4" 5 "Custom_Mode_5" 6 "Custom_Mode_6" 7 "Custom_Mode_7" ;
VAL_TABLE_ SprtModeSpnsnVisDispVal 0 "Setting_Unknown" 1 "Custom_Mode_1" 2 "Custom_Mode_2" 3 "Custom_Mode_3" 4 "Custom_Mode_4" 5 "Custom_Mode_5" 6 "Custom_Mode_6" 7 "Custom_Mode_7" ;
VAL_TABLE_ SprtModeSndVisDispVal 0 "Setting_Unknown" 1 "Custom_Mode_1" 2 "Custom_Mode_2" 3 "Custom_Mode_3" 4 "Custom_Mode_4" 5 "Custom_Mode_5" 6 "Custom_Mode_6" 7 "Custom_Mode_7" ;
VAL_TABLE_ ShfToPrkBfrExtIndOn 0 "FALSE" 1 "TRUE" ;
VAL_TABLE_ HillDscntCtlVirtSwAvl 0 "Not Available" 1 "Available" ;
VAL_TABLE_ WthrSnwModeStrgVisDispVal 0 "Setting_Unknown" 1 "Custom_Mode_1" 2 "Custom_Mode_2" 3 "Custom_Mode_3" 4 "Custom_Mode_4" 5 "Custom_Mode_5" 6 "Custom_Mode_6" 7 "Custom_Mode_7" ;
VAL_TABLE_ SprtModeStrgVisDispVal 0 "Setting_Unknown" 1 "Custom_Mode_1" 2 "Custom_Mode_2" 3 "Custom_Mode_3" 4 "Custom_Mode_4" 5 "Custom_Mode_5" 6 "Custom_Mode_6" 7 "Custom_Mode_7" ;
VAL_TABLE_ TkModeBrkPedVisDispVal 0 "Setting_Unknown" 1 "Custom_Mode_1" 2 "Custom_Mode_2" 3 "Custom_Mode_3" 4 "Custom_Mode_4" 5 "Custom_Mode_5" 6 "Custom_Mode_6" 7 "Custom_Mode_7" ;
VAL_TABLE_ TkModeActvAeroVisDispVal 0 "Setting_Unknown" 1 "Custom_Mode_1" 2 "Custom_Mode_2" 3 "Custom_Mode_3" 4 "Custom_Mode_4" 5 "Custom_Mode_5" 6 "Custom_Mode_6" 7 "Custom_Mode_7" ;
VAL_TABLE_ TireTrdTempSts 0 "Unknown" 1 "Cold" 2 "Cool" 3 "Normal" 4 "Warm" 5 "Hot" ;
VAL_TABLE_ TkModePwrtrnVisDispVal 0 "Setting_Unknown" 1 "Custom_Mode_1" 2 "Custom_Mode_2" 3 "Custom_Mode_3" 4 "Custom_Mode_4" 5 "Custom_Mode_5" 6 "Custom_Mode_6" 7 "Custom_Mode_7" ;
VAL_TABLE_ TkModeESCVisDispVal 0 "Setting_Unknown" 1 "Custom_Mode_1" 2 "Custom_Mode_2" 3 "Custom_Mode_3" 4 "Custom_Mode_4" 5 "Custom_Mode_5" 6 "Custom_Mode_6" 7 "Custom_Mode_7" ;
VAL_TABLE_ TkModeDrvlineVisDispVal 0 "Setting_Unknown" 1 "Custom_Mode_1" 2 "Custom_Mode_2" 3 "Custom_Mode_3" 4 "Custom_Mode_4" 5 "Custom_Mode_5" 6 "Custom_Mode_6" 7 "Custom_Mode_7" ;
VAL_TABLE_ TkModeSndVisDispVal 0 "Setting_Unknown" 1 "Custom_Mode_1" 2 "Custom_Mode_2" 3 "Custom_Mode_3" 4 "Custom_Mode_4" 5 "Custom_Mode_5" 6 "Custom_Mode_6" 7 "Custom_Mode_7" ;
VAL_TABLE_ TkModeRideHghtVisDispVal 0 "Setting_Unknown" 1 "Custom_Mode_1" 2 "Custom_Mode_2" 3 "Custom_Mode_3" 4 "Custom_Mode_4" 5 "Custom_Mode_5" 6 "Custom_Mode_6" 7 "Custom_Mode_7" ;
VAL_TABLE_ TourModeActvAeroVisDispVal 0 "Setting_Unknown" 1 "Custom_Mode_1" 2 "Custom_Mode_2" 3 "Custom_Mode_3" 4 "Custom_Mode_4" 5 "Custom_Mode_5" 6 "Custom_Mode_6" 7 "Custom_Mode_7" ;
VAL_TABLE_ TkModeStrgVisDispVal 0 "Setting_Unknown" 1 "Custom_Mode_1" 2 "Custom_Mode_2" 3 "Custom_Mode_3" 4 "Custom_Mode_4" 5 "Custom_Mode_5" 6 "Custom_Mode_6" 7 "Custom_Mode_7" ;
VAL_TABLE_ TkModeSpnsnVisDispVal 0 "Setting_Unknown" 1 "Custom_Mode_1" 2 "Custom_Mode_2" 3 "Custom_Mode_3" 4 "Custom_Mode_4" 5 "Custom_Mode_5" 6 "Custom_Mode_6" 7 "Custom_Mode_7" ;
VAL_TABLE_ TourModeESCVisDispVal 0 "Setting_Unknown" 1 "Custom_Mode_1" 2 "Custom_Mode_2" 3 "Custom_Mode_3" 4 "Custom_Mode_4" 5 "Custom_Mode_5" 6 "Custom_Mode_6" 7 "Custom_Mode_7" ;
VAL_TABLE_ TourModeDrvlineVisDispVal 0 "Setting_Unknown" 1 "Custom_Mode_1" 2 "Custom_Mode_2" 3 "Custom_Mode_3" 4 "Custom_Mode_4" 5 "Custom_Mode_5" 6 "Custom_Mode_6" 7 "Custom_Mode_7" ;
VAL_TABLE_ TourModeBrkPedVisDispVal 0 "Setting_Unknown" 1 "Custom_Mode_1" 2 "Custom_Mode_2" 3 "Custom_Mode_3" 4 "Custom_Mode_4" 5 "Custom_Mode_5" 6 "Custom_Mode_6" 7 "Custom_Mode_7" ;
VAL_TABLE_ TourModeRideHghtVisDispVal 0 "Setting_Unknown" 1 "Custom_Mode_1" 2 "Custom_Mode_2" 3 "Custom_Mode_3" 4 "Custom_Mode_4" 5 "Custom_Mode_5" 6 "Custom_Mode_6" 7 "Custom_Mode_7" ;
VAL_TABLE_ TourModePwrtrnVisDispVal 0 "Setting_Unknown" 1 "Custom_Mode_1" 2 "Custom_Mode_2" 3 "Custom_Mode_3" 4 "Custom_Mode_4" 5 "Custom_Mode_5" 6 "Custom_Mode_6" 7 "Custom_Mode_7" ;
VAL_TABLE_ TourModeStrgVisDispVal 0 "Setting_Unknown" 1 "Custom_Mode_1" 2 "Custom_Mode_2" 3 "Custom_Mode_3" 4 "Custom_Mode_4" 5 "Custom_Mode_5" 6 "Custom_Mode_6" 7 "Custom_Mode_7" ;
VAL_TABLE_ TourModeSpnsnVisDispVal 0 "Setting_Unknown" 1 "Custom_Mode_1" 2 "Custom_Mode_2" 3 "Custom_Mode_3" 4 "Custom_Mode_4" 5 "Custom_Mode_5" 6 "Custom_Mode_6" 7 "Custom_Mode_7" ;
VAL_TABLE_ TourModeSndVisDispVal 0 "Setting_Unknown" 1 "Custom_Mode_1" 2 "Custom_Mode_2" 3 "Custom_Mode_3" 4 "Custom_Mode_4" 5 "Custom_Mode_5" 6 "Custom_Mode_6" 7 "Custom_Mode_7" ;
VAL_TABLE_ TrlrStbAsstActIO 0 "FALSE" 1 "TRUE" ;
VAL_TABLE_ TrcCntrlOnIO 0 "FALSE" 1 "TRUE" ;
VAL_TABLE_ TrcCntrlOffIO 0 "FALSE" 1 "TRUE" ;
VAL_TABLE_ TnDrvTrCtrlOffUnvIndOn 0 "FALSE" 1 "TRUE" ;
VAL_TABLE_ SrBkLwBkFlDrVisMsgRqOn 0 "FALSE" 1 "TRUE" ;
VAL_TABLE_ TrcStbScrConfig 0 "None" 1 "TCS Only" 2 "TCS and ESC" 3 "TCS ESC and Comp" ;
VAL_TABLE_ EngIntkArBstPr_Inv 0 "FALSE" 1 "TRUE" ;
VAL_TABLE_ FlInjRlCtRstOcc 0 "FALSE" 1 "TRUE" ;
VAL_TABLE_ EngRcmndDwnsftIndOn 0 "FALSE" 1 "TRUE" ;
VAL_TABLE_ EngFuelInjnSysFltIndOn 0 "FALSE" 1 "TRUE" ;
VAL_TABLE_ IdlRecmndToClEngIO 0 "FALSE" 1 "TRUE" ;
VAL_TABLE_ FuelSysNEmsRltMlfActv 0 "FALSE" 1 "TRUE" ;
VAL_TABLE_ FuelFiltChgNowIndOn 0 "FALSE" 1 "TRUE" ;
VAL_TABLE_ ChrgCordThftAlrtCstSetAval 0 "FALSE" 1 "TRUE" ;
VAL_TABLE_ ChrgCordThftAlrtCstCurrSetVal 0 "No Action" 1 "Off" 2 "On" ;
VAL_TABLE_ ChrgPwrLossAlrtCstSetAval 0 "FALSE" 1 "TRUE" ;
VAL_TABLE_ ChrgrSysAudblIndCstCurrSetVal 0 "No Action" 1 "Off" 2 "On" ;
VAL_TABLE_ ChrgPwrLossAlrtCstCurrSetVal 0 "No Action" 1 "Off" 2 "On" ;
VAL_TABLE_ ChrgPortDrIndReq 0 "Inactive" 1 "Open Park" 2 "Open Moving" 3 "Fault" ;
VAL_TABLE_ InsfcntTmtoCmpltChrgIndOn 0 "FALSE" 1 "TRUE" ;
VAL_TABLE_ CntctrsOpnUndrTempIndOn 0 "FALSE" 1 "TRUE" ;
VAL_TABLE_ ChrgrSysAudblIndCstSetAval 0 "FALSE" 1 "TRUE" ;
VAL_TABLE_ ChrgStsPeekInScrnActvIndOn 0 "FALSE" 1 "TRUE" ;
VAL_TABLE_ PrtblChrgCordLimCstSetAval 0 "FALSE" 1 "TRUE" ;
VAL_TABLE_ OffBrdChrgStnFltDtd 0 "FALSE" 1 "TRUE" ;
VAL_TABLE_ NeutCstdwnCertModeActvIndOn 0 "FALSE" 1 "TRUE" ;
VAL_TABLE_ LocBsdChrgCstSetAval 0 "FALSE" 1 "TRUE" ;
VAL_TABLE_ LocBsdChrgCstCurrSetVal 0 "No Action" 1 "Off" 2 "On" ;
VAL_TABLE_ LBCPSS_PstnUpdtLoc 0 "No Action" 1 "Update Position 1" 2 "Update Position 2" 3 "Update Position 3" 4 "Update Position 4" ;
VAL_TABLE_ LBCCDRR_PstnNumResp 0 "No Action" 1 "Clear Position 1" 2 "Clear Position 2" 3 "Clear Position 3" 4 "Clear Position 4" ;
VAL_TABLE_ LBCCDRR_ClrStrdPstnResp 0 "No Action" 1 "Clear Position Request Acknowledged" 2 "Clear Position Request Performed" ;
VAL_TABLE_ ServHybChrgSysIndOn 0 "FALSE" 1 "TRUE" ;
VAL_TABLE_ LBCCF_Loc4PstnStrdIndOn 0 "FALSE" 1 "TRUE" ;
VAL_TABLE_ LBCCF_Loc3PstnStrdIndOn 0 "FALSE" 1 "TRUE" ;
VAL_TABLE_ LBCCF_Loc2PstnStrdIndOn 0 "FALSE" 1 "TRUE" ;
VAL_TABLE_ LBCCF_Loc1PstnStrdIndOn 0 "FALSE" 1 "TRUE" ;
VAL_TABLE_ LBCPSS_PstnUpdtSts 0 "No Action" 1 "Position Updated" 2 "Position Modified" ;
VAL_TABLE_ VehLocSts 0 "Not Within Stored Regions" 1 "Within Stored Region 1" 2 "Within Stored Region 2" 3 "Within Stored Region 3" 4 "Within Stored Region 4" ;
VAL_TABLE_ VehLocSts_Inv 0 "FALSE" 1 "TRUE" ;
VAL_TABLE_ TODCSR_ChrgSchedDyOfWkResp 0 "No Action" 1 "Sunday" 2 "Monday" 3 "Tuesday" 4 "Wednesday" 5 "Thursday" 6 "Friday" 7 "Saturday" 8 "All Days Same" 9 "Monday to Friday Same" 10 "Saturday and Sunday Same" ;
VAL_TABLE_ TODCSR_ChrgSchedCstSetVal 0 "No Action" 1 "Off" 2 "On" ;
VAL_TABLE_ TODCSR_ERSPrdDyResp 0 "No Action" 1 "Weekday 1" 2 "Weekday 2" 3 "Weekday 3" 4 "Weekday 4" 5 "Weekday 5" 6 "Weekend 1" 7 "Weekend 2" 8 "Weekend 3" 9 "Weekend 4" 10 "Weekend 5" ;
VAL_TABLE_ TODCSR_ERSCstSetVal 0 "No Action" 1 "Off" 2 "On" ;
VAL_TABLE_ TODCSR_ERSPrdLvlResp 0 "No Action" 1 "Low Rate" 2 "Medium Rate" 3 "High Rate" 4 "Reserved 1" 5 "Invalid Rate" ;
VAL_TABLE_ PrtblChrgCordLimCstSetResp 0 "No Action" 1 "Reduced" 2 "Maximum" ;
VAL_TABLE_ TODCSR_ERSPrfResp 0 "No Action" 1 "Low Rate" 2 "Medium Rate" 3 "High Rate" ;
VAL_TABLE_ TODCCbnPrcndtngSetResp 0 "No Action" 1 "Off" 2 "On" ;
VAL_TABLE_ TODCSR_LocNumResp 0 "No Action" 1 "Not in Stored Location" 2 "Stored Location 1" 3 "Stored Location 2" 4 "Stored Location 3" 5 "Stored Location 4" ;
VAL_TABLE_ TODCSR_LocChrgPwrLvlResp 0 "Unknown" 1 "Level 1" 2 "Level 2" 3 "DC" 4 "Wireless" ;
VAL_TABLE_ UtlChrgIntfrIndOn 0 "FALSE" 1 "TRUE" ;
VAL_TABLE_ TODCNP_DprtrDyOfWk 0 "Unknown" 1 "Sunday" 2 "Monday" 3 "Tuesday" 4 "Wednesday" 5 "Thursday" 6 "Friday" 7 "Saturday" ;
VAL_TABLE_ TODCNP_Chrg 0 "No Action" 1 "Charge Now" 2 "Charge Later" 3 "Invalid" ;
VAL_TABLE_ TODCNP_PCCLCstCurrSetVal 0 "No Action" 1 "Reduced" 2 "Maximum" ;
VAL_TABLE_ TmOfDyChrgInvHMIEntIndReqd 0 "FALSE" 1 "TRUE" ;
VAL_TABLE_ PrtblChrgCordLimSetExpIndOn 0 "FALSE" 1 "TRUE" ;
VAL_TABLE_ RngPerHrGaindThisChrg_DuD 0 "FALSE" 1 "TRUE" ;
VAL_TABLE_ RngGaindThisChrg_DuD 0 "FALSE" 1 "TRUE" ;
VAL_TABLE_ TODCNextPlndCbnPrcndtngSetResp 0 "No Action" 1 "Off" 2 "On" ;
VAL_TABLE_ EngyEconMeasUnt 0 "Distance Per Electrical Energy" 1 "Distance Per Volume Equivalent" 2 "Electrical Energy Per Distance" 3 "Volume Equivalent Per Distance" 4 "Electrical Energy Per Distance x 100" 5 "Volume Equivalent Per Distance x 100" ;
VAL_TABLE_ ECHG_CurrEconRdy 0 "FALSE" 1 "TRUE" ;
VAL_TABLE_ HiVltgChrgAbrtRsn 0 "No Action" 1 "Loss of AC" 2 "Unplugged Charging" 3 "Unplugged Delayed" 4 "Charge Failure" 5 "Cordset Fault" 6 "Cordset Delay" ;
VAL_TABLE_ HiVltgChrgSysSplyFltIndOn 0 "FALSE" 1 "TRUE" ;
VAL_TABLE_ HiVltgBatStopChrgBtnVsbl 0 "FALSE" 1 "TRUE" ;
VAL_TABLE_ HiVltgBatChrgCordCnctdIndOn 0 "FALSE" 1 "TRUE" ;
VAL_TABLE_ HiVltgBatBulkChrgCmplt 0 "FALSE" 1 "TRUE" ;
VAL_TABLE_ ElecPrplMtrOvrSpdIndOn 0 "FALSE" 1 "TRUE" ;
VAL_TABLE_ HiVltgChrgInhbRsn 0 "No Action" 1 "Cord Not Fully Inserted" 2 "Cord Lock Not Engaged" 3 "See Charging Station" ;
VAL_TABLE_ DrvCycEleclEngyUsd_DuD 0 "FALSE" 1 "TRUE" ;
VAL_TABLE_ HiVltgBatPrplRng_Inv 0 "FALSE" 1 "TRUE" ;
VAL_TABLE_ HiVltgBatPrplRng_DuD 0 "FALSE" 1 "TRUE" ;
VAL_TABLE_ HiVltgBatRmnUsblEngy_Inv 0 "FALSE" 1 "TRUE" ;
VAL_TABLE_ HiVltgBatRmnUsblEngy_DuD 0 "FALSE" 1 "TRUE" ;
VAL_TABLE_ DispHiVltgBatChrgCmpltInfo 0 "FALSE" 1 "TRUE" ;
VAL_TABLE_ ElecRateSchedSsnResp 0 "No Action" 1 "Summer" 2 "Winter" 3 "Yearly" ;
VAL_TABLE_ HiVltgBatTotUsblEngy_Inv 0 "FALSE" 1 "TRUE" ;
VAL_TABLE_ HiVltgBatTotUsblEngy_DuD 0 "FALSE" 1 "TRUE" ;
VAL_TABLE_ ElecRateSchedSsnStrtMthResp 0 "No Action" 1 "January" 2 "February" 3 "March" 4 "April" 5 "May" 6 "June" 7 "July" 8 "August" 9 "September" 10 "October" 11 "November" 12 "December" ;
VAL_TABLE_ StrgWhlTchSnsHndsOnStat 0 "Hands Off" 1 "Hands On" ;
VAL_TABLE_ ACCAutoStSpStat 0 "No_Set_Speed_Change" 1 "Proposed_Speed_Limit_Change" 2 "Accepted_Speed_Limit_Change" 3 "Declined_Speed_Limit_Change" ;
VAL_TABLE_ ACCSpdLimSgnUnt 0 "km/h" 1 "mph" ;
VAL_TABLE_ ACCDrSlctdSpdIndOn 0 "FALSE" 1 "TRUE" ;
VAL_TABLE_ FrwdImpMtgnOpSlctCstCrStVal 0 "SETTING_UNKNOWN" 1 "OFF" 2 "ALERT" 3 "ALERT_BRAKE" 4 "ALERT_BRAKE_STEER" 5 "RESERVED_5" 6 "RESERVED_6" 7 "RESERVED_7" ;
VAL_TABLE_ FrntPCMRspTypCstCrStVal 0 "SETTING_UNKNOWN" 1 "OFF" 2 "ALERT" 3 "ALERT_AND_BRAKE" 4 "ALERT_AND_BRAKE_AND_STEER" 5 "RESERVED_5" 6 "RESERVED_6" 7 "RESERVED_7" ;
VAL_TABLE_ ACCSysSlctdMd 0 "Cruise Control Mode Switching Not Supported" 1 "Adaptive Cruise Control" 2 "Enhanced Cruise Control" ;
VAL_TABLE_ FrntPCMRspTypCstAvlFlg1 0 "FALSE" 1 "TRUE" ;
VAL_TABLE_ AutoEmrgBrkgDsbldIndOn 0 "FALSE" 1 "TRUE" ;
VAL_TABLE_ ACCGoNtfrChmEvntSt 0 "NO_ACTION" 1 "ACTIVE" ;
VAL_TABLE_ AnmlWrnIndReq 0 "Off" 1 "Animal Advisory" 2 "Animal Alert" ;
VAL_TABLE_ FrwdVehAhdIndReq 0 "OFF" 1 "ON" 2 "0.5_Hz" 3 "1_Hz" 4 "2_Hz" 5 "4_Hz" ;
VAL_TABLE_ FrtPedtrnClsnMtgnAudAttnReqd 0 "FALSE" 1 "TRUE" ;
VAL_TABLE_ FrntPCMRspTypCstStAvl 0 "FALSE" 1 "TRUE" ;
VAL_TABLE_ FrntPCMRspTypCstAvlFlg7 0 "FALSE" 1 "TRUE" ;
VAL_TABLE_ FrntPCMRspTypCstAvlFlg6 0 "FALSE" 1 "TRUE" ;
VAL_TABLE_ FrntPCMRspTypCstAvlFlg5 0 "FALSE" 1 "TRUE" ;
VAL_TABLE_ FrntPCMRspTypCstAvlFlg4 0 "FALSE" 1 "TRUE" ;
VAL_TABLE_ FrntPCMRspTypCstAvlFlg3 0 "FALSE" 1 "TRUE" ;
VAL_TABLE_ FrntPCMRspTypCstAvlFlg2 0 "FALSE" 1 "TRUE" ;
VAL_TABLE_ FrwdImpMtgnOpSlctCstAvlFlg7 0 "FALSE" 1 "TRUE" ;
VAL_TABLE_ FrwdImpMtgnOpSlctCstAvlFlg6 0 "FALSE" 1 "TRUE" ;
VAL_TABLE_ FrwdImpMtgnOpSlctCstAvlFlg5 0 "FALSE" 1 "TRUE" ;
VAL_TABLE_ FrwdImpMtgnOpSlctCstAvlFlg4 0 "FALSE" 1 "TRUE" ;
VAL_TABLE_ FrwdImpMtgnOpSlctCstAvlFlg3 0 "FALSE" 1 "TRUE" ;
VAL_TABLE_ FrwdImpMtgnOpSlctCstAvlFlg2 0 "FALSE" 1 "TRUE" ;
VAL_TABLE_ FrwdImpMtgnOpSlctCstAvlFlg1 0 "FALSE" 1 "TRUE" ;
VAL_TABLE_ FrwdClsnAlrtImntAlrtAudAttnReqd 0 "FALSE" 1 "TRUE" ;
VAL_TABLE_ GoNotfrCstAvlFlg7 0 "FALSE" 1 "TRUE" ;
VAL_TABLE_ GoNotfrCstAvlFlg6 0 "FALSE" 1 "TRUE" ;
VAL_TABLE_ GoNotfrCstAvlFlg5 0 "FALSE" 1 "TRUE" ;
VAL_TABLE_ GoNotfrCstAvlFlg4 0 "FALSE" 1 "TRUE" ;
VAL_TABLE_ GoNotfrCstAvlFlg3 0 "FALSE" 1 "TRUE" ;
VAL_TABLE_ GoNotfrCstAvlFlg2 0 "FALSE" 1 "TRUE" ;
VAL_TABLE_ GoNotfrCstAvlFlg1 0 "FALSE" 1 "TRUE" ;
VAL_TABLE_ FrwdImpMtgnOpSlctCstStAvl 0 "FALSE" 1 "TRUE" ;
VAL_TABLE_ PrplSysSndEnhtAdjdEngTrqEst_Inv 0 "FALSE" 1 "TRUE" ;
VAL_TABLE_ HVBCC_DyOfWk 0 "Unknown" 1 "Sunday" 2 "Monday" 3 "Tuesday" 4 "Wednesday" 5 "Thursday" 6 "Friday" 7 "Saturday" ;
VAL_TABLE_ HVBCC_TmDispFormat 0 "No Action" 1 "Display Complete Time" 2 "Display Minutes to Complete" ;
VAL_TABLE_ HVBCC_MinRmn_DuD 0 "FALSE" 1 "TRUE" ;
VAL_TABLE_ HVBCC_TmDispPwrLvl 0 "Unknown" 1 "Level 1" 2 "Level 2" 3 "DC" 4 "Wireless" ;
VAL_TABLE_ ACCAutoSetSpdCstCurrSetVal 0 "Setting Unknown" 1 "Off" 2 "On" ;
VAL_TABLE_ ACCAutoSetSpdCstAvlFlg7 0 "FALSE" 1 "TRUE" ;
VAL_TABLE_ ACCAutoSetSpdCstAvlFlg6 0 "FALSE" 1 "TRUE" ;
VAL_TABLE_ ACCAutoSetSpdCstAvlFlg5 0 "FALSE" 1 "TRUE" ;
VAL_TABLE_ ACCAutoSetSpdCstAvlFlg4 0 "FALSE" 1 "TRUE" ;
VAL_TABLE_ ACCAutoSetSpdCstAvlFlg3 0 "FALSE" 1 "TRUE" ;
VAL_TABLE_ ACCAutoSetSpdCstAvlFlg2 0 "FALSE" 1 "TRUE" ;
VAL_TABLE_ ACCAutoSetSpdCstAvlFlg1 0 "FALSE" 1 "TRUE" ;
VAL_TABLE_ LnKpAsstVirtCtlAval 0 "Not Available" 1 "Available" ;
VAL_TABLE_ ACCAutoSetSpdUnvIndOn 0 "FALSE" 1 "TRUE" ;
VAL_TABLE_ ACCAutoSetSpdCstSetAval 0 "FALSE" 1 "TRUE" ;
VAL_TABLE_ FCASensCstAvlFlg1 0 "FALSE" 1 "TRUE" ;
VAL_TABLE_ FCASensCstCurrSetVal 0 "SettingUnknown" 1 "Off" 2 "Low" 3 "Medium" 4 "High" ;
VAL_TABLE_ FCASensCstSetAval 0 "FALSE" 1 "TRUE" ;
VAL_TABLE_ BlndZnStrgAsstVirtCtlAval 0 "Not Available" 1 "Available" ;
VAL_TABLE_ BlndZnStrgAsstVirtUserCtlAllwd 0 "Not Allowed" 1 "Allowed" ;
VAL_TABLE_ FCASensCstAvlFlg7 0 "FALSE" 1 "TRUE" ;
VAL_TABLE_ FCASensCstAvlFlg6 0 "FALSE" 1 "TRUE" ;
VAL_TABLE_ FCASensCstAvlFlg5 0 "FALSE" 1 "TRUE" ;
VAL_TABLE_ FCASensCstAvlFlg4 0 "FALSE" 1 "TRUE" ;
VAL_TABLE_ FCASensCstAvlFlg3 0 "FALSE" 1 "TRUE" ;
VAL_TABLE_ FCASensCstAvlFlg2 0 "FALSE" 1 "TRUE" ;
VAL_TABLE_ TrfcJamAsstVirtCtlAllwd 0 "Not Allowed" 1 "Allowed" ;
VAL_TABLE_ LnDtnWrnSpprssnVrtCtlCurrSltnVl 0 "Unknown" 1 "Off" 2 "On" ;
VAL_TABLE_ LnDtnWrnSpprssnVirtCtlAval 0 "Not Available" 1 "Available" ;
VAL_TABLE_ LnDtnWrnSpprssnVirtUserCtlAllwd 0 "Not Allowed" 1 "Allowed" ;
VAL_TABLE_ BlndZnStrgAsstVrtCtlCurrSltnVl 0 "Unknown" 1 "Off" 2 "On" ;
VAL_TABLE_ RrStrgModeVirtCtlAval 0 "Not Available" 1 "Available" ;
VAL_TABLE_ RrStrgModeSmrtCtlIcnReqd 0 "FALSE" 1 "TRUE" ;
VAL_TABLE_ EPBStpOnBrkToRelPrkBrkIndReq 0 "OFF" 1 "ON" 2 "0.5_Hz" 3 "1_Hz" 4 "2_Hz" 5 "4_Hz" 6 "RESERVED_1" 7 "RESERVED_2" ;
VAL_TABLE_ VehStbEnhcmntCustAv 0 "FALSE" 1 "TRUE" ;
VAL_TABLE_ VehStbEnhcmntCurStat 0 "On" 1 "Off" ;
VAL_TABLE_ VehStbCompMdCustAv 0 "FALSE" 1 "TRUE" ;
VAL_TABLE_ VehStbCompMdCurStat 0 "On" 1 "Off" ;
VAL_TABLE_ TrcCntrlSysTmpDisReqIO 0 "FALSE" 1 "TRUE" ;
VAL_TABLE_ TCSCustAv 0 "FALSE" 1 "TRUE" ;
VAL_TABLE_ TCSCurStat 0 "On" 1 "Off" ;
VAL_TABLE_ OffRdMdActvAerodynsVisDispVal 0 "Setting_Unknown" 1 "Custom_Mode_1" 2 "Custom_Mode_2" 3 "Custom_Mode_3" 4 "Custom_Mode_4" 5 "Custom_Mode_5" 6 "Custom_Mode_6" 7 "Custom_Mode_7" ;
VAL_TABLE_ ElecPrkBrkSysDisIndReq 0 "OFF" 1 "ALERT_1" 2 "ALERT_2" 3 "ALERT_3" 4 "ALERT_4" 5 "ALERT_5" 6 "ALERT_6" 7 "ALERT_7" ;
VAL_TABLE_ OffRdMdESCVisDispVal 0 "Setting_Unknown" 1 "Custom_Mode_1" 2 "Custom_Mode_2" 3 "Custom_Mode_3" 4 "Custom_Mode_4" 5 "Custom_Mode_5" 6 "Custom_Mode_6" 7 "Custom_Mode_7" ;
VAL_TABLE_ OffRdMdDrvlnVisDispVal 0 "Setting_Unknown" 1 "Custom_Mode_1" 2 "Custom_Mode_2" 3 "Custom_Mode_3" 4 "Custom_Mode_4" 5 "Custom_Mode_5" 6 "Custom_Mode_6" 7 "Custom_Mode_7" ;
VAL_TABLE_ OffRdMdBrkPedVisDispVal 0 "Setting_Unknown" 1 "Custom_Mode_1" 2 "Custom_Mode_2" 3 "Custom_Mode_3" 4 "Custom_Mode_4" 5 "Custom_Mode_5" 6 "Custom_Mode_6" 7 "Custom_Mode_7" ;
VAL_TABLE_ OffRdMdSndVisDispVal 0 "Setting_Unknown" 1 "Custom_Mode_1" 2 "Custom_Mode_2" 3 "Custom_Mode_3" 4 "Custom_Mode_4" 5 "Custom_Mode_5" 6 "Custom_Mode_6" 7 "Custom_Mode_7" ;
VAL_TABLE_ OffRdMdRideHghtVisDispVal 0 "Setting_Unknown" 1 "Custom_Mode_1" 2 "Custom_Mode_2" 3 "Custom_Mode_3" 4 "Custom_Mode_4" 5 "Custom_Mode_5" 6 "Custom_Mode_6" 7 "Custom_Mode_7" ;
VAL_TABLE_ OffRdMdPwrtrnVisDispVal 0 "Setting_Unknown" 1 "Custom_Mode_1" 2 "Custom_Mode_2" 3 "Custom_Mode_3" 4 "Custom_Mode_4" 5 "Custom_Mode_5" 6 "Custom_Mode_6" 7 "Custom_Mode_7" ;
VAL_TABLE_ OffRdMdStrgVisDispVal 0 "Setting_Unknown" 1 "Custom_Mode_1" 2 "Custom_Mode_2" 3 "Custom_Mode_3" 4 "Custom_Mode_4" 5 "Custom_Mode_5" 6 "Custom_Mode_6" 7 "Custom_Mode_7" ;
VAL_TABLE_ OffRdMdSpnsnVisDispVal 0 "Setting_Unknown" 1 "Custom_Mode_1" 2 "Custom_Mode_2" 3 "Custom_Mode_3" 4 "Custom_Mode_4" 5 "Custom_Mode_5" 6 "Custom_Mode_6" 7 "Custom_Mode_7" ;
VAL_TABLE_ ESCInitIO 0 "FALSE" 1 "TRUE" ;
VAL_TABLE_ ESCCmptMdIO 0 "FALSE" 1 "TRUE" ;
VAL_TABLE_ TrlrBrkgSysProfSts 0 "Default Profile" 1 "Profile 1" 2 "Profile 2" 3 "Profile 3" 4 "Profile 4" 5 "Profile 5" ;
VAL_TABLE_ PerfMdMainMenuTy 0 "No_Action" 1 "Main Menu Type 1" 2 "Main Menu Type 2" 3 "Main Menu Type 3" 4 "Main Menu Type 4" 5 "Main Menu Type 5" 6 "Main Menu Type 6" 7 "Main Menu Type 7" ;
VAL_TABLE_ TrlrBrkCnctdIndOn 0 "FALSE" 1 "TRUE" ;
VAL_TABLE_ SrvESCMdIO 0 "FALSE" 1 "TRUE" ;
VAL_TABLE_ ServTracCtlIndOn 0 "FALSE" 1 "TRUE" ;
VAL_TABLE_ RdcBrkgToAvoidOvrhtgIndOn 0 "FALSE" 1 "TRUE" ;
VAL_TABLE_ HillStrtAstActIO 0 "FALSE" 1 "TRUE" ;
VAL_TABLE_ HillRollCntrlActIO 0 "FALSE" 1 "TRUE" ;
VAL_TABLE_ ESCPrfMdIO 0 "FALSE" 1 "TRUE" ;
VAL_TABLE_ ESCOffIO 0 "FALSE" 1 "TRUE" ;
VAL_TABLE_ BrkSysDrftModeUnvWrnIndReq 0 "None" 1 "In Terrain Mode" 2 "Generic" ;
VAL_TABLE_ BrkSysDrftModeDispSts 0 "None" 1 "Pending" 2 "On" 3 "Off" ;
VAL_TABLE_ BrkSysDrftModeSeltnIndOn 0 "FALSE" 1 "TRUE" ;
VAL_TABLE_ BrkPadLifeFrt_Inv 0 "FALSE" 1 "TRUE" ;
VAL_TABLE_ BrkPadLifeRr_Inv 0 "FALSE" 1 "TRUE" ;
VAL_TABLE_ TowHaulMdBrkPedVisDispVal 0 "Setting_Unknown" 1 "Custom_Mode_1" 2 "Custom_Mode_2" 3 "Custom_Mode_3" 4 "Custom_Mode_4" 5 "Custom_Mode_5" 6 "Custom_Mode_6" 7 "Custom_Mode_7" ;
VAL_TABLE_ TowHaulMdActvAerodynsVisDispVal 0 "Setting_Unknown" 1 "Custom_Mode_1" 2 "Custom_Mode_2" 3 "Custom_Mode_3" 4 "Custom_Mode_4" 5 "Custom_Mode_5" 6 "Custom_Mode_6" 7 "Custom_Mode_7" ;
VAL_TABLE_ BrkTempStsIndReq 0 "No Action" 1 "Normal" 2 "Warm" 3 "Hot" 4 "Overheated" ;
VAL_TABLE_ TowHaulMdPwrtrnVisDispVal 0 "Setting_Unknown" 1 "Custom_Mode_1" 2 "Custom_Mode_2" 3 "Custom_Mode_3" 4 "Custom_Mode_4" 5 "Custom_Mode_5" 6 "Custom_Mode_6" 7 "Custom_Mode_7" ;
VAL_TABLE_ TowHaulMdESCVisDispVal 0 "Setting_Unknown" 1 "Custom_Mode_1" 2 "Custom_Mode_2" 3 "Custom_Mode_3" 4 "Custom_Mode_4" 5 "Custom_Mode_5" 6 "Custom_Mode_6" 7 "Custom_Mode_7" ;
VAL_TABLE_ TowHaulMdDrvlnVisDispVal 0 "Setting_Unknown" 1 "Custom_Mode_1" 2 "Custom_Mode_2" 3 "Custom_Mode_3" 4 "Custom_Mode_4" 5 "Custom_Mode_5" 6 "Custom_Mode_6" 7 "Custom_Mode_7" ;
VAL_TABLE_ TowHaulMdSndVisDispVal 0 "Setting_Unknown" 1 "Custom_Mode_1" 2 "Custom_Mode_2" 3 "Custom_Mode_3" 4 "Custom_Mode_4" 5 "Custom_Mode_5" 6 "Custom_Mode_6" 7 "Custom_Mode_7" ;
VAL_TABLE_ TowHaulMdRideHghtVisDispVal 0 "Setting_Unknown" 1 "Custom_Mode_1" 2 "Custom_Mode_2" 3 "Custom_Mode_3" 4 "Custom_Mode_4" 5 "Custom_Mode_5" 6 "Custom_Mode_6" 7 "Custom_Mode_7" ;
VAL_TABLE_ AutoHldActv 0 "FALSE" 1 "TRUE" ;
VAL_TABLE_ ABSActvIndOn 0 "FALSE" 1 "TRUE" ;
VAL_TABLE_ TowHaulMdStrgVisDispVal 0 "Setting_Unknown" 1 "Custom_Mode_1" 2 "Custom_Mode_2" 3 "Custom_Mode_3" 4 "Custom_Mode_4" 5 "Custom_Mode_5" 6 "Custom_Mode_6" 7 "Custom_Mode_7" ;
VAL_TABLE_ TowHaulMdSpnsnVisDispVal 0 "Setting_Unknown" 1 "Custom_Mode_1" 2 "Custom_Mode_2" 3 "Custom_Mode_3" 4 "Custom_Mode_4" 5 "Custom_Mode_5" 6 "Custom_Mode_6" 7 "Custom_Mode_7" ;
VAL_TABLE_ BrkPadLifeRrRstAval 0 "FALSE" 1 "TRUE" ;
VAL_TABLE_ BrkPadLifeFrtRstAval 0 "FALSE" 1 "TRUE" ;
VAL_TABLE_ AutoHldServIndOn 0 "FALSE" 1 "TRUE" ;
VAL_TABLE_ AutoHldDsbldStBltIndOn 0 "FALSE" 1 "TRUE" ;
VAL_TABLE_ AutoHldDsbldDrOpnIndOn 0 "FALSE" 1 "TRUE" ;
VAL_TABLE_ AutoHldAppBrkPedIndOn 0 "FALSE" 1 "TRUE" ;
VAL_TABLE_ CustMdDrvlCstmCurSetVal 0 "SETTING_UNKNOWN" 1 "CUSTOM_MODE_1" 2 "CUSTOM_MODE_2" 3 "CUSTOM_MODE_3" 4 "CUSTOM_MODE_4" 5 "CUSTOM_MODE_5" 6 "CUSTOM_MODE_6" 7 "CUSTOM_MODE_7" ;
VAL_TABLE_ CustMdBrkPdlCstmCurSetVal 0 "SETTING_UNKNOWN" 1 "CUSTOM_MODE_1" 2 "CUSTOM_MODE_2" 3 "CUSTOM_MODE_3" 4 "CUSTOM_MODE_4" 5 "CUSTOM_MODE_5" 6 "CUSTOM_MODE_6" 7 "CUSTOM_MODE_7" ;
VAL_TABLE_ CustMdActAeroCstmCurSetVal 0 "SETTING_UNKNOWN" 1 "CUSTOM_MODE_1" 2 "CUSTOM_MODE_2" 3 "CUSTOM_MODE_3" 4 "CUSTOM_MODE_4" 5 "CUSTOM_MODE_5" 6 "CUSTOM_MODE_6" 7 "CUSTOM_MODE_7" ;
VAL_TABLE_ CustMdRideHghtCstmCurSetVal 0 "SETTING_UNKNOWN" 1 "CUSTOM_MODE_1" 2 "CUSTOM_MODE_2" 3 "CUSTOM_MODE_3" 4 "CUSTOM_MODE_4" 5 "CUSTOM_MODE_5" 6 "CUSTOM_MODE_6" 7 "CUSTOM_MODE_7" ;
VAL_TABLE_ CustMdPTCstmPndSetVal 0 "SETTING_UNKNOWN" 1 "CUSTOM_MODE_1" 2 "CUSTOM_MODE_2" 3 "CUSTOM_MODE_3" 4 "CUSTOM_MODE_4" 5 "CUSTOM_MODE_5" 6 "CUSTOM_MODE_6" 7 "CUSTOM_MODE_7" ;
VAL_TABLE_ CustMdPTCstmCurSetVal 0 "SETTING_UNKNOWN" 1 "CUSTOM_MODE_1" 2 "CUSTOM_MODE_2" 3 "CUSTOM_MODE_3" 4 "CUSTOM_MODE_4" 5 "CUSTOM_MODE_5" 6 "CUSTOM_MODE_6" 7 "CUSTOM_MODE_7" ;
VAL_TABLE_ CustMdSpnCstmCurSetVal 0 "SETTING_UNKNOWN" 1 "CUSTOM_MODE_1" 2 "CUSTOM_MODE_2" 3 "CUSTOM_MODE_3" 4 "CUSTOM_MODE_4" 5 "CUSTOM_MODE_5" 6 "CUSTOM_MODE_6" 7 "CUSTOM_MODE_7" ;
VAL_TABLE_ CustMdSndCstmCurSetVal 0 "SETTING_UNKNOWN" 1 "CUSTOM_MODE_1" 2 "CUSTOM_MODE_2" 3 "CUSTOM_MODE_3" 4 "CUSTOM_MODE_4" 5 "CUSTOM_MODE_5" 6 "CUSTOM_MODE_6" 7 "CUSTOM_MODE_7" ;
VAL_TABLE_ DisPrfMdRq 0 "No Action" 1 "Normal" 2 "Tour" 3 "Sport" 4 "Track" 5 "Performance Mode 5" 6 "Performance Mode 6" 7 "Performance Mode 7" ;
VAL_TABLE_ CustMdTrcStbCstmCurSetVal 0 "SETTING_UNKNOWN" 1 "CUSTOM_MODE_1" 2 "CUSTOM_MODE_2" 3 "CUSTOM_MODE_3" 4 "CUSTOM_MODE_4" 5 "CUSTOM_MODE_5" 6 "CUSTOM_MODE_6" 7 "CUSTOM_MODE_7" ;
VAL_TABLE_ CustMdStrCstmCurSetVal 0 "SETTING_UNKNOWN" 1 "CUSTOM_MODE_1" 2 "CUSTOM_MODE_2" 3 "CUSTOM_MODE_3" 4 "CUSTOM_MODE_4" 5 "CUSTOM_MODE_5" 6 "CUSTOM_MODE_6" 7 "CUSTOM_MODE_7" ;
VAL_TABLE_ PrsnlMdBrkPdlCstmCurSetVal 0 "SETTING_UNKNOWN" 1 "PERSONAL_MODE_1" 2 "PERSONAL_MODE_2" 3 "PERSONAL_MODE_3" 4 "PERSONAL_MODE_4" 5 "PERSONAL_MODE_5" 6 "PERSONAL_MODE_6" 7 "PERSONAL_MODE_7" ;
VAL_TABLE_ PrsnlMdActAeroCstmCurSetVal 0 "SETTING_UNKNOWN" 1 "PERSONAL_MODE_1" 2 "PERSONAL_MODE_2" 3 "PERSONAL_MODE_3" 4 "PERSONAL_MODE_4" 5 "PERSONAL_MODE_5" 6 "PERSONAL_MODE_6" 7 "PERSONAL_MODE_7" ;
VAL_TABLE_ ExtdHillStrtAstCustCurSetVal 0 "SETTING_UNKNOWN" 1 "EXTENDED_HOLD" 2 "STANDARD_HOLD" 3 "RESERVED_3" 4 "RESERVED_4" 5 "RESERVED_5" 6 "RESERVED_6" 7 "RESERVED_7" ;
VAL_TABLE_ PrsnlMdRideHghtCstmCurSetVal 0 "SETTING_UNKNOWN" 1 "PERSONAL_MODE_1" 2 "PERSONAL_MODE_2" 3 "PERSONAL_MODE_3" 4 "PERSONAL_MODE_4" 5 "PERSONAL_MODE_5" 6 "PERSONAL_MODE_6" 7 "PERSONAL_MODE_7" ;
VAL_TABLE_ PrsnlMdDrvlCstmCurSetVal 0 "SETTING_UNKNOWN" 1 "PERSONAL_MODE_1" 2 "PERSONAL_MODE_2" 3 "PERSONAL_MODE_3" 4 "PERSONAL_MODE_4" 5 "PERSONAL_MODE_5" 6 "PERSONAL_MODE_6" 7 "PERSONAL_MODE_7" ;
VAL_TABLE_ CustMdStrCstmSetAv 0 "FALSE" 1 "TRUE" ;
VAL_TABLE_ CustMdSpnCstmSetAv 0 "FALSE" 1 "TRUE" ;
VAL_TABLE_ CustMdSndCstmSetAv 0 "FALSE" 1 "TRUE" ;
VAL_TABLE_ CustMdRideHghtCstmSetAv 0 "FALSE" 1 "TRUE" ;
VAL_TABLE_ CustMdPTCstmSetAv 0 "FALSE" 1 "TRUE" ;
VAL_TABLE_ CustMdDrvlCstmSetAv 0 "FALSE" 1 "TRUE" ;
VAL_TABLE_ CustMdBrkPdlCstmSetAv 0 "FALSE" 1 "TRUE" ;
VAL_TABLE_ CustMdActAeroCstmSetAv 0 "FALSE" 1 "TRUE" ;
VAL_TABLE_ PrsnlMdSpnCstmSetAv 0 "FALSE" 1 "TRUE" ;
VAL_TABLE_ PrsnlMdSndCstmSetAv 0 "FALSE" 1 "TRUE" ;
VAL_TABLE_ PrsnlMdRideHghtCstmSetAv 0 "FALSE" 1 "TRUE" ;
VAL_TABLE_ PrsnlMdDrvlCstmSetAv 0 "FALSE" 1 "TRUE" ;
VAL_TABLE_ PrsnlMdBrkPdlCstmSetAv 0 "FALSE" 1 "TRUE" ;
VAL_TABLE_ PrsnlMdActAeroCstmSetAv 0 "FALSE" 1 "TRUE" ;
VAL_TABLE_ ExtdHillStrtAstCustSetAvl 0 "FALSE" 1 "TRUE" ;
VAL_TABLE_ CustMdTrcStbCstmSetAv 0 "FALSE" 1 "TRUE" ;
VAL_TABLE_ CustMdBrkPdlCstmAvFlg1 0 "FALSE" 1 "TRUE" ;
VAL_TABLE_ CustMdActAeroCstmAvFlg7 0 "FALSE" 1 "TRUE" ;
VAL_TABLE_ CustMdActAeroCstmAvFlg6 0 "FALSE" 1 "TRUE" ;
VAL_TABLE_ CustMdActAeroCstmAvFlg5 0 "FALSE" 1 "TRUE" ;
VAL_TABLE_ CustMdActAeroCstmAvFlg4 0 "FALSE" 1 "TRUE" ;
VAL_TABLE_ CustMdActAeroCstmAvFlg3 0 "FALSE" 1 "TRUE" ;
VAL_TABLE_ CustMdActAeroCstmAvFlg2 0 "FALSE" 1 "TRUE" ;
VAL_TABLE_ CustMdActAeroCstmAvFlg1 0 "FALSE" 1 "TRUE" ;
VAL_TABLE_ CustMdDrvlCstmAvFlg2 0 "FALSE" 1 "TRUE" ;
VAL_TABLE_ CustMdDrvlCstmAvFlg1 0 "FALSE" 1 "TRUE" ;
VAL_TABLE_ CustMdBrkPdlCstmAvFlg7 0 "FALSE" 1 "TRUE" ;
VAL_TABLE_ CustMdBrkPdlCstmAvFlg6 0 "FALSE" 1 "TRUE" ;
VAL_TABLE_ CustMdBrkPdlCstmAvFlg5 0 "FALSE" 1 "TRUE" ;
VAL_TABLE_ CustMdBrkPdlCstmAvFlg4 0 "FALSE" 1 "TRUE" ;
VAL_TABLE_ CustMdBrkPdlCstmAvFlg3 0 "FALSE" 1 "TRUE" ;
VAL_TABLE_ CustMdBrkPdlCstmAvFlg2 0 "FALSE" 1 "TRUE" ;
VAL_TABLE_ CustMdPTCstmAvFlg3 0 "FALSE" 1 "TRUE" ;
VAL_TABLE_ CustMdPTCstmAvFlg2 0 "FALSE" 1 "TRUE" ;
VAL_TABLE_ CustMdPTCstmAvFlg1 0 "FALSE" 1 "TRUE" ;
VAL_TABLE_ CustMdDrvlCstmAvFlg7 0 "FALSE" 1 "TRUE" ;
VAL_TABLE_ CustMdDrvlCstmAvFlg6 0 "FALSE" 1 "TRUE" ;
VAL_TABLE_ CustMdDrvlCstmAvFlg5 0 "FALSE" 1 "TRUE" ;
VAL_TABLE_ CustMdDrvlCstmAvFlg4 0 "FALSE" 1 "TRUE" ;
VAL_TABLE_ CustMdDrvlCstmAvFlg3 0 "FALSE" 1 "TRUE" ;
VAL_TABLE_ CustMdRideHghtCstmAvFlg4 0 "FALSE" 1 "TRUE" ;
VAL_TABLE_ CustMdRideHghtCstmAvFlg3 0 "FALSE" 1 "TRUE" ;
VAL_TABLE_ CustMdRideHghtCstmAvFlg2 0 "FALSE" 1 "TRUE" ;
VAL_TABLE_ CustMdRideHghtCstmAvFlg1 0 "FALSE" 1 "TRUE" ;
VAL_TABLE_ CustMdPTCstmAvFlg7 0 "FALSE" 1 "TRUE" ;
VAL_TABLE_ CustMdPTCstmAvFlg6 0 "FALSE" 1 "TRUE" ;
VAL_TABLE_ CustMdPTCstmAvFlg5 0 "FALSE" 1 "TRUE" ;
VAL_TABLE_ CustMdPTCstmAvFlg4 0 "FALSE" 1 "TRUE" ;
VAL_TABLE_ CustMdSndCstmAvFlg5 0 "FALSE" 1 "TRUE" ;
VAL_TABLE_ CustMdSndCstmAvFlg4 0 "FALSE" 1 "TRUE" ;
VAL_TABLE_ CustMdSndCstmAvFlg3 0 "FALSE" 1 "TRUE" ;
VAL_TABLE_ CustMdSndCstmAvFlg2 0 "FALSE" 1 "TRUE" ;
VAL_TABLE_ CustMdSndCstmAvFlg1 0 "FALSE" 1 "TRUE" ;
VAL_TABLE_ CustMdRideHghtCstmAvFlg7 0 "FALSE" 1 "TRUE" ;
VAL_TABLE_ CustMdRideHghtCstmAvFlg6 0 "FALSE" 1 "TRUE" ;
VAL_TABLE_ CustMdRideHghtCstmAvFlg5 0 "FALSE" 1 "TRUE" ;
VAL_TABLE_ CustMdSpnCstmAvFlg6 0 "FALSE" 1 "TRUE" ;
VAL_TABLE_ CustMdSpnCstmAvFlg5 0 "FALSE" 1 "TRUE" ;
VAL_TABLE_ CustMdSpnCstmAvFlg4 0 "FALSE" 1 "TRUE" ;
VAL_TABLE_ CustMdSpnCstmAvFlg3 0 "FALSE" 1 "TRUE" ;
VAL_TABLE_ CustMdSpnCstmAvFlg2 0 "FALSE" 1 "TRUE" ;
VAL_TABLE_ CustMdSpnCstmAvFlg1 0 "FALSE" 1 "TRUE" ;
VAL_TABLE_ CustMdSndCstmAvFlg7 0 "FALSE" 1 "TRUE" ;
VAL_TABLE_ CustMdSndCstmAvFlg6 0 "FALSE" 1 "TRUE" ;
VAL_TABLE_ CustMdStrCstmAvFlg7 0 "FALSE" 1 "TRUE" ;
VAL_TABLE_ CustMdStrCstmAvFlg6 0 "FALSE" 1 "TRUE" ;
VAL_TABLE_ CustMdStrCstmAvFlg5 0 "FALSE" 1 "TRUE" ;
VAL_TABLE_ CustMdStrCstmAvFlg4 0 "FALSE" 1 "TRUE" ;
VAL_TABLE_ CustMdStrCstmAvFlg3 0 "FALSE" 1 "TRUE" ;
VAL_TABLE_ CustMdStrCstmAvFlg2 0 "FALSE" 1 "TRUE" ;
VAL_TABLE_ CustMdStrCstmAvFlg1 0 "FALSE" 1 "TRUE" ;
VAL_TABLE_ CustMdSpnCstmAvFlg7 0 "FALSE" 1 "TRUE" ;
VAL_TABLE_ EBDFld 0 "FALSE" 1 "TRUE" ;
VAL_TABLE_ CustMdTrcStbCstmAvFlg7 0 "FALSE" 1 "TRUE" ;
VAL_TABLE_ CustMdTrcStbCstmAvFlg6 0 "FALSE" 1 "TRUE" ;
VAL_TABLE_ CustMdTrcStbCstmAvFlg5 0 "FALSE" 1 "TRUE" ;
VAL_TABLE_ CustMdTrcStbCstmAvFlg4 0 "FALSE" 1 "TRUE" ;
VAL_TABLE_ CustMdTrcStbCstmAvFlg3 0 "FALSE" 1 "TRUE" ;
VAL_TABLE_ CustMdTrcStbCstmAvFlg2 0 "FALSE" 1 "TRUE" ;
VAL_TABLE_ CustMdTrcStbCstmAvFlg1 0 "FALSE" 1 "TRUE" ;
VAL_TABLE_ PrsnlMdActAeroCstmAvFlg1 0 "FALSE" 1 "TRUE" ;
VAL_TABLE_ ExtdHillStrtAstCustAvlFlg7 0 "FALSE" 1 "TRUE" ;
VAL_TABLE_ ExtdHillStrtAstCustAvlFlg6 0 "FALSE" 1 "TRUE" ;
VAL_TABLE_ ExtdHillStrtAstCustAvlFlg5 0 "FALSE" 1 "TRUE" ;
VAL_TABLE_ ExtdHillStrtAstCustAvlFlg4 0 "FALSE" 1 "TRUE" ;
VAL_TABLE_ ExtdHillStrtAstCustAvlFlg3 0 "FALSE" 1 "TRUE" ;
VAL_TABLE_ ExtdHillStrtAstCustAvlFlg2 0 "FALSE" 1 "TRUE" ;
VAL_TABLE_ ExtdHillStrtAstCustAvlFlg1 0 "FALSE" 1 "TRUE" ;
VAL_TABLE_ PrsnlMdBrkPdlCstmAvFlg2 0 "FALSE" 1 "TRUE" ;
VAL_TABLE_ PrsnlMdBrkPdlCstmAvFlg1 0 "FALSE" 1 "TRUE" ;
VAL_TABLE_ PrsnlMdActAeroCstmAvFlg7 0 "FALSE" 1 "TRUE" ;
VAL_TABLE_ PrsnlMdActAeroCstmAvFlg6 0 "FALSE" 1 "TRUE" ;
VAL_TABLE_ PrsnlMdActAeroCstmAvFlg5 0 "FALSE" 1 "TRUE" ;
VAL_TABLE_ PrsnlMdActAeroCstmAvFlg4 0 "FALSE" 1 "TRUE" ;
VAL_TABLE_ PrsnlMdActAeroCstmAvFlg3 0 "FALSE" 1 "TRUE" ;
VAL_TABLE_ PrsnlMdActAeroCstmAvFlg2 0 "FALSE" 1 "TRUE" ;
VAL_TABLE_ PrsnlMdDrvlCstmAvFlg3 0 "FALSE" 1 "TRUE" ;
VAL_TABLE_ PrsnlMdDrvlCstmAvFlg2 0 "FALSE" 1 "TRUE" ;
VAL_TABLE_ PrsnlMdDrvlCstmAvFlg1 0 "FALSE" 1 "TRUE" ;
VAL_TABLE_ PrsnlMdBrkPdlCstmAvFlg7 0 "FALSE" 1 "TRUE" ;
VAL_TABLE_ PrsnlMdBrkPdlCstmAvFlg6 0 "FALSE" 1 "TRUE" ;
VAL_TABLE_ PrsnlMdBrkPdlCstmAvFlg5 0 "FALSE" 1 "TRUE" ;
VAL_TABLE_ PrsnlMdBrkPdlCstmAvFlg4 0 "FALSE" 1 "TRUE" ;
VAL_TABLE_ PrsnlMdBrkPdlCstmAvFlg3 0 "FALSE" 1 "TRUE" ;
VAL_TABLE_ PrsnlMdRideHghtCstmAvFlg4 0 "FALSE" 1 "TRUE" ;
VAL_TABLE_ PrsnlMdRideHghtCstmAvFlg3 0 "FALSE" 1 "TRUE" ;
VAL_TABLE_ PrsnlMdRideHghtCstmAvFlg2 0 "FALSE" 1 "TRUE" ;
VAL_TABLE_ PrsnlMdRideHghtCstmAvFlg1 0 "FALSE" 1 "TRUE" ;
VAL_TABLE_ PrsnlMdDrvlCstmAvFlg7 0 "FALSE" 1 "TRUE" ;
VAL_TABLE_ PrsnlMdDrvlCstmAvFlg6 0 "FALSE" 1 "TRUE" ;
VAL_TABLE_ PrsnlMdDrvlCstmAvFlg5 0 "FALSE" 1 "TRUE" ;
VAL_TABLE_ PrsnlMdDrvlCstmAvFlg4 0 "FALSE" 1 "TRUE" ;
VAL_TABLE_ PrsnlMdSndCstmAvFlg5 0 "FALSE" 1 "TRUE" ;
VAL_TABLE_ PrsnlMdSndCstmAvFlg4 0 "FALSE" 1 "TRUE" ;
VAL_TABLE_ PrsnlMdSndCstmAvFlg3 0 "FALSE" 1 "TRUE" ;
VAL_TABLE_ PrsnlMdSndCstmAvFlg2 0 "FALSE" 1 "TRUE" ;
VAL_TABLE_ PrsnlMdSndCstmAvFlg1 0 "FALSE" 1 "TRUE" ;
VAL_TABLE_ PrsnlMdRideHghtCstmAvFlg7 0 "FALSE" 1 "TRUE" ;
VAL_TABLE_ PrsnlMdRideHghtCstmAvFlg6 0 "FALSE" 1 "TRUE" ;
VAL_TABLE_ PrsnlMdRideHghtCstmAvFlg5 0 "FALSE" 1 "TRUE" ;
VAL_TABLE_ PrsnlMdSpnCstmAvFlg6 0 "FALSE" 1 "TRUE" ;
VAL_TABLE_ PrsnlMdSpnCstmAvFlg5 0 "FALSE" 1 "TRUE" ;
VAL_TABLE_ PrsnlMdSpnCstmAvFlg4 0 "FALSE" 1 "TRUE" ;
VAL_TABLE_ PrsnlMdSpnCstmAvFlg3 0 "FALSE" 1 "TRUE" ;
VAL_TABLE_ PrsnlMdSpnCstmAvFlg2 0 "FALSE" 1 "TRUE" ;
VAL_TABLE_ PrsnlMdSpnCstmAvFlg1 0 "FALSE" 1 "TRUE" ;
VAL_TABLE_ PrsnlMdSndCstmAvFlg7 0 "FALSE" 1 "TRUE" ;
VAL_TABLE_ PrsnlMdSndCstmAvFlg6 0 "FALSE" 1 "TRUE" ;
VAL_TABLE_ PrsnlMdStrCstmAvFlg7 0 "FALSE" 1 "TRUE" ;
VAL_TABLE_ PrsnlMdStrCstmAvFlg6 0 "FALSE" 1 "TRUE" ;
VAL_TABLE_ PrsnlMdStrCstmAvFlg5 0 "FALSE" 1 "TRUE" ;
VAL_TABLE_ PrsnlMdStrCstmAvFlg4 0 "FALSE" 1 "TRUE" ;
VAL_TABLE_ PrsnlMdStrCstmAvFlg3 0 "FALSE" 1 "TRUE" ;
VAL_TABLE_ PrsnlMdStrCstmAvFlg2 0 "FALSE" 1 "TRUE" ;
VAL_TABLE_ PrsnlMdStrCstmAvFlg1 0 "FALSE" 1 "TRUE" ;
VAL_TABLE_ PrsnlMdSpnCstmAvFlg7 0 "FALSE" 1 "TRUE" ;
VAL_TABLE_ RdHgtWrn3IndReq 0 "No Indication" 1 "Car Show Unavailable" 2 "Car Show Requested" 3 "Car Show Cancelled" 4 "Cargo Height Active" ;
VAL_TABLE_ SGI_ServStSysIndOn 0 "FALSE" 1 "TRUE" ;
VAL_TABLE_ StLckoutRRCtlCurrSet 0 "Unknown" 1 "Locked Out" 2 "Not Locked Out" ;
VAL_TABLE_ StLckoutRRVirtCtlAval 0 "Not Available" 1 "Available" ;
VAL_TABLE_ StMemRRVirtCtlStorAllwd 0 "Not Allowed" 1 "Allowed" ;
VAL_TABLE_ StMemRRVirtCtlRclAllwd 0 "Not Allowed" 1 "Allowed" ;
VAL_TABLE_ StLckoutLRCtlCurrSet 0 "Unknown" 1 "Locked Out" 2 "Not Locked Out" ;
VAL_TABLE_ StLckoutLRVirtCtlAval 0 "Not Available" 1 "Available" ;
VAL_TABLE_ StMemLRVirtCtlStorAllwd 0 "Not Allowed" 1 "Allowed" ;
VAL_TABLE_ StMemLRVirtCtlRclAllwd 0 "Not Allowed" 1 "Allowed" ;
VAL_TABLE_ RrClsrAjrStat 0 "FALSE" 1 "TRUE" ;
VAL_TABLE_ RrClsrAjrStat_Inv 0 "FALSE" 1 "TRUE" ;
VAL_TABLE_ StBkSdBolsLFVirtCtlAval 0 "Not Available" 1 "Available" ;
VAL_TABLE_ StBkLumbVertLFVirtCtlAval 0 "Not Available" 1 "Available" ;
VAL_TABLE_ StBkLumbHrztlLFVirtCtlAval 0 "Not Available" 1 "Available" ;
VAL_TABLE_ StBkHrztlLFCtlFrmRrVirtCtlAval 0 "Not Available" 1 "Available" ;
VAL_TABLE_ StBkHrztlLFCtlFrmFrtVirtCtlAval 0 "Not Available" 1 "Available" ;
VAL_TABLE_ StHdrstVertLFVirtCtlAval 0 "Not Available" 1 "Available" ;
VAL_TABLE_ StHdrstHrztlLFVirtCtlAval 0 "Not Available" 1 "Available" ;
VAL_TABLE_ StCushSdBolsLFVirtCtlAval 0 "Not Available" 1 "Available" ;
VAL_TABLE_ StCushRrVertLFVirtCtlAval 0 "Not Available" 1 "Available" ;
VAL_TABLE_ StCushLgthHrztlLFVirtCtlAval 0 "Not Available" 1 "Available" ;
VAL_TABLE_ StCushHrztlLFCtlFrmRrVirtCtlAvl 0 "Not Available" 1 "Available" ;
VAL_TABLE_ StCushHrztlLFCtlFrmFrVirtCtlAvl 0 "Not Available" 1 "Available" ;
VAL_TABLE_ StCushFrtVertLFVirtCtlAval 0 "Not Available" 1 "Available" ;
VAL_TABLE_ StMasgTyp2LFVirtCtlAval 0 "Not Available" 1 "Available" ;
VAL_TABLE_ StMasgTyp1LFVirtCtlAval 0 "Not Available" 1 "Available" ;
VAL_TABLE_ StMasgTyp15LFVirtCtlAval 0 "Not Available" 1 "Available" ;
VAL_TABLE_ StMasgTyp14LFVirtCtlAval 0 "Not Available" 1 "Available" ;
VAL_TABLE_ StMasgTyp13LFVirtCtlAval 0 "Not Available" 1 "Available" ;
VAL_TABLE_ StMasgTyp12LFVirtCtlAval 0 "Not Available" 1 "Available" ;
VAL_TABLE_ StMasgTyp11LFVirtCtlAval 0 "Not Available" 1 "Available" ;
VAL_TABLE_ StMasgTyp10LFVirtCtlAval 0 "Not Available" 1 "Available" ;
VAL_TABLE_ StUpprShldrHrztlLFVirtCtlAval 0 "Not Available" 1 "Available" ;
VAL_TABLE_ StMasgTyp9LFVirtCtlAval 0 "Not Available" 1 "Available" ;
VAL_TABLE_ StMasgTyp8LFVirtCtlAval 0 "Not Available" 1 "Available" ;
VAL_TABLE_ StMasgTyp7LFVirtCtlAval 0 "Not Available" 1 "Available" ;
VAL_TABLE_ StMasgTyp6LFVirtCtlAval 0 "Not Available" 1 "Available" ;
VAL_TABLE_ StMasgTyp5LFVirtCtlAval 0 "Not Available" 1 "Available" ;
VAL_TABLE_ StMasgTyp4LFVirtCtlAval 0 "Not Available" 1 "Available" ;
VAL_TABLE_ StMasgTyp3LFVirtCtlAval 0 "Not Available" 1 "Available" ;
VAL_TABLE_ StMemLFVirtCtlNumofMemPstnsAval 0 "Not Available" 1 "One Positions" 2 "Two Positions" 3 "Three Positions" 4 "Four Positions" 5 "Five Positions" 6 "Six Positions" 7 "Seven Positions" 8 "Eight Positions" ;
VAL_TABLE_ StMemLFVirtCtlNumofExtPstnsAval 0 "Not Available" 1 "One Positions" 2 "Two Positions" 3 "Three Positions" 4 "Four Positions" 5 "Five Positions" 6 "Six Positions" 7 "Seven Positions" 8 "Eight Positions" ;
VAL_TABLE_ StBkHrztlLFCtlFrmFrtVirtCtlAlwd 0 "Not Allowed" 1 "Allowed" ;
VAL_TABLE_ StMasgIntstyLFLstKnwnSet 0 "Massage Off" 1 "Intensity 1" 2 "Intensity 2" 3 "Intensity 3" 4 "Intensity 4" 5 "Intensity 5" 6 "Intensity 6" 7 "Intensity 7" ;
VAL_TABLE_ StMasgTypLFLstKnwnSet 0 "Massage Off" 1 "Type 1" 2 "Type 2" 3 "Type 3" 4 "Type 4" 5 "Type 5" 6 "Type 6" 7 "Type 7" 8 "Type 8" 9 "Type 9" 10 "Type 10" 11 "Type 11" 12 "Type 12" 13 "Type 13" 14 "Type 14" 15 "Type 15" ;
VAL_TABLE_ StCushLgthHrztlLFVirtCtlAllwd 0 "Not Allowed" 1 "Allowed" ;
VAL_TABLE_ StCushHrztlLFCtlFrmRrVirCtlAlwd 0 "Not Allowed" 1 "Allowed" ;
VAL_TABLE_ StCushHrztlLFCtlFrmFrVirCtlAlwd 0 "Not Allowed" 1 "Allowed" ;
VAL_TABLE_ StCushFrtVertLFVirtCtlAllwd 0 "Not Allowed" 1 "Allowed" ;
VAL_TABLE_ StBkSdBolsLFVirtCtlAllwd 0 "Not Allowed" 1 "Allowed" ;
VAL_TABLE_ StBkLumbVertLFVirtCtlAllwd 0 "Not Allowed" 1 "Allowed" ;
VAL_TABLE_ StBkLumbHrztlLFVirtCtlAllwd 0 "Not Allowed" 1 "Allowed" ;
VAL_TABLE_ StBkHrztlLFCtlFrmRrVirtCtlAllwd 0 "Not Allowed" 1 "Allowed" ;
VAL_TABLE_ StMemLFVirtCtlStorAllwd 0 "Not Allowed" 1 "Allowed" ;
VAL_TABLE_ StMemLFVirtCtlRclAllwd 0 "Not Allowed" 1 "Allowed" ;
VAL_TABLE_ StUpprShldrHrztlLFVirtCtlAllwd 0 "Not Allowed" 1 "Allowed" ;
VAL_TABLE_ StMasgLFVirtCtlAllwd 0 "Not Allowed" 1 "Allowed" ;
VAL_TABLE_ StHdrstVertLFVirtCtlAllwd 0 "Not Allowed" 1 "Allowed" ;
VAL_TABLE_ StHdrstHrztlLFVirtCtlAllwd 0 "Not Allowed" 1 "Allowed" ;
VAL_TABLE_ StCushSdBolsLFVirtCtlAllwd 0 "Not Allowed" 1 "Allowed" ;
VAL_TABLE_ StCushRrVertLFVirtCtlAllwd 0 "Not Allowed" 1 "Allowed" ;
VAL_TABLE_ DMBlkhdDrAutoClsTmCstSetAval 0 "FALSE" 1 "TRUE" ;
VAL_TABLE_ DMBlkhdDrAutoClsTmCstAvlFlg7 0 "FALSE" 1 "TRUE" ;
VAL_TABLE_ DMBlkhdDrAutoClsTmCstAvlFlg6 0 "FALSE" 1 "TRUE" ;
VAL_TABLE_ DMBlkhdDrAutoClsTmCstAvlFlg5 0 "FALSE" 1 "TRUE" ;
VAL_TABLE_ DMBlkhdDrAutoClsTmCstAvlFlg4 0 "FALSE" 1 "TRUE" ;
VAL_TABLE_ DMBlkhdDrAutoClsTmCstAvlFlg3 0 "FALSE" 1 "TRUE" ;
VAL_TABLE_ DMBlkhdDrAutoClsTmCstAvlFlg2 0 "FALSE" 1 "TRUE" ;
VAL_TABLE_ DMBlkhdDrAutoClsTmCstAvlFlg1 0 "FALSE" 1 "TRUE" ;
VAL_TABLE_ DMBlkhdDrOpnVehOffCstSetAval 0 "FALSE" 1 "TRUE" ;
VAL_TABLE_ DMBlkhdDrOpnVehOffCstAvlFlg7 0 "FALSE" 1 "TRUE" ;
VAL_TABLE_ DMBlkhdDrOpnVehOffCstAvlFlg6 0 "FALSE" 1 "TRUE" ;
VAL_TABLE_ DMBlkhdDrOpnVehOffCstAvlFlg5 0 "FALSE" 1 "TRUE" ;
VAL_TABLE_ DMBlkhdDrOpnVehOffCstAvlFlg4 0 "FALSE" 1 "TRUE" ;
VAL_TABLE_ DMBlkhdDrOpnVehOffCstAvlFlg3 0 "FALSE" 1 "TRUE" ;
VAL_TABLE_ DMBlkhdDrOpnVehOffCstAvlFlg2 0 "FALSE" 1 "TRUE" ;
VAL_TABLE_ DMBlkhdDrOpnVehOffCstAvlFlg1 0 "FALSE" 1 "TRUE" ;
VAL_TABLE_ BlkhdDrRmtActvnChmEvntStat 0 "No Action" 1 "Active" 2 "Cancel Chime" ;
VAL_TABLE_ BlkhdDrLoclActvnChmEvntStat 0 "No Action" 1 "Active" 2 "Cancel Chime" ;
VAL_TABLE_ BlkhdDrObstclChmEvntStat 0 "No Action" 1 "Active" 2 "Cancel Chime" ;
VAL_TABLE_ DMBlkhdDrAutoClsTmCstCurrSetVal 0 "Setting Unknown" 1 "Standard" 2 "Extended" 3 "Keep Open" ;
VAL_TABLE_ BlkhdDrServIndOn 0 "FALSE" 1 "TRUE" ;
VAL_TABLE_ DMPDAutoClsTmRFCstSetAval 0 "FALSE" 1 "TRUE" ;
VAL_TABLE_ DMPDAutoClsTmRFCstAvlFlg7 0 "FALSE" 1 "TRUE" ;
VAL_TABLE_ DMPDAutoClsTmRFCstAvlFlg6 0 "FALSE" 1 "TRUE" ;
VAL_TABLE_ DMPDAutoClsTmRFCstAvlFlg5 0 "FALSE" 1 "TRUE" ;
VAL_TABLE_ DMPDAutoClsTmRFCstAvlFlg4 0 "FALSE" 1 "TRUE" ;
VAL_TABLE_ DMPDAutoClsTmRFCstAvlFlg3 0 "FALSE" 1 "TRUE" ;
VAL_TABLE_ DMPDAutoClsTmRFCstAvlFlg2 0 "FALSE" 1 "TRUE" ;
VAL_TABLE_ DMPDAutoClsTmRFCstAvlFlg1 0 "FALSE" 1 "TRUE" ;
VAL_TABLE_ DMPDClsOutofPrkRFCstSetAval 0 "FALSE" 1 "TRUE" ;
VAL_TABLE_ DMPDClsOutofPrkRFCstAvlFlg7 0 "FALSE" 1 "TRUE" ;
VAL_TABLE_ DMPDClsOutofPrkRFCstAvlFlg6 0 "FALSE" 1 "TRUE" ;
VAL_TABLE_ DMPDClsOutofPrkRFCstAvlFlg5 0 "FALSE" 1 "TRUE" ;
VAL_TABLE_ DMPDClsOutofPrkRFCstAvlFlg4 0 "FALSE" 1 "TRUE" ;
VAL_TABLE_ DMPDClsOutofPrkRFCstAvlFlg3 0 "FALSE" 1 "TRUE" ;
VAL_TABLE_ DMPDClsOutofPrkRFCstAvlFlg2 0 "FALSE" 1 "TRUE" ;
VAL_TABLE_ DMPDClsOutofPrkRFCstAvlFlg1 0 "FALSE" 1 "TRUE" ;
VAL_TABLE_ DMPDDOBlkhdDrOpnRFCstSetAval 0 "FALSE" 1 "TRUE" ;
VAL_TABLE_ DMPDDOBlkhdDrOpnRFCstAvlFlg7 0 "FALSE" 1 "TRUE" ;
VAL_TABLE_ DMPDDOBlkhdDrOpnRFCstAvlFlg6 0 "FALSE" 1 "TRUE" ;
VAL_TABLE_ DMPDDOBlkhdDrOpnRFCstAvlFlg5 0 "FALSE" 1 "TRUE" ;
VAL_TABLE_ DMPDDOBlkhdDrOpnRFCstAvlFlg4 0 "FALSE" 1 "TRUE" ;
VAL_TABLE_ DMPDDOBlkhdDrOpnRFCstAvlFlg3 0 "FALSE" 1 "TRUE" ;
VAL_TABLE_ DMPDDOBlkhdDrOpnRFCstAvlFlg2 0 "FALSE" 1 "TRUE" ;
VAL_TABLE_ DMPDDOBlkhdDrOpnRFCstAvlFlg1 0 "FALSE" 1 "TRUE" ;
VAL_TABLE_ SCAOOAByKeyFobRFCstSetAval 0 "FALSE" 1 "TRUE" ;
VAL_TABLE_ SCAOOAByKeyFobRFCstAvlFlg7 0 "FALSE" 1 "TRUE" ;
VAL_TABLE_ SCAOOAByKeyFobRFCstAvlFlg6 0 "FALSE" 1 "TRUE" ;
VAL_TABLE_ SCAOOAByKeyFobRFCstAvlFlg5 0 "FALSE" 1 "TRUE" ;
VAL_TABLE_ SCAOOAByKeyFobRFCstAvlFlg4 0 "FALSE" 1 "TRUE" ;
VAL_TABLE_ SCAOOAByKeyFobRFCstAvlFlg3 0 "FALSE" 1 "TRUE" ;
VAL_TABLE_ SCAOOAByKeyFobRFCstAvlFlg2 0 "FALSE" 1 "TRUE" ;
VAL_TABLE_ SCAOOAByKeyFobRFCstAvlFlg1 0 "FALSE" 1 "TRUE" ;
VAL_TABLE_ SCAOOAByVirtKeyRFCstSetAval 0 "FALSE" 1 "TRUE" ;
VAL_TABLE_ SCAOOAByVirtKeyRFCstAvlFlg7 0 "FALSE" 1 "TRUE" ;
VAL_TABLE_ SCAOOAByVirtKeyRFCstAvlFlg6 0 "FALSE" 1 "TRUE" ;
VAL_TABLE_ SCAOOAByVirtKeyRFCstAvlFlg5 0 "FALSE" 1 "TRUE" ;
VAL_TABLE_ SCAOOAByVirtKeyRFCstAvlFlg4 0 "FALSE" 1 "TRUE" ;
VAL_TABLE_ SCAOOAByVirtKeyRFCstAvlFlg3 0 "FALSE" 1 "TRUE" ;
VAL_TABLE_ SCAOOAByVirtKeyRFCstAvlFlg2 0 "FALSE" 1 "TRUE" ;
VAL_TABLE_ SCAOOAByVirtKeyRFCstAvlFlg1 0 "FALSE" 1 "TRUE" ;
VAL_TABLE_ SCAPDBrktoClsRFCstSetAval 0 "FALSE" 1 "TRUE" ;
VAL_TABLE_ SCAPDBrktoClsRFCstAvlFlg7 0 "FALSE" 1 "TRUE" ;
VAL_TABLE_ SCAPDBrktoClsRFCstAvlFlg6 0 "FALSE" 1 "TRUE" ;
VAL_TABLE_ SCAPDBrktoClsRFCstAvlFlg5 0 "FALSE" 1 "TRUE" ;
VAL_TABLE_ SCAPDBrktoClsRFCstAvlFlg4 0 "FALSE" 1 "TRUE" ;
VAL_TABLE_ SCAPDBrktoClsRFCstAvlFlg3 0 "FALSE" 1 "TRUE" ;
VAL_TABLE_ SCAPDBrktoClsRFCstAvlFlg2 0 "FALSE" 1 "TRUE" ;
VAL_TABLE_ SCAPDBrktoClsRFCstAvlFlg1 0 "FALSE" 1 "TRUE" ;
VAL_TABLE_ SCAPDBrktoClsRFCstCurrSetVal 0 "Setting Unknown" 1 "Off" 2 "On" ;
VAL_TABLE_ DMPDClsOutofPrkRFCstCurrSetVal 0 "Setting Unknown" 1 "Off" 2 "On" ;
VAL_TABLE_ DMPDAutoClsTmRFCstCurrSetVal 0 "Setting Unknown" 1 "Standard" 2 "Extended" 3 "Keep Open" ;
VAL_TABLE_ SCAPwrDrMtnRFVirtCtlAval 0 "Not Available" 1 "Available" ;
VAL_TABLE_ PwrSdClsrRFServIndOn 0 "FALSE" 1 "TRUE" ;
VAL_TABLE_ PwrSdClsrRFBlckdIndOn 0 "FALSE" 1 "TRUE" ;
VAL_TABLE_ SCAPwrDrMtnRFVirtCtlAllwd 0 "Not Allowed" 1 "Allowed" ;
VAL_TABLE_ StMasgTyp11RFVirtCtlAval 0 "Not Available" 1 "Available" ;
VAL_TABLE_ StMasgTyp10RFVirtCtlAval 0 "Not Available" 1 "Available" ;
VAL_TABLE_ StHdrstVertRFVirtCtlAval 0 "Not Available" 1 "Available" ;
VAL_TABLE_ StHdrstHrztlRFVirtCtlAval 0 "Not Available" 1 "Available" ;
VAL_TABLE_ StCushSdBolsRFVirtCtlAval 0 "Not Available" 1 "Available" ;
VAL_TABLE_ StCushRrVertRFVirtCtlAval 0 "Not Available" 1 "Available" ;
VAL_TABLE_ StCushLgthHrztlRFVirtCtlAval 0 "Not Available" 1 "Available" ;
VAL_TABLE_ StCushHrztlRFCtlFrmRrVirtCtlAvl 0 "Not Available" 1 "Available" ;
VAL_TABLE_ StMasgTyp4RFVirtCtlAval 0 "Not Available" 1 "Available" ;
VAL_TABLE_ StMasgTyp3RFVirtCtlAval 0 "Not Available" 1 "Available" ;
VAL_TABLE_ StMasgTyp2RFVirtCtlAval 0 "Not Available" 1 "Available" ;
VAL_TABLE_ StMasgTyp1RFVirtCtlAval 0 "Not Available" 1 "Available" ;
VAL_TABLE_ StMasgTyp15RFVirtCtlAval 0 "Not Available" 1 "Available" ;
VAL_TABLE_ StMasgTyp14RFVirtCtlAval 0 "Not Available" 1 "Available" ;
VAL_TABLE_ StMasgTyp13RFVirtCtlAval 0 "Not Available" 1 "Available" ;
VAL_TABLE_ StMasgTyp12RFVirtCtlAval 0 "Not Available" 1 "Available" ;
VAL_TABLE_ StCushLgthHrztlRFVirtCtlAllwd 0 "Not Allowed" 1 "Allowed" ;
VAL_TABLE_ StCushHrztlRFCtlFrmRrVirCtlAlwd 0 "Not Allowed" 1 "Allowed" ;
VAL_TABLE_ StCushHrztlRFCtlFrmFrVirCtlAlwd 0 "Not Allowed" 1 "Allowed" ;
VAL_TABLE_ StCushFrtVertRFVirtCtlAllwd 0 "Not Allowed" 1 "Allowed" ;
VAL_TABLE_ StBkSdBolsRFVirtCtlAllwd 0 "Not Allowed" 1 "Allowed" ;
VAL_TABLE_ StBkLumbVertRFVirtCtlAllwd 0 "Not Allowed" 1 "Allowed" ;
VAL_TABLE_ StBkLumbHrztlRFVirtCtlAllwd 0 "Not Allowed" 1 "Allowed" ;
VAL_TABLE_ StBkHrztlRFCtlFrmRrVirtCtlAllwd 0 "Not Allowed" 1 "Allowed" ;
VAL_TABLE_ StMasgTypRFLstKnwnSet 0 "Massage Off" 1 "Type 1" 2 "Type 2" 3 "Type 3" 4 "Type 4" 5 "Type 5" 6 "Type 6" 7 "Type 7" 8 "Type 8" 9 "Type 9" 10 "Type 10" 11 "Type 11" 12 "Type 12" 13 "Type 13" 14 "Type 14" 15 "Type 15" ;
VAL_TABLE_ StBkHrztlRFCtlFrmFrtVirtCtlAlwd 0 "Not Allowed" 1 "Allowed" ;
VAL_TABLE_ StUpprShldrHrztlRFVirtCtlAllwd 0 "Not Allowed" 1 "Allowed" ;
VAL_TABLE_ StMasgRFVirtCtlAllwd 0 "Not Allowed" 1 "Allowed" ;
VAL_TABLE_ StHdrstVertRFVirtCtlAllwd 0 "Not Allowed" 1 "Allowed" ;
VAL_TABLE_ StHdrstHrztlRFVirtCtlAllwd 0 "Not Allowed" 1 "Allowed" ;
VAL_TABLE_ StCushSdBolsRFVirtCtlAllwd 0 "Not Allowed" 1 "Allowed" ;
VAL_TABLE_ StCushRrVertRFVirtCtlAllwd 0 "Not Allowed" 1 "Allowed" ;
VAL_TABLE_ StMemRFVirtCtlNumofExtPstnsAval 0 "Not Available" 1 "One Positions" 2 "Two Positions" 3 "Three Positions" 4 "Four Positions" 5 "Five Positions" 6 "Six Positions" 7 "Seven Positions" 8 "Eight Positions" ;
VAL_TABLE_ StMasgIntstyRFLstKnwnSet 0 "Massage Off" 1 "Intensity 1" 2 "Intensity 2" 3 "Intensity 3" 4 "Intensity 4" 5 "Intensity 5" 6 "Intensity 6" 7 "Intensity 7" ;
VAL_TABLE_ StMemRFVirtCtlNumofMemPstnsAval 0 "Not Available" 1 "One Positions" 2 "Two Positions" 3 "Three Positions" 4 "Four Positions" 5 "Five Positions" 6 "Six Positions" 7 "Seven Positions" 8 "Eight Positions" ;
VAL_TABLE_ StCushHrztlRFCtlFrmFrtVirCtlAvl 0 "Not Available" 1 "Available" ;
VAL_TABLE_ StCushFrtVertRFVirtCtlAval 0 "Not Available" 1 "Available" ;
VAL_TABLE_ StBkSdBolsRFVirtCtlAval 0 "Not Available" 1 "Available" ;
VAL_TABLE_ StBkLumbVertRFVirtCtlAval 0 "Not Available" 1 "Available" ;
VAL_TABLE_ StBkLumbHrztlRFVirtCtlAval 0 "Not Available" 1 "Available" ;
VAL_TABLE_ StBkHrztlRFCtlFrmRrVirtCtlAval 0 "Not Available" 1 "Available" ;
VAL_TABLE_ StBkHrztlRFCtlFrmFrtVirtCtlAval 0 "Not Available" 1 "Available" ;
VAL_TABLE_ StMemRFVirtCtlStorAllwd 0 "Not Allowed" 1 "Allowed" ;
VAL_TABLE_ StMemRFVirtCtlRclAllwd 0 "Not Allowed" 1 "Allowed" ;
VAL_TABLE_ StUpprShldrHrztlRFVirtCtlAval 0 "Not Available" 1 "Available" ;
VAL_TABLE_ StMasgTyp9RFVirtCtlAval 0 "Not Available" 1 "Available" ;
VAL_TABLE_ StMasgTyp8RFVirtCtlAval 0 "Not Available" 1 "Available" ;
VAL_TABLE_ StMasgTyp7RFVirtCtlAval 0 "Not Available" 1 "Available" ;
VAL_TABLE_ StMasgTyp6RFVirtCtlAval 0 "Not Available" 1 "Available" ;
VAL_TABLE_ StMasgTyp5RFVirtCtlAval 0 "Not Available" 1 "Available" ;
VAL_TABLE_ StCushFrtVertRRVirtCtlAval 0 "Not Available" 1 "Available" ;
VAL_TABLE_ StBkSdBolsRRVirtCtlAval 0 "Not Available" 1 "Available" ;
VAL_TABLE_ StBkLumbVertRRVirtCtlAval 0 "Not Available" 1 "Available" ;
VAL_TABLE_ StBkLumbHrztlRRVirtCtlAval 0 "Not Available" 1 "Available" ;
VAL_TABLE_ StBkHrztlRRVirtCtlAval 0 "Not Available" 1 "Available" ;
VAL_TABLE_ StMasgTyp11RRVirtCtlAval 0 "Not Available" 1 "Available" ;
VAL_TABLE_ StMasgTyp10RRVirtCtlAval 0 "Not Available" 1 "Available" ;
VAL_TABLE_ StHdrstVertRRVirtCtlAval 0 "Not Available" 1 "Available" ;
VAL_TABLE_ StHdrstHrztlRRVirtCtlAval 0 "Not Available" 1 "Available" ;
VAL_TABLE_ StCushSdBolsRRVirtCtlAval 0 "Not Available" 1 "Available" ;
VAL_TABLE_ StCushRrVertRRVirtCtlAval 0 "Not Available" 1 "Available" ;
VAL_TABLE_ StCushLgthHrztlRRVirtCtlAval 0 "Not Available" 1 "Available" ;
VAL_TABLE_ StCushHrztlRRVirtCtlAval 0 "Not Available" 1 "Available" ;
VAL_TABLE_ StMasgTyp4RRVirtCtlAval 0 "Not Available" 1 "Available" ;
VAL_TABLE_ StMasgTyp3RRVirtCtlAval 0 "Not Available" 1 "Available" ;
VAL_TABLE_ StMasgTyp2RRVirtCtlAval 0 "Not Available" 1 "Available" ;
VAL_TABLE_ StMasgTyp1RRVirtCtlAval 0 "Not Available" 1 "Available" ;
VAL_TABLE_ StMasgTyp15RRVirtCtlAval 0 "Not Available" 1 "Available" ;
VAL_TABLE_ StMasgTyp14RRVirtCtlAval 0 "Not Available" 1 "Available" ;
VAL_TABLE_ StMasgTyp13RRVirtCtlAval 0 "Not Available" 1 "Available" ;
VAL_TABLE_ StMasgTyp12RRVirtCtlAval 0 "Not Available" 1 "Available" ;
VAL_TABLE_ StBkLumbHrztlRRVirtCtlAllwd 0 "Not Allowed" 1 "Allowed" ;
VAL_TABLE_ StBkHrztlRRVirtCtlAllwd 0 "Not Allowed" 1 "Allowed" ;
VAL_TABLE_ StUpprShldrHrztlRRVirtCtlAval 0 "Not Available" 1 "Available" ;
VAL_TABLE_ StMasgTyp9RRVirtCtlAval 0 "Not Available" 1 "Available" ;
VAL_TABLE_ StMasgTyp8RRVirtCtlAval 0 "Not Available" 1 "Available" ;
VAL_TABLE_ StMasgTyp7RRVirtCtlAval 0 "Not Available" 1 "Available" ;
VAL_TABLE_ StMasgTyp6RRVirtCtlAval 0 "Not Available" 1 "Available" ;
VAL_TABLE_ StMasgTyp5RRVirtCtlAval 0 "Not Available" 1 "Available" ;
VAL_TABLE_ StHdrstHrztlRRVirtCtlAllwd 0 "Not Allowed" 1 "Allowed" ;
VAL_TABLE_ StCushSdBolsRRVirtCtlAllwd 0 "Not Allowed" 1 "Allowed" ;
VAL_TABLE_ StCushRrVertRRVirtCtlAllwd 0 "Not Allowed" 1 "Allowed" ;
VAL_TABLE_ StCushLgthHrztlRRVirtCtlAllwd 0 "Not Allowed" 1 "Allowed" ;
VAL_TABLE_ StCushHrztlRRVirtCtlAllwd 0 "Not Allowed" 1 "Allowed" ;
VAL_TABLE_ StCushFrtVertRRVirtCtlAllwd 0 "Not Allowed" 1 "Allowed" ;
VAL_TABLE_ StBkSdBolsRRVirtCtlAllwd 0 "Not Allowed" 1 "Allowed" ;
VAL_TABLE_ StBkLumbVertRRVirtCtlAllwd 0 "Not Allowed" 1 "Allowed" ;
VAL_TABLE_ StMasgIntstyRRLstKnwnSet 0 "Massage Off" 1 "Intensity 1" 2 "Intensity 2" 3 "Intensity 3" 4 "Intensity 4" 5 "Intensity 5" 6 "Intensity 6" 7 "Intensity 7" ;
VAL_TABLE_ StMasgTypRRLstKnwnSet 0 "Massage Off" 1 "Type 1" 2 "Type 2" 3 "Type 3" 4 "Type 4" 5 "Type 5" 6 "Type 6" 7 "Type 7" 8 "Type 8" 9 "Type 9" 10 "Type 10" 11 "Type 11" 12 "Type 12" 13 "Type 13" 14 "Type 14" 15 "Type 15" ;
VAL_TABLE_ StUpprShldrHrztlRRVirtCtlAllwd 0 "Not Allowed" 1 "Allowed" ;
VAL_TABLE_ StMasgRRVirtCtlAllwd 0 "Not Allowed" 1 "Allowed" ;
VAL_TABLE_ StHdrstVertRRVirtCtlAllwd 0 "Not Allowed" 1 "Allowed" ;
VAL_TABLE_ StMemRRVirtCtlNumofMemPstnsAval 0 "Not Available" 1 "One Positions" 2 "Two Positions" 3 "Three Positions" 4 "Four Positions" 5 "Five Positions" 6 "Six Positions" 7 "Seven Positions" 8 "Eight Positions" ;
VAL_TABLE_ StMemRRVirtCtlNumofExtPstnsAval 0 "Not Available" 1 "One Positions" 2 "Two Positions" 3 "Three Positions" 4 "Four Positions" 5 "Five Positions" 6 "Six Positions" 7 "Seven Positions" 8 "Eight Positions" ;
VAL_TABLE_ StCushFrtVertLRVirtCtlAval 0 "Not Available" 1 "Available" ;
VAL_TABLE_ StBkSdBolsLRVirtCtlAval 0 "Not Available" 1 "Available" ;
VAL_TABLE_ StBkLumbVertLRVirtCtlAval 0 "Not Available" 1 "Available" ;
VAL_TABLE_ StBkLumbHrztlLRVirtCtlAval 0 "Not Available" 1 "Available" ;
VAL_TABLE_ StBkHrztlLRVirtCtlAval 0 "Not Available" 1 "Available" ;
VAL_TABLE_ StMasgTyp11LRVirtCtlAval 0 "Not Available" 1 "Available" ;
VAL_TABLE_ StMasgTyp10LRVirtCtlAval 0 "Not Available" 1 "Available" ;
VAL_TABLE_ StHdrstVertLRVirtCtlAval 0 "Not Available" 1 "Available" ;
VAL_TABLE_ StHdrstHrztlLRVirtCtlAval 0 "Not Available" 1 "Available" ;
VAL_TABLE_ StCushSdBolsLRVirtCtlAval 0 "Not Available" 1 "Available" ;
VAL_TABLE_ StCushRrVertLRVirtCtlAval 0 "Not Available" 1 "Available" ;
VAL_TABLE_ StCushLgthHrztlLRVirtCtlAval 0 "Not Available" 1 "Available" ;
VAL_TABLE_ StCushHrztlLRVirtCtlAval 0 "Not Available" 1 "Available" ;
VAL_TABLE_ StMasgTyp4LRVirtCtlAval 0 "Not Available" 1 "Available" ;
VAL_TABLE_ StMasgTyp3LRVirtCtlAval 0 "Not Available" 1 "Available" ;
VAL_TABLE_ StMasgTyp2LRVirtCtlAval 0 "Not Available" 1 "Available" ;
VAL_TABLE_ StMasgTyp1LRVirtCtlAval 0 "Not Available" 1 "Available" ;
VAL_TABLE_ StMasgTyp15LRVirtCtlAval 0 "Not Available" 1 "Available" ;
VAL_TABLE_ StMasgTyp14LRVirtCtlAval 0 "Not Available" 1 "Available" ;
VAL_TABLE_ StMasgTyp13LRVirtCtlAval 0 "Not Available" 1 "Available" ;
VAL_TABLE_ StMasgTyp12LRVirtCtlAval 0 "Not Available" 1 "Available" ;
VAL_TABLE_ StMemLRVirtCtlNumofExtPstnsAval 0 "Not Available" 1 "One Positions" 2 "Two Positions" 3 "Three Positions" 4 "Four Positions" 5 "Five Positions" 6 "Six Positions" 7 "Seven Positions" 8 "Eight Positions" ;
VAL_TABLE_ StUpprShldrHrztlLRVirtCtlAval 0 "Not Available" 1 "Available" ;
VAL_TABLE_ StMasgTyp9LRVirtCtlAval 0 "Not Available" 1 "Available" ;
VAL_TABLE_ StMasgTyp8LRVirtCtlAval 0 "Not Available" 1 "Available" ;
VAL_TABLE_ StMasgTyp7LRVirtCtlAval 0 "Not Available" 1 "Available" ;
VAL_TABLE_ StMasgTyp6LRVirtCtlAval 0 "Not Available" 1 "Available" ;
VAL_TABLE_ StMasgTyp5LRVirtCtlAval 0 "Not Available" 1 "Available" ;
VAL_TABLE_ RrDrOpnCmfRclCstAvlFlg2 0 "FALSE" 1 "TRUE" ;
VAL_TABLE_ RrDrOpnCmfRclCstAvlFlg1 0 "FALSE" 1 "TRUE" ;
VAL_TABLE_ StMemLRVirtCtlNumofMemPstnsAval 0 "Not Available" 1 "One Positions" 2 "Two Positions" 3 "Three Positions" 4 "Four Positions" 5 "Five Positions" 6 "Six Positions" 7 "Seven Positions" 8 "Eight Positions" ;
VAL_TABLE_ RrDrOpnCmfRclCstSetAval 0 "FALSE" 1 "TRUE" ;
VAL_TABLE_ RrDrOpnCmfRclCstAvlFlg7 0 "FALSE" 1 "TRUE" ;
VAL_TABLE_ RrDrOpnCmfRclCstAvlFlg6 0 "FALSE" 1 "TRUE" ;
VAL_TABLE_ RrDrOpnCmfRclCstAvlFlg5 0 "FALSE" 1 "TRUE" ;
VAL_TABLE_ RrDrOpnCmfRclCstAvlFlg4 0 "FALSE" 1 "TRUE" ;
VAL_TABLE_ RrDrOpnCmfRclCstAvlFlg3 0 "FALSE" 1 "TRUE" ;
VAL_TABLE_ SCAOOAByVirtKeyRFCstCurrSetVal 0 "Setting Unknown" 1 "Off" 2 "On" ;
VAL_TABLE_ SCAOOAByKeyFobRFCstCurrSetVal 0 "Setting Unknown" 1 "Off" 2 "On" ;
VAL_TABLE_ PwrSdClsrRRBlckdIndOn 0 "FALSE" 1 "TRUE" ;
VAL_TABLE_ PwrSdClsrRRServIndOn 0 "FALSE" 1 "TRUE" ;
VAL_TABLE_ ASS_DSPMd6Prsnt 0 "FALSE" 1 "TRUE" ;
VAL_TABLE_ ASS_DSPMd5Prsnt 0 "FALSE" 1 "TRUE" ;
VAL_TABLE_ ASS_DSPMd4Prsnt 0 "FALSE" 1 "TRUE" ;
VAL_TABLE_ ASS_DSPMd3Prsnt 0 "FALSE" 1 "TRUE" ;
VAL_TABLE_ ASS_DSPMd2Prsnt 0 "FALSE" 1 "TRUE" ;
VAL_TABLE_ ASS_DSPMd1Prsnt 0 "FALSE" 1 "TRUE" ;
VAL_TABLE_ ASS_DSPMd0Prsnt 0 "FALSE" 1 "TRUE" ;
VAL_TABLE_ ASS_DSPAvail 0 "FALSE" 1 "TRUE" ;
VAL_TABLE_ ASS_VehNoisCmpnAvail 0 "FALSE" 1 "TRUE" ;
VAL_TABLE_ ASS_SurndAvail 0 "FALSE" 1 "TRUE" ;
VAL_TABLE_ ASS_PhLckdLpLckd 0 "FALSE" 1 "TRUE" ;
VAL_TABLE_ ASS_MtxSnkMutStat 0 "FALSE" 1 "TRUE" ;
VAL_TABLE_ ASS_DSPMd7Prsnt 0 "FALSE" 1 "TRUE" ;
VAL_TABLE_ FrtPsngrMtxSnkMutSts 0 "FALSE" 1 "TRUE" ;
VAL_TABLE_ CCSI_CrtclChmPrdcrSOH 0 "Unknown" 1 "Healthy" 2 "Faulted" ;
VAL_TABLE_ AmpCallAudPlybkSOH 0 "Unknown" 1 "Healthy" 2 "Faulted" ;
VAL_TABLE_ RRMtxSnkMutSts 0 "FALSE" 1 "TRUE" ;
VAL_TABLE_ LRMtxSnkMutSts 0 "FALSE" 1 "TRUE" ;
VAL_TABLE_ AmpSOHALAutoLdnsCmpnAtv 0 "FALSE" 1 "TRUE" ;
VAL_TABLE_ AmpSOHALMutCaus 0 "Unknown" 1 "CAN Requested" 2 "DSP Mode Changed" 3 "Other Internal" ;
VAL_TABLE_ PhnZnAudSOH 0 "Unknown" 1 "Healthy" 2 "Faulted" ;
VAL_TABLE_ QdZnAudVolCtlAval 0 "FALSE" 1 "TRUE" ;
VAL_TABLE_ FrtZnAudVolCtlAval 0 "FALSE" 1 "TRUE" ;
VAL_TABLE_ DirAudPrmtRndrngActv 0 "FALSE" 1 "TRUE" ;
VAL_TABLE_ HMIInCarVcCommSts 0 "ICC_Off" 1 "ICC_Idle" 2 "Front_High_Rear_High" 3 "Front_High_Rear_Normal" 4 "Front_High_Rear_Off" 5 "Front_Normal_Rear_High" 6 "Front_Normal_Rear_Normal" 7 "Front_Normal_Rear_Off" ;
VAL_TABLE_ PhnZnAval 0 "FALSE" 1 "TRUE" ;
VAL_TABLE_ YawRateAuth_Inv 0 "FALSE" 1 "TRUE" ;
VAL_TABLE_ YawRateAuth_DuD 0 "FALSE" 1 "TRUE" ;
VAL_TABLE_ BGI3P_BrkPedPstnAuth_Inv 0 "FALSE" 1 "TRUE" ;
VAL_TABLE_ LatAccelAuth_Inv 0 "FALSE" 1 "TRUE" ;
VAL_TABLE_ LongAccelAuth_Inv 0 "FALSE" 1 "TRUE" ;
VAL_TABLE_ BGI3P_BrkPedModrTrvlAchAuth 0 "FALSE" 1 "TRUE" ;
VAL_TABLE_ BGI3P_BrkPedModrTrvlAchAuth_Inv 0 "FALSE" 1 "TRUE" ;
VAL_TABLE_ BGI3P_BrkPedInitTrvlAchAuth 0 "FALSE" 1 "TRUE" ;
VAL_TABLE_ BGI3P_BrkPedInitTrvlAchAuth_Inv 0 "FALSE" 1 "TRUE" ;
VAL_TABLE_ VCBA_FrtJnctnActv 0 "FALSE" 1 "TRUE" ;
VAL_TABLE_ VCBA_DynGdlnsActv 0 "FALSE" 1 "TRUE" ;
VAL_TABLE_ VCBA_CurbVwGdlnsActv 0 "FALSE" 1 "TRUE" ;
VAL_TABLE_ VCBA_CurbOvrhdActv 0 "FALSE" 1 "TRUE" ;
VAL_TABLE_ VCBA_CurbActv 0 "FALSE" 1 "TRUE" ;
VAL_TABLE_ VCBA_CrgBedActv 0 "FALSE" 1 "TRUE" ;
VAL_TABLE_ VCBA_BowlActv 0 "FALSE" 1 "TRUE" ;
VAL_TABLE_ VCBA_BedHtchActv 0 "FALSE" 1 "TRUE" ;
VAL_TABLE_ VCBA_RrOvrhdActv 0 "FALSE" 1 "TRUE" ;
VAL_TABLE_ VCBA_RrJnctnActv 0 "FALSE" 1 "TRUE" ;
VAL_TABLE_ VCBA_RrHtchActv 0 "FALSE" 1 "TRUE" ;
VAL_TABLE_ VCBA_LRTrlrTowMirActv 0 "FALSE" 1 "TRUE" ;
VAL_TABLE_ VCBA_JPActv 0 "FALSE" 1 "TRUE" ;
VAL_TABLE_ VCBA_InvsblTrlrActv 0 "FALSE" 1 "TRUE" ;
VAL_TABLE_ VCBA_FrtPrspctvActv 0 "FALSE" 1 "TRUE" ;
VAL_TABLE_ VCBA_FrtOvrhdActv 0 "FALSE" 1 "TRUE" ;
VAL_TABLE_ VCBA_TrlrTowMirActv 0 "FALSE" 1 "TRUE" ;
VAL_TABLE_ VCBA_TrlrGdlnsActv 0 "FALSE" 1 "TRUE" ;
VAL_TABLE_ VCBA_TrlrAux2Actv 0 "FALSE" 1 "TRUE" ;
VAL_TABLE_ VCBA_TrlrAux1CmbdActv 0 "FALSE" 1 "TRUE" ;
VAL_TABLE_ VCBA_TrlrAux1Actv 0 "FALSE" 1 "TRUE" ;
VAL_TABLE_ VCBA_SdRrwdActv 0 "FALSE" 1 "TRUE" ;
VAL_TABLE_ VCBA_SdFrwdActv 0 "FALSE" 1 "TRUE" ;
VAL_TABLE_ VCBA_RrPrspctvActv 0 "FALSE" 1 "TRUE" ;
VAL_TABLE_ VCBA_ZmdBowlActv 0 "FALSE" 1 "TRUE" ;
VAL_TABLE_ VCBA_TrnspHdActv 0 "FALSE" 1 "TRUE" ;
VAL_TABLE_ SrrndVsnRcrdrDelFileReqSts 0 "Unknown" 1 "File_1 Deleted" 2 "File_2 Deleted" 3 "File_3 Deleted" 4 "File_4 Deleted" 5 "File_5 Deleted" 6 "No Selection" 7 "Delete Failed" ;
VAL_TABLE_ SrrndVsnRcrdrVwprtSts 0 "Unknown" 1 "Playback Mosaic" 2 "Playback Zoom1" 3 "Playback Zoom2" 4 "Playback Zoom3" 5 "Playback Zoom4" 6 "List Recent" 7 "List Saved" ;
VAL_TABLE_ SrrndVsnRcrdrVwprtReq 0 "Unknown" 1 "Playback Mosaic" 2 "Playback Zoom1" 3 "Playback Zoom2" 4 "Playback Zoom3" 5 "Playback Zoom4" 6 "List Recent" 7 "List Saved" ;
VAL_TABLE_ SrrndVsnRcrdrPlybkSts 0 "Unknown" 1 "Play" 2 "Pause" 3 "Rewind" 4 "Fast Forward" 5 "No Selection" ;
VAL_TABLE_ SrrndVsnRcrdrRcrdSts 0 "Unknown" 1 "Enabled" 2 "Disabled" ;
VAL_TABLE_ SrrndVsnRcrdrListPgSts 0 "Unknown" 1 "Page Up" 2 "Page Down" 3 "No Selection" ;
VAL_TABLE_ VGVS_TrlrActv 0 "FALSE" 1 "TRUE" ;
VAL_TABLE_ VGVS_DynActv 0 "FALSE" 1 "TRUE" ;
VAL_TABLE_ VGVS_CurbVwActv 0 "FALSE" 1 "TRUE" ;
VAL_TABLE_ SrrndVsnRcrdrRcrdgActv 0 "FALSE" 1 "TRUE" ;
VAL_TABLE_ ClsnEvntDatRcrdgTrgrd 0 "FALSE" 1 "TRUE" ;
VAL_TABLE_ SVRCBA_PgUpActv 0 "FALSE" 1 "TRUE" ;
VAL_TABLE_ SVRCBA_PgDnActv 0 "FALSE" 1 "TRUE" ;
VAL_TABLE_ AATP_ActAxlTrqAuth_Inv 0 "FALSE" 1 "TRUE" ;
VAL_TABLE_ PrplSysMtrASpdAuth_Inv 0 "FALSE" 1 "TRUE" ;
VAL_TABLE_ TGI2P_TrnsOutShftAngVelAuth_Inv 0 "FALSE" 1 "TRUE" ;
VAL_TABLE_ EGIP_EngActlStdyStatTrqAuth_Inv 0 "FALSE" 1 "TRUE" ;
VAL_TABLE_ HstVehFrtRdWhlAng_Inv 0 "FALSE" 1 "TRUE" ;
VAL_TABLE_ ESP_EngSpdStAuth 0 "Normal_Operation" 1 "Degraded_Operation" 2 "Invalid" ;
VAL_TABLE_ DslGlwPlgIO 0 "FALSE" 1 "TRUE" ;
VAL_TABLE_ TSP_TmpDrvrShfCtlActvAuth 0 "FALSE" 1 "TRUE" ;
VAL_TABLE_ TSP_ElecRngSeltnInDrvActvAuth 0 "FALSE" 1 "TRUE" ;
VAL_TABLE_ VMI1P_AccelActlPstnAuth_Inv 0 "FALSE" 1 "TRUE" ;
VAL_TABLE_ LIB1StatOfChrg_Inv 0 "FALSE" 1 "TRUE" ;
VAL_TABLE_ VMI1P_VehTopSpdLimModeActvAuth 0 "FALSE" 1 "TRUE" ;
VAL_TABLE_ VMI1P_AccelPedOvrrdActvAuth 0 "FALSE" 1 "TRUE" ;
VAL_TABLE_ LIB1CellVltgFlt 0 "No Fault" 1 "Low Severity" 2 "Medium Severity" 3 "High Severity" ;
VAL_TABLE_ LIB1CellVltgFlt_Inv 0 "FALSE" 1 "TRUE" ;
VAL_TABLE_ ClsnImntBrkgAxlTrqRqActvAuth 0 "FALSE" 1 "TRUE" ;
VAL_TABLE_ ACCBRP_ReqActvAuth 0 "FALSE" 1 "TRUE" ;
VAL_TABLE_ ACCBRP_ACCActvAuth 0 "FALSE" 1 "TRUE" ;
VAL_TABLE_ ACCATRIP_TrqActvAuth 0 "FALSE" 1 "TRUE" ;
VAL_TABLE_ DMSIP_DrvrAttnStatAuth_Inv 0 "FALSE" 1 "TRUE" ;
VAL_TABLE_ PrkAsstCustSeltn 0 "Off" 1 "On" 2 "Failed" ;
VAL_TABLE_ DMSIP_DrvrAttnStatAuth 0 "Unknown" 1 "Attention is On Road" 2 "Attention is Off Road" 3 "Attention is Driver's Lap" 4 "Attention is Center Console / Radio" 5 "Driver\???s Eyes Fully Closed" 6 "Driver Window / Mirror" 7 "Passenger Window / Mirror" 8 "Rear View Mirror" 9 "Overhead Console" 10 "No Driver" 11 "Front IPC" ;
VAL_TABLE_ LCCPIP_LnCntrCtlAclPedLimRqAuth 0 "FALSE" 1 "TRUE" ;
VAL_TABLE_ AAASSRP_StrgReqStsAuth 0 "Unknown" 1 "Active" 2 "Inactive" ;
VAL_TABLE_ BGI1P_DrvrDrOpnStsAuth_Inv 0 "FALSE" 1 "TRUE" ;
VAL_TABLE_ BGI1P_DrvrDrOpnStsAuth_DuD 0 "FALSE" 1 "TRUE" ;
VAL_TABLE_ BGI1P_DrvrDrOpnStsAuth 0 "FALSE" 1 "TRUE" ;
VAL_TABLE_ EngCyldrDctvRqd 0 "FALSE" 1 "TRUE" ;
VAL_TABLE_ EngCylDctvMd 0 "All Cylinders Active" 1 "Deactivation In Progress" 2 "Half of Total Cylinders Active" 3 "Reactivation In Progress" ;
VAL_TABLE_ BGI1P_OutsdAmbtLgtLvlStsAuth 0 "Unknown" 1 "Day" 2 "Night" ;
VAL_TABLE_ SWIP_StrgWhlAngAuth_DuD 0 "FALSE" 1 "TRUE" ;
VAL_TABLE_ SWIP_StrgWhlAngCalStsAuth 0 "Unknown" 1 "Estimated" 2 "Calibrated" ;
VAL_TABLE_ SWIP_StrgWhlAngAuth_Inv 0 "FALSE" 1 "TRUE" ;
VAL_TABLE_ ElecPSTrqOvrlySts 0 "Unknown" 1 "Temporarily Inhibited" 2 "Inactive" 3 "Active" 4 "Temporarily Limited" 5 "Failed" ;
VAL_TABLE_ ADASAutoRsmChmEvntStat 0 "No Action" 1 "Active" 2 "Cancel Chime" ;
VAL_TABLE_ StBltRmndrChmTyp2EvntStat 0 "No_Action" 1 "Active" 2 "Cancel_Chime" ;
VAL_TABLE_ StBltRmndrChmEvntStat 0 "NO_ACTION" 1 "ACTIVE" 2 "CANCEL_CHIME" ;
VAL_TABLE_ BCMGI2_DrvrShtlModeCmnd 0 "FALSE" 1 "TRUE" ;
VAL_TABLE_ BVSCRP_CPSAxlTrqCmdReqStsAuth 0 "No Request" 1 "Request Honored" 2 "Lost Arbitration" 3 "Serial Data Failure Temporary" 4 "Serial Data Failure Permanent" 5 "Control System Failure Temporary" 6 "Control System Failure Permanent" ;
VAL_TABLE_ BVSCRP_CPSAxlTrqCmdLimStsAuth 0 "Request Not Limited" 1 "Request Value Limited to Minimum" 2 "Request Value Limited to Maximum" 3 "Request Rate Limited" ;
VAL_TABLE_ BVSCRP_ACCAxlTrqCmdReqStsAuth 0 "No Request" 1 "Request Honored" 2 "Lost Arbitration" 3 "Request Denied" 4 "Request Suspended Till Driver Input" ;
VAL_TABLE_ BVSCRP_ACCAxlTrqCmdLimStsAuth 0 "Request Not Limited" 1 "Request Value Limited Minimum" 2 "Request Value Limited Maximum" 3 "Request Rate Limited" ;
VAL_TABLE_ CruzCtlActvAuth 0 "FALSE" 1 "TRUE" ;
VAL_TABLE_ CnvntlCruzCtlIndReqAuth 0 "No Action" 1 "Cruise Control Telltale Off" 2 "Cruise Control Unavailable Telltale On" 3 "Cruise Control White Telltale On" 4 "Cruise Control Green Telltale On" 5 "Cruise Control Blue Telltale On" ;
VAL_TABLE_ BVSCRP_CruzCtlEnbldAuth 0 "FALSE" 1 "TRUE" ;
VAL_TABLE_ BVSCRP_CltchPdlActPosAuth_Inv 0 "FALSE" 1 "TRUE" ;
VAL_TABLE_ DrSeltdSpdLmtrSetSpdLimRchdAuth 0 "No Limit Reached" 1 "High Limit Reached" 2 "Low Limit Reached" 3 "Reserved" ;
VAL_TABLE_ DrSeltdSpdLmtrAutoMdSpLmStsAuth 0 "No Set Speed Change" 1 "Proposed Speed Limit Change" 2 "Accepted Speed Limit Change" 3 "Declined Speed Limit Change" ;
VAL_TABLE_ SpdLmtrSpdLimSgnUntAuth 0 "km/h" 1 "mph" ;
VAL_TABLE_ PABRP_VehTopSpdLimArbdStatAuth 0 "Torque" 1 "Torque & Friction Brake" 2 "Inactive" ;
VAL_TABLE_ EGI2P_PwrtrnCrnkActvAuth 0 "FALSE" 1 "TRUE" ;
VAL_TABLE_ DrSeltdSpdLmtrSetTypActvAuth 0 "Off" 1 "Manual" 2 "Auto" 3 "Reserved" ;
VAL_TABLE_ BrkPdlDrvAppPrsDetcdAuth 0 "FALSE" 1 "TRUE" ;
VAL_TABLE_ BrkPdlDrvAppPrsDetcdAuth_Inv 0 "FALSE" 1 "TRUE" ;
VAL_TABLE_ Bat12VCfg 0 "PbA Only" 1 "Li Only" 2 "Dual PbA" 3 "Dual Li" 4 "Dual Mix- PbA Primary" 5 "Dual Mix- Li Primary" 6 "Reserved" 7 "Unknown Batt Type" ;
VAL_TABLE_ ETRPP_ElcTransRngPriAuth 0 "NO_REQUEST" 1 "PARK" 2 "REVERSE" 3 "NEUTRAL" 4 "DRIVE" 5 "LOW_RANGE" 6 "MANUAL_RANGE" ;
VAL_TABLE_ BSIS2P_ABSFldAuth 0 "FALSE" 1 "TRUE" ;
VAL_TABLE_ BSIS2P_ABSAtvAuth 0 "FALSE" 1 "TRUE" ;
VAL_TABLE_ BSIS2P_BrkPdlDrvApplPresAuth_Inv 0 "FALSE" 1 "TRUE" ;
VAL_TABLE_ BdyCtlTopSpdLimSrcAuth 0 "None" 1 "Teen" 2 "Valet" 3 "HoodOpen" 4 "Reserved" 5 "Reserved" 6 "Reserved" 7 "Reserved" ;
VAL_TABLE_ BdyCtlTopSpdLimIndOnAuth 0 "FALSE" 1 "TRUE" ;
VAL_TABLE_ BdyCtlAccelLimIndOnAuth 0 "FALSE" 1 "TRUE" ;
VAL_TABLE_ CnvtTopModSpdLimIndOnAuth 0 "FALSE" 1 "TRUE" ;
VAL_TABLE_ DrvShftCntrlTrgtGr 0 "Unknown" 1 "First Gear" 2 "Second Gear" 3 "Third Gear" 4 "Fourth Gear" 5 "Fifth Gear" 6 "Sixth Gear" 7 "Seventh Gear" 8 "Eighth Gear" 9 "Ninth Gear" 10 "Tenth Gear" ;
VAL_TABLE_ DrvShftCntrlReqDndIO 0 "FALSE" 1 "TRUE" ;
VAL_TABLE_ TEGP_TrnsShftLvrPstnAuth_Inv 0 "FALSE" 1 "TRUE" ;
VAL_TABLE_ TEGP_TrnsEstGrAuth 0 "Not Supported" 1 "First Gear" 2 "Second Gear" 3 "Third Gear" 4 "Fourth Gear" 5 "Fifth Gear" 6 "Sixth Gear" 7 "Seventh Gear" 8 "Eighth Gear" 9 "Ninth Gear" 10 "Tenth Gear" 11 "Unused and Reserved" 12 "CVT Forward Gear" 13 "Neutral Gear" 14 "Reverse Gear" 15 "Park Gear" ;
VAL_TABLE_ TEGP_TrnsEstGrAuth_Inv 0 "FALSE" 1 "TRUE" ;
VAL_TABLE_ TrnsTUTDMdSt 0 "No Activation" 1 "Driver Shift Control Active" 2 "Electronic Range Select Active" ;
VAL_TABLE_ TEGP_TransCmndGrAuth 0 "Not Supported" 1 "First Gear" 2 "Second Gear" 3 "Third Gear" 4 "Fourth Gear" 5 "Fifth Gear" 6 "Sixth Gear" 7 "Seventh Gear" 8 "Eighth Gear" 9 "Ninth Gear" 10 "Tenth Gear" 11 "Unused and Reserved" 12 "CVT Forward Gear" 13 "Neutral Gear" 14 "Reverse Gear" 15 "Park Gear" ;
VAL_TABLE_ TEGP_TrnsShftLvrPstnAuth 0 "Between Ranges" 1 "Park Range" 2 "Reverse Range" 3 "Neutral Range" 4 "Forward Range A" 5 "Forward Range B" 6 "Forward Range C" 7 "Forward Range D" 8 "Forward Range E" 9 "Forward Range F" 10 "Forward Range G" 11 "Forward Range H" 12 "Forward Range I" 13 "Forward Range J" 14 "Lever Position Unknown" ;
VAL_TABLE_ TrnsRngInhbtSt 0 "No Range Inhibit Active" 1 "Transmission Inhibit Active" 2 "Transmission Range Re-Selection Req" 3 "Driveline Not Engaged" 4 "Diagnostic Inhibit Active" ;
VAL_TABLE_ TEGP_TrnsEngdStAuth 0 "Transmission Not Engaged" 1 "Transmission Engaged in Forward" 2 "Transmission Engaged in Reverse" 3 "Operating State Not Reached" ;
VAL_TABLE_ TEGP_TrnsEngdStAuth_Inv 0 "FALSE" 1 "TRUE" ;
VAL_TABLE_ HiVltgBatOutOfEngyIndReq 0 "No Action" 1 "Charge Soon" 2 "Charge Now" 3 "Out of Energy" 4 "Start Engine" ;
VAL_TABLE_ DrvrElecVehModeCmnd 0 "FALSE" 1 "TRUE" ;
VAL_TABLE_ EASSI_StrtStpSt 0 "Engine Off" 1 "Engine Running" 2 "Engine Starting" 3 "Engine Stopping" ;
VAL_TABLE_ BSISP_TCSDrvrIntntAuth 0 "Disabled" 1 "Enabled" ;
VAL_TABLE_ BSISP_TCSActvAuth 0 "FALSE" 1 "TRUE" ;
VAL_TABLE_ BSISP_ETRSHydrlcBrkgStsAuth 0 "Not Active" 1 "Active" 2 "Failed" ;
VAL_TABLE_ BSISP_ESCSysStsAuth 0 "Normal Operation" 1 "Failed" 2 "Initializing" 3 "Enhanced Operation" 4 "Driver Disable" ;
VAL_TABLE_ BSISP_ESCActvAuth 0 "FALSE" 1 "TRUE" ;
VAL_TABLE_ HstVehTrlrDtd 0 "Unknown" 1 "Trailer Not Detected" 2 "Trailer Detected" 3 "Unsupported Trailer Detected" ;
VAL_TABLE_ BrkgSysVehTopSpdLimIndOnAuth 0 "FALSE" 1 "TRUE" ;
VAL_TABLE_ BSISP_TCSFaildAuth 0 "FALSE" 1 "TRUE" ;
VAL_TABLE_ HVBSOC_BatSOC_Inv 0 "FALSE" 1 "TRUE" ;
VAL_TABLE_ HVBI_BatPackPrcdVltg_DuD 0 "FALSE" 1 "TRUE" ;
VAL_TABLE_ HVBI_BatPackPrcdVltg_Inv 0 "FALSE" 1 "TRUE" ;
VAL_TABLE_ VAP_ActlVehAccelAuth_Inv 0 "FALSE" 1 "TRUE" ;
VAL_TABLE_ PrplDispEngTrq_Inv 0 "FALSE" 1 "TRUE" ;
VAL_TABLE_ PrplDispEngTrq_DuD 0 "FALSE" 1 "TRUE" ;
VAL_TABLE_ MemIdfrMemStorIndReq 0 "No Action" 1 "Driver 1" 2 "Driver 2" 3 "Driver 3" 4 "Driver 4" 5 "Driver 5" 6 "Driver 6" 7 "Driver 7" 8 "Driver 8" ;
VAL_TABLE_ EngBstPrsInd_Inv 0 "FALSE" 1 "TRUE" ;
VAL_TABLE_ ThrPstn_Inv 0 "FALSE" 1 "TRUE" ;
VAL_TABLE_ EngPrplDispTrqLvlPct_DuD 0 "FALSE" 1 "TRUE" ;
VAL_TABLE_ TrnsTrqCnvCltCmdMd 0 "Unlocked" 1 "Transitioning" 2 "Controlled Slip" 3 "Locked" 4 "Not Supported" ;
VAL_TABLE_ PrkLmpsAct 0 "FALSE" 1 "TRUE" ;
VAL_TABLE_ WRDSP_LRAuth 0 "Unknown" 1 "Not Supported" 2 "Invalid" 3 "Forward" 4 "Reverse" ;
VAL_TABLE_ WRDSP_LFAuth 0 "Unknown" 1 "Not Supported" 2 "Invalid" 3 "Forward" 4 "Reverse" ;
VAL_TABLE_ WRDSP_RRAuth 0 "Unknown" 1 "Not Supported" 2 "Invalid" 3 "Forward" 4 "Reverse" ;
VAL_TABLE_ WRDSP_RFAuth 0 "Unknown" 1 "Not Supported" 2 "Invalid" 3 "Forward" 4 "Reverse" ;
VAL_TABLE_ VSANDP_VehSpdAvgNDrvnAuth_Inv 0 "FALSE" 1 "TRUE" ;
VAL_TABLE_ DRCDNDP_DRCAvgDrvnSrcAuth 0 "Transmission Output Speed" 1 "Wheel Speed" ;
VAL_TABLE_ DRCDNDP_DRCAvgDrvnRstOccAuth 0 "FALSE" 1 "TRUE" ;
VAL_TABLE_ DRCDNDP_DRCAvgDrvnAuth_Inv 0 "FALSE" 1 "TRUE" ;
VAL_TABLE_ SSID1P_LatAccelAuth_Inv 0 "FALSE" 1 "TRUE" ;
VAL_TABLE_ DRCDNDP_DRCAvgNonDrvnRstOccAuth 0 "FALSE" 1 "TRUE" ;
VAL_TABLE_ DRCDNDP_DRCAvgNonDrvnAuth_Inv 0 "FALSE" 1 "TRUE" ;
VAL_TABLE_ RdWhlAng_Inv 0 "FALSE" 1 "TRUE" ;
VAL_TABLE_ VehPtchAng_Inv 0 "FALSE" 1 "TRUE" ;
VAL_TABLE_ VehRollAng_Inv 0 "FALSE" 1 "TRUE" ;
VAL_TABLE_ AFLHiBmsOtgIndOn 0 "FALSE" 1 "TRUE" ;
VAL_TABLE_ AFLCkLoBmsIndOn 0 "FALSE" 1 "TRUE" ;
VAL_TABLE_ EngOilPrs_Inv 0 "FALSE" 1 "TRUE" ;
VAL_TABLE_ APACR_SptFndChmEvntStat 0 "NO_ACTION" 1 "ACTIVE" 2 "CANCEL_CHIME" ;
VAL_TABLE_ APACR_FaildChmEvntStat 0 "NO_ACTION" 1 "ACTIVE" 2 "CANCEL_CHIME" ;
VAL_TABLE_ APACR_CncldChmEvntStat 0 "NO_ACTION" 1 "ACTIVE" 2 "CANCEL_CHIME" ;
VAL_TABLE_ APACR_CmpltChmEvntStat 0 "NO_ACTION" 1 "ACTIVE" 2 "CANCEL_CHIME" ;
VAL_TABLE_ APACR_StopChmEvntStat 0 "NO_ACTION" 1 "ACTIVE" 2 "CANCEL_CHIME" ;
VAL_TABLE_ ELWWIP_WprFrtFtrReqAuth 0 "Wiper Front Stop" 1 "Wiper Front Crank Suspend" 2 "Wiper Front Depressed Park" 3 "Wiper Front Park" 4 "Wiper Front Winter Park" 5 "Wiper Front Service Park" 6 "Wiper Front Intermittent 5" 7 "Wiper Front Intermittent 4" 8 "Wiper Front Intermittent 3" 9 "Wiper Front Intermittent 2" 10 "Wiper Front Intermittent 1" 11 "Wiper Front Low Wipe" 12 "Wiper Front High Wipe" ;
VAL_TABLE_ LnCntrWrnIndRqst 0 "No Indication" 1 "Can not See Lanes" 2 "Tight Curve" 3 "Freeway Ends" 4 "Construction" 5 "Excessive Speed" 6 "Vehicles Too Close" 7 "Canceled Take Steering" 8 "Can not See Eyes" 9 "Due to Weather" 10 "Take Steering" 11 "Take Vehicle Control" 12 "Service Driver Assist System" 13 "Lane Following Locked Out" 14 "TJA Max Speed Reached" 15 "TJA Available" 16 "TJA Active" ;
VAL_TABLE_ ELWWIP_BrkLmpLtCmdAuth 0 "No_Action" 1 "Off" 2 "On" 3 "Emergency_Brake_Flashing" 4 "Police_Flashing" ;
VAL_TABLE_ LKALnMrkgIndLt 0 "Off" 1 "White" 2 "Green" 3 "Amber" 4 "Amber Flashing" ;
VAL_TABLE_ FrntPsSeatbeltStat 0 "Unknown" 1 "Unfastened" 2 "Fastened" ;
VAL_TABLE_ FrntPsSeatbeltStat_Inv 0 "FALSE" 1 "TRUE" ;
VAL_TABLE_ ELWWIP_BrkLmpRtCmdAuth 0 "No_Action" 1 "Off" 2 "On" 3 "Emergency_Brake_Flashing" 4 "Police_Flashing" ;
VAL_TABLE_ ORIP_DrvrStBltSts1Auth_Inv 0 "FALSE" 1 "TRUE" ;
VAL_TABLE_ LnDtWrnCntrlVsAlrtCmdGnc 0 "OFF" 1 "NOT READY TO ASSIST" 2 "READY TO ASSIST" 3 "ALERT" 4 "INTERVENTION" ;
VAL_TABLE_ LKALnMrkgIndRt 0 "Off" 1 "White" 2 "Green" 3 "Amber" 4 "Amber Flashing" ;
VAL_TABLE_ AdpLghtRspTypCstAvlFlg4 0 "FALSE" 1 "TRUE" ;
VAL_TABLE_ MltpPsStBtRmndrChmEvntStat 0 "No Action" 1 "Active" 2 "Cancel Chime" ;
VAL_TABLE_ RrPCMRspTypCstCrStVal 0 "SETTING_UNKNOWN" 1 "OFF" 2 "ALERT" 3 "ALERT_AND_BRAKE" 4 "RESERVED_4 RESERVED_5" 5 "RESERVED_6" 6 "RESERVED_7" ;
VAL_TABLE_ ORIP_DrvrStBltSts1Auth 0 "Unknown" 1 "UnFastened" 2 "Fastened" ;
VAL_TABLE_ ElecPrkBrkCtnChiEveStat 0 "NO_ACTION" 1 "ACTIVE" 2 "CANCEL_CHIME" ;
VAL_TABLE_ ELWWIP_TrlrRvrsLmpsCmdAuth 0 "Off" 1 "On" 2 "Flashing" ;
VAL_TABLE_ ELWWIP_RvrsLmpCmdAuth 0 "Off" 1 "On" 2 "Flashing" ;
VAL_TABLE_ ELWWIP_CHMSLCmdAuth 0 "No_Action" 1 "Off" 2 "On" 3 "Emergency_Brake_Flashing" ;
VAL_TABLE_ LDWCtrlHndOff1ChmEvntStat 0 "NO_ACTION" 1 "ACTIVE" 2 "CANCEL_CHIME" ;
VAL_TABLE_ FrwdCllsnAlrtImAlrtDrIntAlrtChmE 0 "NO_ACTION" 1 "ACTIVE" 2 "CANCEL_CHIME" ;
VAL_TABLE_ FrntPCMChmEvntStat 0 "NO_ACTION" 1 "ACTIVE" 2 "CANCEL_CHIME" ;
VAL_TABLE_ ElecPrkBrkFixDurChiEveStat 0 "NO_ACTION" 1 "ACTIVE" 2 "CANCEL_CHIME" ;
VAL_TABLE_ LDWCtrlRtHndSdChmEvntStat 0 "NO_ACTION" 1 "ACTIVE" 2 "CANCEL_CHIME" ;
VAL_TABLE_ LDWCtrlLtHndSdChmEvntStat 0 "NO_ACTION" 1 "ACTIVE" 2 "CANCEL_CHIME" ;
VAL_TABLE_ LDWCtrlHndOff3ChmEvntStat 0 "NO_ACTION" 1 "ACTIVE" 2 "CANCEL_CHIME" ;
VAL_TABLE_ LDWCtrlHndOff2ChmEvntStat 0 "NO_ACTION" 1 "ACTIVE" 2 "CANCEL_CHIME" ;
VAL_TABLE_ MemStrDblBeepChmEvStRR 0 "No Action" 1 "Active" 2 "Cancel Chime" ;
VAL_TABLE_ MemStrDblBeepChmEvStLR 0 "No Action" 1 "Active" 2 "Cancel Chime" ;
VAL_TABLE_ MemStrDblBeepChmEvStDrv 0 "No Action" 1 "Active" 2 "Cancel Chime" ;
VAL_TABLE_ MemStrDblBeepChmEvStCoDrv 0 "No Action" 1 "Active" 2 "Cancel Chime" ;
VAL_TABLE_ MemStrSnglBeepChmEvStRR 0 "No Action" 1 "Active" 2 "Cancel Chime" ;
VAL_TABLE_ MemStrSnglBeepChmEvStLR 0 "No Action" 1 "Active" 2 "Cancel Chime" ;
VAL_TABLE_ MemStrSnglBeepChmEvStDrv 0 "No Action" 1 "Active" 2 "Cancel Chime" ;
VAL_TABLE_ MemStrSnglBeepChmEvStCoDrv 0 "No Action" 1 "Active" 2 "Cancel Chime" ;
VAL_TABLE_ MemStrTrplBeepChmEvStRR 0 "No Action" 1 "Active" 2 "Cancel Chime" ;
VAL_TABLE_ MemStrTrplBeepChmEvStLR 0 "No Action" 1 "Active" 2 "Cancel Chime" ;
VAL_TABLE_ MemStrTrplBeepChmEvStDrv 0 "No Action" 1 "Active" 2 "Cancel Chime" ;
VAL_TABLE_ MemStrTrplBeepChmEvStCoDrv 0 "No Action" 1 "Active" 2 "Cancel Chime" ;
VAL_TABLE_ PrkAsstFllFrZn2ChEvntSt 0 "NO_ACTION" 1 "ACTIVE" 2 "CANCEL_CHIME" ;
VAL_TABLE_ PrkAsstFllFrZn1ChEvntSt 0 "NO_ACTION" 1 "ACTIVE" 2 "CANCEL_CHIME" ;
VAL_TABLE_ PrkAsstFlChEvntSt 0 "NO_ACTION" 1 "ACTIVE" 2 "CANCEL_CHIME" ;
VAL_TABLE_ PAMutSts 0 "No Action" 1 "Show Mute" 2 "Show Unmute" ;
VAL_TABLE_ PrkAsstFllFrZn6ChEvntSt 0 "NO_ACTION" 1 "ACTIVE" 2 "CANCEL_CHIME" ;
VAL_TABLE_ PrkAsstFllFrZn5ChEvntSt 0 "NO_ACTION" 1 "ACTIVE" 2 "CANCEL_CHIME" ;
VAL_TABLE_ PrkAsstFllFrZn4ChEvntSt 0 "NO_ACTION" 1 "ACTIVE" 2 "CANCEL_CHIME" ;
VAL_TABLE_ PrkAsstFllFrZn3ChEvntSt 0 "NO_ACTION" 1 "ACTIVE" 2 "CANCEL_CHIME" ;
VAL_TABLE_ PrkAsstFllRrZn4ChEvntSt 0 "NO_ACTION" 1 "ACTIVE" 2 "CANCEL_CHIME" ;
VAL_TABLE_ PrkAsstFllRrZn3ChEvntSt 0 "NO_ACTION" 1 "ACTIVE" 2 "CANCEL_CHIME" ;
VAL_TABLE_ PrkAsstFllRrZn2ChEvntSt 0 "NO_ACTION" 1 "ACTIVE" 2 "CANCEL_CHIME" ;
VAL_TABLE_ PrkAsstFllRrZn1ChEvntSt 0 "NO_ACTION" 1 "ACTIVE" 2 "CANCEL_CHIME" ;
VAL_TABLE_ PrkAsstFrLftSdZn1ChEvntSt 0 "NO_ACTION" 1 "ACTIVE" 2 "CANCEL_CHIME" ;
VAL_TABLE_ PrkAsstFrFrstRprtChEvntSt 0 "NO_ACTION" 1 "ACTIVE" 2 "CANCEL_CHIME" ;
VAL_TABLE_ PrkAsstFllRrZn6ChEvntSt 0 "NO_ACTION" 1 "ACTIVE" 2 "CANCEL_CHIME" ;
VAL_TABLE_ PrkAsstFllRrZn5ChEvntSt 0 "NO_ACTION" 1 "ACTIVE" 2 "CANCEL_CHIME" ;
VAL_TABLE_ PrkAsstFrLftSdZn5ChEvntSt 0 "NO_ACTION" 1 "ACTIVE" 2 "CANCEL_CHIME" ;
VAL_TABLE_ PrkAsstFrLftSdZn4ChEvntSt 0 "NO_ACTION" 1 "ACTIVE" 2 "CANCEL_CHIME" ;
VAL_TABLE_ PrkAsstFrLftSdZn3ChEvntSt 0 "NO_ACTION" 1 "ACTIVE" 2 "CANCEL_CHIME" ;
VAL_TABLE_ PrkAsstFrLftSdZn2ChEvntSt 0 "NO_ACTION" 1 "ACTIVE" 2 "CANCEL_CHIME" ;
VAL_TABLE_ PrkAsstFrRghtSdZn3ChEvntSt 0 "NO_ACTION" 1 "ACTIVE" 2 "CANCEL_CHIME" ;
VAL_TABLE_ PrkAsstFrRghtSdZn2ChEvntSt 0 "NO_ACTION" 1 "ACTIVE" 2 "CANCEL_CHIME" ;
VAL_TABLE_ PrkAsstFrRghtSdZn1ChEvntSt 0 "NO_ACTION" 1 "ACTIVE" 2 "CANCEL_CHIME" ;
VAL_TABLE_ PrkAsstFrLftSdZn6ChEvntSt 0 "NO_ACTION" 1 "ACTIVE" 2 "CANCEL_CHIME" ;
VAL_TABLE_ PrkAsstFrRgrChEvntSt 0 "NO_ACTION" 1 "ACTIVE" 2 "CANCEL_CHIME" ;
VAL_TABLE_ PrkAsstFrRghtSdZn6ChEvntSt 0 "NO_ACTION" 1 "ACTIVE" 2 "CANCEL_CHIME" ;
VAL_TABLE_ PrkAsstFrRghtSdZn5ChEvntSt 0 "NO_ACTION" 1 "ACTIVE" 2 "CANCEL_CHIME" ;
VAL_TABLE_ PrkAsstFrRghtSdZn4ChEvntSt 0 "NO_ACTION" 1 "ACTIVE" 2 "CANCEL_CHIME" ;
VAL_TABLE_ PrkAsstRrLftSdZn3ChEvntSt 0 "NO_ACTION" 1 "ACTIVE" 2 "CANCEL_CHIME" ;
VAL_TABLE_ PrkAsstRrLftSdZn2ChEvntSt 0 "NO_ACTION" 1 "ACTIVE" 2 "CANCEL_CHIME" ;
VAL_TABLE_ PrkAsstRrLftSdZn1ChEvntSt 0 "NO_ACTION" 1 "ACTIVE" 2 "CANCEL_CHIME" ;
VAL_TABLE_ PrkAsstRrFrstRprtChEvntSt 0 "NO_ACTION" 1 "ACTIVE" 2 "CANCEL_CHIME" ;
VAL_TABLE_ PrkAsstRrRghtSdZn1ChEvntSt 0 "NO_ACTION" 1 "ACTIVE" 2 "CANCEL_CHIME" ;
VAL_TABLE_ PrkAsstRrLftSdZn6ChEvntSt 0 "NO_ACTION" 1 "ACTIVE" 2 "CANCEL_CHIME" ;
VAL_TABLE_ PrkAsstRrLftSdZn5ChEvntSt 0 "NO_ACTION" 1 "ACTIVE" 2 "CANCEL_CHIME" ;
VAL_TABLE_ PrkAsstRrLftSdZn4ChEvntSt 0 "NO_ACTION" 1 "ACTIVE" 2 "CANCEL_CHIME" ;
VAL_TABLE_ PrkAsstRrRghtSdZn5ChEvntSt 0 "NO_ACTION" 1 "ACTIVE" 2 "CANCEL_CHIME" ;
VAL_TABLE_ PrkAsstRrRghtSdZn4ChEvntSt 0 "NO_ACTION" 1 "ACTIVE" 2 "CANCEL_CHIME" ;
VAL_TABLE_ PrkAsstRrRghtSdZn3ChEvntSt 0 "NO_ACTION" 1 "ACTIVE" 2 "CANCEL_CHIME" ;
VAL_TABLE_ PrkAsstRrRghtSdZn2ChEvntSt 0 "NO_ACTION" 1 "ACTIVE" 2 "CANCEL_CHIME" ;
VAL_TABLE_ PwrSdClsrLRObstclChmEvntStat 0 "No_Action" 1 "Active" 2 "Cancel_Chime" ;
VAL_TABLE_ PwrSdClsrLFObstclChmEvntStat 0 "No_Action" 1 "Active" 2 "Cancel_Chime" ;
VAL_TABLE_ PrkAsstRrRgrChEvntSt 0 "NO_ACTION" 1 "ACTIVE" 2 "CANCEL_CHIME" ;
VAL_TABLE_ PrkAsstRrRghtSdZn6ChEvntSt 0 "NO_ACTION" 1 "ACTIVE" 2 "CANCEL_CHIME" ;
VAL_TABLE_ PwrSdSldClsrLFRmtActChmEvntStat 0 "No_Action" 1 "Active" 2 "Cancel_Chime" ;
VAL_TABLE_ PwrSdSldClsrLFLclActChmEvntStat 0 "No_Action" 1 "Active" 2 "Cancel_Chime" ;
VAL_TABLE_ PwrSdClsrRRObstclChmEvntStat 0 "No_Action" 1 "Active" 2 "Cancel_Chime" ;

BA_DEF_ SG_  "SignalType" STRING ;
BA_DEF_ SG_  "SignalLongName" STRING ;
BA_DEF_ BO_  "GenMsgCycleTime" INT 0 10000;
BA_DEF_ BO_  "GenMsgSendType" ENUM "cyclicX","spontanX","cyclicIfActiveX","spontanWithDelay","cyclicAndSpontanX","cyclicAndSpontanWithDelay","spontanWithRepetition","cyclicIfActiveAndSpontanWD";
BA_DEF_DEF_  "SignalType" "";
BA_DEF_DEF_  "SignalLongName" "";
BA_DEF_DEF_  "GenMsgCycleTime" 0;
BA_DEF_DEF_  "GenMsgSendType" "cyclicX";
