VERSION ""

NS_ :

BS_:

BU_: WCM4 WCM3 WCM2 WCM VPM VLM VKM VICM VECM VDM VCU_RTOS_ETH VCU_ENTRY_ETH VCU_AGVM_ETH VCU UVM UPM TIM TEST_TOOL_1 TCP_ETH TCP TCM TCCM SRR_SRR_ETH SRR_SRR SRR_SLR_ETH SRR_SLR SRR_RR SRR_RF_ETH SRR_RF SRR_LR_CR SRR_LF_ETH SRR_LF SIB SDM SCL SBZA_R SBZA_L SBM SAM_RR SAM_RF SAM_LR SAM_LF SAM_BH SADS RadioLow_ETH RadioLow RSI_RTOS_ETH RSI RDCM PTM PLCM PFCM PDR_ETH PDR PCM PA ODS2 ODS NVM MTCM_R MTCM_L MSM_RR MSM_P MSM_LR MSM_D MSB2 MSB1 MRCM_R MRCM_L MFC LRR_RR_ETH LRR_LR_ETH LRR_CF_ETH LRR LRL_CF_ETH LIB_48V LIB1 IPC_INT IPC_GP IPC ICS_Info ICCM HVAC_FP_R HVAC_FP_F HUD_CAN HDLM FPI_RTOS_ETH FPI FOPM FCM_LC FCM EPSb EPS_1 EPSRAb EPSRAa EPS EOCM_HC_Superset EOCM_HCP2 EOCM ELM ECP_X1 ECP_S2 ECP_S ECP_MC ECP_H3 ECP_H2 ECP_H1 ECP_E ECM EBCM DMS DEFC DCM CSM_ETH CSM_AV CSM CGM_OTA_ETH CGM BSM_MH BSM_HEV BSM BCM ARS ARB APA AOS AMP ALC AHS AHL_AFL ADIMb ADIMa ACP2_MCU
VAL_TABLE_ PwrSdClsrRFObstclChmEvntStat 0 "No_Action" 1 "Active" 2 "Cancel_Chime" ;
VAL_TABLE_ PwrSdSldClsrRFRmtActChmEvntStat 0 "No_Action" 1 "Active" 2 "Cancel_Chime" ;
VAL_TABLE_ PwrSdSldClsrRFLclActChmEvntStat 0 "No_Action" 1 "Active" 2 "Cancel_Chime" ;
VAL_TABLE_ PwrSdSldClsrLRRmtActChmEvntStat 0 "No_Action" 1 "Active" 2 "Cancel_Chime" ;
VAL_TABLE_ PwrSdSldClsrLRLclActChmEvntStat 0 "No_Action" 1 "Active" 2 "Cancel_Chime" ;
VAL_TABLE_ PwrSdSwgClsrLFRmtActChmEvntStat 0 "No_Action" 1 "Active" 2 "Cancel_Chime" ;
VAL_TABLE_ PwrSdSwgClsrLFLclActChmEvntStat 0 "No_Action" 1 "Active" 2 "Cancel_Chime" ;
VAL_TABLE_ PwrSdSldClsrRRRmtActChmEvntStat 0 "No_Action" 1 "Active" 2 "Cancel_Chime" ;
VAL_TABLE_ PwrSdSldClsrRRLclActChmEvntStat 0 "No_Action" 1 "Active" 2 "Cancel_Chime" ;
VAL_TABLE_ PwrSdSwgClsrRFRmtActChmEvntStat 0 "No_Action" 1 "Active" 2 "Cancel_Chime" ;
VAL_TABLE_ PwrSdSwgClsrRFLclActChmEvntStat 0 "No_Action" 1 "Active" 2 "Cancel_Chime" ;
VAL_TABLE_ PwrSdSwgClsrLRRmtActChmEvntStat 0 "No_Action" 1 "Active" 2 "Cancel_Chime" ;
VAL_TABLE_ PwrSdSwgClsrLRLclActChmEvntStat 0 "No_Action" 1 "Active" 2 "Cancel_Chime" ;
VAL_TABLE_ RIMIntCllnChmEvStat 0 "NO_ACTION" 1 "ACTIVE" 2 "CANCEL_CHIM" ;
VAL_TABLE_ RIMBrkPlsChEvStat 0 "NO_ACTION" 1 "ACTIVE" 2 "CANCEL_CHIM" ;
VAL_TABLE_ PwrSdSwgClsrRRRmtActChmEvntStat 0 "No_Action" 1 "Active" 2 "Cancel_Chime" ;
VAL_TABLE_ PwrSdSwgClsrRRLclActChmEvntStat 0 "No_Action" 1 "Active" 2 "Cancel_Chime" ;
VAL_TABLE_ WlkAwyLkInhbtChmEvSt 0 "NO_ACTION" 1 "ACTIVE" 2 "CANCEL_CHIME" ;
VAL_TABLE_ RrPCMChmEvntSt 0 "NO_ACTION" 1 "ACTIVE" 2 "CANCEL_CHIME" ;
VAL_TABLE_ RlOvrDsblStsChgChmEvntStat 0 "No_Action" 1 "Active" 2 "Cancel_Chime" ;
VAL_TABLE_ AutMemRclCstAvlFlg5 0 "FALSE" 1 "TRUE" ;
VAL_TABLE_ AutMemRclCstAvlFlg4 0 "FALSE" 1 "TRUE" ;
VAL_TABLE_ AutMemRclCstAvlFlg3 0 "FALSE" 1 "TRUE" ;
VAL_TABLE_ AutMemRclCstAvlFlg2 0 "FALSE" 1 "TRUE" ;
VAL_TABLE_ AutMemRclCstAvlFlg1 0 "FALSE" 1 "TRUE" ;
VAL_TABLE_ AdpLghtRspTypCstAvlFlg7 0 "FALSE" 1 "TRUE" ;
VAL_TABLE_ AdpLghtRspTypCstAvlFlg6 0 "FALSE" 1 "TRUE" ;
VAL_TABLE_ AdpLghtRspTypCstAvlFlg5 0 "FALSE" 1 "TRUE" ;
VAL_TABLE_ EsyExtCstAvlFlg5 0 "FALSE" 1 "TRUE" ;
VAL_TABLE_ EsyExtCstAvlFlg4 0 "FALSE" 1 "TRUE" ;
VAL_TABLE_ EsyExtCstAvlFlg3 0 "FALSE" 1 "TRUE" ;
VAL_TABLE_ EsyExtCstAvlFlg2 0 "FALSE" 1 "TRUE" ;
VAL_TABLE_ EsyExtCstAvlFlg1 0 "FALSE" 1 "TRUE" ;
VAL_TABLE_ EngIdlAtv 0 "FALSE" 1 "TRUE" ;
VAL_TABLE_ AutMemRclCstAvlFlg7 0 "FALSE" 1 "TRUE" ;
VAL_TABLE_ AutMemRclCstAvlFlg6 0 "FALSE" 1 "TRUE" ;
VAL_TABLE_ RrPCMRspTypCstAvlFlg2 0 "FALSE" 1 "TRUE" ;
VAL_TABLE_ RrPCMRspTypCstAvlFlg1 0 "FALSE" 1 "TRUE" ;
VAL_TABLE_ LowBmAct 0 "FALSE" 1 "TRUE" ;
VAL_TABLE_ LDWCtrlAudAttnReqd 0 "FALSE" 1 "TRUE" ;
VAL_TABLE_ HighBmAct 0 "FALSE" 1 "TRUE" ;
VAL_TABLE_ FlToPsSwAtv 0 "FALSE" 1 "TRUE" ;
VAL_TABLE_ EsyExtCstAvlFlg7 0 "FALSE" 1 "TRUE" ;
VAL_TABLE_ EsyExtCstAvlFlg6 0 "FALSE" 1 "TRUE" ;
VAL_TABLE_ TrlrConnStat 0 "Not Connected" 1 "Connected" ;
VAL_TABLE_ StrgLckd 0 "FALSE" 1 "TRUE" ;
VAL_TABLE_ RrPCMRspTypCstStAvl 0 "FALSE" 1 "TRUE" ;
VAL_TABLE_ RrPCMRspTypCstAvlFlg7 0 "FALSE" 1 "TRUE" ;
VAL_TABLE_ RrPCMRspTypCstAvlFlg6 0 "FALSE" 1 "TRUE" ;
VAL_TABLE_ RrPCMRspTypCstAvlFlg5 0 "FALSE" 1 "TRUE" ;
VAL_TABLE_ RrPCMRspTypCstAvlFlg4 0 "FALSE" 1 "TRUE" ;
VAL_TABLE_ RrPCMRspTypCstAvlFlg3 0 "FALSE" 1 "TRUE" ;
VAL_TABLE_ PwrRrClsrMtnSts 0 "Unknown" 1 "Closed" 2 "Opening" 3 "Closing" 4 "Stopped - Normal" 5 "Stopped - Obstacle" 6 "Closing - Hold System Fault" 7 "Fully Opened" 8 "Opening due to Obstacle" 9 "Closing due to Obstacle" ;
VAL_TABLE_ TrnLmpRtIO 0 "FALSE" 1 "TRUE" ;
VAL_TABLE_ TrnLmpLftIO 0 "FALSE" 1 "TRUE" ;
VAL_TABLE_ IndHtdArmrstLvlFrtLt 0 "Off" 1 "1" 2 "2" 3 "3" 4 "Linked" ;
VAL_TABLE_ IndHtdArmrstLvlRrLt 0 "Off" 1 "1" 2 "2" 3 "3" 4 "Linked" ;
VAL_TABLE_ IndHtdArmrstLvlFrtRt 0 "Off" 1 "1" 2 "2" 3 "3" 4 "Linked" ;
VAL_TABLE_ SLVFSP_SpdLimVsnFsdSpdUntAuth 0 "km/h" 1 "mph" ;
VAL_TABLE_ LFSCDS_CshLgAdjFdRr 0 "Not Selected" 1 "Selected-No Movement" 2 "Forward" 3 "Rearward" ;
VAL_TABLE_ LFSCDS_CshBlstrInOut 0 "Not Selected" 1 "Selected-No Movement" 2 "In" 3 "Out" ;
VAL_TABLE_ LFSCDS_BkCshBlstInOt 0 "Not Selected" 1 "Selected-No Movement" 2 "Back Bolster In" 3 "Back Bolster Out" 4 "Cushion Bolster In" 5 "Cushion Bolster Out" ;
VAL_TABLE_ LFSCDS_BkBlstrInOut 0 "Not Selected" 1 "Selected-No Movement" 2 "In" 3 "Out" ;
VAL_TABLE_ LFSCDS_HdrstTltFwdRr 0 "Not Selected" 1 "Selected-No Movement" 2 "Forward" 3 "Rearward" ;
VAL_TABLE_ LFSCDS_HdrstFwdRrwd 0 "Not Selected" 1 "Selected-No Movement" 2 "Forward" 3 "Rearward" ;
VAL_TABLE_ LFSCDS_HdrstFdRrUDn 0 "Not Selected" 1 "Selected-No Movement" 2 "Up" 3 "Down" 4 "Forward" 5 "Rearward" ;
VAL_TABLE_ LFSCDS_DispReq 0 "FALSE" 1 "TRUE" ;
VAL_TABLE_ LFSCDS_LmbrUDnFdRr 0 "Not Selected" 1 "Selected-No Movement" 2 "Up" 3 "Down" 4 "Forward" 5 "Rearward" ;
VAL_TABLE_ LFSCDS_LmbrFwdRr 0 "Not Selected" 1 "Selected-No Movement" 2 "Forward" 3 "Rearward" ;
VAL_TABLE_ LFSCDS_HdrstWngInOt 0 "Not Selected" 1 "Selected-No Movement" 2 "In" 3 "Out" ;
VAL_TABLE_ LFSCDS_HdrstUpDn 0 "Not Selected" 1 "Selected-No Movement" 2 "Up" 3 "Down" ;
VAL_TABLE_ LFSCDS_MassgIntsty 0 "Massage Off" 1 "Massage Intensity 1" 2 "Massage Intensity 2" 3 "Massage Intensity 3" 4 "Massage Intensity 4" 5 "Massage Intensity 5" 6 "Massage Intensity 6" 7 "Massage Intensity 7" ;
VAL_TABLE_ LFSCDS_Massg 0 "Not Selected" 1 "Selected Massage Off" 2 "Selected Massage On" ;
VAL_TABLE_ LFSCDS_LmbrUpDwn 0 "Not Selected" 1 "Selected-No Movement" 2 "Up" 3 "Down" ;
VAL_TABLE_ APAWI_AutoStrgIconReq 0 "NO_ICON" 1 "ACTIVE" 2 "DEACTIVATED" ;
VAL_TABLE_ LFSCDS_UprShldrFdRr 0 "Not Selected" 1 "Selected-No Movement" 2 "Forward" 3 "Rearward" ;
VAL_TABLE_ LFSCDS_MassgTyp 0 "Massage Off" 1 "Massage Type 1" 2 "Massage Type 2" 3 "Massage Type 3" 4 "Massage Type 4" 5 "Massage Type 5" 6 "Massage Type 6" 7 "Massage Type 7" 8 "Massage Type 8" 9 "Massage Type 9" 10 "Massage Type 10" 11 "Massage Type 11" 12 "Massage Type 12" 13 "Massage Type 13" 14 "Massage Type 14" 15 "Massage Type 15" ;
VAL_TABLE_ APAWI_FcsReq 0 "NO_REQUEST" 1 "FOCUS_REQUEST_IPC" 2 "FOCUS_REQUEST_CSM" ;
VAL_TABLE_ AdpLghtRspTypCstStAvl 0 "FALSE" 1 "TRUE" ;
VAL_TABLE_ APAWI_WrnIndReq 0 "OFF" 1 "SEARCHING_PARALLEL_RIGHT" 2 "SEARCHING_PARALLEL_LEFT" 3 "SEARCHING_CROSS_RIGHT" 4 "SEARCHING_CROSS_LEFT" 5 "SPOT_FOUND" 6 "SPOT_FOUND_PARALLEL_LEFT" 7 "SPOT_FOUND_CROSS_LEFT" 8 "SPOT_FOUND_PARALLEL_RIGHT" 9 "SPOT_FOUND_CROSS_RIGHT" 10 "MOVE_AHEAD" 11 "MOVE_AHEAD_PARALLEL_LEFT" 12 "MOVE_AHEAD_CROSS_LEFT" 13 "MOVE_AHEAD_PARALLEL_RIGHT" 14 "MOVE_AHEAD_CROSS_RIGHT" 15 "STOP_AND_R_PARALLEL_LEFT" 16 "STOP_AND_R_CROSS_BACK_LEFT" 17 "STOP_AND_R_CROSS_FRONT_LEFT" 18 "STOP_AND_R_PARALLEL_RIGHT" 19 "STOP_AND_R_CROSS_BACK_RIGHT" 20 "STOP_AND_R_CROSS_FRONT_RIGHT" 21 "SEARCH_SPEED_WARNING" 22 "SEARCH_DEACTIVATED" 23 "EXIT_PARK_TO_LEFT" 24 "EXIT_PARK_TO_RIGHT" 25 "SELECT_DRIVE_GEAR" 26 "AUTO_STEERING_ACTIVE" 27 "AUTO_PARKING_ACTIVE" 28 "DRIVE_BACKWARD" 29 "BACKWARD_MOVE" 30 "DRIVE_FORWARD" 31 "FORWARD_MOVE" 32 "STOP" 33 "SHIFTING" 34 "POSITION_REACHED" 35 "TAKE_CONTROL" 36 "PARKING_COMPLETE" 37 "EXIT_PARK_COMPLETE" 38 "DEACTIVATED" 39 "CANCELED_GENERAL" 40 "CANCELED_MOVES" 41 "CANCELED_SPEED" 42 "CANCELED_INTERFERENCE" 43 "CANCELED_EXIT_PARK" 44 "STOPPING" 45 "AUTO_PARKING_COMPLETE" 46 "RELEASE_BRAKE" 47 "IN_VEHICLE_OR_REMOTE" 48 "REMOTE_STAY_ALERT" 49 "REMOTE_CONNECTING" 50 "REMOTE_CANNOT_CONNECT" 51 "REMOTE_NO_DEVICE" 52 "REMOTE_SHIFT_TO_PARK" 53 "REMOTE_RETRY" 54 "REMOTE_CANCELED_RANGE" 55 "REMOTE_CANCELED_SUPERVISION" 56 "REMOTE_CANCELED_CONNECTION" 57 "REMOTE_PAUSED_RANGE" 58 "REMOTE_PAUSED_SUPERVISION" 59 "REMOTE_PAUSED_CONNECTION" ;
VAL_TABLE_ LRSCDS_CshLgAdjFdRr 0 "Not Selected" 1 "Selected-No Movement" 2 "Forward" 3 "Rearward" ;
VAL_TABLE_ LRSCDS_CshBlstrInOut 0 "Not Selected" 1 "Selected-No Movement" 2 "In" 3 "Out" ;
VAL_TABLE_ LRSCDS_BkCshBlstInOt 0 "Not Selected" 1 "Selected-No Movement" 2 "Back Bolster In" 3 "Back Bolster Out" 4 "Cushion Bolster In" 5 "Cushion Bolster Out" ;
VAL_TABLE_ LRSCDS_BkBlstrInOut 0 "Not Selected" 1 "Selected-No Movement" 2 "In" 3 "Out" ;
VAL_TABLE_ LRSCDS_HdrstTltFwdRr 0 "Not Selected" 1 "Selected-No Movement" 2 "Forward" 3 "Rearward" ;
VAL_TABLE_ LRSCDS_HdrstFwdRrwd 0 "Not Selected" 1 "Selected-No Movement" 2 "Forward" 3 "Rearward" ;
VAL_TABLE_ LRSCDS_HdrstFdRrUDn 0 "Not Selected" 1 "Selected-No Movement" 2 "Up" 3 "Down" 4 "Forward" 5 "Rearward" ;
VAL_TABLE_ LRSCDS_DispReq 0 "FALSE" 1 "TRUE" ;
VAL_TABLE_ LRSCDS_LmbrUDnFdRr 0 "Not Selected" 1 "Selected-No Movement" 2 "Up" 3 "Down" 4 "Forward" 5 "Rearward" ;
VAL_TABLE_ LRSCDS_LmbrFwdRr 0 "Not Selected" 1 "Selected-No Movement" 2 "Forward" 3 "Rearward" ;
VAL_TABLE_ LRSCDS_HdrstWngInOt 0 "Not Selected" 1 "Selected-No Movement" 2 "In" 3 "Out" ;
VAL_TABLE_ LRSCDS_HdrstUpDn 0 "Not Selected" 1 "Selected-No Movement" 2 "Up" 3 "Down" ;
VAL_TABLE_ LRSCDS_MassgIntsty 0 "Massage Off" 1 "Massage Intensity 1" 2 "Massage Intensity 2" 3 "Massage Intensity 3" 4 "Massage Intensity 4" 5 "Massage Intensity 5" 6 "Massage Intensity 6" 7 "Massage Intensity 7" ;
VAL_TABLE_ LRSCDS_Massg 0 "Not Selected" 1 "Selected Massage Off" 2 "Selected Massage On" ;
VAL_TABLE_ LRSCDS_LmbrUpDwn 0 "Not Selected" 1 "Selected-No Movement" 2 "Up" 3 "Down" ;
VAL_TABLE_ SDGPARS_CntrLtSd 0 "OFF" 1 "FAILED" 2 "BLOCKED" 3 "ATTACHED_OBJECT" 4 "NO_OBJECT" 5 "ZONE_1" 6 "ZONE_2" 7 "ZONE_3" 8 "ZONE_4" 9 "ZONE_5" 10 "ZONE_6" 11 "OFF_NO_FAULT" 12 "RESERVED_1" 13 "RESERVED_2" 14 "RESERVED_3" ;
VAL_TABLE_ LRSCDS_UprShldrFdRr 0 "Not Selected" 1 "Selected-No Movement" 2 "Forward" 3 "Rearward" ;
VAL_TABLE_ LRSCDS_MassgTyp 0 "Massage Off" 1 "Massage Type 1" 2 "Massage Type 2" 3 "Massage Type 3" 4 "Massage Type 4" 5 "Massage Type 5" 6 "Massage Type 6" 7 "Massage Type 7" 8 "Massage Type 8" 9 "Massage Type 9" 10 "Massage Type 10" 11 "Massage Type 11" 12 "Massage Type 12" 13 "Massage Type 13" 14 "Massage Type 14" 15 "Massage Type 15" ;
VAL_TABLE_ SDGPARS_FrtLtSd 0 "OFF" 1 "FAILED" 2 "BLOCKED" 3 "ATTACHED_OBJECT" 4 "NO_OBJECT" 5 "ZONE_1" 6 "ZONE_2" 7 "ZONE_3" 8 "ZONE_4" 9 "ZONE_5" 10 "ZONE_6" 11 "OFF_NO_FAULT" 12 "RESERVED_1" 13 "RESERVED_2" 14 "RESERVED_3" ;
VAL_TABLE_ SDGPARS_CntrRtSd 0 "OFF" 1 "FAILED" 2 "BLOCKED" 3 "ATTACHED_OBJECT" 4 "NO_OBJECT" 5 "ZONE_1" 6 "ZONE_2" 7 "ZONE_3" 8 "ZONE_4" 9 "ZONE_5" 10 "ZONE_6" 11 "OFF_NO_FAULT" 12 "RESERVED_1" 13 "RESERVED_2" 14 "RESERVED_3" ;
VAL_TABLE_ SDGPARS_RrLtSd 0 "OFF" 1 "FAILED" 2 "BLOCKED" 3 "ATTACHED_OBJECT" 4 "NO_OBJECT" 5 "ZONE_1" 6 "ZONE_2" 7 "ZONE_3" 8 "ZONE_4" 9 "ZONE_5" 10 "ZONE_6" 11 "OFF_NO_FAULT" 12 "RESERVED_1" 13 "RESERVED_2" 14 "RESERVED_3" ;
VAL_TABLE_ SDGPARS_FrtRtSd 0 "OFF" 1 "FAILED" 2 "BLOCKED" 3 "ATTACHED_OBJECT" 4 "NO_OBJECT" 5 "ZONE_1" 6 "ZONE_2" 7 "ZONE_3" 8 "ZONE_4" 9 "ZONE_5" 10 "ZONE_6" 11 "OFF_NO_FAULT" 12 "RESERVED_1" 13 "RESERVED_2" 14 "RESERVED_3" ;
VAL_TABLE_ AirbgStIndOn 0 "FALSE" 1 "TRUE" ;
VAL_TABLE_ SDGPARS_RrRtSd 0 "OFF" 1 "FAILED" 2 "BLOCKED" 3 "ATTACHED_OBJECT" 4 "NO_OBJECT" 5 "ZONE_1" 6 "ZONE_2" 7 "ZONE_3" 8 "ZONE_4" 9 "ZONE_5" 10 "ZONE_6" 11 "OFF_NO_FAULT" 12 "RESERVED_1" 13 "RESERVED_2" 14 "RESERVED_3" ;
VAL_TABLE_ RFSCDS_CshLgAdjFdRr 0 "Not Selected" 1 "Selected-No Movement" 2 "Forward" 3 "Rearward" ;
VAL_TABLE_ RFSCDS_CshBlstrInOut 0 "Not Selected" 1 "Selected-No Movement" 2 "In" 3 "Out" ;
VAL_TABLE_ RFSCDS_BkCshBlstInOt 0 "Not Selected" 1 "Selected-No Movement" 2 "Back Bolster In" 3 "Back Bolster Out" 4 "Cushion Bolster In" 5 "Cushion Bolster Out" ;
VAL_TABLE_ RFSCDS_BkBlstrInOut 0 "Not Selected" 1 "Selected-No Movement" 2 "In" 3 "Out" ;
VAL_TABLE_ RFSCDS_HdrstTltFwdRr 0 "Not Selected" 1 "Selected-No Movement" 2 "Forward" 3 "Rearward" ;
VAL_TABLE_ RFSCDS_HdrstFwdRrwd 0 "Not Selected" 1 "Selected-No Movement" 2 "Forward" 3 "Rearward" ;
VAL_TABLE_ RFSCDS_HdrstFdRrUDn 0 "Not Selected" 1 "Selected-No Movement" 2 "Up" 3 "Down" 4 "Forward" 5 "Rearward" ;
VAL_TABLE_ RFSCDS_DispReq 0 "FALSE" 1 "TRUE" ;
VAL_TABLE_ RFSCDS_LmbrUDnFdRr 0 "Not Selected" 1 "Selected-No Movement" 2 "Up" 3 "Down" 4 "Forward" 5 "Rearward" ;
VAL_TABLE_ RFSCDS_LmbrFwdRr 0 "Not Selected" 1 "Selected-No Movement" 2 "Forward" 3 "Rearward" ;
VAL_TABLE_ RFSCDS_HdrstWngInOt 0 "Not Selected" 1 "Selected-No Movement" 2 "In" 3 "Out" ;
VAL_TABLE_ RFSCDS_HdrstUpDn 0 "Not Selected" 1 "Selected-No Movement" 2 "Up" 3 "Down" ;
VAL_TABLE_ RFSCDS_MassgIntsty 0 "Massage Off" 1 "Massage Intensity 1" 2 "Massage Intensity 2" 3 "Massage Intensity 3" 4 "Massage Intensity 4" 5 "Massage Intensity 5" 6 "Massage Intensity 6" 7 "Massage Intensity 7" ;
VAL_TABLE_ RFSCDS_Massg 0 "Not Selected" 1 "Selected Massage Off" 2 "Selected Massage On" ;
VAL_TABLE_ RFSCDS_LmbrUpDwn 0 "Not Selected" 1 "Selected-No Movement" 2 "Up" 3 "Down" ;
VAL_TABLE_ RideHghtSeltn1Pndg 0 "FALSE" 1 "TRUE" ;
VAL_TABLE_ RFSCDS_UprShldrFdRr 0 "Not Selected" 1 "Selected-No Movement" 2 "Forward" 3 "Rearward" ;
VAL_TABLE_ RFSCDS_MassgTyp 0 "Massage Off" 1 "Massage Type 1" 2 "Massage Type 2" 3 "Massage Type 3" 4 "Massage Type 4" 5 "Massage Type 5" 6 "Massage Type 6" 7 "Massage Type 7" 8 "Massage Type 8" 9 "Massage Type 9" 10 "Massage Type 10" 11 "Massage Type 11" 12 "Massage Type 12" 13 "Massage Type 13" 14 "Massage Type 14" 15 "Massage Type 15" ;
VAL_TABLE_ RideHghtSeltn5Pndg 0 "FALSE" 1 "TRUE" ;
VAL_TABLE_ RideHghtSeltn4Unv 0 "FALSE" 1 "TRUE" ;
VAL_TABLE_ RideHghtSeltn4Pndg 0 "FALSE" 1 "TRUE" ;
VAL_TABLE_ RideHghtSeltn3Unv 0 "FALSE" 1 "TRUE" ;
VAL_TABLE_ RideHghtSeltn3Pndg 0 "FALSE" 1 "TRUE" ;
VAL_TABLE_ RideHghtSeltn2Unv 0 "FALSE" 1 "TRUE" ;
VAL_TABLE_ RideHghtSeltn2Pndg 0 "FALSE" 1 "TRUE" ;
VAL_TABLE_ RideHghtSeltn1Unv 0 "FALSE" 1 "TRUE" ;
VAL_TABLE_ OATP_OtsAirTmpCrValAuth_Inv 0 "FALSE" 1 "TRUE" ;
VAL_TABLE_ RideHghtSeltn8Unv 0 "FALSE" 1 "TRUE" ;
VAL_TABLE_ RideHghtSeltn8Pndg 0 "FALSE" 1 "TRUE" ;
VAL_TABLE_ RideHghtSeltn7Unv 0 "FALSE" 1 "TRUE" ;
VAL_TABLE_ RideHghtSeltn7Pndg 0 "FALSE" 1 "TRUE" ;
VAL_TABLE_ RideHghtSeltn6Unv 0 "FALSE" 1 "TRUE" ;
VAL_TABLE_ RideHghtSeltn6Pndg 0 "FALSE" 1 "TRUE" ;
VAL_TABLE_ RideHghtSeltn5Unv 0 "FALSE" 1 "TRUE" ;
VAL_TABLE_ RRSCDS_CshLgAdjFdRr 0 "Not Selected" 1 "Selected-No Movement" 2 "Forward" 3 "Rearward" ;
VAL_TABLE_ RRSCDS_CshBlstrInOut 0 "Not Selected" 1 "Selected-No Movement" 2 "In" 3 "Out" ;
VAL_TABLE_ RRSCDS_BkCshBlstInOt 0 "Not Selected" 1 "Selected-No Movement" 2 "Back Bolster In" 3 "Back Bolster Out" 4 "Cushion Bolster In" 5 "Cushion Bolster Out" ;
VAL_TABLE_ RRSCDS_BkBlstrInOut 0 "Not Selected" 1 "Selected-No Movement" 2 "In" 3 "Out" ;
VAL_TABLE_ RRSCDS_HdrstTltFwdRr 0 "Not Selected" 1 "Selected-No Movement" 2 "Forward" 3 "Rearward" ;
VAL_TABLE_ RRSCDS_HdrstFwdRrwd 0 "Not Selected" 1 "Selected-No Movement" 2 "Forward" 3 "Rearward" ;
VAL_TABLE_ RRSCDS_HdrstFdRrUDn 0 "Not Selected" 1 "Selected-No Movement" 2 "Up" 3 "Down" 4 "Forward" 5 "Rearward" ;
VAL_TABLE_ RRSCDS_DispReq 0 "FALSE" 1 "TRUE" ;
VAL_TABLE_ RRSCDS_LmbrUDnFdRr 0 "Not Selected" 1 "Selected-No Movement" 2 "Up" 3 "Down" 4 "Forward" 5 "Rearward" ;
VAL_TABLE_ RRSCDS_LmbrFwdRr 0 "Not Selected" 1 "Selected-No Movement" 2 "Forward" 3 "Rearward" ;
VAL_TABLE_ RRSCDS_HdrstWngInOt 0 "Not Selected" 1 "Selected-No Movement" 2 "In" 3 "Out" ;
VAL_TABLE_ RRSCDS_HdrstUpDn 0 "Not Selected" 1 "Selected-No Movement" 2 "Up" 3 "Down" ;
VAL_TABLE_ RRSCDS_MassgIntsty 0 "Massage Off" 1 "Massage Intensity 1" 2 "Massage Intensity 2" 3 "Massage Intensity 3" 4 "Massage Intensity 4" 5 "Massage Intensity 5" 6 "Massage Intensity 6" 7 "Massage Intensity 7" ;
VAL_TABLE_ RRSCDS_Massg 0 "Not Selected" 1 "Selected Massage Off" 2 "Selected Massage On" ;
VAL_TABLE_ RRSCDS_LmbrUpDwn 0 "Not Selected" 1 "Selected-No Movement" 2 "Up" 3 "Down" ;
VAL_TABLE_ RPARS_Lt 0 "OFF" 1 "FAILED" 2 "BLOCKED" 3 "ATTACHED_OBJECT" 4 "NO_OBJECT" 5 "ZONE_1" 6 "ZONE_2" 7 "ZONE_3" 8 "ZONE_4" 9 "ZONE_5" 10 "ZONE_6" 11 "OFF_NO_FAULT" 12 "RESERVED_1" 13 "RESERVED_2" 14 "RESERVED_3" ;
VAL_TABLE_ RRSCDS_UprShldrFdRr 0 "Not Selected" 1 "Selected-No Movement" 2 "Forward" 3 "Rearward" ;
VAL_TABLE_ RRSCDS_MassgTyp 0 "Massage Off" 1 "Massage Type 1" 2 "Massage Type 2" 3 "Massage Type 3" 4 "Massage Type 4" 5 "Massage Type 5" 6 "Massage Type 6" 7 "Massage Type 7" 8 "Massage Type 8" 9 "Massage Type 9" 10 "Massage Type 10" 11 "Massage Type 11" 12 "Massage Type 12" 13 "Massage Type 13" 14 "Massage Type 14" 15 "Massage Type 15" ;
VAL_TABLE_ RPARS_Rt 0 "OFF" 1 "FAILED" 2 "BLOCKED" 3 "ATTACHED_OBJECT" 4 "NO_OBJECT" 5 "ZONE_1" 6 "ZONE_2" 7 "ZONE_3" 8 "ZONE_4" 9 "ZONE_5" 10 "ZONE_6" 11 "OFF_NO_FAULT" 12 "RESERVED_1" 13 "RESERVED_2" 14 "RESERVED_3" ;
VAL_TABLE_ RPARS_LtCntr 0 "OFF" 1 "FAILED" 2 "BLOCKED" 3 "ATTACHED_OBJECT" 4 "NO_OBJECT" 5 "ZONE_1" 6 "ZONE_2" 7 "ZONE_3" 8 "ZONE_4" 9 "ZONE_5" 10 "ZONE_6" 11 "OFF_NO_FAULT" 12 "RESERVED_1" 13 "RESERVED_2" 14 "RESERVED_3" ;
VAL_TABLE_ eLSDActrTrqPctg_Inv 0 "FALSE" 1 "TRUE" ;
VAL_TABLE_ RPARS_RtCntr 0 "OFF" 1 "FAILED" 2 "BLOCKED" 3 "ATTACHED_OBJECT" 4 "NO_OBJECT" 5 "ZONE_1" 6 "ZONE_2" 7 "ZONE_3" 8 "ZONE_4" 9 "ZONE_5" 10 "ZONE_6" 11 "OFF_NO_FAULT" 12 "RESERVED_1" 13 "RESERVED_2" 14 "RESERVED_3" ;
VAL_TABLE_ FourWhlDrvWrnIndReq 0 "No Action" 1 "No Indication" 2 "For 4WD Low Shift Transmission To Neutral" 3 "To Exit 4WD Low Shift Transmission to Neutral" 4 "For 4WD Low Reduce Speed" 5 "To Exit 4WD Low Reduce Speed" 6 "Reminder Vehicle Still In 4WD Low" 7 "4WD Shift in Progress" 8 "4WD Shift Not Allowed Engine Warming Up" 9 "4WD Shift Not Allowed Mismatched Tire" 10 "4WD Shift Not Allowed In Park" 11 "Apply Brake For 4WD Shift" 12 "No 4WD Shifts Allowed" 13 "Reduce Speed For 4WD Shift" 14 "Turn off Engine for 4WD Shift" 15 "For 4WD Shift Transmission Neutral" ;
VAL_TABLE_ PAVisObjIndStatReq 0 "No Action" 1 "Driver Tube Front" 2 "Driver Tube Rear" 3 "Full Active" ;
VAL_TABLE_ SAP_SecAxl4WDAWDEstTrqAuth_Inv 0 "FALSE" 1 "TRUE" ;
VAL_TABLE_ EDADS_CrntFwdMsdGr 0 "None" 1 "First Gear" 2 "Second Gear" 3 "Third Gear" 4 "Fourth Gear" 5 "Fifth Gear" 6 "Sixth Gear" 7 "Seventh Gear" 8 "Eighth Gear" 9 "Ninth Gear" 10 "Tenth Gear" 11 "Unused" 12 "Unused" 13 "Unused" 14 "Unused" 15 "Unused" ;
VAL_TABLE_ EDADS_ShftIndSt 0 "Shift Down" 1 "Shift Up" 2 "No Shift" ;
VAL_TABLE_ EDADS_RcmndtFwdGr 0 "None" 1 "First Gear" 2 "Second Gear" 3 "Third Gear" 4 "Fourth Gear" 5 "Fifth Gear" 6 "Sixth Gear" 7 "Seventh Gear" 8 "Eighth Gear" 9 "Ninth Gear" 10 "Tenth Gear" 11 "Unused" 12 "Unused" 13 "Unused" 14 "Unused" 15 "Unused" ;
VAL_TABLE_ EDADS_EcoDrvShftIO 0 "FALSE" 1 "TRUE" ;
VAL_TABLE_ PAIM_SnsrDstbdIndOn 0 "FALSE" 1 "TRUE" ;
VAL_TABLE_ PAIM_SnsrClnIndOn 0 "FALSE" 1 "TRUE" ;
VAL_TABLE_ PAIM_SnsrBlckdIndOn 0 "FALSE" 1 "TRUE" ;
VAL_TABLE_ PAIM_RrOffIndOn 0 "FALSE" 1 "TRUE" ;
VAL_TABLE_ PAIM_OffIndOn 0 "FALSE" 1 "TRUE" ;
VAL_TABLE_ PAIM_FrtOffIndOn 0 "FALSE" 1 "TRUE" ;
VAL_TABLE_ PAIM_FaildIndOn 0 "FALSE" 1 "TRUE" ;
VAL_TABLE_ PAIM_DsbldIndOn 0 "FALSE" 1 "TRUE" ;
VAL_TABLE_ PAIM_TeenDrvrPAOffUnvIndOn 0 "FALSE" 1 "TRUE" ;
VAL_TABLE_ VwgVwprtReq 0 "Unknown" 1 "Front Perspective" 2 "Front Junction" 3 "Front Overhead" 4 "Side Forward" 5 "Rear Perspective" 6 "Rear Junction" 7 "Rear Overhead" 8 "Side Rearward" 9 "Bowl" 10 "Zoomed Bowl" 11 "Japan" 12 "Rear Hitch" 13 "Bed Hitch" 14 "Trailer Aux1" 15 "Trailer Towing Mirror" 16 "L R Trailer Towing Mirror" 17 "Trailer Aux1 Combined" 18 "Trailer Aux2" 19 "Invisible Trailer" 20 "Cargo Bed" 21 "Curb Overhead" 22 "Curb" 23 "No Request" 24 "Transparent Hood" ;
VAL_TABLE_ SAP_SecAxlOpMdAuth 0 "2WD High" 1 "4WD High Rigid Coupling" 2 "4WD Low Rigid Coupling" 3 "AWD Active Single Clutch" 4 "4WD High Active Clutch" 5 "4WD Low Active Clutch" 6 "AWD Active Twin Clutch" 7 "2WD Low" 8 "Unknown" 9 "Neutral" ;
VAL_TABLE_ SAP_SecAxlOpMdAuth_Inv 0 "FALSE" 1 "TRUE" ;
VAL_TABLE_ EnrgMgtLdShdRq 0 "No Load Shedding" 1 "Load Shed Level 1" 2 "Load Shed Level 2" 3 "Load Shed Level 3" 4 "Load Shed Level 4" ;
VAL_TABLE_ VwgVwprtSts 0 "Unknown" 1 "Front Perspective" 2 "Front Junction" 3 "Front Overhead" 4 "Side Forward" 5 "Rear Perspective" 6 "Rear Junction" 7 "Rear Overhead" 8 "Side Rearward" 9 "Bowl" 10 "Zoomed Bowl" 11 "Japan" 12 "Rear Hitch" 13 "Bed Hitch" 14 "Trailer Aux1" 15 "Trailer Towing Mirror" 16 "L R Trailer Towing Mirror" 17 "Trailer Aux1 Combined" 18 "Trailer Aux2" 19 "Invisible Trailer" 20 "Cargo Bed" 21 "Curb Overhead" 22 "Curb" 23 "No Request" 24 "Transparent Hood" ;
VAL_TABLE_ MemCmd 0 "No Operation Required" 1 "Store Mem 1 (Button Mem 1)" 2 "Store Mem 2(Button Mem 2)" 3 "Store Mem 3 (Button Mem 3)" 4 "Store Mem EXIT (Button Mem Exit)" 5 "Recall Mem 1 (Button Mem 1)" 6 "Recall Mem 2 (Button Mem 2)" 7 "Recall Mem 3 (Button Mem 3)" 8 "Recall Mem EXIT (Button Mem Exit)" 9 "Stop All Movement" 10 "RESERVED_10" 11 "RESERVED_11" 12 "RESERVED_12" 13 "RESERVED_13" 14 "RESERVED_14" 15 "RESERVED_15" ;
VAL_TABLE_ FrntPsStbltRmIndReq 0 "OFF" 1 "ON" 2 "0.5_Hz" 3 "1_Hz" 4 "2_Hz" 5 "4_Hz" 6 "RESERVED_1" 7 "RESERVED_2" ;
VAL_TABLE_ TireLFLoTracIndOn 0 "FALSE" 1 "TRUE" ;
VAL_TABLE_ MemIdfrIgnOnIndReq 0 "No Action" 1 "Driver 1" 2 "Driver 2" 3 "Driver 3" 4 "Driver 4" 5 "Driver 5" 6 "Driver 6" 7 "Driver 7" 8 "Driver 8" ;
VAL_TABLE_ AutMemRclCstCurSetVal 0 "SETTING_UNKNOWN" 1 "OFF" 2 "ON" 3 "AUTO_MEMORY_RECALL" 4 "EASY_EXIT" 5 "AUTO_MEMORY_AND EASY_EXIT_RECALLS" 6 "RESERVED_7" ;
VAL_TABLE_ AdpLghtRspTypCstCurSetVal 0 "SETTING_UNKNOWN" 1 "OFF" 2 "CORNER_AND_CURVE_LIGHTING" 3 "INTELLIGENT_LIGHT_DISTRIBUTION" 4 "INTELLIGENT_LIGHT_DISTRIBUTION_GPS_ASSISTANCE" 5 "RESERVED_5" 6 "RESERVED_6" 7 "RESERVED_7" ;
VAL_TABLE_ TireRRLoTracIndOn 0 "FALSE" 1 "TRUE" ;
VAL_TABLE_ TireRFLoTracIndOn 0 "FALSE" 1 "TRUE" ;
VAL_TABLE_ TireLRLoTracIndOn 0 "FALSE" 1 "TRUE" ;
VAL_TABLE_ AutMemRclCstStAvl 0 "FALSE" 1 "TRUE" ;
VAL_TABLE_ CTDStat 0 "OFF" 1 "ARMED" 2 "DISARMED" 3 "ALARM ACTIVE" 4 "ARMING DELAY" 5 "POST ALARM DELAY" ;
VAL_TABLE_ BrkSysHillStrtAsstStat 0 "Inactive" 1 "Brake Pressure Hold" 2 "Normal Pressure Decay" 3 "Drive-off Pressure Decay" 4 "Reserved_4" 5 "Reserved_5" 6 "Reserved_6" 7 "Reserved_7" ;
VAL_TABLE_ CnvtblTpWndMtnReq 0 "NO_ACTION" 1 "OPEN" 2 "CLOSE" 3 "COMFORT_OPEN" 4 "COMFORT_CLOSE" ;
VAL_TABLE_ CnvtBkWndPstnSts 0 "Denormalized" 1 "Fully Closed" 2 "Less Than Position A" 3 "Position A" 4 "Greater Than A but less than Position C" 5 "Position C" 6 "Greater than Position C but less than Fully open" 7 "Fully Open" ;
VAL_TABLE_ CTGI2P_CnvtTopStsAuth 0 "Indeterminate" 1 "Fully Closed" 2 "Fully Open" 3 "Closing" 4 "Opening" 5 "Halted" ;
VAL_TABLE_ FrntPsStBltRmOccStat_Inv 0 "FALSE" 1 "TRUE" ;
VAL_TABLE_ EsyExtCstCurSetVal 0 "SETTING_UNKNOWN" 1 "OFF" 2 "ON" 3 "RESERVED_3" 4 "RESERVED_4" 5 "RESERVED_5" 6 "RESERVED_6" 7 "RESERVED_7" ;
VAL_TABLE_ CrgBedVwAutoLgtCstCurrSetVal 0 "Setting_Unknown" 1 "Off" 2 "On" 3 "Reserved_3" 4 "Reserved_4" 5 "Reserved_5" 6 "Reserved_6" 7 "Reserved_7" ;
VAL_TABLE_ FrwdVhImAlrtIndRqst 0 "OFF" 1 "ON" 2 "0.5_Hz" 3 "1_Hz" 4 "2_Hz" 5 "4_Hz" 6 "RESERVED_1" 7 "RESERVED_2" ;
VAL_TABLE_ FrtRdHgtGPSCstCurrSetVal 0 "SETTING_UNKNOWN" 1 "OFF" 2 "ON" 3 "RESERVED_3" 4 "RESERVED_4" 5 "RESERVED_5" 6 "RESERVED_6" 7 "RESERVED_7" ;
VAL_TABLE_ FrntPsStBltRmOccStat 0 "UNKNOWN" 1 "EMPTY" 2 "OCCUPIED" ;
VAL_TABLE_ HybStatElecVehModeOvrrd 0 "Undetermined" 1 "No Override" 2 "Too Cold" 3 "Battery Low" 4 "Speed too High" 5 "Generic Override" 6 "Grade too High" 7 "Accelerator Pedal Threshold Exceeded" ;
VAL_TABLE_ HSP_DrvAlrtTypCstCurrSetValAuth 0 "SETTING_UNKNOWN" 1 "CHIME" 2 "SEAT" ;
VAL_TABLE_ GoNotfrCstCrStVal 0 "SETTING_UNKNOWN" 1 "OFF" 2 "ON" 3 "RESERVED_3" 4 "RESERVED_4" 5 "RESERVED_5" 6 "RESERVED_6" 7 "RESERVED_7" ;
VAL_TABLE_ LtRtHnTrCstCurSetVal 0 "SETTING_UNKNOWN" 1 "LEFT_HAND_DRIVE" 2 "RIGHT_HAND_DRIVE" 3 "AUTOMATIC_WITH_GPS" 4 "RESERVED_4" 5 "RESERVED_5" 6 "RESERVED_6" 7 "RESERVED_7" ;
VAL_TABLE_ LnDtWrnCntrlFtrSt 0 "OFF" 1 "STANDBY" 2 "READY TO ASSIST" 3 "FAILED" 4 "ALERT AND CONTROL" ;
VAL_TABLE_ JckKnfDtnCstCurrSetVal 0 "Setting_Unknown" 1 "Off" 2 "On" 3 "Reserved_3" 4 "Reserved_4" 5 "Reserved_5" 6 "Reserved_6" 7 "Reserved_7" ;
VAL_TABLE_ LvlgSysEntEgrsMdCstCurrSetVal 0 "SETTING_UNKNOWN" 1 "OFF" 2 "ON" 3 "RESERVED_3" 4 "RESERVED_4" 5 "RESERVED_5" 6 "RESERVED_6" 7 "RESERVED_7" ;
VAL_TABLE_ LvlgSysAlgnMdCstCurrSetVal 0 "SETTING_UNKNOWN" 1 "OFF" 2 "ON" 3 "RESERVED_3" 4 "RESERVED_4" 5 "RESERVED_5" 6 "RESERVED_6" 7 "RESERVED_7" ;
VAL_TABLE_ PrkAsstONOFFCstCrStVal 0 "SETTING_UNKNOWN" 1 "OFF" 2 "ALERT" 3 "ALERT_BRAKE" 4 "RESERVED_4" 5 "RESERVED_5" 6 "RESERVED_6" 7 "RESERVED_7" ;
VAL_TABLE_ NghtVsnSysStat 0 "UNKNOWN" 1 "INITIALIZING" 2 "INACTIVE" 3 "ACTIVE" 4 "NEEDS SERVICE" 5 "NOT DARK" 6 "TEMPORARILY UNAVAILABLE" 7 "NEEDS HEADLIGHTS" ;
VAL_TABLE_ LvlgSysServMdCstCurrSetVal 0 "SETTING_UNKNOWN" 1 "OFF" 2 "ON" 3 "RESERVED_3" 4 "RESERVED_4" 5 "RESERVED_5" 6 "RESERVED_6" 7 "RESERVED_7" ;
VAL_TABLE_ AutoHldEnbld 0 "FALSE" 1 "TRUE" ;
VAL_TABLE_ PrkAsstTrHtchPsntCstCrStVal 0 "SETTING_UNKNOWN" 1 "OFF_NOT_ATTACHED" 2 "ON_ATTACHED" 3 "RESERVED_3" 4 "RESERVED_4" 5 "RESERVED_5" 6 "RESERVED_6" 7 "RESERVED_7" ;
VAL_TABLE_ PrkAsstStat 0 "OFF" 1 "STANDBY" 2 "DISABLED" 3 "FAILED" 4 "FRONT_REAR_ACTIVE" 5 "REAR_ACTIVE" 6 "FRONT_ACTIVE" 7 "UNKNOWN" ;
VAL_TABLE_ PrsnlMdStrCstmCurSetVal 0 "SETTING_UNKNOWN" 1 "PERSONAL_MODE_1" 2 "PERSONAL_MODE_2" 3 "PERSONAL_MODE_3" 4 "PERSONAL_MODE_4" 5 "PERSONAL_MODE_5" 6 "PERSONAL_MODE_6" 7 "PERSONAL_MODE_7" ;
VAL_TABLE_ PrsnlMdSpnCstmCurSetVal 0 "SETTING_UNKNOWN" 1 "PERSONAL_MODE_1" 2 "PERSONAL_MODE_2" 3 "PERSONAL_MODE_3" 4 "PERSONAL_MODE_4" 5 "PERSONAL_MODE_5" 6 "PERSONAL_MODE_6" 7 "PERSONAL_MODE_7" ;
VAL_TABLE_ PrsnlMdSndCstmCurSetVal 0 "SETTING_UNKNOWN" 1 "PERSONAL_MODE_1" 2 "PERSONAL_MODE_2" 3 "PERSONAL_MODE_3" 4 "PERSONAL_MODE_4" 5 "PERSONAL_MODE_5" 6 "PERSONAL_MODE_6" 7 "PERSONAL_MODE_7" ;
VAL_TABLE_ RideHghtSeltn3Name 0 "No Action" 1 "Auto" 2 "Raised 2" 3 "Raised" 4 "Normal" 5 "Entry/Exit" 6 "Cargo/Trailer" 7 "Lowered" ;
VAL_TABLE_ RideHghtSeltn2Name 0 "No Action" 1 "Auto" 2 "Raised 2" 3 "Raised" 4 "Normal" 5 "Entry/Exit" 6 "Cargo/Trailer" 7 "Lowered" ;
VAL_TABLE_ RideHghtSeltn1Name 0 "No Action" 1 "Auto" 2 "Raised 2" 3 "Raised" 4 "Normal" 5 "Entry/Exit" 6 "Cargo/Trailer" 7 "Lowered" ;
VAL_TABLE_ RideHghtSeltn5Name 0 "No Action" 1 "Auto" 2 "Raised 2" 3 "Raised" 4 "Normal" 5 "Entry/Exit" 6 "Cargo/Trailer" 7 "Lowered" ;
VAL_TABLE_ RideHghtSeltn4Name 0 "No Action" 1 "Auto" 2 "Raised 2" 3 "Raised" 4 "Normal" 5 "Entry/Exit" 6 "Cargo/Trailer" 7 "Lowered" ;
VAL_TABLE_ RideHghtSeltn8Name 0 "No Action" 1 "Auto" 2 "Raised 2" 3 "Raised" 4 "Normal" 5 "Entry/Exit" 6 "Cargo/Trailer" 7 "Lowered" ;
VAL_TABLE_ RideHghtSeltn7Name 0 "No Action" 1 "Auto" 2 "Raised 2" 3 "Raised" 4 "Normal" 5 "Entry/Exit" 6 "Cargo/Trailer" 7 "Lowered" ;
VAL_TABLE_ RideHghtSeltn6Name 0 "No Action" 1 "Auto" 2 "Raised 2" 3 "Raised" 4 "Normal" 5 "Entry/Exit" 6 "Cargo/Trailer" 7 "Lowered" ;
VAL_TABLE_ RrVwPrkAstSymCsCrStVal 0 "SETTING_UNKNOWN" 1 "OFF" 2 "ON" 3 "RESERVED_3" 4 "RESERVED_4" 5 "RESERVED_5" 6 "RESERVED_6" 7 "RESERVED_7" ;
VAL_TABLE_ RnngBrdManDplyCstCurrSetVal 0 "Setting_Unknown" 1 "Off" 2 "Extend to Door" 3 "Extend to Bed" 4 "Reserved_4" 5 "Reserved_5" 6 "Reserved_6" 7 "Reserved_7" ;
VAL_TABLE_ RnngBrdAutoDplyCstCurrSetVal 0 "Setting_Unknown" 1 "Off" 2 "Door" 3 "Door_Park" 4 "Reserved_5" 5 "Reserved_6" 6 "Reserved_7" ;
VAL_TABLE_ StBltShfIntlkCstCurrSetVal 0 "SETTING_UNKNOWN" 1 "OFF" 2 "ON" 3 "RESERVED_3" 4 "RESERVED_4" 5 "RESERVED_5" 6 "RESERVED_6" 7 "RESERVED_7" ;
VAL_TABLE_ SrrndVwLghtCsCrStVal 0 "SETTING_UNKNOWN" 1 "OFF" 2 "ON" 3 "RESERVED_3" 4 "RESERVED_4" 5 "RESERVED_5" 6 "RESERVED_6" 7 "RESERVED_7" ;
VAL_TABLE_ TrlrMirVidGdlnsCstCurrSetVal 0 "Setting_Unknown" 1 "Off" 2 "On" 3 "Reserved_3" 4 "Reserved_4" 5 "Reserved_5" 6 "Reserved_6" 7 "Reserved_7" ;
VAL_TABLE_ TnDrvStBltShfIntlkCstCurrSetVal 0 "SETTING_UNKNOWN" 1 "OFF" 2 "ON" 3 "RESERVED_3" 4 "RESERVED_4" 5 "RESERVED_5" 6 "RESERVED_6" 7 "RESERVED_7" ;
VAL_TABLE_ StBltTghtngCstCrStVal 0 "SETTING_UNKNOWN" 1 "OFF" 2 "ON" 3 "RESERVED_3" 4 "RESERVED_4" 5 "RESERVED_5" 6 "RESERVED_6" 7 "RESERVED_7" ;
VAL_TABLE_ BrkLtsAtv 0 "FALSE" 1 "TRUE" ;
VAL_TABLE_ APAExtPrkSftBtnRqst 0 "HIDDEN" 1 "DISABLED" 2 "ENABLED" 3 "HIGHLIGHTED" ;
VAL_TABLE_ APACrssFrntInSftBtnRqst 0 "HIDDEN" 1 "DISABLED" 2 "ENABLED" 3 "HIGHLIGHTED" ;
VAL_TABLE_ APACrssBckInSftBtnRqst 0 "HIDDEN" 1 "DISABLED" 2 "ENABLED" 3 "HIGHLIGHTED" ;
VAL_TABLE_ APASrchSftBtnRqst 0 "HIDDEN" 1 "DISABLED" 2 "ENABLED" 3 "HIGHLIGHTED" ;
VAL_TABLE_ APARghtSftBtnRqst 0 "HIDDEN" 1 "DISABLED" 2 "ENABLED" 3 "HIGHLIGHTED" ;
VAL_TABLE_ APAPrllPrkSftBtnRqst 0 "HIDDEN" 1 "DISABLED" 2 "ENABLED" 3 "HIGHLIGHTED" ;
VAL_TABLE_ APALftSftBtnRqst 0 "HIDDEN" 1 "DISABLED" 2 "ENABLED" 3 "HIGHLIGHTED" ;
VAL_TABLE_ EngCmptAjr 0 "FALSE" 1 "TRUE" ;
VAL_TABLE_ EngCmptAjr_Inv 0 "FALSE" 1 "TRUE" ;
VAL_TABLE_ ElvtdIdlCstCrStVal 0 "No Action" 1 "Off" 2 "On" ;
VAL_TABLE_ DrvDrAjrStat 0 "FALSE" 1 "TRUE" ;
VAL_TABLE_ DrvDrAjrStat_Inv 0 "FALSE" 1 "TRUE" ;
VAL_TABLE_ CoDrvDrAjrStat 0 "FALSE" 1 "TRUE" ;
VAL_TABLE_ CoDrvDrAjrStat_Inv 0 "FALSE" 1 "TRUE" ;
VAL_TABLE_ LftglsAjrStat 0 "FALSE" 1 "TRUE" ;
VAL_TABLE_ LftglsAjrStat_Inv 0 "FALSE" 1 "TRUE" ;
VAL_TABLE_ LRDrAjrStat 0 "FALSE" 1 "TRUE" ;
VAL_TABLE_ LRDrAjrStat_Inv 0 "FALSE" 1 "TRUE" ;
VAL_TABLE_ InvsblTrlrOprtlSts 0 "Available" 1 "Degraded" 2 "Unavailable" 3 "Unknown" ;
VAL_TABLE_ HSP_HptcStOprtlStsAuth 0 "Normal Operation" 1 "Unknown" 2 "Failed" ;
VAL_TABLE_ SAP_SecAxl4WDAWDStatAuth 0 "Normal" 1 "Temporary_Limited" 2 "Temporary_Inhibit" 3 "Permanently_Failed" ;
VAL_TABLE_ RRDrAjrStat 0 "FALSE" 1 "TRUE" ;
VAL_TABLE_ RRDrAjrStat_Inv 0 "FALSE" 1 "TRUE" ;
VAL_TABLE_ LogisticModeStatus 0 "Off" 1 "Plant" 2 "Transport Mode" 3 "Storage Mode" ;
VAL_TABLE_ LnCntrEsclnSts 0 "None" 1 "Driver Not Looking to Roadway" 2 "Limited Condition" 3 "System Faulted" ;
VAL_TABLE_ CIBAutoBrkReqActv 0 "FALSE" 1 "TRUE" ;
VAL_TABLE_ CIBAutoBrkRelIndOn 0 "FALSE" 1 "TRUE" ;
VAL_TABLE_ APAVMR_SloDnIndOn 0 "FALSE" 1 "TRUE" ;
VAL_TABLE_ APAVMR_NAvalIndOn 0 "FALSE" 1 "TRUE" ;
VAL_TABLE_ TrnSwAct 0 "NO_ACTIVATION" 1 "LEFT" 2 "RIGHT" ;
VAL_TABLE_ TrlrTirePresProfXferSts 0 "Not Active" 1 "Completed" 2 "In Progress" 3 "Failed" ;
VAL_TABLE_ CkSoftTpIO 0 "FALSE" 1 "TRUE" ;
VAL_TABLE_ CkRrPrkLmpIndOn 0 "FALSE" 1 "TRUE" ;
VAL_TABLE_ CkLoBmsIndOn 0 "FALSE" 1 "TRUE" ;
VAL_TABLE_ CkFrtPrkLmpsIndOn 0 "FALSE" 1 "TRUE" ;
VAL_TABLE_ CkFgLmpsIndOn 0 "FALSE" 1 "TRUE" ;
VAL_TABLE_ CkDyTmRnngLmpsIndOn 0 "FALSE" 1 "TRUE" ;
VAL_TABLE_ CkCrnrLmpsIndOn 0 "FALSE" 1 "TRUE" ;
VAL_TABLE_ CkBrkLmpsIndOn 0 "FALSE" 1 "TRUE" ;
VAL_TABLE_ DrMtzdStBltUnIndOn 0 "FALSE" 1 "TRUE" ;
VAL_TABLE_ DrMtzdStBltFldIndOn 0 "FALSE" 1 "TRUE" ;
VAL_TABLE_ DispSmrtTowVidOn 0 "FALSE" 1 "TRUE" ;
VAL_TABLE_ Deg360VidFtrPrsnt 0 "FALSE" 1 "TRUE" ;
VAL_TABLE_ DRLAct 0 "FALSE" 1 "TRUE" ;
VAL_TABLE_ CrgBedVwAutoLgtCstSetAval 0 "FALSE" 1 "TRUE" ;
VAL_TABLE_ CnvtblTopTneuAjrStat 0 "FALSE" 1 "TRUE" ;
VAL_TABLE_ ClsTrnkLidIO 0 "FALSE" 1 "TRUE" ;
VAL_TABLE_ FrntPsStbltRmIndOn 0 "FALSE" 1 "TRUE" ;
VAL_TABLE_ FrntPsMtzdStBltUnIndOn 0 "FALSE" 1 "TRUE" ;
VAL_TABLE_ FrntPsMtzdStBltFldIndOn 0 "FALSE" 1 "TRUE" ;
VAL_TABLE_ EsyExtCstStAvl 0 "FALSE" 1 "TRUE" ;
VAL_TABLE_ ESCLTrntheStrWheelWhlStrtgIO 0 "FALSE" 1 "TRUE" ;
VAL_TABLE_ DsplyTrgVdOn 0 "FALSE" 1 "TRUE" ;
VAL_TABLE_ DspFrnt360CmrON 0 "FALSE" 1 "TRUE" ;
VAL_TABLE_ DrvStBltRmIndOn 0 "FALSE" 1 "TRUE" ;
VAL_TABLE_ JckKnfDtnCstSetAval 0 "FALSE" 1 "TRUE" ;
VAL_TABLE_ HiBmOtgIndOn 0 "FALSE" 1 "TRUE" ;
VAL_TABLE_ HSP_HptcStPrsntAuth 0 "FALSE" 1 "TRUE" ;
VAL_TABLE_ GrdBrkgAct 0 "FALSE" 1 "TRUE" ;
VAL_TABLE_ GoNotfrCstStAvl 0 "FALSE" 1 "TRUE" ;
VAL_TABLE_ FrwdVhHdwyAlrtIndOn 0 "FALSE" 1 "TRUE" ;
VAL_TABLE_ FrtStrgeCmptAjr 0 "FALSE" 1 "TRUE" ;
VAL_TABLE_ FrtRdHgtGPSCstSetAval 0 "FALSE" 1 "TRUE" ;
VAL_TABLE_ LvlgSysEntEgrsMdCstSetAval 0 "FALSE" 1 "TRUE" ;
VAL_TABLE_ LvlgSysAlgnMdCstSetSelable 0 "FALSE" 1 "TRUE" ;
VAL_TABLE_ LvlgSysAlgnMdCstSetAval 0 "FALSE" 1 "TRUE" ;
VAL_TABLE_ LtRtHnTrCstStAvl 0 "FALSE" 1 "TRUE" ;
VAL_TABLE_ LnCntrMisuseCond 0 "FALSE" 1 "TRUE" ;
VAL_TABLE_ LnCntrDrvAwrIndOn 0 "FALSE" 1 "TRUE" ;
VAL_TABLE_ LicLpOtIO 0 "FALSE" 1 "TRUE" ;
VAL_TABLE_ LSCMBAutoBrkRlsIndOn 0 "FALSE" 1 "TRUE" ;
VAL_TABLE_ PrkAsstTrHtchPsntCstStAvl 0 "FALSE" 1 "TRUE" ;
VAL_TABLE_ PrkAsstONOFFCstStAvl 0 "FALSE" 1 "TRUE" ;
VAL_TABLE_ PedtrnProtSysDpl 0 "FALSE" 1 "TRUE" ;
VAL_TABLE_ NoSDCrdPrIndOn 0 "FALSE" 1 "TRUE" ;
VAL_TABLE_ MovblTpServRqrdIO 0 "FALSE" 1 "TRUE" ;
VAL_TABLE_ MovblTpNormzRqrdIO 0 "FALSE" 1 "TRUE" ;
VAL_TABLE_ LvlgSysServMdCstSetSelable 0 "FALSE" 1 "TRUE" ;
VAL_TABLE_ LvlgSysServMdCstSetAval 0 "FALSE" 1 "TRUE" ;
VAL_TABLE_ RnngBrdAutoDplyCstSetAval 0 "FALSE" 1 "TRUE" ;
VAL_TABLE_ RegVltgCtlEngyRcvryActv 0 "FALSE" 1 "TRUE" ;
VAL_TABLE_ RearPsStbltVisIndMd 0 "FALSE" 1 "TRUE" ;
VAL_TABLE_ RIMUnIndOn 0 "FALSE" 1 "TRUE" ;
VAL_TABLE_ RIMONIndOn 0 "FALSE" 1 "TRUE" ;
VAL_TABLE_ RIMOFFIndOn 0 "FALSE" 1 "TRUE" ;
VAL_TABLE_ PrsnlMdStrCstmSetAv 0 "FALSE" 1 "TRUE" ;
VAL_TABLE_ PrkBrkSwAtv 0 "FALSE" 1 "TRUE" ;
VAL_TABLE_ RvLpOtIO 0 "FALSE" 1 "TRUE" ;
VAL_TABLE_ RstrntDplyIndOn 0 "FALSE" 1 "TRUE" ;
VAL_TABLE_ RrVwPrkAstSymCsStAvl 0 "FALSE" 1 "TRUE" ;
VAL_TABLE_ RrFgLpOtIO 0 "FALSE" 1 "TRUE" ;
VAL_TABLE_ RrAxlTmpInhIO 0 "FALSE" 1 "TRUE" ;
VAL_TABLE_ RrAxlMlfIO 0 "FALSE" 1 "TRUE" ;
VAL_TABLE_ RnngBrdManDplyCstSetSelbl 0 "FALSE" 1 "TRUE" ;
VAL_TABLE_ RnngBrdManDplyCstSetAval 0 "FALSE" 1 "TRUE" ;
VAL_TABLE_ SftTpMchnOvhtIO 0 "FALSE" 1 "TRUE" ;
VAL_TABLE_ SftTpLtcIO 0 "FALSE" 1 "TRUE" ;
VAL_TABLE_ ServPedtrnFrndlyAlrtIndOn 0 "FALSE" 1 "TRUE" ;
VAL_TABLE_ SerRideSysIO 0 "FALSE" 1 "TRUE" ;
VAL_TABLE_ SDCrdFllIndOn 0 "FALSE" 1 "TRUE" ;
VAL_TABLE_ SDCrdErrIndOn 0 "FALSE" 1 "TRUE" ;
VAL_TABLE_ TrlrMirVidEnblCstSetAval 0 "FALSE" 1 "TRUE" ;
VAL_TABLE_ TrlrBrkDtd 0 "FALSE" 1 "TRUE" ;
VAL_TABLE_ TrgrdVidRcrdrFtrPrsnt 0 "FALSE" 1 "TRUE" ;
VAL_TABLE_ TnDrvStBltShfIntlkCstSetAval 0 "FALSE" 1 "TRUE" ;
VAL_TABLE_ TargaTopAjrStat 0 "FALSE" 1 "TRUE" ;
VAL_TABLE_ StBltTghtngCstStAv 0 "FALSE" 1 "TRUE" ;
VAL_TABLE_ StBltShfIntlkCstSetAval 0 "FALSE" 1 "TRUE" ;
VAL_TABLE_ SrrndVwLghtCsStAvl 0 "FALSE" 1 "TRUE" ;
VAL_TABLE_ FrtStrgeCmptAjr_Inv 0 "FALSE" 1 "TRUE" ;
VAL_TABLE_ WprFrActFltdStat 0 "FALSE" 1 "TRUE" ;
VAL_TABLE_ TrnSigSwRtActv 0 "FALSE" 1 "TRUE" ;
VAL_TABLE_ TrnSigSwLtActv 0 "FALSE" 1 "TRUE" ;
VAL_TABLE_ TrlrMirVidGdlnsCstSetAval 0 "FALSE" 1 "TRUE" ;
VAL_TABLE_ TireLocatnWarnEn 0 "FALSE" 1 "TRUE" ;
VAL_TABLE_ TirePrsLF_Inv 0 "FALSE" 1 "TRUE" ;
VAL_TABLE_ TirePrsLR_Inv 0 "FALSE" 1 "TRUE" ;
VAL_TABLE_ TirePrsRF_Inv 0 "FALSE" 1 "TRUE" ;
VAL_TABLE_ TirePrsStatLF 0 "Unknown" 1 "Nominal" 2 "Low - Service Now" 3 "Low" 4 "Low - Extended Mobility" 5 "High" ;
VAL_TABLE_ TirePrsRR_Inv 0 "FALSE" 1 "TRUE" ;
VAL_TABLE_ TirePrsStatRF 0 "Unknown" 1 "Nominal" 2 "Low - Service Now" 3 "Low" 4 "Low - Extended Mobility" 5 "High" ;
VAL_TABLE_ TirePrsStatLR_Inv 0 "FALSE" 1 "TRUE" ;
VAL_TABLE_ TirePrsStatLR 0 "Unknown" 1 "Nominal" 2 "Low - Service Now" 3 "Low" 4 "Low - Extended Mobility" 5 "High" ;
VAL_TABLE_ TirePrsStatLF_Inv 0 "FALSE" 1 "TRUE" ;
VAL_TABLE_ TirePrsStatRR_Inv 0 "FALSE" 1 "TRUE" ;
VAL_TABLE_ TirePrsStatRR 0 "Unknown" 1 "Nominal" 2 "Low - Service Now" 3 "Low" 4 "Low - Extended Mobility" 5 "High" ;
VAL_TABLE_ TirePrsStatRF_Inv 0 "FALSE" 1 "TRUE" ;
VAL_TABLE_ ACCDsngIndOn 0 "FALSE" 1 "TRUE" ;
VAL_TABLE_ TCTPIR_DrvrNtfn 0 "No Action" 1 "No Indication" 2 "Warm" 3 "Increase Speed or Apply Brake" 4 "Ready for Drive Away" 5 "Please Wait" 6 "Apply and Hold Brake" 7 "Cool Down" 8 "Creep Disabled" ;
VAL_TABLE_ FPARS_Lt 0 "OFF" 1 "FAILED" 2 "BLOCKED" 3 "ATTACHED_OBJECT" 4 "NO_OBJECT" 5 "ZONE_1" 6 "ZONE_2" 7 "ZONE_3" 8 "ZONE_4" 9 "ZONE_5" 10 "ZONE_6" 11 "OFF_NO_FAULT" 12 "RESERVED_1" 13 "RESERVED_2" 14 "RESERVED_3" ;
VAL_TABLE_ FPARS_Rt 0 "OFF" 1 "FAILED" 2 "BLOCKED" 3 "ATTACHED_OBJECT" 4 "NO_OBJECT" 5 "ZONE_1" 6 "ZONE_2" 7 "ZONE_3" 8 "ZONE_4" 9 "ZONE_5" 10 "ZONE_6" 11 "OFF_NO_FAULT" 12 "RESERVED_1" 13 "RESERVED_2" 14 "RESERVED_3" ;
VAL_TABLE_ FPARS_LtCntr 0 "OFF" 1 "FAILED" 2 "BLOCKED" 3 "ATTACHED_OBJECT" 4 "NO_OBJECT" 5 "ZONE_1" 6 "ZONE_2" 7 "ZONE_3" 8 "ZONE_4" 9 "ZONE_5" 10 "ZONE_6" 11 "OFF_NO_FAULT" 12 "RESERVED_1" 13 "RESERVED_2" 14 "RESERVED_3" ;
VAL_TABLE_ FPARS_RtCntr 0 "OFF" 1 "FAILED" 2 "BLOCKED" 3 "ATTACHED_OBJECT" 4 "NO_OBJECT" 5 "ZONE_1" 6 "ZONE_2" 7 "ZONE_3" 8 "ZONE_4" 9 "ZONE_5" 10 "ZONE_6" 11 "OFF_NO_FAULT" 12 "RESERVED_1" 13 "RESERVED_2" 14 "RESERVED_3" ;
VAL_TABLE_ RdHgtWrn2IndReq 0 "No Indication" 1 "Auto Lowering" 2 "Suspension Low-Wait" 3 "Suspension Low-Caution" 4 "Suspension High" 5 "Safety Lowered" 6 "Raised 2 Inhibit 4WD" 7 "Raised 2 Inhibit Speed" 8 "Raised Inhibit Speed" 9 "Cargo Inhibit Speed" 10 "Entry Exit Pending Speed" 11 "Raised 2 Inhibit Crawl" 12 "Object Detected" 13 "SuspensionOverloaded" 14 "Lowered Inhibit DMC" 15 "Raised 2 Speed Limit Enabled" ;
VAL_TABLE_ ACCHdwySttngIndOn 0 "FALSE" 1 "TRUE" ;
VAL_TABLE_ EVMESS_StrtPhs 0 "No Indication" 1 "Complete" 2 "Phase 1" 3 "Phase 2" 4 "Phase 3" 5 "Skip Phase 2" ;
VAL_TABLE_ EngIntAirTmp_Inv 0 "FALSE" 1 "TRUE" ;
VAL_TABLE_ FrwdHdwyVisIndCtl 0 "FCA" 1 "ACC" 2 "None" ;
VAL_TABLE_ FCA_ACCGapSetIndOn 0 "FALSE" 1 "TRUE" ;
VAL_TABLE_ FCAACCGapSeltn 0 "Far" 1 "Medium" 2 "Near" 3 "Off" 4 "Unknown" ;
VAL_TABLE_ ACCTrlrGapSetIndOn 0 "FALSE" 1 "TRUE" ;
VAL_TABLE_ LnCntrCnvMsgIndRqst 0 "No Indication" 1 "Behind Slow Vehicle" 2 "Being Passed on Left" 3 "Being Passed on Right" 4 "Tailgater Detected" 5 "Left Blind Spot Occupied" 6 "Right Blind Spot Occupied" 7 "Heavy Traffic" 8 "Merging Vehicle" 9 "Slow Moving Traffic in Left Lane" 10 "Slow Moving Traffic Ahead" 11 "Slow Moving Traffic in Right Lane" 12 "Major Road Interchange Ahead" 13 "Road Exit Detected Ahead" 14 "Exit Only Lane Ahead" 15 "Lane Ending Ahead" 16 "Road Detour Detected" 17 "Take Time to Look at Road" 18 "Show Fuel Level" 19 "Show Fuel Range Normal" 20 "Show Fuel Range Low" 21 "Take Steering Active With Muting" ;
VAL_TABLE_ FllwgTmDsplyMd 0 "NO DISPLAY" 1 "DEFAULT" 2 "NORMAL" 3 "LESS THAN MINIMUM" 4 "GREATER THAN MAXIMUM" ;
VAL_TABLE_ VCTLS_UsrCtlAllwd 0 "Allowed" 1 "Not Allowed" ;
VAL_TABLE_ VCTLS_CurrSeltnVal 0 "Unknown" 1 "On" 2 "Left" 3 "Right" 4 "Off" ;
VAL_TABLE_ VCTLS_CtlAval 0 "Not Available" 1 "Available" ;
VAL_TABLE_ AirbgStsIndReq 0 "OFF" 1 "ON" 2 "0.5_Hz" 3 "1_Hz" 4 "2_Hz" 5 "4_Hz" 6 "RESERVED_1" 7 "RESERVED_2" ;
VAL_TABLE_ AdpAndCnvntlCruzCtlIndReq 0 "No Action" 1 "Cruise Control and Adaptive Cruise Control Telltale Off" 2 "Cruise Control Unavailable Telltale On" 3 "Cruise Control White Telltale On" 4 "Cruise Control Green Telltale On" 5 "Cruise Control Blue Telltale On" 6 "Adaptive Cruise Control Unavailable Telltale On" 7 "Adaptive Cruise Control White Telltale On" 8 "Adaptive Cruise Control Green Telltale On" 9 "Adaptive Cruise Control Blue Telltale On" ;
VAL_TABLE_ DrvStBltRmIndReq 0 "OFF" 1 "ON" 2 "0.5_Hz" 3 "1_Hz" 4 "2_Hz" 5 "4_Hz" 6 "RESERVED_1" 7 "RESERVED_2" ;
VAL_TABLE_ BSSIP_BrkAsstBrkBstStsAuth 0 "No Boost" 1 "Normal Boost" 2 "Boost with Warning" 3 "Shut Down Boost" 4 "No Boost EPB Assist" 5 "Hydraulic Leak Detection" 6 "Half System Boost" 7 "Diagnostic Mode" 8 "Brake Fade 1" 9 "Brake Fade 2" ;
VAL_TABLE_ SGI2P_AirSpnsnRdHghtActlStsAuth 0 "Faulted" 1 "Entry/Exit" 2 "Lowered 3" 3 "Lowered 2" 4 "Lowered 1" 5 "Showroom" 6 "Normal" 7 "Raised 1" 8 "Raised 2" 9 "Raised 3" 10 "Cargo" 11 "Trailer Low" 12 "Trailer High" 13 "Car Show" ;
VAL_TABLE_ RdHgtStatIndReq 0 "Nominal Trim" 1 "Raised 2" 2 "Raised 1" 3 "Lowered 1" 4 "Lowered 2" 5 "Cargo/Trailer" 6 "Entry/Exit" 7 "Alignment Mode" 8 "Service Mode" 9 "Entry/Exit Pending" 10 "Safety Lowered" 11 "Car Show" 12 "Trailer Low" 13 "Trailer High" ;
VAL_TABLE_ AutoLnChgCstCurrSetVal 0 "Setting Unkown" 1 "Off" 2 "On" 3 "LCOD" 4 "LCOD and ALC" ;
VAL_TABLE_ ArtcldRnngBrdSt 0 "No Action" 1 "Resume Normal Operation" 2 "Running Boards Deployed" 3 "Running Boards Stowed" 4 "Running Boards Cargo Access" 5 "Running Boards Inhibited" 6 "Running Boards Could Not Extend" ;
VAL_TABLE_ LAOA_LatAsstOffOptAval 0 "FALSE" 1 "TRUE" ;
VAL_TABLE_ LAOA_LatAsstLKAOptAval 0 "FALSE" 1 "TRUE" ;
VAL_TABLE_ LAOA_LatAsstLDWOptAval 0 "FALSE" 1 "TRUE" ;
VAL_TABLE_ LAOA_LatAsstHoLFOptAval 0 "FALSE" 1 "TRUE" ;
VAL_TABLE_ AxlLckUnavailIndReq 0 "No Action" 1 "Rear Axle Not Locked" 2 "Not in 4WD Low" 3 "Speed Too High" 4 "Not During Hill Decent" 5 "Generic Unavailable" 6 "Not in Terrain" 7 "Not in Terrain or Offroad" ;
VAL_TABLE_ AutoTrnspHdActvnCstCurrSetVal 0 "Setting Unknown" 1 "Active" 2 "Inactive" ;
VAL_TABLE_ DslExhFldDiagWrnIdRq 0 "No Indication" 1 "Warning Level 1" 2 "Warning Level 2" 3 "Warning Level 3" 4 "Warning Level 4" 5 "Warning Level 5" 6 "Warning Level 6" 7 "Warning Level 7" ;
VAL_TABLE_ DrvrSeltdSpdLmtrIndReq 0 "No Action" 1 "Driver Selected Speed Limiter Telltale Off" 2 "Driver Selected Speed Limiter Unavailable Telltale On" 3 "Driver Selected Speed Limiter White Telltale On" 4 "Driver Selected Speed Limiter Green Telltale On" ;
VAL_TABLE_ BSSIP_LnchCtlModeStsAuth 0 "Disable" 1 "General" 2 "General Custom" 3 "High Traction" 4 "High Traction Custom" 5 "Line Lock" 6 "Line Lock Press Brake" 7 "Line Lock Release Brake" ;
VAL_TABLE_ FPLTLI_AuxPrkLmpLtCmd 0 "No Action" 1 "Off" 2 "On" 3 "Ramp On" 4 "Ramp Off" ;
VAL_TABLE_ FCAGpSet 0 "FAR" 1 "MEDIUM" 2 "NEAR" 3 "OFF" 4 "UNKNOWN" 5 "FAULTED" ;
VAL_TABLE_ FPLTLI_PrkLmpLtCmd 0 "No Action" 1 "Off" 2 "On" 3 "Ramp On" 4 "Ramp Off" ;
VAL_TABLE_ FPLTLI_AuxPrkLmpRtCmd 0 "No Action" 1 "Off" 2 "On" 3 "Ramp On" 4 "Ramp Off" ;
VAL_TABLE_ LtAstStsIndRq 0 "No Indication" 1 "Off" 2 "LDW" 3 "LKA" 4 "HoLF" ;
VAL_TABLE_ HybStatShtlModeOvrrd 0 "Undetermined" 1 "No Override" 2 "Too Cold" 3 "Battery Low" 4 "Speed too High" 5 "Generic Override" 6 "Grade too High" 7 "Accelerator Pedal Threshold Exceeded" ;
VAL_TABLE_ FPLTLI_PrkLmpRtCmd 0 "No Action" 1 "Off" 2 "On" 3 "Ramp On" 4 "Ramp Off" ;
VAL_TABLE_ MemStorCmpltdIndReq 0 "No Indication" 1 "Memory Button 1" 2 "Memory Button 2" 3 "Memory Button 3" 4 "Memory Button Exit" ;
VAL_TABLE_ MemRclHldUntilCmpltIndReq 0 "No Indication" 1 "Memory Button 1" 2 "Memory Button 2" 3 "Memory Button 3" 4 "Memory Button Exit" ;
VAL_TABLE_ MemRclCmpltIndReq 0 "No Indication" 1 "Memory Button 1" 2 "Memory Button 2" 3 "Memory Button 3" 4 "Memory Button Exit" ;
VAL_TABLE_ NtVsnVidCntrstSts 0 "No Action" 1 "Min" 2 "Default-2" 3 "Default-1" 4 "Default" 5 "Default+1" 6 "Default+2" 7 "Max" ;
VAL_TABLE_ NtVsnVidBrghtnsSts 0 "No Action" 1 "Min" 2 "Default-2" 3 "Default-1" 4 "Default" 5 "Default+1" 6 "Default+2" 7 "Max" ;
VAL_TABLE_ RdHgtAtLocIndReq 0 "No Indication" 1 "Stored" 2 "Cleared" 3 "All Cleared" 4 "Not Saved" 5 "Unknown" ;
VAL_TABLE_ RdHgtActvnIndReq 0 "No Indication" 1 "Raising" 2 "Lowering" 3 "Location Raising" 4 "Location Lowering" 5 "Raising Without Remember" ;
VAL_TABLE_ PARgn 0 "Europe" 1 "North America" ;
VAL_TABLE_ SecAxlTransStatAchvd_Inv 0 "FALSE" 1 "TRUE" ;
VAL_TABLE_ RdHgtWrn1IndReq 0 "No indication" 1 "Front Lift Inhibited" 2 "Leveling Inhibited" 3 "Front Lift Unavailable" 4 "Leveling Unavailable" 5 "Front Lift Faulted" 6 "Leveling Faulted" ;
VAL_TABLE_ RdHgtMvmtIndReq 0 "No Movement" 1 "Raising to 2" 2 "Raising" 3 "Lowering" 4 "Cargo Loading" ;
VAL_TABLE_ TrnsSftMdSt 0 "No Override Mode" 1 "Performance Mode" 2 "Lift-Foot Cornering Mode" 3 "Automatic Grade Braking Mode" ;
VAL_TABLE_ TrlrMirVidEnblCstCurrSetVal 0 "Setting_Unknown" 1 "Off" 2 "On" 3 "Reserved_3" 4 "Reserved_4" 5 "Reserved_5" 6 "Reserved_6" 7 "Reserved_7" ;
VAL_TABLE_ SecAxlTransStatAchvd 0 "Unknown" 1 "Neutral" 2 "Mode 1" ;
VAL_TABLE_ WndPstnStsLR 0 "Denormalized" 1 "Fully Closed" 2 "Less Than Position A" 3 "Position A" 4 "Greater Than A but less than Position C" 5 "Position C" 6 "Greater than Position C but less than Fully open" 7 "Fully Open" ;
VAL_TABLE_ WndPstnStsLF 0 "Denormalized" 1 "Fully Closed" 2 "Less Than Position A" 3 "Position A" 4 "Greater Than A but less than Position C" 5 "Position C" 6 "Greater than Position C but less than Fully open" 7 "Fully Open" ;
VAL_TABLE_ VhSpdCntlSystmTyp 0 "No Vehicle Speed Control" 1 "Conventional Cruise Control" 2 "Adaptive Cruise Control" ;
VAL_TABLE_ ACCRtSpdAdVsIndOn 0 "FALSE" 1 "TRUE" ;
VAL_TABLE_ WndPstnStsRR 0 "Denormalized" 1 "Fully Closed" 2 "Less Than Position A" 3 "Position A" 4 "Greater Than A but less than Position C" 5 "Position C" 6 "Greater than Position C but less than Fully open" 7 "Fully Open" ;
VAL_TABLE_ WndPstnStsRF 0 "Denormalized" 1 "Fully Closed" 2 "Less Than Position A" 3 "Position A" 4 "Greater Than A but less than Position C" 5 "Position C" 6 "Greater than Position C but less than Fully open" 7 "Fully Open" ;
VAL_TABLE_ WthrSnwModeDrvlineVisDispVal 0 "Setting_Unknown" 1 "Custom_Mode_1" 2 "Custom_Mode_2" 3 "Custom_Mode_3" 4 "Custom_Mode_4" 5 "Custom_Mode_5" 6 "Custom_Mode_6" 7 "Custom_Mode_7" ;
VAL_TABLE_ WthrSnwModeBrkPedVisDispVal 0 "Setting_Unknown" 1 "Custom_Mode_1" 2 "Custom_Mode_2" 3 "Custom_Mode_3" 4 "Custom_Mode_4" 5 "Custom_Mode_5" 6 "Custom_Mode_6" 7 "Custom_Mode_7" ;
VAL_TABLE_ WthrSnwModeActvAeroVisDispVal 0 "Setting_Unknown" 1 "Custom_Mode_1" 2 "Custom_Mode_2" 3 "Custom_Mode_3" 4 "Custom_Mode_4" 5 "Custom_Mode_5" 6 "Custom_Mode_6" 7 "Custom_Mode_7" ;
VAL_TABLE_ WthrSnwModeRideHghtVisDispVal 0 "Setting_Unknown" 1 "Custom_Mode_1" 2 "Custom_Mode_2" 3 "Custom_Mode_3" 4 "Custom_Mode_4" 5 "Custom_Mode_5" 6 "Custom_Mode_6" 7 "Custom_Mode_7" ;
VAL_TABLE_ WthrSnwModePwrtrnVisDispVal 0 "Setting_Unknown" 1 "Custom_Mode_1" 2 "Custom_Mode_2" 3 "Custom_Mode_3" 4 "Custom_Mode_4" 5 "Custom_Mode_5" 6 "Custom_Mode_6" 7 "Custom_Mode_7" ;
VAL_TABLE_ WthrSnwModeESCVisDispVal 0 "Setting_Unknown" 1 "Custom_Mode_1" 2 "Custom_Mode_2" 3 "Custom_Mode_3" 4 "Custom_Mode_4" 5 "Custom_Mode_5" 6 "Custom_Mode_6" 7 "Custom_Mode_7" ;
VAL_TABLE_ WthrSnwModeSpnsnVisDispVal 0 "Setting_Unknown" 1 "Custom_Mode_1" 2 "Custom_Mode_2" 3 "Custom_Mode_3" 4 "Custom_Mode_4" 5 "Custom_Mode_5" 6 "Custom_Mode_6" 7 "Custom_Mode_7" ;
VAL_TABLE_ WthrSnwModeSndVisDispVal 0 "Setting_Unknown" 1 "Custom_Mode_1" 2 "Custom_Mode_2" 3 "Custom_Mode_3" 4 "Custom_Mode_4" 5 "Custom_Mode_5" 6 "Custom_Mode_6" 7 "Custom_Mode_7" ;
VAL_TABLE_ CmdSndRwCtStbtVisInd 0 "No Indication" 1 "Unbuckled Indication" 2 "Buckled Indication" 3 "Unbuckled Flashing Indication" ;
VAL_TABLE_ CltTpTrvAchv 0 "FALSE" 1 "TRUE" ;
VAL_TABLE_ CltTpTrvAchv_Inv 0 "FALSE" 1 "TRUE" ;
VAL_TABLE_ AdvdFrtLgtSysIndReq 0 "NO INDICATION" 1 "FAILURE INDICATION" 2 "TOURIST MODE SETTING CHANGED" 3 "TOURIST MODE REMINDER" ;
VAL_TABLE_ ACCHdwySttng 0 "FAR" 1 "MEDIUM" 2 "NEAR" ;
VAL_TABLE_ CmdThrdRwLtStbtVisInd 0 "No Indication" 1 "Unbuckled Indication" 2 "Buckled Indication" 3 "Unbuckled Flashing Indication" ;
VAL_TABLE_ CmdThrdRwCtStbtVisInd 0 "No Indication" 1 "Unbuckled Indication" 2 "Buckled Indication" 3 "Unbuckled Flashing Indication" ;
VAL_TABLE_ CmdSndRwRtStbtVisInd 0 "No Indication" 1 "Unbuckled Indication" 2 "Buckled Indication" 3 "Unbuckled Flashing Indication" ;
VAL_TABLE_ CmdSndRwLtStbtVisInd 0 "No Indication" 1 "Unbuckled Indication" 2 "Buckled Indication" 3 "Unbuckled Flashing Indication" ;
VAL_TABLE_ ElecShftrLckdHldBrkToOvrrdIndOn 0 "FALSE" 1 "TRUE" ;
VAL_TABLE_ CmdThrdRwRtStbtVisInd 0 "No Indication" 1 "Unbuckled Indication" 2 "Buckled Indication" 3 "Unbuckled Flashing Indication" ;
VAL_TABLE_ ElecAxlUnvIndReq 0 "No Indication" 1 "Limited" 2 "Faulted" ;
VAL_TABLE_ ElecAxlBstGageIndReq 0 "Normal" 1 "Temporarily Unavailable" 2 "Unavailable" ;
VAL_TABLE_ DslEmnsOBDMrkt 0 "North America" 1 "LD Europe" 2 "HD Europe" ;
VAL_TABLE_ LnCntrSpchPrmtReq 0 "No Prompt" 1 "Take Steering" 2 "Take Vehicle Control" ;
VAL_TABLE_ GlrFrHiBmSts 0 "OFF" 1 "AHBA" 2 "GFHB" ;
VAL_TABLE_ EngCmptHotWrnIndReq 0 "Off" 1 "Service" 2 "Hot Idle" 3 "Hot" ;
VAL_TABLE_ ElecShftPrTwoGrsSelIndRq 0 "OFF" 1 "PARK" 2 "NEUTRAL" 3 "DRIVE" ;
VAL_TABLE_ ROSP_FrntPsRestOcpStatAuth 0 "Unknown" 1 "Empty" 2 "Empty or Occupied_Non-Adult" 3 "Occupied_Adult" ;
VAL_TABLE_ PdWrnIndRqst 0 "OFF" 1 "PEDESTRIAN ADVISORY" 2 "PEDESTRIAN ALERT" 3 "RESERVED" ;
VAL_TABLE_ PPVehRadioMutReq 0 "Unknown" 1 "Mute Requested" 2 "Mute Not Requested" ;
VAL_TABLE_ NtVsnFncSts 0 "Normal" 1 "Limited" 2 "Unavailable" 3 "Invalid" ;
VAL_TABLE_ ACCSysSlctdMdDspIndOn 0 "FALSE" 1 "TRUE" ;
VAL_TABLE_ ACCShftToPrkBfrExIndOn 0 "FALSE" 1 "TRUE" ;
VAL_TABLE_ WhlSlpSt 0 "No Slip Detected" 1 "Negative Slip Detected" 2 "Positive Slip Detected" 3 "Slip Detection Fault" ;
VAL_TABLE_ VehMassEstSts 0 "Undetermined" 1 "Degraded" 2 "Normal" ;
VAL_TABLE_ TrlrArtclnAngCalSts 0 "Unknown" 1 "Available" 2 "Degraded" 3 "Unavailable" ;
VAL_TABLE_ AutoLnChgCstAvlFlg3 0 "FALSE" 1 "TRUE" ;
VAL_TABLE_ AutoLnChgCstAvlFlg2 0 "FALSE" 1 "TRUE" ;
VAL_TABLE_ AutoLnChgCstAvlFlg1 0 "FALSE" 1 "TRUE" ;
VAL_TABLE_ AutoBmSlctAllwd 0 "FALSE" 1 "TRUE" ;
VAL_TABLE_ AirCndOffIO 0 "FALSE" 1 "TRUE" ;
VAL_TABLE_ AdptCrsCntrlEngd 0 "FALSE" 1 "TRUE" ;
VAL_TABLE_ ACCompCmnd 0 "Off" 1 "On" ;
VAL_TABLE_ ACCTmpUnvIndOn 0 "FALSE" 1 "TRUE" ;
VAL_TABLE_ AutoTrnspHdActvnCstAvlFlg3 0 "FALSE" 1 "TRUE" ;
VAL_TABLE_ AutoTrnspHdActvnCstAvlFlg2 0 "FALSE" 1 "TRUE" ;
VAL_TABLE_ AutoTrnspHdActvnCstAvlFlg1 0 "FALSE" 1 "TRUE" ;
VAL_TABLE_ AutoLnChgCstSetAval 0 "FALSE" 1 "TRUE" ;
VAL_TABLE_ AutoLnChgCstAvlFlg7 0 "FALSE" 1 "TRUE" ;
VAL_TABLE_ AutoLnChgCstAvlFlg6 0 "FALSE" 1 "TRUE" ;
VAL_TABLE_ AutoLnChgCstAvlFlg5 0 "FALSE" 1 "TRUE" ;
VAL_TABLE_ AutoLnChgCstAvlFlg4 0 "FALSE" 1 "TRUE" ;
VAL_TABLE_ DCCnvStblznErrIndOn 0 "FALSE" 1 "TRUE" ;
VAL_TABLE_ CustmStbCtlRdctReqIndOn 0 "FALSE" 1 "TRUE" ;
VAL_TABLE_ AxlLcksServIO 0 "FALSE" 1 "TRUE" ;
VAL_TABLE_ AutoTrnspHdActvnCstSetAval 0 "FALSE" 1 "TRUE" ;
VAL_TABLE_ AutoTrnspHdActvnCstAvlFlg7 0 "FALSE" 1 "TRUE" ;
VAL_TABLE_ AutoTrnspHdActvnCstAvlFlg6 0 "FALSE" 1 "TRUE" ;
VAL_TABLE_ AutoTrnspHdActvnCstAvlFlg5 0 "FALSE" 1 "TRUE" ;
VAL_TABLE_ AutoTrnspHdActvnCstAvlFlg4 0 "FALSE" 1 "TRUE" ;
VAL_TABLE_ DM8Denied 0 "FALSE" 1 "TRUE" ;
VAL_TABLE_ DM7Denied 0 "FALSE" 1 "TRUE" ;
VAL_TABLE_ DM6Denied 0 "FALSE" 1 "TRUE" ;
VAL_TABLE_ DM5Denied 0 "FALSE" 1 "TRUE" ;
VAL_TABLE_ DM4Denied 0 "FALSE" 1 "TRUE" ;
VAL_TABLE_ DM3Denied 0 "FALSE" 1 "TRUE" ;
VAL_TABLE_ DM2Denied 0 "FALSE" 1 "TRUE" ;
VAL_TABLE_ DM1Denied 0 "FALSE" 1 "TRUE" ;
VAL_TABLE_ ElecShfPriTransCtlrMalfIndOn 0 "FALSE" 1 "TRUE" ;
VAL_TABLE_ ElecShfPriShfToDrvTryAgnIndOn 0 "FALSE" 1 "TRUE" ;
VAL_TABLE_ ElecShfPriRdcSpdForReqdShfIndOn 0 "FALSE" 1 "TRUE" ;
VAL_TABLE_ ElecShfLckdBcklPsngrStBltIndOn 0 "FALSE" 1 "TRUE" ;
VAL_TABLE_ ElecShfLckdBcklDrvrStBltIndOn 0 "FALSE" 1 "TRUE" ;
VAL_TABLE_ DrSlctdSpdLmtrEnbld 0 "FALSE" 1 "TRUE" ;
VAL_TABLE_ DrSlctdSpdLmtrActv 0 "FALSE" 1 "TRUE" ;
VAL_TABLE_ ElecShftPrDrDoorStIndIO 0 "FALSE" 1 "TRUE" ;
VAL_TABLE_ ElecShftPrAtPrkIO 0 "FALSE" 1 "TRUE" ;
VAL_TABLE_ ElecShfUnlckdBrkToShfIndOn 0 "FALSE" 1 "TRUE" ;
VAL_TABLE_ ElecShfPriTrnVehOffForPrkIndOn 0 "FALSE" 1 "TRUE" ;
VAL_TABLE_ ElecShftPrTrnMlfIO 0 "FALSE" 1 "TRUE" ;
VAL_TABLE_ ElecShftPrRngInvRqIO 0 "FALSE" 1 "TRUE" ;
VAL_TABLE_ ElecShftPrPrkInvRqIO 0 "FALSE" 1 "TRUE" ;
VAL_TABLE_ ElecShftPrLtdPrfMdIO 0 "FALSE" 1 "TRUE" ;
VAL_TABLE_ ElecShftPrHldShftLevEngRngIO 0 "FALSE" 1 "TRUE" ;
VAL_TABLE_ ElecShftPrDrPrkIntShftAtmpIO 0 "FALSE" 1 "TRUE" ;
VAL_TABLE_ ElecShftPrDrIntShftAtmpIO 0 "FALSE" 1 "TRUE" ;
VAL_TABLE_ ElecShftPrDrExitIO 0 "FALSE" 1 "TRUE" ;
VAL_TABLE_ FrwdCllsnSysRdIndOn 0 "FALSE" 1 "TRUE" ;
VAL_TABLE_ FrwdCllsnSysOffIndOn 0 "FALSE" 1 "TRUE" ;
VAL_TABLE_ FrwdCllsnAlrtOffIndOn 0 "FALSE" 1 "TRUE" ;
VAL_TABLE_ FrtPedtrnBrkgWrnIndOn 0 "FALSE" 1 "TRUE" ;
VAL_TABLE_ FrntAxlLckIO 0 "FALSE" 1 "TRUE" ;
VAL_TABLE_ FrFgLmpIO 0 "FALSE" 1 "TRUE" ;
VAL_TABLE_ EngNEmsnsRltMlfnAct 0 "FALSE" 1 "TRUE" ;
VAL_TABLE_ EngCstFlCtOffAct 0 "FALSE" 1 "TRUE" ;
VAL_TABLE_ LnCntrArrwBlck4Act 0 "FALSE" 1 "TRUE" ;
VAL_TABLE_ LnCntrArrwBlck3Act 0 "FALSE" 1 "TRUE" ;
VAL_TABLE_ LnCntrArrwBlck2Act 0 "FALSE" 1 "TRUE" ;
VAL_TABLE_ LnCntrArrwBlck1Act 0 "FALSE" 1 "TRUE" ;
VAL_TABLE_ HzrdReqActv 0 "FALSE" 1 "TRUE" ;
VAL_TABLE_ GenFld 0 "FALSE" 1 "TRUE" ;
VAL_TABLE_ FrwdClsnSysIndOn 0 "FALSE" 1 "TRUE" ;
VAL_TABLE_ FrwdCllsnSysUnIndOn 0 "FALSE" 1 "TRUE" ;
VAL_TABLE_ LvlgSysEntEgrsMdCstAvlFlg3 0 "FALSE" 1 "TRUE" ;
VAL_TABLE_ LvlgSysEntEgrsMdCstAvlFlg2 0 "FALSE" 1 "TRUE" ;
VAL_TABLE_ LvlgSysEntEgrsMdCstAvlFlg1 0 "FALSE" 1 "TRUE" ;
VAL_TABLE_ LvlgSysAlgnMdCstAvlFlg7 0 "FALSE" 1 "TRUE" ;
VAL_TABLE_ LvlgSysAlgnMdCstAvlFlg6 0 "FALSE" 1 "TRUE" ;
VAL_TABLE_ LnKpAsstUnAvIndOn 0 "FALSE" 1 "TRUE" ;
VAL_TABLE_ LnDprtrWrngUnAvIndOn 0 "FALSE" 1 "TRUE" ;
VAL_TABLE_ LnCntrArrwBlck5Act 0 "FALSE" 1 "TRUE" ;
VAL_TABLE_ LvlgSysServMdCstAvlFlg4 0 "FALSE" 1 "TRUE" ;
VAL_TABLE_ LvlgSysServMdCstAvlFlg3 0 "FALSE" 1 "TRUE" ;
VAL_TABLE_ LvlgSysServMdCstAvlFlg2 0 "FALSE" 1 "TRUE" ;
VAL_TABLE_ LvlgSysServMdCstAvlFlg1 0 "FALSE" 1 "TRUE" ;
VAL_TABLE_ LvlgSysEntEgrsMdCstAvlFlg7 0 "FALSE" 1 "TRUE" ;
VAL_TABLE_ LvlgSysEntEgrsMdCstAvlFlg6 0 "FALSE" 1 "TRUE" ;
VAL_TABLE_ LvlgSysEntEgrsMdCstAvlFlg5 0 "FALSE" 1 "TRUE" ;
VAL_TABLE_ LvlgSysEntEgrsMdCstAvlFlg4 0 "FALSE" 1 "TRUE" ;
VAL_TABLE_ PrkAsstActIndCmnd 0 "FALSE" 1 "TRUE" ;
VAL_TABLE_ NoKeyDtdElecShfDndIndOn 0 "FALSE" 1 "TRUE" ;
VAL_TABLE_ MemStorTmdOutIndOn 0 "FALSE" 1 "TRUE" ;
VAL_TABLE_ MemStorPrssSetFrstIndOn 0 "FALSE" 1 "TRUE" ;
VAL_TABLE_ MemSeeAutoRclSetsIndOn 0 "FALSE" 1 "TRUE" ;
VAL_TABLE_ LvlgSysServMdCstAvlFlg7 0 "FALSE" 1 "TRUE" ;
VAL_TABLE_ LvlgSysServMdCstAvlFlg6 0 "FALSE" 1 "TRUE" ;
VAL_TABLE_ LvlgSysServMdCstAvlFlg5 0 "FALSE" 1 "TRUE" ;
VAL_TABLE_ SftTpFlrIO 0 "FALSE" 1 "TRUE" ;
VAL_TABLE_ RrVirtBmpAutoBrkRelIndOn 0 "FALSE" 1 "TRUE" ;
VAL_TABLE_ RrFgLmpIO 0 "FALSE" 1 "TRUE" ;
VAL_TABLE_ RrAxlLckIO 0 "FALSE" 1 "TRUE" ;
VAL_TABLE_ RmtRflshDispActvnReq 0 "FALSE" 1 "TRUE" ;
VAL_TABLE_ RmtRflshCmpgnAval 0 "FALSE" 1 "TRUE" ;
VAL_TABLE_ ROSP_FrtPsRestOcpFltIndAuth 0 "FALSE" 1 "TRUE" ;
VAL_TABLE_ StNtLtchdIO 0 "FALSE" 1 "TRUE" ;
VAL_TABLE_ SrvPedtrnProtSysIO 0 "FALSE" 1 "TRUE" ;
VAL_TABLE_ SrvFrwdCllsnSysIndOn 0 "FALSE" 1 "TRUE" ;
VAL_TABLE_ SrvDvrAsstSystVslMsgRqstOn 0 "FALSE" 1 "TRUE" ;
VAL_TABLE_ SftTpVltLwIO 0 "FALSE" 1 "TRUE" ;
VAL_TABLE_ SftTpVehOvSpdIO 0 "FALSE" 1 "TRUE" ;
VAL_TABLE_ SftTpTmpLwIO 0 "FALSE" 1 "TRUE" ;
VAL_TABLE_ TrlrFgLtFld 0 "FALSE" 1 "TRUE" ;
VAL_TABLE_ TrlrDisconndIndOn 0 "FALSE" 1 "TRUE" ;
VAL_TABLE_ TrlrBrkLtFld 0 "FALSE" 1 "TRUE" ;
VAL_TABLE_ TrlLfTrInLtFld 0 "FALSE" 1 "TRUE" ;
VAL_TABLE_ TnDrvRIMOFFUnvIndOn 0 "FALSE" 1 "TRUE" ;
VAL_TABLE_ TnDrvGapAdjUnvIndOn 0 "FALSE" 1 "TRUE" ;
VAL_TABLE_ TeenDrvrLnDprtrWrnOffUnvIndOn 0 "FALSE" 1 "TRUE" ;
VAL_TABLE_ StlthModeActv 0 "FALSE" 1 "TRUE" ;
VAL_TABLE_ TrnsEmsRltMlfAtv 0 "FALSE" 1 "TRUE" ;
VAL_TABLE_ TrnLmpRrRtOtgIndOn 0 "FALSE" 1 "TRUE" ;
VAL_TABLE_ TrnLmpRrLtOtgIndOn 0 "FALSE" 1 "TRUE" ;
VAL_TABLE_ TrnLmpFrtRtOtgIndOn 0 "FALSE" 1 "TRUE" ;
VAL_TABLE_ TrnLmpFrtLtOtgIndOn 0 "FALSE" 1 "TRUE" ;
VAL_TABLE_ TrlrTlLtFld 0 "FALSE" 1 "TRUE" ;
VAL_TABLE_ TrlrRvrsLmpOtgIndOn 0 "FALSE" 1 "TRUE" ;
VAL_TABLE_ TrlrRtTrInLtFld 0 "FALSE" 1 "TRUE" ;
VAL_TABLE_ SnrfActlPstn 0 "0%" 1 "10%" 2 "20%" 3 "30%" 4 "40%" 5 "50%" 6 "60%" 7 "70%" 8 "80%" 9 "90%" 10 "100%" 11 "Between Positions" 12 "Vent" 13 "Comfort Open" ;
VAL_TABLE_ TrnsThrmlMngmntSt 0 "Normal" 1 "Countermeasures Active" 2 "Driver Intervention Requested" ;
VAL_TABLE_ VltSwAtvIO 0 "FALSE" 1 "TRUE" ;
VAL_TABLE_ UIDInStatusSD 0 "Not Present" 1 "Present" ;
VAL_TABLE_ TrnstStrgLogisticsMdActivation 0 "FALSE" 1 "TRUE" ;
VAL_TABLE_ TrnsOilChngIO 0 "FALSE" 1 "TRUE" ;
VAL_TABLE_ TrnsNEmsRltMlfActv 0 "FALSE" 1 "TRUE" ;
VAL_TABLE_ ADASMsgDispLocNonActvInd 0 "None" 1 "Cluster Display" 2 "Center Stack Display" 3 "Both" ;
VAL_TABLE_ ADASMsgDispLocLtdPerfStatInd 0 "None" 1 "Cluster Display" 2 "Center Stack Display" 3 "Both" ;
VAL_TABLE_ ArflBsdOnOccpRrPsCstCurrSetVal 0 "Setting Unknown" 1 "Off" 2 "On" ;
VAL_TABLE_ ArflBsdOnOccpFrtPsCstCurrSetVal 0 "Setting Unknown" 1 "Off" 2 "On" ;
VAL_TABLE_ ADASTrmLvlInd 0 "None" 1 "Super" 2 "Ultra" ;
VAL_TABLE_ LnCntrWrn2IndReq 0 "No Indication" 1 "Hill Descent Control Active" 2 "Power Take Off Active" 3 "Road Users Too Close" 4 "Unknown Object Too Close" 5 "Turn Signal is On" 6 "Excessive Acceleration" 7 "Door is Open" 8 "Traction Control Event" 9 "Traction Control Off" 10 "VSC Event" 11 "VSC Off" 12 "Release Parking Brake" 13 "Transfer Case Setting" 14 "Battery Low" 15 "Speed Limiter Active or Being Activated" 16 "Steep Road" 17 "Switch Gear to Drive" 18 "Regen Active" 19 "Brakes Overheated" 20 "No Route Information" 21 "Ultra Cruise Accelerator Pressed" 22 "Approaching Emergency Vehicle" 23 "Construction Zone Approaching" 24 "Railroad Approaching" 25 "Weather" ;
VAL_TABLE_ SprTireSt 0 "Undetermined" 1 "No Spare Detected" 2 "Spare Detected" ;
VAL_TABLE_ BrkFldLvlSt 0 "Normal" 1 "Low" 2 "Unknown" ;
VAL_TABLE_ ACRfHiSdFldPrs_Inv 0 "FALSE" 1 "TRUE" ;
VAL_TABLE_ ArbdEngTemp_Inv 0 "FALSE" 1 "TRUE" ;
VAL_TABLE_ BarPrsAbs_Inv 0 "FALSE" 1 "TRUE" ;
VAL_TABLE_ DslExhFldLvlPct_Inv 0 "FALSE" 1 "TRUE" ;
VAL_TABLE_ ElecMtrARotrTemp_Inv 0 "FALSE" 1 "TRUE" ;
VAL_TABLE_ ElecMtrASttrTemp_Inv 0 "FALSE" 1 "TRUE" ;
VAL_TABLE_ HiVltgBatMaxTemp_Inv 0 "FALSE" 1 "TRUE" ;
VAL_TABLE_ ABSPr 0 "FALSE" 1 "TRUE" ;
VAL_TABLE_ HiVltgBatMinTemp_Inv 0 "FALSE" 1 "TRUE" ;
VAL_TABLE_ TrnsOilTmp_Inv 0 "FALSE" 1 "TRUE" ;
VAL_TABLE_ TireTmpLF_Inv 0 "FALSE" 1 "TRUE" ;
VAL_TABLE_ AdpLghtRspTypCstAvlFlg2 0 "FALSE" 1 "TRUE" ;
VAL_TABLE_ AdpLghtRspTypCstAvlFlg1 0 "FALSE" 1 "TRUE" ;
VAL_TABLE_ TireTmpLR_Inv 0 "FALSE" 1 "TRUE" ;
VAL_TABLE_ TireTmpRF_Inv 0 "FALSE" 1 "TRUE" ;
VAL_TABLE_ TireTmpRR_Inv 0 "FALSE" 1 "TRUE" ;
VAL_TABLE_ FrtRdHgtGPSCstAvlbltyFlg7 0 "FALSE" 1 "TRUE" ;
VAL_TABLE_ FrtRdHgtGPSCstAvlbltyFlg6 0 "FALSE" 1 "TRUE" ;
VAL_TABLE_ FrtRdHgtGPSCstAvlbltyFlg5 0 "FALSE" 1 "TRUE" ;
VAL_TABLE_ FrtRdHgtGPSCstAvlbltyFlg4 0 "FALSE" 1 "TRUE" ;
VAL_TABLE_ FrtRdHgtGPSCstAvlbltyFlg3 0 "FALSE" 1 "TRUE" ;
VAL_TABLE_ FrtRdHgtGPSCstAvlbltyFlg2 0 "FALSE" 1 "TRUE" ;
VAL_TABLE_ FrtRdHgtGPSCstAvlbltyFlg1 0 "FALSE" 1 "TRUE" ;
VAL_TABLE_ AdpLghtRspTypCstAvlFlg3 0 "FALSE" 1 "TRUE" ;
VAL_TABLE_ LvlgSysAlgnMdCstAvlFlg1 0 "FALSE" 1 "TRUE" ;
VAL_TABLE_ LtRtHnTrCstAvlFlg7 0 "FALSE" 1 "TRUE" ;
VAL_TABLE_ LtRtHnTrCstAvlFlg6 0 "FALSE" 1 "TRUE" ;
VAL_TABLE_ LtRtHnTrCstAvlFlg5 0 "FALSE" 1 "TRUE" ;
VAL_TABLE_ LtRtHnTrCstAvlFlg4 0 "FALSE" 1 "TRUE" ;
VAL_TABLE_ LtRtHnTrCstAvlFlg3 0 "FALSE" 1 "TRUE" ;
VAL_TABLE_ LtRtHnTrCstAvlFlg2 0 "FALSE" 1 "TRUE" ;
VAL_TABLE_ LtRtHnTrCstAvlFlg1 0 "FALSE" 1 "TRUE" ;
VAL_TABLE_ PrkAsstONOFFCstAvlFlg3 0 "FALSE" 1 "TRUE" ;
VAL_TABLE_ PrkAsstONOFFCstAvlFlg2 0 "FALSE" 1 "TRUE" ;
VAL_TABLE_ PrkAsstONOFFCstAvlFlg1 0 "FALSE" 1 "TRUE" ;
VAL_TABLE_ PTHiElecLdReqd 0 "FALSE" 1 "TRUE" ;
VAL_TABLE_ LvlgSysAlgnMdCstAvlFlg5 0 "FALSE" 1 "TRUE" ;
VAL_TABLE_ LvlgSysAlgnMdCstAvlFlg4 0 "FALSE" 1 "TRUE" ;
VAL_TABLE_ LvlgSysAlgnMdCstAvlFlg3 0 "FALSE" 1 "TRUE" ;
VAL_TABLE_ LvlgSysAlgnMdCstAvlFlg2 0 "FALSE" 1 "TRUE" ;
VAL_TABLE_ PrkAsstTrHtchPsntCstAvlFlg4 0 "FALSE" 1 "TRUE" ;
VAL_TABLE_ PrkAsstTrHtchPsntCstAvlFlg3 0 "FALSE" 1 "TRUE" ;
VAL_TABLE_ PrkAsstTrHtchPsntCstAvlFlg2 0 "FALSE" 1 "TRUE" ;
VAL_TABLE_ PrkAsstTrHtchPsntCstAvlFlg1 0 "FALSE" 1 "TRUE" ;
VAL_TABLE_ PrkAsstONOFFCstAvlFlg7 0 "FALSE" 1 "TRUE" ;
VAL_TABLE_ PrkAsstONOFFCstAvlFlg6 0 "FALSE" 1 "TRUE" ;
VAL_TABLE_ PrkAsstONOFFCstAvlFlg5 0 "FALSE" 1 "TRUE" ;
VAL_TABLE_ PrkAsstONOFFCstAvlFlg4 0 "FALSE" 1 "TRUE" ;
VAL_TABLE_ RnngBrdAutoDplyCstAvlFlg5 0 "FALSE" 1 "TRUE" ;
VAL_TABLE_ RnngBrdAutoDplyCstAvlFlg4 0 "FALSE" 1 "TRUE" ;
VAL_TABLE_ RnngBrdAutoDplyCstAvlFlg3 0 "FALSE" 1 "TRUE" ;
VAL_TABLE_ RnngBrdAutoDplyCstAvlFlg2 0 "FALSE" 1 "TRUE" ;
VAL_TABLE_ RnngBrdAutoDplyCstAvlFlg1 0 "FALSE" 1 "TRUE" ;
VAL_TABLE_ PrkAsstTrHtchPsntCstAvlFlg7 0 "FALSE" 1 "TRUE" ;
VAL_TABLE_ PrkAsstTrHtchPsntCstAvlFlg6 0 "FALSE" 1 "TRUE" ;
VAL_TABLE_ PrkAsstTrHtchPsntCstAvlFlg5 0 "FALSE" 1 "TRUE" ;
VAL_TABLE_ RnngBrdManDplyCstAvlFlg6 0 "FALSE" 1 "TRUE" ;
VAL_TABLE_ RnngBrdManDplyCstAvlFlg5 0 "FALSE" 1 "TRUE" ;
VAL_TABLE_ RnngBrdManDplyCstAvlFlg4 0 "FALSE" 1 "TRUE" ;
VAL_TABLE_ RnngBrdManDplyCstAvlFlg3 0 "FALSE" 1 "TRUE" ;
VAL_TABLE_ RnngBrdManDplyCstAvlFlg2 0 "FALSE" 1 "TRUE" ;
VAL_TABLE_ RnngBrdManDplyCstAvlFlg1 0 "FALSE" 1 "TRUE" ;
VAL_TABLE_ RnngBrdAutoDplyCstAvlFlg7 0 "FALSE" 1 "TRUE" ;
VAL_TABLE_ RnngBrdAutoDplyCstAvlFlg6 0 "FALSE" 1 "TRUE" ;
VAL_TABLE_ RrVwPrkAstSymCsAvlFlg7 0 "FALSE" 1 "TRUE" ;
VAL_TABLE_ RrVwPrkAstSymCsAvlFlg6 0 "FALSE" 1 "TRUE" ;
VAL_TABLE_ RrVwPrkAstSymCsAvlFlg5 0 "FALSE" 1 "TRUE" ;
VAL_TABLE_ RrVwPrkAstSymCsAvlFlg4 0 "FALSE" 1 "TRUE" ;
VAL_TABLE_ RrVwPrkAstSymCsAvlFlg3 0 "FALSE" 1 "TRUE" ;
VAL_TABLE_ RrVwPrkAstSymCsAvlFlg2 0 "FALSE" 1 "TRUE" ;
VAL_TABLE_ RrVwPrkAstSymCsAvlFlg1 0 "FALSE" 1 "TRUE" ;
VAL_TABLE_ RnngBrdManDplyCstAvlFlg7 0 "FALSE" 1 "TRUE" ;
VAL_TABLE_ StBltTghtngCstAvlFlg1 0 "FALSE" 1 "TRUE" ;
VAL_TABLE_ SrrndVwLghtCsAvlFlg7 0 "FALSE" 1 "TRUE" ;
VAL_TABLE_ SrrndVwLghtCsAvlFlg6 0 "FALSE" 1 "TRUE" ;
VAL_TABLE_ SrrndVwLghtCsAvlFlg5 0 "FALSE" 1 "TRUE" ;
VAL_TABLE_ SrrndVwLghtCsAvlFlg4 0 "FALSE" 1 "TRUE" ;
VAL_TABLE_ SrrndVwLghtCsAvlFlg3 0 "FALSE" 1 "TRUE" ;
VAL_TABLE_ SrrndVwLghtCsAvlFlg2 0 "FALSE" 1 "TRUE" ;
VAL_TABLE_ SrrndVwLghtCsAvlFlg1 0 "FALSE" 1 "TRUE" ;
VAL_TABLE_ TnDrvStBltShfIntlkCstAvlFlg2 0 "FALSE" 1 "TRUE" ;
VAL_TABLE_ TnDrvStBltShfIntlkCstAvlFlg1 0 "FALSE" 1 "TRUE" ;
VAL_TABLE_ StBltTghtngCstAvlFlg7 0 "FALSE" 1 "TRUE" ;
VAL_TABLE_ StBltTghtngCstAvlFlg6 0 "FALSE" 1 "TRUE" ;
VAL_TABLE_ StBltTghtngCstAvlFlg5 0 "FALSE" 1 "TRUE" ;
VAL_TABLE_ StBltTghtngCstAvlFlg4 0 "FALSE" 1 "TRUE" ;
VAL_TABLE_ StBltTghtngCstAvlFlg3 0 "FALSE" 1 "TRUE" ;
VAL_TABLE_ StBltTghtngCstAvlFlg2 0 "FALSE" 1 "TRUE" ;
VAL_TABLE_ TrlrMirVidEnblCstAvlFlg3 0 "FALSE" 1 "TRUE" ;
VAL_TABLE_ TrlrMirVidEnblCstAvlFlg2 0 "FALSE" 1 "TRUE" ;
VAL_TABLE_ TrlrMirVidEnblCstAvlFlg1 0 "FALSE" 1 "TRUE" ;
VAL_TABLE_ TnDrvStBltShfIntlkCstAvlFlg7 0 "FALSE" 1 "TRUE" ;
VAL_TABLE_ TnDrvStBltShfIntlkCstAvlFlg6 0 "FALSE" 1 "TRUE" ;
VAL_TABLE_ TnDrvStBltShfIntlkCstAvlFlg5 0 "FALSE" 1 "TRUE" ;
VAL_TABLE_ TnDrvStBltShfIntlkCstAvlFlg4 0 "FALSE" 1 "TRUE" ;
VAL_TABLE_ TnDrvStBltShfIntlkCstAvlFlg3 0 "FALSE" 1 "TRUE" ;
VAL_TABLE_ TrlrMirVidGdlnsCstAvlFlg4 0 "FALSE" 1 "TRUE" ;
VAL_TABLE_ TrlrMirVidGdlnsCstAvlFlg3 0 "FALSE" 1 "TRUE" ;
VAL_TABLE_ TrlrMirVidGdlnsCstAvlFlg2 0 "FALSE" 1 "TRUE" ;
VAL_TABLE_ TrlrMirVidGdlnsCstAvlFlg1 0 "FALSE" 1 "TRUE" ;
VAL_TABLE_ TrlrMirVidEnblCstAvlFlg7 0 "FALSE" 1 "TRUE" ;
VAL_TABLE_ TrlrMirVidEnblCstAvlFlg6 0 "FALSE" 1 "TRUE" ;
VAL_TABLE_ TrlrMirVidEnblCstAvlFlg5 0 "FALSE" 1 "TRUE" ;
VAL_TABLE_ TrlrMirVidEnblCstAvlFlg4 0 "FALSE" 1 "TRUE" ;
VAL_TABLE_ CrshEvntEnbld 0 "FALSE" 1 "TRUE" ;
VAL_TABLE_ TmngBltChgIndOn 0 "FALSE" 1 "TRUE" ;
VAL_TABLE_ TrnsOlTmpSnsPrs 0 "FALSE" 1 "TRUE" ;
VAL_TABLE_ TrlrMirVidGdlnsCstAvlFlg7 0 "FALSE" 1 "TRUE" ;
VAL_TABLE_ TrlrMirVidGdlnsCstAvlFlg6 0 "FALSE" 1 "TRUE" ;
VAL_TABLE_ TrlrMirVidGdlnsCstAvlFlg5 0 "FALSE" 1 "TRUE" ;
VAL_TABLE_ CSI_ChmPrdcrSOH 0 "Unknown" 1 "Healthy" 2 "Faulted" ;
VAL_TABLE_ ClstrDspAnmReq 0 "NoAction" 1 "Ready" 2 "WelcomePlay" 3 "StartPlay" 4 "ShutdownPlay" ;
VAL_TABLE_ OATDispdVal_DuD 0 "FALSE" 1 "TRUE" ;
VAL_TABLE_ IPC_LCMDataMsgStat 0 "No Action" 1 "Acknowledge" ;
VAL_TABLE_ IPC_LCMFileTrans 0 "No Action" 1 "Begin Transfer" 2 "Successful Block Transfer" 3 "Cancel Transfer" 4 "Retry Last Block" ;
VAL_TABLE_ HVACICRTLR_LtLvlActv 0 "FALSE" 1 "TRUE" ;
VAL_TABLE_ HVACICRTLR_RtLvlActv 0 "FALSE" 1 "TRUE" ;
VAL_TABLE_ HVACICRADSR_LtSet 0 "NoAction" 1 "Auto" 2 "Floor" 3 "FloorAndVent" 4 "Vent" 5 "VentAndRoof" 6 "Roof" 7 "RoofAndFloor" 8 "FloorAndVentAndRoof" ;
VAL_TABLE_ HVACICRADSR_RtSet 0 "NoAction" 1 "Auto" 2 "Floor" 3 "FloorAndVent" 4 "Vent" 5 "VentAndRoof" 6 "Roof" 7 "RoofAndFloor" 8 "FloorAndVentAndRoof" ;
VAL_TABLE_ HVACInfoCtlReqRrDfgSet 0 "NoAction" 1 "RearDefogOFF" 2 "RearDefogON" ;
VAL_TABLE_ HVACInfoCtlReqSyncSet 0 "NoAction" 1 "SYNC_all" 2 "UnSYNC_all" 3 "SYNC_Rear_to_Driver" 4 "UnSYNC_Rear_to_Driver" 5 "SYNC_3rd_Row_to_Driver" 6 "UnSYNC_3rd_Row_to_Driver" ;
VAL_TABLE_ HVACICRBLR_LvlActv 0 "FALSE" 1 "TRUE" ;
VAL_TABLE_ HVACInfoCtlReqRrPwrSetChg 0 "FALSE" 1 "TRUE" ;
VAL_TABLE_ HVACInfoCtlReqRrLckSetChg 0 "FALSE" 1 "TRUE" ;
VAL_TABLE_ HVACInfoCtlReqRrDfgSetChg 0 "FALSE" 1 "TRUE" ;
VAL_TABLE_ HVACInfoCtlReqRrAutoSetChg 0 "FALSE" 1 "TRUE" ;
VAL_TABLE_ HVACInfoCtlReqBlwSpdRdct 0 "FALSE" 1 "TRUE" ;
VAL_TABLE_ HVACICRADSCR_RtChgNext 0 "FALSE" 1 "TRUE" ;
VAL_TABLE_ HVACICRADSCR_LtChgNext 0 "FALSE" 1 "TRUE" ;
VAL_TABLE_ VirtKeyPinToStrtFobNDtd 0 "FALSE" 1 "TRUE" ;
VAL_TABLE_ ChrgCommCtlrCommEnblSts 0 "No Action" 1 "Initiate Communication" 2 "Disable Communication" 3 "Restart Communication" 4 "HLC Communication" 5 "Failed" ;
VAL_TABLE_ HVACInfoCtlReqSyncRrSetChg 0 "FALSE" 1 "TRUE" ;
VAL_TABLE_ HVACInfoCtlReqSyncAllSetChg 0 "FALSE" 1 "TRUE" ;
VAL_TABLE_ TAC_AudConctOutcm 0 "NO_ACTION" 1 "REQUEST_GRANTED" 2 "REQUEST_DENIED" 3 "AUDIO_FAULT" 4 "RESERVED_2" 5 "RESERVED_3" 6 "RESERVED_4" 7 "RESERVED_5" 8 "RESERVED_6" 9 "RESERVED_7" 10 "RESERVED_8" 11 "RESERVED_9" 12 "RESERVED_10" 13 "RESERVED_11" 14 "RESERVED_12" 15 "RESERVED_13" ;
VAL_TABLE_ TAC_AudChConctStat 0 "NO_ACTION" 1 "MIX_PROMPT" 2 "MUTEX_PROMPT" 3 "RING_TONE" 4 "PHONE" 5 "EMERGENCY_PHONE" 6 "RESERVED_1" 7 "RESERVED_2" 8 "RESERVED_3" 9 "RESERVED_4" 10 "RESERVED_5" 11 "RESERVED_6" 12 "RESERVED_7" 13 "RESERVED_8" 14 "RESERVED_9" 15 "RESERVED_10" ;
VAL_TABLE_ TDOSWCCSR_ChgSetReq 0 "NO_ACTION" 1 "OFF" 2 "ON" 3 "RESERVED_3" 4 "RESERVED_4" 5 "RESERVED_5" 6 "RESERVED_6" 7 "RESERVED_7" ;
VAL_TABLE_ InfoSysStat 0 "Sleep" 1 "AnimationInit" 2 "HMI_Init" 3 "HMI_Inactive" 4 "Start" 5 "Run" 6 "Propulsion" 7 "Accessory" 8 "LocalInfotainment" 9 "LocalPhone" 10 "LocalValet" 11 "LocalEject" 12 "ValetMode" 13 "TheftLocked" 14 "NoCalibration" 15 "NoVIN" 16 "RemoteReflashProgramming" 17 "OffMode" 18 "VirtualSwitchDisplay" 19 "NoInVehicleInfotainment" ;
VAL_TABLE_ AutoMemRclCstChgSetReq 0 "NO_ACTION" 1 "OFF" 2 "ON" 3 "AUTO_MEMORY_RECALL" 4 "EASY_EXIT" 5 "AUTO_MEMORY_AND_EASY_EXIT_RECALLS" 6 "RESERVED6" 7 "RESERVED7" ;
VAL_TABLE_ AdpLghtRspTypCstChgSetReq 0 "NO_ACTION" 1 "OFF" 2 "CORNER_AND_CURVE_LIGHTING" 3 "INTELLIGENT_LIGHT_DISTRIBUTION" 4 "INTELLIGENT_LIGHT_DISTRIBUTION_GPS_ASSISTANCE" 5 "RESERVED_5" 6 "RESERVED_6" 7 "RESERVED_7" ;
VAL_TABLE_ TDOSWCCSR_IncSwAct 0 "FALSE" 1 "TRUE" ;
VAL_TABLE_ TDOSWCCSR_DecSwAct 0 "FALSE" 1 "TRUE" ;
VAL_TABLE_ EsyExtCstChgSetReq 0 "NO_ACTION" 1 "OFF" 2 "ON" 3 "RESERVED_3" 4 "RESERVED_4" 5 "RESERVED_5" 6 "RESERVED_6" 7 "RESERVED_7" ;
VAL_TABLE_ DrvrAlrtTypCstChgStReq 0 "SETTING_UNKNOWN" 1 "CHIME" 2 "SEAT" 3 "RESERVED_3" 4 "RESERVED_4" 5 "RESERVED_5" 6 "RESERVED_6" 7 "RESERVED_7" ;
VAL_TABLE_ CrgBedVwAutoLgtCstChgSetReq 0 "No_Action" 1 "Off" 2 "On" ;
VAL_TABLE_ FrwdImpMtgnOpSlctCstChgSetReq 0 "NO_ACTION" 1 "OFF" 2 "ALERT" 3 "ALERT_BRAKE" 4 "ALERT_BRAKE_STEER" 5 "RESERVED_5" 6 "RESERVED_6" 7 "RESERVED_7" ;
VAL_TABLE_ FrtRdHgtGPSCstChngSetReq 0 "NO_ACTION" 1 "OFF" 2 "ON" 3 "RESERVED_3" 4 "RESERVED_4" 5 "RESERVED_5" 6 "RESERVED_6" 7 "RESERVED_7" ;
VAL_TABLE_ FrntPCMRspTypCstChgSetReq 0 "NO_ACTION" 1 "OFF" 2 "ALERT" 3 "ALERT_AND_BRAKE" 4 "ALERT_AND_BRAKE_AND_STEER" 5 "RESERVED_5" 6 "RESERVED_6" 7 "RESERVED_7" ;
VAL_TABLE_ GoNotfrCstChgSetReq 0 "NO_ACTION" 1 "OFF" 2 "ON" 3 "RESERVED_3" 4 "RESERVED_4" 5 "RESERVED_5" 6 "RESERVED_6" 7 "RESERVED_7" ;
VAL_TABLE_ GlrFrHgBmRspTypCstChgSetReq 0 "NO_ACTION" 1 "AUTOMATIC_HIGH_BEAM" 2 "GLARE_FREE_HIGH_BEAM" 3 "RESERVED_3" 4 "RESERVED_4" 5 "RESERVED_5" 6 "RESERVED_6" 7 "RESERVED_7" ;
VAL_TABLE_ PhnLtInVehCstChgSetReq 0 "NO_ACTION" 1 "OFF" 2 "ON" 3 "RESERVED_3" 4 "RESERVED_4" 5 "RESERVED_5" 6 "RESERVED_6" 7 "RESERVED_7" ;
VAL_TABLE_ LtRtHnTrCstChgSetReq 0 "NO_ACTION" 1 "LEFT_HAND_DRIVE" 2 "RIGHT_HAND_DRIVE" 3 "AUTOMATIC_WITH_GPS" 4 "RESERVED_4" 5 "RESERVED_5" 6 "RESERVED_6" 7 "RESERVED_7" ;
VAL_TABLE_ JckKnfDtnCstChgSetReq 0 "No_Action" 1 "Off" 2 "On" ;
VAL_TABLE_ APACrssBckInSftBtnStat 0 "NOT_PRESSED" 1 "PRESSED" ;
VAL_TABLE_ PrkAsstTrHtchPsntCstChgSetReq 0 "NO_ACTION" 1 "OFF_NOT_ATTACHED" 2 "ON_ATTACHED" 3 "RESERVED_3" 4 "RESERVED_4" 5 "RESERVED_5" 6 "RESERVED_6" 7 "RESERVED_7" ;
VAL_TABLE_ PrkAsstOnOffCstChgSetReq 0 "No_Action" 1 "Off" 2 "Alert" 3 "Alert_Brake" ;
VAL_TABLE_ RrCrsTrfcAlrtCstChngSetReq 0 "NO_ACTION" 1 "OFF" 2 "ALERT" 3 "ALERT AND BRAKE" 4 "RESERVED_4" 5 "RESERVED_5" 6 "RESERVED_6" 7 "RESERVED_7" ;
VAL_TABLE_ RnngBrdManDplyCstChgSetReq 0 "NO_ACTION" 1 "OFF" 2 "EXTEND_DOOR" 3 "EXTEND_BED" 4 "RESERVED_4 RESERVED_5" 5 "RESERVED_6" 6 "RESERVED_7" ;
VAL_TABLE_ RnngBrdAutoDplyCstChgSetReq 0 "NO_ACTION" 1 "OFF" 2 "DOOR" 3 "DOOR_PARK" 4 "RESERVED_4 RESERVED_5" 5 "RESERVED_6" 6 "RESERVED_7" ;
VAL_TABLE_ SBZAlrtCstChngSetReq 0 "NO_ACTION" 1 "OFF" 2 "ON" 3 "RESERVED_3" 4 "RESERVED_4" 5 "RESERVED_5" 6 "RESERVED_6" 7 "RESERVED_7" ;
VAL_TABLE_ RrVwPrkAstSymCstChgSetReq 0 "NO_ACTION" 1 "OFF" 2 "ON" 3 "RESERVED_3" 4 "RESERVED_4" 5 "RESERVED_5" 6 "RESERVED_6" 7 "RESERVED_7" ;
VAL_TABLE_ RrPCMRspTypCstChgSetReq 0 "NO_ACTION" 1 "OFF" 2 "ALERT" 3 "ALERT_AND_BRAKE" 4 "ALERT_AND_BRAKE_AND_STEER" 5 "RESERVED_5" 6 "RESERVED_6" 7 "RESERVED_7" ;
VAL_TABLE_ SrrndVwLghtCstChgSetReq 0 "SETTING_UNKNOWN" 1 "ON" 2 "OFF" 3 "RESERVED_3" 4 "RESERVED_4" 5 "RESERVED_5" 6 "RESERVED_6" 7 "RESERVED_7" ;
VAL_TABLE_ SelUlkCstChgSetReq 0 "NO_ACTION" 1 "DRIVER_DOOR_ONLY" 2 "ALL_DOORS" 3 "RESERVED_3" 4 "RESERVED_4" 5 "RESERVED_5" 6 "RESERVED_6" 7 "RESERVED_7" ;
VAL_TABLE_ TnDrvSpdLmtCstChgStReq 0 "NO_ACTION" 1 "OFF" 2 "ON" 3 "RESERVED_3" 4 "RESERVED_4" 5 "RESERVED_5" 6 "RESERVED_6" 7 "RESERVED_7" ;
VAL_TABLE_ StBltTghtngCstChgSetReq 0 "NO_ACTION" 1 "OFF" 2 "ON" 3 "RESERVED_3" 4 "RESERVED_4" 5 "RESERVED_5" 6 "RESERVED_6" 7 "RESERVED_7" ;
VAL_TABLE_ StBltShfIntlkCstChgSetReq 0 "NO ACTION" 1 "OFF" 2 "ON" 3 "RESERVED 3" 4 "RESERVED 4" 5 "RESERVED 5" 6 "RESERVED 6" 7 "RESERVED 7" ;
VAL_TABLE_ TrlrMirVidEnblCstChgSetReq 0 "No_Action" 1 "Off" 2 "On" ;
VAL_TABLE_ TrffcLgtAsstCstChgSetReq 0 "NO_ACTION" 1 "OFF" 2 "ALERT" 3 "RESERVED_3" 4 "RESERVED_4" 5 "RESERVED_5" 6 "RESERVED_6" 7 "RESERVED_7" ;
VAL_TABLE_ TnDrvStBltShfIntlkCstChgSetReq 0 "NO_ACTION" 1 "OFF" 2 "ON" 3 "RESERVED_3" 4 "RESERVED_4" 5 "RESERVED_5" 6 "RESERVED_6" 7 "RESERVED_7" ;
VAL_TABLE_ VehLctrLtsCstChgSetReq 0 "NO_ACTION" 1 "OFF" 2 "ON" 3 "On Without Animation" 4 "RESERVED_4" 5 "RESERVED_5" 6 "RESERVED_6" 7 "RESERVED_7" ;
VAL_TABLE_ TrlrMirVidGdlnsCstChgSetReq 0 "No_Action" 1 "Off" 2 "On" ;
VAL_TABLE_ APALftSftBtnStat 0 "NOT_PRESSED" 1 "PRESSED" ;
VAL_TABLE_ APAFcStatCSM 0 "NO_FOCUS" 1 "FOCUS" ;
VAL_TABLE_ APAExtPrkSftBtnStat 0 "NOT_PRESSED" 1 "PRESSED" ;
VAL_TABLE_ ElvtdIdlCstChgSetReq 0 "No Action" 1 "Off" 2 "On" ;
VAL_TABLE_ WlkAwyLckCstChgSetReq 0 "NO_ACTION" 1 "OFF" 2 "ON" 3 "ON_WITH_CHIRP" 4 "RESERVED_4" 5 "RESERVED_5" 6 "RESERVED_6" 7 "RESERVED_7" ;
VAL_TABLE_ TimeDispFormat 0 "12 Hour Mode" 1 "24 Hour Mode" ;
VAL_TABLE_ RstrCstDfltReq 0 "FALSE" 1 "TRUE" ;
VAL_TABLE_ RFStStsDispActv 0 "FALSE" 1 "TRUE" ;
VAL_TABLE_ LFStStsDispActv 0 "FALSE" 1 "TRUE" ;
VAL_TABLE_ APASrchSftBtnStat 0 "NOT_PRESSED" 1 "PRESSED" ;
VAL_TABLE_ APARghtSftBtnStat 0 "NOT_PRESSED" 1 "PRESSED" ;
VAL_TABLE_ APAPrllPrkSftBtnStat 0 "NOT_PRESSED" 1 "PRESSED" ;
VAL_TABLE_ ValetMdReq 0 "NoAction" 1 "SetPIN" 2 "ClearPIN" ;
VAL_TABLE_ TeenDrvReq 0 "No Action" 1 "Verify Teen PIN" 2 "Update Teen PIN" 3 "Set Teen Key" 4 "Clear Teen Key" 5 "Check for Teen Key" 6 "Clear Teen Keys and PIN" 7 "Reset Report Card" 8 "Request Report Card Data" ;
VAL_TABLE_ LngSelExt 0 "NA English" 1 "German" 2 "Italian" 3 "Swedish" 4 "French" 5 "Spanish" 6 "Dutch" 7 "Portuguese" 8 "Norwegian" 9 "Finnish" 10 "Danish" 11 "Greek" 12 "Japanese" 13 "Arabic" 14 "Standard Chinese" 15 "Polish" 16 "Turkish" 17 "Korean" 18 "Traditional Chinese" 19 "UK English" 20 "Hungarian" 21 "Czech" 22 "Slovak" 23 "Russian" 24 "Brazilian Portuguese" 25 "Thai" 26 "Bulgarian" 27 "Romanian" 28 "Slovenian" 29 "Croatian" 30 "Ukrainian" 31 "NA French" 32 "NA Spanish" 33 "Cantonese" 34 "Uzbek" 35 "Serbian" 36 "Lithuanian" 37 "Estonian" 38 "Latvian" 39 "Macedonian" 40 "AU English" 41 "ZA English" 42 "Hebrew" 43 "LA Spanish" ;
VAL_TABLE_ PTOEngRunTmrCstSetReq 0 "No Action" 1 "Min 10" 2 "Min 30" 3 "Min 90" 4 "Min 120" 5 "Min 150" 6 "Min 180" 7 "Min 210" 8 "Min 240" 9 "Min 270" 10 "Min 200" 11 "Min 330" 12 "Min 360" 13 "Min 390" 14 "Min 420" 15 "Min 450" ;
VAL_TABLE_ PTOEngSpdTypCstSetReq 0 "No Action" 1 "Preset" 2 "Variable" ;
VAL_TABLE_ PTOSet1SpdCstSetReq 0 "No Action" 1 "RPM 1100" 2 "RPM 1200" 3 "RPM 1300" 4 "RPM 1400" 5 "RPM 1500" 6 "RPM 1600" 7 "RPM 1700" 8 "RPM 1800" 9 "RPM 1900" 10 "RPM 2000" 11 "RPM 2100" 12 "RPM 2200" 13 "RPM 2300" 14 "RPM 2400" 15 "RPM 2500" ;
VAL_TABLE_ PTOStndbySpdCstSetReq 0 "No Action" 1 "RPM 900" 2 "RPM 1000" 3 "RPM 1100" 4 "RPM 1200" 5 "RPM 1300" 6 "RPM 1400" 7 "RPM 1500" ;
VAL_TABLE_ LnChgAlrtCstChngSetReq 0 "NO_ACTION" 1 "OFF" 2 "ON" 3 "RESERVED_3" 4 "RESERVED_4" 5 "RESERVED_5" 6 "RESERVED_6" 7 "RESERVED_7" ;
VAL_TABLE_ PTOSet2SpdCstSetReq 0 "No Action" 1 "RPM 1700" 2 "RPM 1800" 3 "RPM 1900" 4 "RPM 2000" 5 "RPM 2100" 6 "RPM 2200" 7 "RPM 2300" 8 "RPM 2400" 9 "RPM 2500" 10 "RPM 2600" 11 "RPM 2700" 12 "RPM 2800" 13 "RPM 2900" 14 "RPM 3000" 15 "RPM 3100" ;
VAL_TABLE_ TCP_LCMFileTrans 0 "No Action" 1 "Begin Transfer" 2 "Successful Block Transfer" 3 "Cancel Transfer" 4 "Retry Last Block" ;
VAL_TABLE_ PTOTpStpSpdCstSetReq 0 "No Action" 1 "RPM 5" 2 "RPM 10" 3 "RPM 25" 4 "RPM 50" 5 "RPM 100" 6 "RPM 250" 7 "RPM 500" ;
VAL_TABLE_ TCP_LCMDataMsgStat 0 "No Action" 1 "Acknowledge" ;
VAL_TABLE_ CamVidICS_DispAct 0 "FALSE" 1 "TRUE" ;
VAL_TABLE_ TrlrLtngSeqReq 0 "No Action" 1 "Off" 2 "On" ;
VAL_TABLE_ PTOModeCstSetReq 0 "No Action" 1 "Standard" 2 "Remote" ;
VAL_TABLE_ VwgVwprtTopDnVwSeltn 0 "Unknown" 1 "No Request" 2 "Top Down View" ;
VAL_TABLE_ VwgVwprtZoomBtnSeltd 0 "FALSE" 1 "TRUE" ;
VAL_TABLE_ VwgVwprtNtfnFcsReqd 0 "FALSE" 1 "TRUE" ;
VAL_TABLE_ VwgVwprtNtfnDsmsReqd 0 "FALSE" 1 "TRUE" ;
VAL_TABLE_ TrfcJamAsstVirtCtlReq 0 "No Action" 1 "Off" 2 "On" ;
VAL_TABLE_ DrvrSeltdSpdLmtrVirtCtlReqd 0 "FALSE" 1 "TRUE" ;
VAL_TABLE_ DrvrSeltdSpdLmtrVirtCtlReq 0 "No Action" 1 "Manual" 2 "Auto" 3 "Off" ;
VAL_TABLE_ DMBlkhdDrAutoClsTmCstChgSetReq 0 "No Action" 1 "Standard" 2 "Extended" 3 "Keep Open" ;
VAL_TABLE_ MFC_LCMFileTrans 0 "No Action" 1 "Begin Transfer" 2 "Successful Block Transfer" 3 "Cancel Transfer" 4 "Retry Last Block" ;
VAL_TABLE_ MFC_LCMDataMsgStat 0 "No Action" 1 "Acknowledge" ;
VAL_TABLE_ BklghtngCnfg 0 "Off" 1 "On" 2 "Local" ;
VAL_TABLE_ WCM_LCMDataMsgStat 0 "No Action" 1 "Acknowledge" ;
VAL_TABLE_ WCM_LCMFileTrans 0 "No Action" 1 "Begin Transfer" 2 "Successful Block Transfer" 3 "Cancel Transfer" 4 "Retry Last Block" ;
VAL_TABLE_ ASSLC_AutoLdnsCmpnAct 0 "FALSE" 1 "TRUE" ;
VAL_TABLE_ ASSLC_VcSrcActOnMtx 0 "FALSE" 1 "TRUE" ;
VAL_TABLE_ ZALC_LRMtxSnkMut 0 "FALSE" 1 "TRUE" ;
VAL_TABLE_ ZALC_MltZnMixPrmtAudRR 0 "FALSE" 1 "TRUE" ;
VAL_TABLE_ ZALC_MltZnMixPrmtAudPsngrFrt 0 "FALSE" 1 "TRUE" ;
VAL_TABLE_ ZALC_MltZnMixPrmtAudLR 0 "FALSE" 1 "TRUE" ;
VAL_TABLE_ ZALC_MltZnMixPrmtAudDrvrFrt 0 "FALSE" 1 "TRUE" ;
VAL_TABLE_ ZALC_MltZnAudFtrStat 0 "Unknown" 1 "Single Zone Audio" 2 "Dual Zone Audio" 3 "Quad Zone Audio" ;
VAL_TABLE_ ZALC_PsngrFrtMtxSnkMut 0 "FALSE" 1 "TRUE" ;
VAL_TABLE_ ZALC_RRMtxSnkMut 0 "FALSE" 1 "TRUE" ;
VAL_TABLE_ FrtCntrStckOptDskDrvDckStat 0 "DS_EMPTY" 1 "DS_LOADING" 2 "DS_READY" 3 "DS_EJECT" 4 "DS_READ_FORMAT_ERROR" 5 "DS_STAT_5" 6 "DS_STAT_6" 7 "DS_STAT_7" ;
VAL_TABLE_ ZALC_VcSrcActvOnRRMtx 0 "FALSE" 1 "TRUE" ;
VAL_TABLE_ ZALC_VcSrcActvOnPsngrFrtMtx 0 "FALSE" 1 "TRUE" ;
VAL_TABLE_ ZALC_VcSrcActvOnLRMtx 0 "FALSE" 1 "TRUE" ;
VAL_TABLE_ ASTC_AmpLwPwrSt 0 "FALSE" 1 "TRUE" ;
VAL_TABLE_ ASTC_DSPMd 0 "NO_ACTION" 1 "DSP_MODE_0" 2 "DSP_MODE_1" 3 "DSP_MODE_2" 4 "DSP_MODE_3" 5 "DSP_MODE_4" 6 "DSP_MODE_5" 7 "DSP_MODE_6" 8 "DSP_MODE_7" 9 "RESERVED_1" 10 "RESERVED_2" 11 "RESERVED_3" 12 "RESERVED_4" 13 "RESERVED_5" 14 "RESERVED_6" 15 "RESERVED_7" ;
VAL_TABLE_ ASTC_ChimSnkSpkrPos 0 "NO_ACTION" 1 "FULL_FRONT" 2 "FULL_REAR" 3 "FULL_LEFT" 4 "FULL_RIGHT" 5 "RIGHT_FRONT" 6 "RIGHT_REAR" 7 "LEFT_FRONT" 8 "LEFT_REAR" 9 "RESERVED_1" 10 "RESERVED_2" 11 "RESERVED_3" 12 "RESERVED_4" 13 "RESERVED_5" 14 "RESERVED_6" 15 "RESERVED_7" ;
VAL_TABLE_ ASTC_GblAudSnkMut 0 "FALSE" 1 "TRUE" ;
VAL_TABLE_ ASTC_MtxSnkMut 0 "FALSE" 1 "TRUE" ;
VAL_TABLE_ FrtCntrStckHptcFdbkReq 0 "NO_ACTION" 1 "TAP" 2 "LONG_PRESS" 3 "PRESS_&_HOLD_SCROLL" 4 "PRESS_&_HOLD_END" 5 "RESERVED_05" 6 "RESERVED_06" 7 "RESERVED_07" 8 "RESERVED_08" 9 "RESERVED_09" 10 "RESERVED_10" 11 "RESERVED_11" 12 "RESERVED_12" 13 "RESERVED_13" 14 "RESERVED_14" 15 "RESERVED_15" ;
VAL_TABLE_ ASTC_VehNoisCmpnAct 0 "FALSE" 1 "TRUE" ;
VAL_TABLE_ ADASIS_NAVILINK_DgtlMpEfSpdLm 0 "UNKNOWN" 1 "<= 5 KM/H [MPH]" 2 "7 KM/H [MPH]" 3 "10 KM/H [MPH]" 4 "15 KM/H [MPH]" 5 "20 KM/H [MPH]" 6 "25 KM/H [MPH]" 7 "30 KM/H [MPH]" 8 "35 KM/H [MPH]" 9 "40 KM/H [MPH]" 10 "45 KM/H [MPH]" 11 "50 KM/H [MPH]" 12 "55 KM/H [MPH]" 13 "60 KM/H" 14 "MPH]65 KM/H [MPH]" 15 "70 KM/H [MPH]" 16 "75 KM/H [MPH]" 17 "80 KM/H [MPH]" 18 "85 KM/H [MPH]" 19 "90 KM/H [MPH]" 20 "95 KM/H [MPH]" 21 "100 KM/H [MPH]" 22 "105 KM/H [MPH]" 23 "110 KM/H [MPH]" 24 "115 KM/H [MPH]" 25 "120 KM/H[MPH]" 26 "130 KM/H [MPH]" 27 "140 KM/H [MPH]" 28 "150 KM/H [MPH]" 29 "160 KM/H [MPH]" 30 "UNLIMITED" 31 "NOT AVAILABLE" ;
VAL_TABLE_ ADASIS_NAVILINK_CntryCd 0 "AD" 1 "AT" 2 "BE" 3 "CZ" 4 "DK" 5 "EE" 6 "FR" 7 "DE" 8 "GR" 9 "HU" 10 "IE" 11 "IT" 12 "BY" 13 "BG" 14 "CY" 15 "MT" 16 "HR" 17 "TR" 18 "RS" 19 "ME" 20 "LV" 21 "LT" 22 "LU" 23 "NL" 24 "NO" 25 "PL" 26 "PT" 27 "UK" 28 "SK" 29 "SI" 30 "ES" 31 "SE" 32 "CH" 33 "RO" 34 "RU" 35 "UA" 36 "BA" 37 "AL" 38 "MD" 39 "IS" 40 "MK" 41 "US" 42 "ZA" 43 "AU" 44 "NZ" 45 "KR" 46 "CN" 47 "CA" 48 "MX" 49 "FI" 50 "OTHER" 51 "UNKNOWN" ;
VAL_TABLE_ VwgVwprtSeltn 0 "Unknown" 1 "Front Perspective" 2 "Front Junction" 3 "Front Overhead" 4 "Side Forward" 5 "Rear Perspective" 6 "Rear Junction" 7 "Rear Overhead" 8 "Side Rearward" 9 "Bowl" 10 "Zoomed Bowl" 11 "Japan" 12 "Rear Hitch" 13 "Bed Hitch" 14 "Trailer Aux1" 15 "Trailer Towing Mirror" 16 "L R Trailer Towing Mirror" 17 "Trailer Aux1 Combined" 18 "Trailer Aux2" 19 "Invisible Trailer" 20 "Cargo Bed" 21 "Curb Overhead" 22 "Curb" 23 "No Request" 24 "Transparent Hood" ;
VAL_TABLE_ SrrndVsnRcrdrListFcs 0 "Unknown" 1 "File_1" 2 "File_2" 3 "File_3" 4 "File_4" 5 "File_5" 6 "Delete_1" 7 "Delete_2" 8 "Delete_3" 9 "Delete_4" 10 "Delete_5" 11 "No Focus" ;
VAL_TABLE_ ADASIS_NAVILINK_DgtlMpPsngRst 0 "NO PASSING RESTRICTIONS" 1 "GENERAL NO OVERTAKE" 2 "FLUCTUATING (E.G. LED SIGNS)" 3 "CONDITIONAL PASSENGER CAR WITH TRAILER" 4 "CONDITIONAL TRACTORS ARE ALLOWED TO OVERTAKE" 5 "CONDITIONAL WHEN WET" 6 "CONDITIONAL WHEN SNOW" 7 "UNKNOWN CONDITION" ;
VAL_TABLE_ ADASIS_NAVILINK_DgMpCnSpdLmTyp 0 "LANE DEPENDENT" 1 "ONLY BY FOG" 2 "ONLY BY NIGHT" 3 "ONLY BY DAY" 4 "BY TIME OF DAY" 5 "ONLY BY RAIN" 6 "ONLY BY SNOW" 7 "UNKNOWN" ;
VAL_TABLE_ SrrndVsnRcrdrVwprtSeltn 0 "Unknown" 1 "Playback Mosaic" 2 "Playback Zoom1" 3 "Playback Zoom2" 4 "Playback Zoom3" 5 "Playback Zoom4" 6 "List Recent" 7 "List Saved" 8 "No Request" ;
VAL_TABLE_ SrrndVsnRcrdrFileSeltn 0 "Unknown" 1 "File_1" 2 "File_2" 3 "File_3" 4 "File_4" 5 "File_5" 6 "No Selection" ;
VAL_TABLE_ SrrndVsnRcrdrFileDeltn 0 "Unknown" 1 "File_1" 2 "File_2" 3 "File_3" 4 "File_4" 5 "File_5" 6 "No Selection" ;
VAL_TABLE_ PFASndSeltnCstChgSetReq 0 "No Action" 1 "Pedestrian Alert Sound 1" 2 "Pedestrian Alert Sound 2" 3 "Pedestrian Alert Sound 3" 4 "RESERVED_4" 5 "RESERVED_5" 6 "RESERVED_6" 7 "RESERVED_7" ;
VAL_TABLE_ SrrndVsnRcrdrPlybkSeltn 0 "Unknown" 1 "Play" 2 "Pause" 3 "Rewind" 4 "Fast Forward" 5 "No Selection" ;
VAL_TABLE_ SrrndVsnRcrdrPlybkFcs 0 "Unknown" 1 "View_1" 2 "View_2" 3 "View_3" 4 "View_4" 5 "Zoomed" 6 "No Focus" ;
VAL_TABLE_ ADASIS_NAVILINK_BldUpFlg 0 "NOT VALID" 1 "VALID" ;
VAL_TABLE_ PASftBtnSeltdStatRw 0 "Not_Pressed" 1 "Pressed" 2 "Unknown" 3 "Failed" ;
VAL_TABLE_ APASftBtnSeltdStatRw 0 "Not_Pressed" 1 "Pressed" 2 "Unknown" 3 "Failed" ;
VAL_TABLE_ VGS_TrlrActv 0 "FALSE" 1 "TRUE" ;
VAL_TABLE_ VGS_DynActv 0 "FALSE" 1 "TRUE" ;
VAL_TABLE_ VGS_CurbVwActv 0 "FALSE" 1 "TRUE" ;
VAL_TABLE_ TrgdVidRecSwAct 0 "FALSE" 1 "TRUE" ;
VAL_TABLE_ ADASIS_NAVILINK_CntrldAccssRd 0 "ROAD IS NOT CONTROLLED ACCESS ROAD" 1 "ROAD IS CONTROLLED ACCESS ROAD" ;
VAL_TABLE_ SrrndVsnRcrdrSaveFile 0 "Unknown" 1 "Save" 2 "Not Pressed" ;
VAL_TABLE_ SrrndVsnRcrdrRcrdSeltn 0 "Unknown" 1 "Enabled" 2 "Disabled" ;
VAL_TABLE_ SrrndVsnRcrdrListPgSeltn 0 "Unknown" 1 "Page Up" 2 "Page Down" 3 "No Selection" ;
VAL_TABLE_ ONPC_DprtrDyOfWkReq 0 "Unknown" 1 "Sunday" 2 "Monday" 3 "Tuesday" 4 "Wednesday" 5 "Thursday" 6 "Friday" 7 "Saturday" ;
VAL_TABLE_ ONPC_Req 0 "No Action" 1 "Charge Now" 2 "Charge Later" ;
VAL_TABLE_ DAPR_CtlDir 0 "None" 1 "Left" 2 "Right" 3 "Center" 4 "Custom1" 5 "Custom 2" 6 "Custom 3" 7 "Custom 4" ;
VAL_TABLE_ DAPR_CurrPrmt 0 "FALSE" 1 "TRUE" ;
VAL_TABLE_ DAPR_CtlZn 0 "None" 1 "Zone 1" 2 "Zone 2" 3 "Zone 3" 4 "Zone 4" 5 "Zone 5" 6 "Zone 6" 7 "Zone 7" 8 "Zone 8" 9 "Zone 9" 10 "Zone 10" 11 "Zone 11" 12 "Zone 12" 13 "Zone 13" 14 "Custom 1" 15 "Custom 2" ;
VAL_TABLE_ LVMAVC_RmtEnbl 0 "NO_ACTION" 1 "REMOTE_ENABLE_ON" 2 "REMOTE_ENABLE_ACTIVE" ;
VAL_TABLE_ LVMAVC_PrmtAudResp 0 "NO_ACTION" 1 "ACTIVE" ;
VAL_TABLE_ LVMAVC_ApplID 0 "NO_ACTION" 1 "LVM_NAV" 2 "LVM_DMB" 3 "LVM_PERFORMANCE_COMPUTER" 4 "LVM_COMPLEX_MODE" ;
VAL_TABLE_ LVMAVC_StreoAudResp 0 "NO_ACTION" 1 "ACTIVE" ;
VAL_TABLE_ LVMAVC_SpchRcgnAval 0 "NO_ACTION" 1 "LVM_SPEECH_REC_AVAILABLE" ;
VAL_TABLE_ LVMAVC_RmtSpchRcgnID 0 "NO_ACTION" 1 "LVM_NAV" 2 "LVM_DMB" 3 "LVM_PDR" ;
VAL_TABLE_ LVMAVC_RmtSpchRcgnActn 0 "NO_ACTION" 1 "ACTIVATE_LVM_SR" 2 "PTT_BUTTON_PRESS" 3 "END_BUTTON_PRESS" ;
VAL_TABLE_ OvrrdNextPlndCbnPrcndtngReq 0 "No Action" 1 "Off" 2 "On" ;
VAL_TABLE_ HMIInCarVcCommCtl 0 "ICC_Off" 1 "Front_High_Rear_High" 2 "Front_High_Rear_Normal" 3 "Front_High_Rear_Off" 4 "Front_Normal_Rear_High" 5 "Front_Normal_Rear_Normal" 6 "Front_Normal_Rear_Off" ;
VAL_TABLE_ AutoTrnspHdActvnCstChgSetReq 0 "No Action" 1 "Active" 2 "Inactive" ;
VAL_TABLE_ AutoLnChgCstChgSetReq 0 "No Action" 1 "Off" 2 "On" 3 "LCOD" 4 "LCOD and ALC" ;
VAL_TABLE_ ChrgPwrLossAlrtCstSetReq 0 "No Action" 1 "Off" 2 "On" ;
VAL_TABLE_ ChrgDatReq 0 "No Action" 1 "Wakeup Init All" 2 "Reinit All" 3 "Reinit Partial" ;
VAL_TABLE_ LocBsdChrgPstnMdfnReq 0 "No Action" 1 "Store Position 1" 2 "Store Position 2" 3 "Store Position 3" 4 "Store Position 4" ;
VAL_TABLE_ TrlrHtchTyp 0 "Unknown" 1 "Conventional" 2 "5th Wheel" 3 "Gooseneck" ;
VAL_TABLE_ LocBsdChrgCstSetReq 0 "No Action" 1 "Off" 2 "On" ;
VAL_TABLE_ FrtCntrStckVidInSel 0 "Primary Video Input" 1 "Reserved" 2 "LVM Video Input" ;
VAL_TABLE_ ChrgSysAudblIndCstSetReq 0 "No Action" 1 "Off" 2 "On" ;
VAL_TABLE_ Frt360CamSwAct 0 "FALSE" 1 "TRUE" ;
VAL_TABLE_ DrvrSeltdTrlrPrsnt 0 "Trailer Present" 1 "No Trailer" ;
VAL_TABLE_ DirAudPrmtRndrngEnbld 0 "FALSE" 1 "TRUE" ;
VAL_TABLE_ TrlrTyp 0 "Unknown" 1 "Box" 2 "Not-Box" ;
VAL_TABLE_ TrlrStatTowHaulModeOvrrd 0 "No Override" 1 "Override to Not Tow Haul" 2 "Unused and Reserved 1" 3 "Unused and Reserved 2" ;
VAL_TABLE_ TrlrAppAux1CamPrvwReqd 0 "FALSE" 1 "TRUE" ;
VAL_TABLE_ TrlRvsLghtFldEnbld 0 "FALSE" 1 "TRUE" ;
VAL_TABLE_ LifetmEleclEngyEconRstReqd 0 "FALSE" 1 "TRUE" ;
VAL_TABLE_ HybTripDatRstReqd 0 "FALSE" 1 "TRUE" ;
VAL_TABLE_ HndsFrVcCallActv 0 "FALSE" 1 "TRUE" ;
VAL_TABLE_ HiVltgBatStopChrgReq 0 "FALSE" 1 "TRUE" ;
VAL_TABLE_ FrtZnAudVolSyncCtlOn 0 "FALSE" 1 "TRUE" ;
VAL_TABLE_ FrtCntrStckTchCtlrRstCmd 0 "FALSE" 1 "TRUE" ;
VAL_TABLE_ TrlrProfDrvrReqdSeltn 0 "No Action" 1 "Default Profile" 2 "Profile1" 3 "Profile2" 4 "Profile3" 5 "Profile4" 6 "Profile5" 7 "Profile6" 8 "Profile7" 9 "Profile8" 10 "Profile9" 11 "Profile10" 12 "Profile11" 13 "Profile12" 14 "Profile13" 15 "Profile14" 16 "Profile15" 17 "Profile16" 18 "Profile17" 19 "Profile18" 20 "Profile19" 21 "Profile20" ;
VAL_TABLE_ VcRcgnSesnActv 0 "FALSE" 1 "TRUE" ;
VAL_TABLE_ TrlrTirePresSnsrIDLrnReqd 0 "FALSE" 1 "TRUE" ;
VAL_TABLE_ TrlrTirePresProfXferd 0 "FALSE" 1 "TRUE" ;
VAL_TABLE_ TrlrThftAlrtEnbld 0 "FALSE" 1 "TRUE" ;
VAL_TABLE_ TrlrLghtAlrtEnbld 0 "FALSE" 1 "TRUE" ;
VAL_TABLE_ TrlrAppInvsblTrlrPrvwReqd 0 "FALSE" 1 "TRUE" ;
VAL_TABLE_ TrlrAppAux2CamPrvwReqd 0 "FALSE" 1 "TRUE" ;
VAL_TABLE_ DMSIntnDrvrCstChgSetReq 0 "No Action" 1 "Off" 2 "On" ;
VAL_TABLE_ TrlrProfDeltn 0 "No Profile Deleted" 1 "Profile1 Deleted" 2 "Profile2 Deleted" 3 "Profile3 Deleted" 4 "Profile4 Deleted" 5 "Profile5 Deleted" 6 "Profile6 Deleted" 7 "Profile7 Deleted" 8 "Profile8 Deleted" 9 "Profile9 Deleted" 10 "Profile10 Deleted" 11 "Profile11 Deleted" 12 "Profile12 Deleted" 13 "Profile13 Deleted" 14 "Profile14 Deleted" 15 "Profile15 Deleted" 16 "Profile16 Deleted" 17 "Profile17 Deleted" 18 "Profile18 Deleted" 19 "Profile19 Deleted" 20 "Profile20 Deleted" ;
VAL_TABLE_ NumofAxls 0 "Unknown" 1 "1" 2 "2" 3 "3" ;
VAL_TABLE_ ReqRrClmtApp 0 "FALSE" 1 "TRUE" ;
VAL_TABLE_ ReqFrtClmtApp 0 "FALSE" 1 "TRUE" ;
VAL_TABLE_ HtdStrgWhlSwActv_HVAC_FP_F 0 "FALSE" 1 "TRUE" ;
VAL_TABLE_ ManHtdStrgWhlReqd_HVAC_FP_F 0 "FALSE" 1 "TRUE" ;
VAL_TABLE_ ManHtdStrgWhlReqd_HVAC_FP_F_Inv 0 "FALSE" 1 "TRUE" ;
VAL_TABLE_ HtdStrgWhlStkSw_HVAC_FP_F 0 "FALSE" 1 "TRUE" ;
VAL_TABLE_ HtdStrgWhlStkSw_HVAC_FP_F_Inv 0 "FALSE" 1 "TRUE" ;
VAL_TABLE_ RHVSRR_HtdBckLvlChgUp 0 "FALSE" 1 "TRUE" ;
VAL_TABLE_ RHVSRR_HtdBckLvlChgDn 0 "FALSE" 1 "TRUE" ;
VAL_TABLE_ RHVSLR_VntLvlChgUp 0 "FALSE" 1 "TRUE" ;
VAL_TABLE_ RHVSLR_VntLvlChgDn 0 "FALSE" 1 "TRUE" ;
VAL_TABLE_ RHVSLR_HtdCushBckLvlChgUp 0 "FALSE" 1 "TRUE" ;
VAL_TABLE_ RHVSLR_HtdCushBckLvlChgDn 0 "FALSE" 1 "TRUE" ;
VAL_TABLE_ RHVSLR_HtdBckLvlChgUp 0 "FALSE" 1 "TRUE" ;
VAL_TABLE_ RHVSLR_HtdBckLvlChgDn 0 "FALSE" 1 "TRUE" ;
VAL_TABLE_ RHVSRR_VntLvlChgUp 0 "FALSE" 1 "TRUE" ;
VAL_TABLE_ RHVSRR_VntLvlChgDn 0 "FALSE" 1 "TRUE" ;
VAL_TABLE_ RHVSRR_HtdCushBckLvlChgUp 0 "FALSE" 1 "TRUE" ;
VAL_TABLE_ RHVSRR_HtdCushBckLvlChgDn 0 "FALSE" 1 "TRUE" ;
VAL_TABLE_ FCSTP12_FrtCntrStckTchFlg2 0 "FALSE" 1 "TRUE" ;
VAL_TABLE_ FCSTP12_FrtCntrStckTchFlg1 0 "FALSE" 1 "TRUE" ;
VAL_TABLE_ StrgeOpn 0 "FALSE" 1 "TRUE" ;
VAL_TABLE_ FCSTP34_FrtCntrStckTchFlg4 0 "FALSE" 1 "TRUE" ;
VAL_TABLE_ FCSTP34_FrtCntrStckTchFlg3 0 "FALSE" 1 "TRUE" ;
VAL_TABLE_ FCSS1_FrtCntrStckSldr1Prxmty 0 "NOPROXIMITY_NOTOUCH" 1 "PROXIMITY_DETECTED" 2 "TOUCH_DETECTED" 3 "RESERVED" ;
VAL_TABLE_ FCSS2_FrtCntrStckSldr2Prxmty 0 "NOPROXIMITY_NOTOUCH" 1 "PROXIMITY_DETECTED" 2 "TOUCH_DETECTED" 3 "RESERVED" ;
VAL_TABLE_ FCSS3_FrtCntrStckSldr3Prxmty 0 "NOPROXIMITY_NOTOUCH" 1 "PROXIMITY_DETECTED" 2 "TOUCH_DETECTED" 3 "RESERVED" ;
VAL_TABLE_ FrtCntrStckPriVidInLckd 0 "Not_Locked" 1 "Locked" ;
VAL_TABLE_ FrtCntrStckLVMVidInLckd 0 "Not_Locked" 1 "Locked" ;
VAL_TABLE_ AutoTransGrDispdVal 0 "None" 1 "P" 2 "R" 3 "N" 4 "D" 5 "D1" 6 "D2" 7 "D3" 8 "D4" 9 "D5" 10 "D6" 11 "D7" 12 "D8" 13 "D9" 14 "D10" 15 "First(1)" 16 "Second(2)" 17 "Third(3)" 18 "Fourth(4)" 19 "Fifth(5)" 20 "Sixth(6)" 21 "Seventh(7)" 22 "Eighth(8)" 23 "Ninth(9)" 24 "M" 25 "M1" 26 "M2" 27 "M3" 28 "M4" 29 "M5" 30 "M6" 31 "M7" 32 "M8" 33 "M9" 34 "M10" 35 "L" 36 "L1" 37 "L2" 38 "L3" 39 "L4" 40 "L5" 41 "L6" 42 "L7" 43 "L8" 44 "L9" 45 "L10" 46 "I" 47 "Park In Progress" 48 "Reverse In Progress" 49 "Neutral In Progress" 50 "Drive In Progress" 51 "Dbar1" 52 "Dbar2" 53 "Dbar3" 54 "Dbar4" 55 "Dbar5" 56 "Dbar6" 57 "Dbar7" 58 "Dbar8" 59 "Dbar9" 60 "Dbar10" 61 "Manual In Progress" ;
VAL_TABLE_ AutoTransGrDispdVal_Inv 0 "FALSE" 1 "TRUE" ;
VAL_TABLE_ JmpStrtReqd 0 "FALSE" 1 "TRUE" ;
VAL_TABLE_ StrWhlCtlVolDnSw 0 "Released" 1 "Pressed" ;
VAL_TABLE_ StrWhlCtlPshToTlkSw 0 "Released" 1 "Pressed" ;
VAL_TABLE_ StrWhlCtlFvrtUpSw 0 "Released" 1 "Pressed" ;
VAL_TABLE_ StrWhlCtlFvrtDnSw 0 "Released" 1 "Pressed" ;
VAL_TABLE_ StrWhlCtlEndSw 0 "Released" 1 "Pressed" ;
VAL_TABLE_ ChmMngrSoH 0 "UNKNOWN" 1 "INITIALIZED" 2 "RESERVED_2" 3 "RESERVED_3" 4 "RESERVED_4" 5 "RESERVED_5" 6 "RESERVED_6" 7 "RESERVED_7" ;
VAL_TABLE_ StrWhlCtlVolUpSw 0 "Released" 1 "Pressed" ;
VAL_TABLE_ HUD_RclCmpt 0 "No Recall Requested" 1 "Recall In Process" 2 "Recall Complete" ;
VAL_TABLE_ HUD_CustSelActvStat 0 "FALSE" 1 "TRUE" ;
VAL_TABLE_ HUD_CustSelActvStat_Inv 0 "FALSE" 1 "TRUE" ;
VAL_TABLE_ DispMeasSysExtnd 0 "US" 1 "IMPERIAL" 2 "Metric KM/L" 3 "Metric L/100KM" ;
VAL_TABLE_ ClstrAnmStat 0 "Uninitialized" 1 "Ready" 2 "WelcomePlay" 3 "StartPlay" 4 "ShutdownPlay" ;
VAL_TABLE_ PAMutDrvrReq 0 "No Action" 1 "Mute Requested" 2 "Unmute Requested" ;
VAL_TABLE_ NtVsnVidCntrstUserReq 0 "No Action" 1 "Increase" 2 "Decrease" 3 "Set to default" ;
VAL_TABLE_ NtVsnVidBrghtnsUserReq 0 "No Action" 1 "Increase" 2 "Decrease" 3 "Set to default" ;
VAL_TABLE_ IPC_RunCrnkInpActv 0 "FALSE" 1 "TRUE" ;
VAL_TABLE_ IPC_RunCrnkInpActv_Inv 0 "FALSE" 1 "TRUE" ;
VAL_TABLE_ StkHUD_CustSelStat 0 "FALSE" 1 "TRUE" ;
VAL_TABLE_ FuelFiltLifeRstReqd 0 "FALSE" 1 "TRUE" ;
VAL_TABLE_ DispMeasSys 0 "Metric" 1 "English" ;
VAL_TABLE_ ClstrHMI_Rdy 0 "FALSE" 1 "TRUE" ;
VAL_TABLE_ APARghtSftBtnStatIPC 0 "NOT_PRESSED" 1 "PRESSED" ;
VAL_TABLE_ APALftSftBtnStatIPC 0 "NOT_PRESSED" 1 "PRESSED" ;
VAL_TABLE_ APAFcStatIPC 0 "NO_FOCUS" 1 "FOCUS" ;
VAL_TABLE_ AmbtLgtGblPrxmtyEnCstChgSetReq 0 "No Action" 1 "Enable" 2 "Disable" ;
VAL_TABLE_ TSMWrngPopUpSts 0 "TSM Warning Off" 1 "TSM Warning On" ;
VAL_TABLE_ TSMSgnNtfnWrnDispd 0 "FALSE" 1 "TRUE" ;
VAL_TABLE_ TSMPageDispActv 0 "FALSE" 1 "TRUE" ;
VAL_TABLE_ TSMCustRstReq 0 "FALSE" 1 "TRUE" ;
VAL_TABLE_ StrgWhlCtlInCarVcCommCtlSw 0 "Released" 1 "Pressed" ;
VAL_TABLE_ Trip1Odo_Inv 0 "FALSE" 1 "TRUE" ;
VAL_TABLE_ Trip2Odo_Inv 0 "FALSE" 1 "TRUE" ;
VAL_TABLE_ LnchCtlWhlSlReq 0 "No Action" 1 "Five Percent" 2 "Five And A Half Percent" 3 "Six Percent" 4 "Six And A Half Percent" 5 "Seven Percent" 6 "Seven And A Half Percent" 7 "Eight Percent" 8 "Eight And A Half Percent" 9 "Nine Percent" 10 "Nine And A Half Percent" 11 "Ten Percent" 12 "Ten And A Half Percent" 13 "Eleven Percent" 14 "Eleven And a Half Percent" 15 "Twelve Percent" 16 "Twelve And A Half Percent" 17 "Thirteen Percent" 18 "Thirteen And A Half Percent" 19 "Fourteen Percent" 20 "Fourteen And A Half Percent" 21 "Fifteen Percent" ;
VAL_TABLE_ LnchCtlEngRPMReq 0 "No Action" 1 "800" 2 "900" 3 "1000" 4 "1100" 5 "1200" 6 "1300" 7 "1400" 8 "1500" 9 "1600" 10 "1700" 11 "1800" 12 "1900" 13 "2000" 14 "2100" 15 "2200" 16 "2300" 17 "2400" 18 "2500" 19 "2600" 20 "2700" 21 "2800" 22 "2900" 23 "3000" 24 "3100" 25 "3200" 26 "3300" 27 "3400" 28 "3500" 29 "3600" 30 "3700" 31 "3800" 32 "3900" 33 "4000" 34 "FlexibleRPM 1" 35 "FlexibleRPM 2" 36 "FlexibleRPM 3" 37 "FlexibleRPM 4" 38 "FlexibleRPM 5" ;
VAL_TABLE_ EngAirFiltMonDrvrReq 0 "No Action" 1 "Enable" 2 "Disable" 3 "Reset" ;
VAL_TABLE_ BrkPadLifeSysDrvrReq 0 "No Action" 1 "Disable" 2 "Enable" 3 "Reset Front" 4 "Reset Rear" ;
VAL_TABLE_ TCStmpDsblReqConf 0 "No action" 1 "NO" 2 "YES" ;
VAL_TABLE_ TCSCurrStReq 0 "No action" 1 "OFF" 2 "ON" ;
VAL_TABLE_ LnchCtlModeReq 0 "No Action" 1 "Automatic" 2 "Custom" 3 "Line Lock" ;
VAL_TABLE_ RdHgtAtLocStorConf 0 "No Action" 1 "Store" 2 "Clear" 3 "All Clear" 4 "Undo Delete" ;
VAL_TABLE_ EngOilLifeRstReq 0 "FALSE" 1 "TRUE" ;
VAL_TABLE_ VehStbEnhCurrStReq 0 "No action" 1 "OFF" 2 "ON" ;
VAL_TABLE_ VehStbCompMdCurrStReq 0 "No action" 1 "OFF" 2 "ON" ;
VAL_TABLE_ TPMTrLdnRstReq 0 "UNKNOWN" 1 "LIGHT LOAD" 2 "BEST ECONOMY LOAD" 3 "MAX LOAD" ;
VAL_TABLE_ VehFlRngLwIO 0 "FALSE" 1 "TRUE" ;
VAL_TABLE_ TrnsOilLfRstRq 0 "No Request" 1 "Reset Request Active" ;
VAL_TABLE_ TripBEleclEngyEconRstReqd 0 "FALSE" 1 "TRUE" ;
VAL_TABLE_ TripAEleclEngyEconRstReqd 0 "FALSE" 1 "TRUE" ;
VAL_TABLE_ TPSnsrProgEvReq 0 "FALSE" 1 "TRUE" ;
VAL_TABLE_ LnchCtlRelLineLckReqd 0 "FALSE" 1 "TRUE" ;
VAL_TABLE_ FobProgEvntRqd 0 "FALSE" 1 "TRUE" ;
VAL_TABLE_ ACCAutoSetSpdCstChgSetReq 0 "No Action" 1 "Off" 2 "On" ;
VAL_TABLE_ DMSDrwIntnWrnDrvrResp 0 "No Action" 1 "Dismiss" ;
VAL_TABLE_ TransOilFiltLifeRstReq 0 "No Request" 1 "Reset Request Active" ;
VAL_TABLE_ CustmStbCtlRdctReqConf 0 "No Action" 1 "No" 2 "Yes" ;
VAL_TABLE_ FllwgDstIndTmDstSel 0 "TIME" 1 "DISTANCE" ;
VAL_TABLE_ VehFlRngCalc_Inv 0 "FALSE" 1 "TRUE" ;
VAL_TABLE_ VehSpdBsgDispStat 0 "Unknown" 1 "Enabled" 2 "Disabled" ;
VAL_TABLE_ FuelLvlLoIndOn 0 "FALSE" 1 "TRUE" ;
VAL_TABLE_ MFCInfoActvnReqd 0 "FALSE" 1 "TRUE" ;
VAL_TABLE_ PDRRI_LpDiffGainLoss 0 "Loss" 1 "Gain" ;
VAL_TABLE_ LVMAVR_PrmtAudReq 0 "NO_ACTION" 1 "PROMPT_REQUEST" ;
VAL_TABLE_ LVMAVR_DispReq 0 "NO_ACTION" 1 "LVM_NAV" 2 "LVM_DMB" 3 "LVM_PDR" ;
VAL_TABLE_ LVMAVR_ApplStat 0 "NO_ACTION" 1 "LVM_NAV" 2 "LVM_DMB" 3 "LVM_PERFORMANCE_COMPUTER" 4 "LVM_COMPLEX_MODE" ;
VAL_TABLE_ IconRcrdReqActv 0 "FALSE" 1 "TRUE" ;
VAL_TABLE_ LVMAVR_StreoAudReq 0 "NO_ACTION" 1 "STEREO_REQUEST" ;
VAL_TABLE_ LVMAVR_SpchRcgnActv 0 "NO_ACTION" 1 "LVM_SPEECH_REC_READY" 2 "LVM_SPEECH_REC_ACTIVE" ;
VAL_TABLE_ TeleAlrmVisReq 0 "NO_ACTION" 1 "ACTIVE" 2 "CANCEL_FLASH" ;
VAL_TABLE_ TeleAlrmHrnReq 0 "NO_ACTION" 1 "ACTIVE" 2 "CANCEL_HORN" ;
VAL_TABLE_ RmtTrlrLtngSeqReq 0 "No Action" 1 "Off" 2 "On" ;
VAL_TABLE_ ASVSC_ReqEnbld 0 "FALSE" 1 "TRUE" ;
VAL_TABLE_ AudSeltdSrcReq 0 "No Action" 1 "AM" 2 "FM" 3 "XM" 4 "DAB" 5 "MediaPlayer" 6 "IPOD" 7 "Bluetooth" 8 "AUX" 9 "Audio Disk Player" 10 "LVM Stereo Audio" 11 "Internet App Audio" 12 "RSI_1" 13 "RSI_2" 14 "RadioSourceReserve14" 15 "RadioSourceReserve15" 16 "RadioSourceReserve16" 17 "RadioSourceReserve17" 18 "RadioSourceReserve18" 19 "RadioSourceReserve19" 20 "RadioSourceReserve20" 21 "RadioSourceReserve21" 22 "RadioSourceReserve22" 23 "RadioSourceReserve23" 24 "RadioSourceReserve24" 25 "RadioSourceReserve25" 26 "RadioSourceReserve26" 27 "RadioSourceReserve27" 28 "RadioSourceReserve29" 29 "RadioSourceReserve30" 30 "RadioSourceReserve31" ;
VAL_TABLE_ V2VEvnt2ChmEvntStat 0 "No Action" 1 "Active" 2 "Cancel Chime" ;
VAL_TABLE_ V2VEvnt1ChmEvntStat 0 "No Action" 1 "Active" 2 "Cancel Chime" ;
VAL_TABLE_ TBTTrnChmEvntStat 0 "NO_ACTION" 1 "ACTIVE" 2 "CANCEL_CHIME" ;
VAL_TABLE_ V2XOprtlStsInd 0 "Unknown" 1 "Off" 2 "Operational Alerts Enabled" 3 "Operational Alerts Disabled" 4 "Operation V2X Disabled" 5 "Manufacturing" 6 "Service" 7 "Failed" ;
VAL_TABLE_ V2VEvnt6ChmEvntStat 0 "No Action" 1 "Active" 2 "Cancel Chime" ;
VAL_TABLE_ V2VEvnt5ChmEvntStat 0 "No Action" 1 "Active" 2 "Cancel Chime" ;
VAL_TABLE_ V2VEvnt4ChmEvntStat 0 "No Action" 1 "Active" 2 "Cancel Chime" ;
VAL_TABLE_ V2VEvnt3ChmEvntStat 0 "No Action" 1 "Active" 2 "Cancel Chime" ;
VAL_TABLE_ V2VAlrtAudAttnReqd 0 "FALSE" 1 "TRUE" ;
VAL_TABLE_ TAR_AudSrcStat 0 "NO_ACTION" 1 "AUDIO_READY" 2 "AUDIO_PLAYING" 3 "AUDIO_REQUEST" 4 "AUDIO_DISCONNECT RESERVED_1" 5 "RESERVED_2" 6 "RESERVED_3" 7 "RESERVED_4" 8 "RESERVED_5" 9 "RESERVED_6" 10 "RESERVED_7" 11 "RESERVED_8" 12 "RESERVED_9" 13 "RESERVED_10" 14 "RESERVED_11" ;
VAL_TABLE_ TAR_AudConctReq 0 "NO ACTION" 1 "MIX_PROMPT" 2 "MUTEX_PROMPT" 3 "RING_TONE" 4 "PHONE" 5 "EMERGENCY_PHONE" 6 "RESERVED_1" 7 "RESERVED_2" 8 "RESERVED_3" 9 "RESERVED_4" 10 "RESERVED_5" 11 "RESERVED_6" 12 "RESERVED_7" 13 "RESERVED_8" 14 "RESERVED_9" 15 "RESERVED_10" ;
VAL_TABLE_ InfoActivtnReq 0 "FALSE" 1 "TRUE" ;
VAL_TABLE_ TnrFreqBndReq 0 "No Action" 1 "Off" 2 "AM" 3 "FM" 4 "DAB" 5 "XM" 6 "RadioBandReserve6" 7 "RadioBandReserve7" 8 "RadioBandReserve8" 9 "RadioBandReserve9" 10 "RadioBandReserve10" 11 "RadioBandReserve11" 12 "RadioBandReserve12" 13 "RadioBandReserve13" 14 "RadioBandReserve14" 15 "RadioBandReserve15" ;
VAL_TABLE_ V2VT_LgtActlPhs 0 "Unknown" 1 "Green" 2 "Yellow" 3 "Red" ;
VAL_TABLE_ V2VT_EmrgVehWrnDir 0 "Not Available" 1 "Front" 2 "Right" 3 "Back" 4 "Left" ;
VAL_TABLE_ V2VT_LgtPhsAtArvl 0 "Unknown" 1 "Green" 2 "Yellow" 3 "Red" ;
VAL_TABLE_ V2VT_LgtVldDir 0 "Unknown" 1 "Straight" 2 "Left" 3 "Right" 4 "All Direction" ;
VAL_TABLE_ V2VT_WrnIndReq 0 "No Indication" 1 "Hard Braking" 2 "Slippery Road" 3 "Stationary Vehicle" 4 "Emergency Vehicle" 5 "Intersection Collision Left" 6 "Intersection Collision Right" 7 "Construction Ahead" 8 "Green Light Optimal Speed Advisory" 9 "Intersection Stop" ;
VAL_TABLE_ TnDrvrVolLimRmtCstChgSetReq 0 "No Action" 1 "Off" 2 "On" ;
VAL_TABLE_ EmrgRespSysTyp 0 "Unknown" 1 "none" 2 "Onstar" 3 "eCall" 4 "ChevyStar" 5 "ERA" 6 "Generic" ;
VAL_TABLE_ ByclDtnCstChgSetReq 0 "No Action" 1 "Off" 2 "Alert" ;
VAL_TABLE_ LBCCDRR_PstnNumReq 0 "No Action" 1 "Position Number 1" 2 "Position Number 2" 3 "Position Number 3" 4 "Position Number 4" ;
VAL_TABLE_ LBCCDRR_ClrStrdPstnReq 0 "No Action" 1 "Request to Clear Position" 2 "Confirmation to Clear Position" ;
VAL_TABLE_ RDMACANFCPP_RadDevPrngNFCAllwd 0 "Unknown" 1 "NFC Pairing Disabled" 2 "NFC Pairing Enabled" ;
VAL_TABLE_ NFCICRstReqd 0 "FALSE" 1 "TRUE" ;
VAL_TABLE_ HillDscntCtlCurrStatReq 0 "No Action" 1 "Disable" 2 "Enable" ;
VAL_TABLE_ RadioDevBTPrngSts 0 "Unknown" 1 "Failed" 2 "Successful" 3 "In progress" 4 "Already paired" ;
VAL_TABLE_ RPSU_Mth 0 "Unknown" 1 "January" 2 "February" 3 "March" 4 "April" 5 "May" 6 "June" 7 "July" 8 "August" 9 "September" 10 "October" 11 "November" 12 "December" ;
VAL_TABLE_ RPSU_Sts 0 "Unknown" 1 "Inactive" 2 "Scheduled" ;
VAL_TABLE_ RadioDevBTDscvrblSts 0 "On" 1 "Off" ;
VAL_TABLE_ InfoFrtSnshdMtnReq 0 "No Request" 1 "Open" 2 "Close" ;
VAL_TABLE_ PhnLtInVehCstSetAval 0 "FALSE" 1 "TRUE" ;
VAL_TABLE_ PhnLtInVehCstCurrSetVal 0 "Setting_Unknown" 1 "Off" 2 "On" 3 "Reserved_3" 4 "Reserved_4" 5 "Reserved_5" 6 "Reserved_6" 7 "Reserved_7" ;
VAL_TABLE_ WrlsChrgSysChrgStat 0 "WCS Not Present" 1 "Charging Inactive" 2 "Charging Active" 3 "Charging Complete" 4 "Foreign Object Detected" 5 "WCS Overtemp Shutdown" 6 "Phone Overtemp" 7 "Establishing Communications" ;
VAL_TABLE_ NFCEHS_NFCStcRstOcc 0 "FALSE" 1 "TRUE" ;
VAL_TABLE_ NFCEHS_NFCHndvrSts 0 "Unknown" 1 "RF Not Detected" 2 "Handover Started" 3 "Handover Successful" 4 "Handover Failure" ;
VAL_TABLE_ NFCEHS_NFCErrRFInterErrOOR 0 "FALSE" 1 "TRUE" ;
VAL_TABLE_ PhnWrlsChrg1DsbldCstAvlFlg3 0 "FALSE" 1 "TRUE" ;
VAL_TABLE_ PhnWrlsChrg1DsbldCstAvlFlg2 0 "FALSE" 1 "TRUE" ;
VAL_TABLE_ PhnWrlsChrg1DsbldCstAvlFlg1 0 "FALSE" 1 "TRUE" ;
VAL_TABLE_ PhnWrlsChrg1DsbldCstCurrSetVal 0 "Setting Unknown" 1 "Off" 2 "On" ;
VAL_TABLE_ PhnLtInVehIndOn 0 "FALSE" 1 "TRUE" ;
VAL_TABLE_ NFCDevDtd 0 "FALSE" 1 "TRUE" ;
VAL_TABLE_ PhnLtInVehCstAvlFlg7 0 "FALSE" 1 "TRUE" ;
VAL_TABLE_ PhnLtInVehCstAvlFlg6 0 "FALSE" 1 "TRUE" ;
VAL_TABLE_ PhnLtInVehCstAvlFlg5 0 "FALSE" 1 "TRUE" ;
VAL_TABLE_ PhnLtInVehCstAvlFlg4 0 "FALSE" 1 "TRUE" ;
VAL_TABLE_ PhnLtInVehCstAvlFlg3 0 "FALSE" 1 "TRUE" ;
VAL_TABLE_ PhnLtInVehCstAvlFlg2 0 "FALSE" 1 "TRUE" ;
VAL_TABLE_ PhnLtInVehCstAvlFlg1 0 "FALSE" 1 "TRUE" ;
VAL_TABLE_ HVACTlmCtlTempLvlActvReqd 0 "FALSE" 1 "TRUE" ;
VAL_TABLE_ VCCLR_CrgMirLmp 0 "No Action" 1 "On" 2 "Off" ;
VAL_TABLE_ VCCLR_CrgLmpHtch 0 "No Action" 1 "On" 2 "Off" ;
VAL_TABLE_ VCCLR_CrgLmp 0 "No Action" 1 "On" 2 "Off" ;
VAL_TABLE_ VCCLR_CrgBedLmp 0 "No Action" 1 "On" 2 "Off" ;
VAL_TABLE_ VCDLR_DomeLgt 0 "No Action" 1 "On" 2 "Off" ;
VAL_TABLE_ VCDLR_DomeDft 0 "No Action" 1 "On" 2 "Off" ;
VAL_TABLE_ VirtCtlDrvModeReq 0 "Normal" 1 "Powertrain Sport" 2 "Chassis Sport" 3 "Eco" 4 "Mountain" 5 "Hold" 6 "Snow Ice" 7 "Start Stop" 8 "Tow Haul" 9 "Grade Braking Disable" 10 "Speed Matching" 11 "Track" 12 "Exhaust Brake" 13 "Normal AWD" 14 "ManualRegen" 15 "Crawl" 16 "Custom" 17 "Personal" 18 "Baja" 19 "Max Power" 20 "Offroad" 21 "Reserved 2" 22 "Reserved 3" 23 "Reserved 4" 24 "Reserved 5" 25 "Reserved 6" 26 "Reserved 7" 27 "Reserved 8" 28 "Reserved 9" 29 "Reserved 10" 30 "No Mode Change Requested" 31 "Critically Disabled" ;
VAL_TABLE_ VirtCtlAutoHiBmReq 0 "No Action" 1 "On" 2 "Off" ;
VAL_TABLE_ TireLkDtnUsrReq 0 "No Action" 1 "Enable" 2 "Disable" 3 "Reset" ;
VAL_TABLE_ VirtCtlTskLmpReq 0 "No Action" 1 "On" 2 "Left" 3 "Right" 4 "Off" ;
VAL_TABLE_ VirtCtlPwrWndLckoutReq 0 "No Action" 1 "On" 2 "Off" ;
VAL_TABLE_ VirtCtlFgLmpRrReq 0 "No Action" 1 "On" 2 "Off" ;
VAL_TABLE_ VirtCtlFgLmpFrtReq 0 "No Action" 1 "On" 2 "Off" ;
VAL_TABLE_ VirtCtlChldSftyLckReq 0 "No Action" 1 "On" 2 "Off" ;
VAL_TABLE_ StVntdCoolBkLvlLFVirtCtlReq 0 "No Request" 1 "Off" 2 "Low" 3 "Medium" 4 "High" ;
VAL_TABLE_ StHtdCushLvlLFVirtCtlReq 0 "No Request" 1 "Off" 2 "Low" 3 "Medium" 4 "High" ;
VAL_TABLE_ StHtdBkLvlLFVirtCtlReq 0 "No Request" 1 "Off" 2 "Low" 3 "Medium" 4 "High" ;
VAL_TABLE_ StVntdCoolCushLvlLFVirtCtlReq 0 "No Request" 1 "Off" 2 "Low" 3 "Medium" 4 "High" ;
VAL_TABLE_ CldrMth 0 "Unknown" 1 "January" 2 "February" 3 "March" 4 "April" 5 "May" 6 "June" 7 "July" 8 "August" 9 "September" 10 "October" 11 "November" 12 "December" ;
VAL_TABLE_ PLCM_LCMFileTrans 0 "No Action" 1 "Begin Transfer" 2 "Successful Block Transfer" 3 "Cancel Transfer" 4 "Retry Last Block" ;
VAL_TABLE_ VirtCtlAuxAlrmSnsrReq 0 "No Action" 1 "On" 2 "Off" ;
VAL_TABLE_ AutoVehHldVirtReq 0 "No Action" 1 "Disable" 2 "Enable One Key Cycle" 3 "Enable Always" ;
VAL_TABLE_ PLCM_LCMDataMsgStat 0 "No Action" 1 "Acknowledge" ;
VAL_TABLE_ CustMdDrvlCstChngSetReq 0 "NO ACTION" 1 "CUSTOM_MODE_1" 2 "CUSTOM_MODE_2" 3 "CUSTOM_MODE_3" 4 "CUSTOM_MODE_4" 5 "CUSTOM_MODE_5" 6 "CUSTOM_MODE_6" 7 "CUSTOM_MODE_7" ;
VAL_TABLE_ CustMdBrkPdlCstChngSetReq 0 "NO_ACTION" 1 "CUSTOM_MODE_1" 2 "CUSTOM_MODE_2" 3 "CUSTOM_MODE_3" 4 "CUSTOM_MODE_4" 5 "CUSTOM_MODE_5" 6 "CUSTOM_MODE_6" 7 "CUSTOM_MODE_7" ;
VAL_TABLE_ CustMdActAeroCstChngSetReq 0 "NO_ACTION" 1 "CUSTOM_MODE_1" 2 "CUSTOM_MODE_2" 3 "CUSTOM_MODE_3" 4 "CUSTOM_MODE_4" 5 "CUSTOM_MODE_5" 6 "CUSTOM_MODE_6" 7 "CUSTOM_MODE_7" ;
VAL_TABLE_ CustMdSndCstChngSetReq 0 "NO_ACTION" 1 "CUSTOM_MODE_1" 2 "CUSTOM_MODE_2" 3 "CUSTOM_MODE_3" 4 "CUSTOM_MODE_4" 5 "CUSTOM_MODE_5" 6 "CUSTOM_MODE_6" 7 "CUSTOM_MODE_7" ;
VAL_TABLE_ CustMdRideHghtCstChngSetReq 0 "NO_ACTION" 1 "CUSTOM_MODE_1" 2 "CUSTOM_MODE_2" 3 "CUSTOM_MODE_3" 4 "CUSTOM_MODE_4" 5 "CUSTOM_MODE_5" 6 "CUSTOM_MODE_6" 7 "CUSTOM_MODE_7" ;
VAL_TABLE_ CustMdPTCstChngSetReq 0 "NO ACTION" 1 "CUSTOM_MODE_1" 2 "CUSTOM_MODE_2" 3 "CUSTOM_MODE_3" 4 "CUSTOM_MODE_4" 5 "CUSTOM_MODE_5" 6 "CUSTOM_MODE_6" 7 "CUSTOM_MODE_7" ;
VAL_TABLE_ CustMdStrCstChngSetReq 0 "NO_ACTION" 1 "CUSTOM_MODE_1" 2 "CUSTOM_MODE_2" 3 "CUSTOM_MODE_3" 4 "CUSTOM_MODE_4" 5 "CUSTOM_MODE_5" 6 "CUSTOM_MODE_6" 7 "CUSTOM_MODE_7" ;
VAL_TABLE_ CustMdSpnCstChngSetReq 0 "NO_ACTION" 1 "CUSTOM_MODE_1" 2 "CUSTOM_MODE_2" 3 "CUSTOM_MODE_3" 4 "CUSTOM_MODE_4" 5 "CUSTOM_MODE_5" 6 "CUSTOM_MODE_6" 7 "CUSTOM_MODE_7" ;
VAL_TABLE_ LvlgSysAlgnMdCstChgSetReq 0 "No Action" 1 "Off" 2 "On" ;
VAL_TABLE_ ExtdHillStrtAsstCstChgSetReq 0 "NO_ACTION" 1 "EXTENDED_HOLD" 2 "STANDARD_HOLD" 3 "RESERVED_3" 4 "RESERVED_4" 5 "RESERVED_5" 6 "RESERVED_6" 7 "RESERVED_7" ;
VAL_TABLE_ CustMdTrcStbCstChngSetReq 0 "NO_ACTION" 1 "CUSTOM_MODE_1" 2 "CUSTOM_MODE_2" 3 "CUSTOM_MODE_3" 4 "CUSTOM_MODE_4" 5 "CUSTOM_MODE_5" 6 "CUSTOM_MODE_6" 7 "CUSTOM_MODE_7" ;
VAL_TABLE_ PrsnlMdActAeroCstChngSetReq 0 "NO_ACTION" 1 "PERSONAL_MODE_1" 2 "PERSONAL_MODE_2" 3 "PERSONAL_MODE_3" 4 "PERSONAL_MODE_4" 5 "PERSONAL_MODE_5" 6 "PERSONAL_MODE_6" 7 "PERSONAL_MODE_7" ;
VAL_TABLE_ LvlgSysServMdCstChgSetReq 0 "No Action" 1 "Off" 2 "On" ;
VAL_TABLE_ LvlgSysEntEgrsMdCstChgSetReq 0 "No Action" 1 "Off" 2 "On" ;
VAL_TABLE_ PrsnlMdDrvlCstChngSetReq 0 "NO_ACTION" 1 "PERSONAL_MODE_1" 2 "PERSONAL_MODE_2" 3 "PERSONAL_MODE_3" 4 "PERSONAL_MODE_4" 5 "PERSONAL_MODE_5" 6 "PERSONAL_MODE_6" 7 "PERSONAL_MODE_7" ;
VAL_TABLE_ PrsnlMdBrkPdlCstChngSetReq 0 "NO_ACTION" 1 "PERSONAL_MODE_1" 2 "PERSONAL_MODE_2" 3 "PERSONAL_MODE_3" 4 "PERSONAL_MODE_4" 5 "PERSONAL_MODE_5" 6 "PERSONAL_MODE_6" 7 "PERSONAL_MODE_7" ;
VAL_TABLE_ PrsnlMdSpnCstChngSetReq 0 "NO_ACTION" 1 "PERSONAL_MODE_1" 2 "PERSONAL_MODE_2" 3 "PERSONAL_MODE_3" 4 "PERSONAL_MODE_4" 5 "PERSONAL_MODE_5" 6 "PERSONAL_MODE_6" 7 "PERSONAL_MODE_7" ;
VAL_TABLE_ PrsnlMdSndCstChngSetReq 0 "NO_ACTION" 1 "PERSONAL_MODE_1" 2 "PERSONAL_MODE_2" 3 "PERSONAL_MODE_3" 4 "PERSONAL_MODE_4" 5 "PERSONAL_MODE_5" 6 "PERSONAL_MODE_6" 7 "PERSONAL_MODE_7" ;
VAL_TABLE_ PrsnlMdRideHghtCstChngSetReq 0 "NO_ACTION" 1 "PERSONAL_MODE_1" 2 "PERSONAL_MODE_2" 3 "PERSONAL_MODE_3" 4 "PERSONAL_MODE_4" 5 "PERSONAL_MODE_5" 6 "PERSONAL_MODE_6" 7 "PERSONAL_MODE_7" ;
VAL_TABLE_ CustmPT_CfgPgAct 0 "FALSE" 1 "TRUE" ;
VAL_TABLE_ DrvrSeltdConf 0 "NO_ACTION" 1 "SETTINGS_ACCEPTED" 2 "SETTINGS_CANCELED" 3 "MENU_ERROR_EVENT" ;
VAL_TABLE_ PrsnlMdStrCstChngSetReq 0 "NO_ACTION" 1 "PERSONAL_MODE_1" 2 "PERSONAL_MODE_2" 3 "PERSONAL_MODE_3" 4 "PERSONAL_MODE_4" 5 "PERSONAL_MODE_5" 6 "PERSONAL_MODE_6" 7 "PERSONAL_MODE_7" ;
VAL_TABLE_ ACCCSR_Aux1Colr 0 "No Action" 1 "OFF" 2 "Color Type 1" 3 "Color Type 2" 4 "Color Type 3" 5 "Color Type 4" 6 "Color Type 5" 7 "Color Type 6" 8 "Color Type 7" 9 "Color Type 8" 10 "Color Type 9" 11 "Color Type 10" 12 "Color Type 11" 13 "Color Type 12" 14 "Color Type 13" 15 "Color Type 14" 16 "Color Type 15" 17 "Color Type 16" 18 "Color Type 17" 19 "Color Type 18" 20 "Color Type 19" 21 "Color Type 20" 22 "Color Type 21" 23 "Color Type 22" 24 "Color Type 23" 25 "Color Type 24" 26 "Color Type 25" 27 "Color Type 26" 28 "Color Type 27" 29 "Color Type 28" 30 "Color Type 29" 31 "Color Type 30" 32 "Color Type 31" 33 "Color Type 32" 34 "Color Type 33" 35 "Color Type 34" 36 "Color Type 35" 37 "Color Type 36" 38 "Color Type 37" 39 "Color Type 38" 40 "Color Type 39" 41 "Color Type 40" 42 "Color Type 41" 43 "Color Type 42" 44 "Color Type 43" 45 "Color Type 44" 46 "Color Type 45" 47 "Color Type 46" 48 "Color Type 47" 49 "Color Type 48" 50 "Color Type 49" 51 "Color Type 50" 52 "Color Type 51" 53 "Color Type 52" 54 "Color Type 53" 55 "Color Type 54" 56 "Color Type 55" 57 "Color Type 56" 58 "Color Type 57" 59 "Color Type 58" 60 "Color Type 59" 61 "Color Type 60" 62 "Color Type 61" 63 "Color Type 62" 64 "Color Type 63" 65 "Color Type 64" 66 "Color Type 65" 67 "Color Type 66" 68 "Color Type 67" 69 "Color Type 68" 70 "Color Type 69" 71 "Color Type 70" 72 "Color Type 71" 73 "Color Type 72" 74 "Color Type 73" 75 "Color Type 74" 76 "Color Type 75" 77 "Color Type 76" 78 "Color Type 77" 79 "Color Type 78" 80 "Color Type 79" 81 "Color Type 80" 82 "Color Type 81" 83 "Color Type 82" 84 "Color Type 83" 85 "Color Type 84" 86 "Color Type 85" 87 "Color Type 86" 88 "Color Type 87" 89 "Color Type 88" 90 "Color Type 89" 91 "Color Type 90" 92 "Color Type 91" 93 "Color Type 92" 94 "Color Type 93" 95 "Color Type 94" 96 "Color Type 95" 97 "Color Type 96" 98 "Color Type 97" 99 "Color Type 98" 100 "Color Type 99" 101 "Color Type 100" 102 "Color Type 101" 103 "Color Type 102" 104 "Color Type 103" 105 "Color Type 104" 106 "Color Type 105" 107 "Color Type 106" 108 "Color Type 107" 109 "Color Type 108" 110 "Color Type 109" 111 "Color Type 110" 112 "Color Type 111" 113 "Color Type 112" 114 "Color Type 113" 115 "Color Type 114" 116 "Color Type 115" 117 "Color Type 116" 118 "Color Type 117" 119 "Color Type 118" 120 "Color Type 119" 121 "Color Type 120" 122 "Color Type 121" 123 "Color Type 122" 124 "Color Type 123" 125 "Color Type 124" 126 "Color Type 125" 127 "Color Type 126" ;
VAL_TABLE_ ACCCSR_Aux1Brghtns 0 "No Action" 1 "BrightnessLevel 1" 2 "BrightnessLevel 2" 3 "BrightnessLevel 3" 4 "BrightnessLevel 4" 5 "ReservedLevel 5" 6 "ReservedLevel 6" 7 "ReservedLevel 7" ;
VAL_TABLE_ ACCCSR_Aux1Anm 0 "No Action" 1 "OFF" 2 "Animation Type 1" 3 "Animation Type 2" 4 "Animation Type 3" 5 "Animation Type 4" 6 "Animation Type 5" 7 "Animation Type 6" 8 "Animation Type 7" 9 "Animation Type 8" 10 "Animation Type 9" 11 "Animation Type 10" 12 "Animation Type 11" 13 "Animation Type 12" 14 "Animation Type 13" 15 "Animation Type 14" ;
VAL_TABLE_ ACCCSR_IntrAnm 0 "No Action" 1 "OFF" 2 "Animation Type 1" 3 "Animation Type 2" 4 "Animation Type 3" 5 "Animation Type 4" 6 "Animation Type 5" 7 "Animation Type 6" 8 "Animation Type 7" 9 "Animation Type 8" 10 "Animation Type 9" 11 "Animation Type 10" 12 "Animation Type 11" 13 "Animation Type 12" 14 "Animation Type 13" 15 "Animation Type 14" ;
VAL_TABLE_ ACCCSR_IntrColr 0 "No Action" 1 "OFF" 2 "Color Type 1" 3 "Color Type 2" 4 "Color Type 3" 5 "Color Type 4" 6 "Color Type 5" 7 "Color Type 6" 8 "Color Type 7" 9 "Color Type 8" 10 "Color Type 9" 11 "Color Type 10" 12 "Color Type 11" 13 "Color Type 12" 14 "Color Type 13" 15 "Color Type 14" 16 "Color Type 15" 17 "Color Type 16" 18 "Color Type 17" 19 "Color Type 18" 20 "Color Type 19" 21 "Color Type 20" 22 "Color Type 21" 23 "Color Type 22" 24 "Color Type 23" 25 "Color Type 24" 26 "Color Type 25" 27 "Color Type 26" 28 "Color Type 27" 29 "Color Type 28" 30 "Color Type 29" 31 "Color Type 30" 32 "Color Type 31" 33 "Color Type 32" 34 "Color Type 33" 35 "Color Type 34" 36 "Color Type 35" 37 "Color Type 36" 38 "Color Type 37" 39 "Color Type 38" 40 "Color Type 39" 41 "Color Type 40" 42 "Color Type 41" 43 "Color Type 42" 44 "Color Type 43" 45 "Color Type 44" 46 "Color Type 45" 47 "Color Type 46" 48 "Color Type 47" 49 "Color Type 48" 50 "Color Type 49" 51 "Color Type 50" 52 "Color Type 51" 53 "Color Type 52" 54 "Color Type 53" 55 "Color Type 54" 56 "Color Type 55" 57 "Color Type 56" 58 "Color Type 57" 59 "Color Type 58" 60 "Color Type 59" 61 "Color Type 60" 62 "Color Type 61" 63 "Color Type 62" 64 "Color Type 63" 65 "Color Type 64" 66 "Color Type 65" 67 "Color Type 66" 68 "Color Type 67" 69 "Color Type 68" 70 "Color Type 69" 71 "Color Type 70" 72 "Color Type 71" 73 "Color Type 72" 74 "Color Type 73" 75 "Color Type 74" 76 "Color Type 75" 77 "Color Type 76" 78 "Color Type 77" 79 "Color Type 78" 80 "Color Type 79" 81 "Color Type 80" 82 "Color Type 81" 83 "Color Type 82" 84 "Color Type 83" 85 "Color Type 84" 86 "Color Type 85" 87 "Color Type 86" 88 "Color Type 87" 89 "Color Type 88" 90 "Color Type 89" 91 "Color Type 90" 92 "Color Type 91" 93 "Color Type 92" 94 "Color Type 93" 95 "Color Type 94" 96 "Color Type 95" 97 "Color Type 96" 98 "Color Type 97" 99 "Color Type 98" 100 "Color Type 99" 101 "Color Type 100" 102 "Color Type 101" 103 "Color Type 102" 104 "Color Type 103" 105 "Color Type 104" 106 "Color Type 105" 107 "Color Type 106" 108 "Color Type 107" 109 "Color Type 108" 110 "Color Type 109" 111 "Color Type 110" 112 "Color Type 111" 113 "Color Type 112" 114 "Color Type 113" 115 "Color Type 114" 116 "Color Type 115" 117 "Color Type 116" 118 "Color Type 117" 119 "Color Type 118" 120 "Color Type 119" 121 "Color Type 120" 122 "Color Type 121" 123 "Color Type 122" 124 "Color Type 123" 125 "Color Type 124" 126 "Color Type 125" 127 "Color Type 126" ;
VAL_TABLE_ ACCCSR_IntrBrghtns 0 "No Action" 1 "BrightnessLevel 1" 2 "BrightnessLevel 2" 3 "BrightnessLevel 3" 4 "BrightnessLevel 4" 5 "ReservedLevel 5" 6 "ReservedLevel 6" 7 "ReservedLevel 7" ;
VAL_TABLE_ AutDrvLckCstChgSetReq 0 "NO_ACTION" 1 "OFF" 2 "ON" 3 "RESERVED_3" 4 "RESERVED_4" 5 "RESERVED_5" 6 "RESERVED_6" 7 "RESERVED_7" ;
VAL_TABLE_ AirQltySensCstChgSetReq 0 "NO_ACTION" 1 "OFF" 2 "LOW_SENSITIVITY" 3 "HI_SENSITIVITY" 4 "RESERVED_4" 5 "RESERVED_5" 6 "RESERVED_6" 7 "RESERVED_7" ;
VAL_TABLE_ AutoAirDstCstChgSetReq 0 "NO_ACTION" 1 "DIFFUSE_AIRFLOW" 2 "NORMAL" 3 "DIRECT_AIRFLOW" 4 "OSCILLATING_AIRFLOW" 5 "RESERVED_5" 6 "RESERVED_6" 7 "RESERVED_7" ;
VAL_TABLE_ AutUnlckCstChgSetReq 0 "NO_ACTION" 1 "OFF" 2 "ALL_DOORS" 3 "DRIVER_DOOR" 4 "RESERVED_4" 5 "RESERVED_5" 6 "RESERVED_6" 7 "RESERVED_7" ;
VAL_TABLE_ AutoFanCstChgSetReq 0 "NO_ACTION" 1 "LOW" 2 "NORMAL" 3 "HIGH" 4 "RESERVED_4" 5 "RESERVED_5" 6 "RESERVED_6" 7 "RESERVED_7" ;
VAL_TABLE_ AutoDfgCstChgSetReq 0 "NO_ACTION" 1 "OFF" 2 "ON" 3 "RESERVED_3" 4 "RESERVED_4" 5 "RESERVED_5" 6 "RESERVED_6" 7 "RESERVED_7" ;
VAL_TABLE_ AutoCoolStCstChgSetReq 0 "NO_ACTION" 1 "OFF" 2 "ON" 3 "RESERVED_3" 4 "RESERVED_4" 5 "RESERVED_5" 6 "RESERVED_6" 7 "RESERVED_7" ;
VAL_TABLE_ AutoRrWpCstChgSetReq 0 "NO_ACTION" 1 "OFF" 2 "ON" 3 "RESERVED_3" 4 "RESERVED_4" 5 "RESERVED_5" 6 "RESERVED_6" 7 "RESERVED_7" ;
VAL_TABLE_ AutoMrFldCstChgSetReq 0 "NO_ACTION" 1 "OFF" 2 "ON" 3 "RESERVED_3" 4 "RESERVED_4" 5 "RESERVED_5" 6 "RESERVED_6" 7 "RESERVED_7" ;
VAL_TABLE_ AutoHtdStCstChgSetReq 0 "NO_ACTION" 1 "OFF" 2 "ON" 3 "RESERVED_3" 4 "RESERVED_4" 5 "RESERVED_5" 6 "RESERVED_6" 7 "RESERVED_7" ;
VAL_TABLE_ ExitLghtngCstChgSetReq 0 "NO_ACTION" 1 "OFF" 2 "THIRTY_SECONDS_DEFAULT" 3 "ONE_MINUTE" 4 "TWO_MINUTES" 5 "RESERVED_5" 6 "RESERVED_6" 7 "RESERVED_7" ;
VAL_TABLE_ DayTmTlLtsCstChgSetReq 0 "NO_ACTION" 1 "OFF" 2 "ON" 3 "RESERVED_3" 4 "RESERVED_4" 5 "RESERVED_5" 6 "RESERVED_6" 7 "RESERVED_7" ;
VAL_TABLE_ LDCLCstChgSetReq 0 "NO_ACTION" 1 "OFF" 2 "ON" 3 "RESERVED_3" 4 "RESERVED_4" 5 "RESERVED_5" 6 "RESERVED_6" 7 "RESERVED_7" ;
VAL_TABLE_ IonzrCtrlCstChgSetReq 0 "NO_ACTION" 1 "OFF" 2 "ON" 3 "RESERVED_3" 4 "RESERVED_4" 5 "RESERVED_5" 6 "RESERVED_6" 7 "RESERVED_7" ;
VAL_TABLE_ HFRCCstChgSetReq 0 "NO_ACTION" 1 "OFF" 2 "OPEN_AND_CLOSE" 3 "OPEN_ONLY" 4 "RESERVED_4" 5 "RESERVED_5" 6 "RESERVED_6" 7 "RESERVED_7" ;
VAL_TABLE_ PsvUnlckCstChgSetReq 0 "NO_ACTION" 1 "DRIVER_DOOR" 2 "ALL_DOORS" 3 "OFF" 4 "RESERVED_4" 5 "RESERVED_5" 6 "RESERVED_6" 7 "RESERVED_7" ;
VAL_TABLE_ PlltnCtrlCstChgSetReq 0 "NO_ACTION" 1 "OFF" 2 "ON" 3 "RESERVED_3" 4 "RESERVED_4" 5 "RESERVED_5" 6 "RESERVED_6" 7 "RESERVED_7" ;
VAL_TABLE_ OpDrAtLOCstChgSetReq 0 "NO_ACTION" 1 "OFF" 2 "ON" 3 "RESERVED_3" 4 "RESERVED_4" 5 "RESERVED_5" 6 "RESERVED_6" 7 "RESERVED_7" ;
VAL_TABLE_ RemInVehRmCstChgSetReq 0 "NO_ACTION" 1 "OFF" 2 "ON" 3 "RESERVED_3" 4 "RESERVED_4" 5 "RESERVED_5" 6 "RESERVED_6" 7 "RESERVED_7" ;
VAL_TABLE_ PwrRrClsrCstChgSetReq 0 "No_Action" 1 "Off" 2 "On" 3 "On_Custom_Height" 4 "RESERVED_4" 5 "RESERVED_5" 6 "RESERVED_6" 7 "RESERVED_7" ;
VAL_TABLE_ RevTltMrCstChgSetReq 0 "NO_ACTION" 1 "OFF" 2 "DRIVER" 3 "PASSENGER" 4 "DRIVER_AND_PASSENGER" 5 "RESERVED_5" 6 "RESERVED_6" 7 "RESERVED_7" ;
VAL_TABLE_ RemWndOpCstChgSetReq 0 "NO_ACTION" 1 "OFF" 2 "ON" 3 "RESERVED_3" 4 "RESERVED_4" 5 "RESERVED_5" 6 "RESERVED_6" 7 "RESERVED_7" ;
VAL_TABLE_ RemLftVehRmCstChgSetReq 0 "NO_ACTION" 1 "OFF" 2 "ON" 3 "RESERVED_3" 4 "RESERVED_4" 5 "RESERVED_5" 6 "RESERVED_6" 7 "RESERVED_7" ;
VAL_TABLE_ RmtStrtCoolStCstChgSetReq 0 "NO_ACTION" 1 "OFF" 2 "ON" 3 "RESERVED_3" 4 "RESERVED_4" 5 "RESERVED_5" 6 "RESERVED_6" 7 "RESERVED_7" ;
VAL_TABLE_ RmtSnrfOpCstChgSetReq 0 "NO_ACTION" 1 "OFF" 2 "ON" 3 "RESERVED_3" 4 "RESERVED_4" 5 "RESERVED_5" 6 "RESERVED_6" 7 "RESERVED_7" ;
VAL_TABLE_ RlkRtUlkDrCstChSetReq 0 "NO_ACTION" 1 "OFF" 2 "ON" 3 "RESERVED_3" 4 "RESERVED_4" 5 "RESERVED_5" 6 "RESERVED_6" 7 "RESERVED_7" ;
VAL_TABLE_ RnSnsCstChgSetReq 0 "NO_ACTION" 1 "OFF" 2 "ON" 3 "RESERVED_3" 4 "RESERVED_4" 5 "RESERVED_5" 6 "RESERVED_6" 7 "RESERVED_7" ;
VAL_TABLE_ RmtStrtHtdStCstChgSetReq 0 "NO_ACTION" 1 "OFF" 2 "ON" 3 "RESERVED_3" 4 "RESERVED_4" 5 "RESERVED_5" 6 "RESERVED_6" 7 "RESERVED_7" ;
VAL_TABLE_ RrZnStUpCstChgSetReq 0 "NO_ACTION" 1 "REAR_OFF" 2 "REAR_MIMIC_FRONT" 3 "REAR_LAST_KNOWN" 4 "RESERVED_4" 5 "RESERVED_5" 6 "RESERVED_6" 7 "RESERVED_7" ;
VAL_TABLE_ RrStRmndrEnblDsblCstChgSetReq 0 "No_Action" 1 "Off" 2 "On" ;
VAL_TABLE_ RrDfgStUpCstChgSetReq 0 "NO_ACTION" 1 "MANUAL" 2 "AUTOMATIC" 3 "RESERVED_3" 4 "RESERVED_4" 5 "RESERVED_5" 6 "RESERVED_6" 7 "RESERVED_7" ;
VAL_TABLE_ RtUlkLtFbCstChgSetReq 0 "NO_ACTION" 1 "OFF" 2 "FLASH_LIGHTS_ON" 3 "RESERVED_3" 4 "RESERVED_4" 5 "RESERVED_5" 6 "RESERVED_6" 7 "RESERVED_7" ;
VAL_TABLE_ RtLkFdbkCstChgSetReq 0 "NO_ACTION" 1 "HORN_AND_LIGHTS_OFF" 2 "HORN_AND_LIGHTS_ON" 3 "FLASH_LIGHTS_ONLY" 4 "HORN_CHIRP_ONLY" 5 "RESERVED_5" 6 "RESERVED_6" 7 "RESERVED_7" ;
VAL_TABLE_ TODCSR_ChrgSchedDyOfWkReq 0 "No Action" 1 "Sunday" 2 "Monday" 3 "Tuesday" 4 "Wednesday" 5 "Thursday" 6 "Friday" 7 "Saturday" 8 "All Days Same" 9 "Monday to Friday Same" 10 "Saturday and Sunday Same" ;
VAL_TABLE_ TODCSR_ChrgSchedCstSetReq 0 "No Action" 1 "Off" 2 "On" ;
VAL_TABLE_ TODCSR_ERSPrdDyReq 0 "No Action" 1 "Weekday 1" 2 "Weekday 2" 3 "Weekday 3" 4 "Weekday 4" 5 "Weekday 5" 6 "Weekend 1" 7 "Weekend 2" 8 "Weekend 3" 9 "Weekend 4" 10 "Weekend 5" ;
VAL_TABLE_ TODCSR_ERSCstSetReq 0 "No Action" 1 "Off" 2 "On" ;
VAL_TABLE_ TODCSR_ERSPrdLvlReq 0 "No Action" 1 "Low Rate" 2 "Medium Rate" 3 "High Rate" 4 "Reserved 1" 5 "Invalid Rate" ;
VAL_TABLE_ PrtblChrgCordLimCstSetReq 0 "No Action" 1 "Reduced" 2 "Maximum" ;
VAL_TABLE_ TODCSR_ERSPrfReq 0 "No Action" 1 "Low Rate" 2 "Medium Rate" 3 "High Rate" ;
VAL_TABLE_ TODCCbnPrcndtngSetReq 0 "No Action" 1 "Off" 2 "On" ;
VAL_TABLE_ TODCSR_LocNumReq 0 "No Action" 1 "Not in Stored Location" 2 "Stored Location 1" 3 "Stored Location 2" 4 "Stored Location 3" 5 "Stored Location 4" ;
VAL_TABLE_ TODCSR_LocChrgPwrLvlReq 0 "Unknown" 1 "Level 1" 2 "Level 2" 3 "DC" 4 "Wireless" ;
VAL_TABLE_ ADASIS_NAVILINK_SpdLmtPsdSpd_DuD 0 "FALSE" 1 "TRUE" ;
VAL_TABLE_ ADASIS_NAVILINK_DigMpVerYr 0 "2000" 1 "2001" 2 "2002" 3 "2003" 4 "2004" 5 "2005" 6 "2006" 7 "2007" 8 "2008" 9 "2009" 10 "2010" 11 "2011" 12 "2012" 13 "2013" 14 "2014" 15 "2015" 16 "2016" 17 "2017" 18 "2018" 19 "2019" 20 "2020" 21 "2021" 22 "2022" 23 "2023" 24 "2024" 25 "2025" 26 "2026" 27 "2027" 28 "2028" 29 "2029" 30 "2030" 31 "2031" 32 "2032" 33 "2033" 34 "2034" 35 "2035" 36 "2036" 37 "2037" 38 "2038" 39 "2039" 40 "2040" 41 "2041" 42 "2042" 43 "2043" 44 "2044" 45 "2045" 46 "2046" 47 "2047" 48 "2048" 49 "2049" 50 "2050" 51 "2051" 52 "2052" 53 "2053" 54 "2054" 55 "2055" 56 "2056" 57 "2057" 58 "2058" 59 "2059" 60 "2060" 61 "2061" 62 "2062" 63 "NOT APPLICABLE" ;
VAL_TABLE_ ADASIS_NAVILINK_DigMpCndlSpdLmt 0 "UNKNOWN" 1 "<= 5 KM/H [MPH]" 2 "7 KM/H [MPH]" 3 "10 KM/H [MPH]" 4 "15 KM/H [MPH]" 5 "20 KM/H [MPH]" 6 "25 KM/H [MPH]" 7 "30 KM/H [MPH]" 8 "35 KM/H [MPH]" 9 "40 KM/H [MPH]" 10 "45 KM/H [MPH]" 11 "50 KM/H [MPH]" 12 "55 KM/H [MPH]" 13 "60 KM/H" 14 "MPH]65 KM/H [MPH]" 15 "70 KM/H [MPH]" 16 "75 KM/H [MPH]" 17 "80 KM/H [MPH]" 18 "85 KM/H [MPH]" 19 "90 KM/H [MPH]" 20 "95 KM/H [MPH]" 21 "100 KM/H [MPH]" 22 "105 KM/H [MPH]" 23 "110 KM/H [MPH]" 24 "115 KM/H [MPH]" 25 "120 KM/H[MPH]" 26 "130 KM/H [MPH]" 27 "140 KM/H [MPH]" 28 "150 KM/H [MPH]" 29 "160 KM/H [MPH]" 30 "UNLIMITED" 31 "NOT AVAILABLE" ;
VAL_TABLE_ ADASIS_NAVILINK_DgtlMpSpdCtgry 0 "> 130 KPH OR > 80 MPH" 1 "101-130 KPH OR 65\???80 MPH" 2 "91-100 KPH OR 55\???64 MPH" 3 "71-90 KPH OR 41\???54 MPH" 4 "51-70 KPH OR 31\???40 MPH" 5 "31-50 KPH OR 21\???30 MPH" 6 "11-30 KPH OR 6 \???20 MPH" 7 "<11 KPH OR < 6 MPH" 8 "UNKNOWN" ;
VAL_TABLE_ ADASIS_NAVILINK_DigMpVerQtr 0 "QUARTER 1" 1 "QUARTER 2" 2 "QUARTER 3" 3 "QUARTER 4" ;
VAL_TABLE_ ADASIS_NAVILINK_FncRdClss 0 "LOCAL" 1 "SFREEWAY" 2 "FREEWAY" 3 "PED-MALL" 4 "HIGHWAY" 5 "ARTERIAL" 6 "ALLEY" 7 "COLLECTOR" ;
VAL_TABLE_ ADASIS_NAVILINK_DigMpEfSpdLmTyp 0 "IMPLICIT" 1 "ON TRAFFIC SIGN" 2 "ONLY BY NIGHT" 3 "ONLY BY DAY" 4 "TIME OF DAY" 5 "ONLY BY RAIN" 6 "ONLY BY SNOW OR FOG" 7 "UNKOWN" ;
VAL_TABLE_ ADASIS_NAVILINK_SprtdLnRd 0 "ROAD IS NOT CONTROLLED ACCESS ROAD" 1 "ROAD IS CONTROLLED ACCESS ROAD" ;
VAL_TABLE_ ADASIS_NAVILINK_SpdLmtUnt 0 "MILES/H" 1 "KM/H" ;
VAL_TABLE_ ADASIS_NAVILINK_MpDtAv 0 "NOT VALID" 1 "VALID" ;
VAL_TABLE_ ADASIS_NAVILINK_DigMpPstSpdLmAs 0 "NOT ASSURED" 1 "ASSURED" ;
VAL_TABLE_ ADASIS_NAVILINK_DigMpDrvngSd 0 "DRIVING SIDE LEFT" 1 "DRIVING SIDE RIGHT" ;
VAL_TABLE_ ADASIS_NAVILINK_LnCtgry 0 "NO INFO AVAILABLE" 1 "ONE LANE" 2 "TWO OR THREE LANES" 3 "FOUR OR MORE LANES" ;
VAL_TABLE_ ReqAirDstRRRr 0 "NoAction" 1 "Auto" 2 "Floor" 3 "FloorAndVent" 4 "Vent" 5 "VentAndRoof" 6 "Roof" 7 "RoofAndFloor" 8 "FloorAndVentAndRoof" ;
VAL_TABLE_ ReqAirDstRLRr 0 "NoAction" 1 "Auto" 2 "Floor" 3 "FloorAndVent" 4 "Vent" 5 "VentAndRoof" 6 "Roof" 7 "RoofAndFloor" 8 "FloorAndVentAndRoof" ;
VAL_TABLE_ HtdStBckCushStckSwLR 0 "FALSE" 1 "TRUE" ;
VAL_TABLE_ RrAirHandlingDrActrPwrFdbk 0 "No Action" 1 "Power Off" 2 "Power On" ;
VAL_TABLE_ ReqBlwLvlRrAtvRr 0 "FALSE" 1 "TRUE" ;
VAL_TABLE_ ReqAirDstChgNxtRRRr 0 "FALSE" 1 "TRUE" ;
VAL_TABLE_ ReqAirDstChgNxtRLRr 0 "FALSE" 1 "TRUE" ;
VAL_TABLE_ HtdVntStSwActvRR 0 "FALSE" 1 "TRUE" ;
VAL_TABLE_ HtdVntStSwActvLR 0 "FALSE" 1 "TRUE" ;
VAL_TABLE_ HtdStBckStckSwRR 0 "FALSE" 1 "TRUE" ;
VAL_TABLE_ HtdStBckStckSwLR 0 "FALSE" 1 "TRUE" ;
VAL_TABLE_ HtdStBckCushStckSwRR 0 "FALSE" 1 "TRUE" ;
VAL_TABLE_ VntStStckSwRR 0 "FALSE" 1 "TRUE" ;
VAL_TABLE_ VntStStckSwLR 0 "FALSE" 1 "TRUE" ;
VAL_TABLE_ RrHVACCtrlInitFin 0 "FALSE" 1 "TRUE" ;
VAL_TABLE_ ReqTmpLvlRRAtvRr 0 "FALSE" 1 "TRUE" ;
VAL_TABLE_ ReqTmpLvlRLAtvRr 0 "FALSE" 1 "TRUE" ;
VAL_TABLE_ ReqSYNC_RrChgRr 0 "FALSE" 1 "TRUE" ;
VAL_TABLE_ ReqRrHVAC_PwrChgRr 0 "FALSE" 1 "TRUE" ;
VAL_TABLE_ ReqRrAutoRr 0 "FALSE" 1 "TRUE" ;
VAL_TABLE_ HVACFCRADR_RtSet 0 "NoAction" 1 "Auto" 2 "Floor" 3 "FloorAndVent" 4 "Vent" 5 "VentAndRoof" 6 "Roof" 7 "RoofAndFloor" 8 "FloorAndVentAndRoof" ;
VAL_TABLE_ HVACFCRADR_RtChgNext 0 "FALSE" 1 "TRUE" ;
VAL_TABLE_ HVACFCRADR_LtSet 0 "NoAction" 1 "Auto" 2 "Floor" 3 "FloorAndVent" 4 "Vent" 5 "VentAndRoof" 6 "Roof" 7 "RoofAndFloor" 8 "FloorAndVentAndRoof" ;
VAL_TABLE_ HVACFCRADR_LtChgNext 0 "FALSE" 1 "TRUE" ;
VAL_TABLE_ HVACFCRACH_CompSetChg 0 "FALSE" 1 "TRUE" ;
VAL_TABLE_ HVACFCRACH_HtrSetChg 0 "FALSE" 1 "TRUE" ;
VAL_TABLE_ HtdStBckCushStckSwRF 0 "FALSE" 1 "TRUE" ;
VAL_TABLE_ HtdStBckCushStckSwLF 0 "FALSE" 1 "TRUE" ;
VAL_TABLE_ HVACFCRRA_SetChg 0 "FALSE" 1 "TRUE" ;
VAL_TABLE_ HVACFCRBLR_LvlActv 0 "FALSE" 1 "TRUE" ;
VAL_TABLE_ HVACFCRRD_SetChg 0 "FALSE" 1 "TRUE" ;
VAL_TABLE_ HVACFCRRP_SetChg 0 "FALSE" 1 "TRUE" ;
VAL_TABLE_ VntStStckSwLF 0 "FALSE" 1 "TRUE" ;
VAL_TABLE_ HtdVntStSwActvRF 0 "FALSE" 1 "TRUE" ;
VAL_TABLE_ HtdVntStSwActvLF 0 "FALSE" 1 "TRUE" ;
VAL_TABLE_ HtdStBckStckSwRF 0 "FALSE" 1 "TRUE" ;
VAL_TABLE_ HtdStBckStckSwLF 0 "FALSE" 1 "TRUE" ;
VAL_TABLE_ HVACFrtCtlReqSyncRrSetChg 0 "FALSE" 1 "TRUE" ;
VAL_TABLE_ HVACFCRSA_SetChg 0 "FALSE" 1 "TRUE" ;
VAL_TABLE_ HVACFCRTLR_LtLvlActv 0 "FALSE" 1 "TRUE" ;
VAL_TABLE_ HVACFCRTLR_RtLvlActv 0 "FALSE" 1 "TRUE" ;
VAL_TABLE_ RHVSLF_VntLvlChgUp 0 "FALSE" 1 "TRUE" ;
VAL_TABLE_ RHVSLF_VntLvlChgDn 0 "FALSE" 1 "TRUE" ;
VAL_TABLE_ RHVSLF_HtdCushBckLvlChgUp 0 "FALSE" 1 "TRUE" ;
VAL_TABLE_ RHVSLF_HtdCushBckLvlChgDn 0 "FALSE" 1 "TRUE" ;
VAL_TABLE_ RHVSLF_HtdBckLvlChgUp 0 "FALSE" 1 "TRUE" ;
VAL_TABLE_ RHVSLF_HtdBckLvlChgDn 0 "FALSE" 1 "TRUE" ;
VAL_TABLE_ HVACFCRL_SetChg 0 "FALSE" 1 "TRUE" ;
VAL_TABLE_ VntStStckSwRF 0 "FALSE" 1 "TRUE" ;
VAL_TABLE_ RHVSRF_VntLvlChgUp 0 "FALSE" 1 "TRUE" ;
VAL_TABLE_ RHVSRF_VntLvlChgDn 0 "FALSE" 1 "TRUE" ;
VAL_TABLE_ RHVSRF_HtdCushBckLvlChgUp 0 "FALSE" 1 "TRUE" ;
VAL_TABLE_ RHVSRF_HtdCushBckLvlChgDn 0 "FALSE" 1 "TRUE" ;
VAL_TABLE_ RHVSRF_HtdBckLvlChgUp 0 "FALSE" 1 "TRUE" ;
VAL_TABLE_ RHVSRF_HtdBckLvlChgDn 0 "FALSE" 1 "TRUE" ;
VAL_TABLE_ PCOSN2_NtfnFrstRowRtStOccpSts 0 "Unknown" 1 "Empty" 2 "Occupied" 3 "Data Not Available" ;
VAL_TABLE_ PCOSN2_NtfnFrstRowRtStBtSts 0 "Unknown" 1 "UnFastened" 2 "Fastened" 3 "Data Not Available" ;
VAL_TABLE_ PCOSN2_NtfnFrstRowLtStOccpSts 0 "Unknown" 1 "Empty" 2 "Occupied" 3 "Data Not Available" ;
VAL_TABLE_ PCOSN2_NtfnFrstRowLtStBtSts 0 "Unknown" 1 "UnFastened" 2 "Fastened" 3 "Data Not Availabl" ;
VAL_TABLE_ PCOSN2_NtfnRrImpASevAchvd 0 "FALSE" 1 "TRUE" ;
VAL_TABLE_ InfoFrtSnshdMtnCtlAval 0 "Not Available" 1 "Available" ;
VAL_TABLE_ CustMdEVPedMpCstmAvFlg1 0 "FALSE" 1 "TRUE" ;
VAL_TABLE_ CustMdEVPedMpCstmAvFlg2 0 "FALSE" 1 "TRUE" ;
VAL_TABLE_ FrtStHtdBkLvlAval 0 "Not Available" 1 "Two Levels Available" 2 "Three Levels Available" 3 "Four Levels Available" ;
VAL_TABLE_ RrStHtdCushBkLvlAval 0 "Not Available" 1 "Two Levels Available" 2 "Three Levels Available" 3 "Four Levels Available" ;
VAL_TABLE_ RrStHtdBkLvlAval 0 "Not Available" 1 "Two Levels Available" 2 "Three Levels Available" 3 "Four Levels Available" ;
VAL_TABLE_ FrtStVntCoolLvlAval 0 "Not Available" 1 "Two Levels Available" 2 "Three Levels Available" 3 "Four Levels Available" ;
VAL_TABLE_ FrtStHtdCushBkLvlAval 0 "Not Available" 1 "Two Levels Available" 2 "Three Levels Available" 3 "Four Levels Available" ;
VAL_TABLE_ RrStVntCoolLvlAval 0 "Not Available" 1 "Two Levels Available" 2 "Three Levels Available" 3 "Four Levels Available" ;
VAL_TABLE_ CustMdEVPedMpCstmCurSetVal 0 "SETTING_UNKNOWN" 1 "CUSTOM_MODE_1" 2 "CUSTOM_MODE_2" 3 "CUSTOM_MODE_3" 4 "CUSTOM_MODE_4" 5 "CUSTOM_MODE_5" 6 "CUSTOM_MODE_6" 7 "CUSTOM_MODE_7" ;
VAL_TABLE_ VhStShVehOnExtdMdSwReqd 0 "FALSE" 1 "TRUE" ;
VAL_TABLE_ VSEMOpEndAllwdSts 0 "Unknown" 1 "Not Allowed" 2 "Allowed" ;
VAL_TABLE_ CustMdEngyRegnCstmCurSetVal 0 "SETTING_UNKNOWN" 1 "CUSTOM_MODE_1" 2 "CUSTOM_MODE_2" 3 "CUSTOM_MODE_3" 4 "CUSTOM_MODE_4" 5 "CUSTOM_MODE_5" 6 "CUSTOM_MODE_6" 7 "CUSTOM_MODE_7" ;
VAL_TABLE_ OffRdMdElecVehPedMpVisDispVal 0 "SETTING_UNKNOWN" 1 "CUSTOM_MODE_1" 2 "CUSTOM_MODE_2" 3 "CUSTOM_MODE_3" 4 "CUSTOM_MODE_4" 5 "CUSTOM_MODE_5" 6 "CUSTOM_MODE_6" 7 "CUSTOM_MODE_7" ;
VAL_TABLE_ PrsnlMdEngyRegnCstmCurSetVal 0 "SETTING_UNKNOWN" 1 "CUSTOM_MODE_1" 2 "CUSTOM_MODE_2" 3 "CUSTOM_MODE_3" 4 "CUSTOM_MODE_4" 5 "CUSTOM_MODE_5" 6 "CUSTOM_MODE_6" 7 "CUSTOM_MODE_7" ;
VAL_TABLE_ PrsnlMdEVPedMpCstmCurSetVal 0 "SETTING_UNKNOWN" 1 "CUSTOM_MODE_1" 2 "CUSTOM_MODE_2" 3 "CUSTOM_MODE_3" 4 "CUSTOM_MODE_4" 5 "CUSTOM_MODE_5" 6 "CUSTOM_MODE_6" 7 "CUSTOM_MODE_7" ;
VAL_TABLE_ OffRdMdEngyRegnVisDispVal 0 "SETTING_UNKNOWN" 1 "CUSTOM_MODE_1" 2 "CUSTOM_MODE_2" 3 "CUSTOM_MODE_3" 4 "CUSTOM_MODE_4" 5 "CUSTOM_MODE_5" 6 "CUSTOM_MODE_6" 7 "CUSTOM_MODE_7" ;
VAL_TABLE_ SprtMdEngyRegnVisDispVal 0 "SETTING_UNKNOWN" 1 "CUSTOM_MODE_1" 2 "CUSTOM_MODE_2" 3 "CUSTOM_MODE_3" 4 "CUSTOM_MODE_4" 5 "CUSTOM_MODE_5" 6 "CUSTOM_MODE_6" 7 "CUSTOM_MODE_7" ;
VAL_TABLE_ SprtMdElecVehPedMpVisDispVal 0 "SETTING_UNKNOWN" 1 "CUSTOM_MODE_1" 2 "CUSTOM_MODE_2" 3 "CUSTOM_MODE_3" 4 "CUSTOM_MODE_4" 5 "CUSTOM_MODE_5" 6 "CUSTOM_MODE_6" 7 "CUSTOM_MODE_7" ;
VAL_TABLE_ TourMdElecVehPedMpVisDispVal 0 "SETTING_UNKNOWN" 1 "CUSTOM_MODE_1" 2 "CUSTOM_MODE_2" 3 "CUSTOM_MODE_3" 4 "CUSTOM_MODE_4" 5 "CUSTOM_MODE_5" 6 "CUSTOM_MODE_6" 7 "CUSTOM_MODE_7" ;
VAL_TABLE_ TkMdEngyRegnVisDispVal 0 "SETTING_UNKNOWN" 1 "CUSTOM_MODE_1" 2 "CUSTOM_MODE_2" 3 "CUSTOM_MODE_3" 4 "CUSTOM_MODE_4" 5 "CUSTOM_MODE_5" 6 "CUSTOM_MODE_6" 7 "CUSTOM_MODE_7" ;
VAL_TABLE_ TkMdElecVehPedMpVisDispVal 0 "SETTING_UNKNOWN" 1 "CUSTOM_MODE_1" 2 "CUSTOM_MODE_2" 3 "CUSTOM_MODE_3" 4 "CUSTOM_MODE_4" 5 "CUSTOM_MODE_5" 6 "CUSTOM_MODE_6" 7 "CUSTOM_MODE_7" ;
VAL_TABLE_ TrnMdBrkPedVisDispVal 0 "SETTING_UNKNOWN" 1 "CUSTOM_MODE_1" 2 "CUSTOM_MODE_2" 3 "CUSTOM_MODE_3" 4 "CUSTOM_MODE_4" 5 "CUSTOM_MODE_5" 6 "CUSTOM_MODE_6" 7 "CUSTOM_MODE_7" ;
VAL_TABLE_ TrnMdActvAerodynsVisDispVal 0 "SETTING_UNKNOWN" 1 "CUSTOM_MODE_1" 2 "CUSTOM_MODE_2" 3 "CUSTOM_MODE_3" 4 "CUSTOM_MODE_4" 5 "CUSTOM_MODE_5" 6 "CUSTOM_MODE_6" 7 "CUSTOM_MODE_7" ;
VAL_TABLE_ TourMdEngyRegnVisDispVal 0 "SETTING_UNKNOWN" 1 "CUSTOM_MODE_1" 2 "CUSTOM_MODE_2" 3 "CUSTOM_MODE_3" 4 "CUSTOM_MODE_4" 5 "CUSTOM_MODE_5" 6 "CUSTOM_MODE_6" 7 "CUSTOM_MODE_7" ;
VAL_TABLE_ TrnMdESCVisDispVal 0 "SETTING_UNKNOWN" 1 "CUSTOM_MODE_1" 2 "CUSTOM_MODE_2" 3 "CUSTOM_MODE_3" 4 "CUSTOM_MODE_4" 5 "CUSTOM_MODE_5" 6 "CUSTOM_MODE_6" 7 "CUSTOM_MODE_7" ;
VAL_TABLE_ TrnMdDrvlnVisDispVal 0 "SETTING_UNKNOWN" 1 "CUSTOM_MODE_1" 2 "CUSTOM_MODE_2" 3 "CUSTOM_MODE_3" 4 "CUSTOM_MODE_4" 5 "CUSTOM_MODE_5" 6 "CUSTOM_MODE_6" 7 "CUSTOM_MODE_7" ;
VAL_TABLE_ TrnMdPwrtrnVisDispVal 0 "SETTING_UNKNOWN" 1 "CUSTOM_MODE_1" 2 "CUSTOM_MODE_2" 3 "CUSTOM_MODE_3" 4 "CUSTOM_MODE_4" 5 "CUSTOM_MODE_5" 6 "CUSTOM_MODE_6" 7 "CUSTOM_MODE_7" ;
VAL_TABLE_ TrnMdEngyRegnVisDispVal 0 "SETTING_UNKNOWN" 1 "CUSTOM_MODE_1" 2 "CUSTOM_MODE_2" 3 "CUSTOM_MODE_3" 4 "CUSTOM_MODE_4" 5 "CUSTOM_MODE_5" 6 "CUSTOM_MODE_6" 7 "CUSTOM_MODE_7" ;
VAL_TABLE_ TrnMdElecVehPedMpVisDispVal 0 "SETTING_UNKNOWN" 1 "CUSTOM_MODE_1" 2 "CUSTOM_MODE_2" 3 "CUSTOM_MODE_3" 4 "CUSTOM_MODE_4" 5 "CUSTOM_MODE_5" 6 "CUSTOM_MODE_6" 7 "CUSTOM_MODE_7" ;
VAL_TABLE_ CustMdEVPedMpCstmAvFlg3 0 "FALSE" 1 "TRUE" ;
VAL_TABLE_ TrnMdSndVisDispVal 0 "SETTING_UNKNOWN" 1 "CUSTOM_MODE_1" 2 "CUSTOM_MODE_2" 3 "CUSTOM_MODE_3" 4 "CUSTOM_MODE_4" 5 "CUSTOM_MODE_5" 6 "CUSTOM_MODE_6" 7 "CUSTOM_MODE_7" ;
VAL_TABLE_ TrnMdRideHghtVisDispVal 0 "SETTING_UNKNOWN" 1 "CUSTOM_MODE_1" 2 "CUSTOM_MODE_2" 3 "CUSTOM_MODE_3" 4 "CUSTOM_MODE_4" 5 "CUSTOM_MODE_5" 6 "CUSTOM_MODE_6" 7 "CUSTOM_MODE_7" ;
VAL_TABLE_ TrnMdStrgVisDispVal 0 "SETTING_UNKNOWN" 1 "CUSTOM_MODE_1" 2 "CUSTOM_MODE_2" 3 "CUSTOM_MODE_3" 4 "CUSTOM_MODE_4" 5 "CUSTOM_MODE_5" 6 "CUSTOM_MODE_6" 7 "CUSTOM_MODE_7" ;
VAL_TABLE_ TrnMdSpnsnVisDispVal 0 "SETTING_UNKNOWN" 1 "CUSTOM_MODE_1" 2 "CUSTOM_MODE_2" 3 "CUSTOM_MODE_3" 4 "CUSTOM_MODE_4" 5 "CUSTOM_MODE_5" 6 "CUSTOM_MODE_6" 7 "CUSTOM_MODE_7" ;
VAL_TABLE_ WthrMdEngyRegnVisDispVal 0 "SETTING_UNKNOWN" 1 "CUSTOM_MODE_1" 2 "CUSTOM_MODE_2" 3 "CUSTOM_MODE_3" 4 "CUSTOM_MODE_4" 5 "CUSTOM_MODE_5" 6 "CUSTOM_MODE_6" 7 "CUSTOM_MODE_7" ;
VAL_TABLE_ WthrMdElecVehPedMpVisDispVal 0 "SETTING_UNKNOWN" 1 "CUSTOM_MODE_1" 2 "CUSTOM_MODE_2" 3 "CUSTOM_MODE_3" 4 "CUSTOM_MODE_4" 5 "CUSTOM_MODE_5" 6 "CUSTOM_MODE_6" 7 "CUSTOM_MODE_7" ;
VAL_TABLE_ CustMdEVPedMpCstmAvFlg4 0 "FALSE" 1 "TRUE" ;
VAL_TABLE_ HtdStrgWhlLvlAval 0 "Not Available" 1 "Two Levels Available" 2 "Three Levels Available" 3 "Four Levels Available" ;
VAL_TABLE_ CustMdEngyRegnCstmAvFlg4 0 "FALSE" 1 "TRUE" ;
VAL_TABLE_ CustMdEngyRegnCstmAvFlg3 0 "FALSE" 1 "TRUE" ;
VAL_TABLE_ CustMdEngyRegnCstmAvFlg2 0 "FALSE" 1 "TRUE" ;
VAL_TABLE_ CustMdEngyRegnCstmAvFlg1 0 "FALSE" 1 "TRUE" ;
VAL_TABLE_ CustMdEVPedMpCstmSetAv 0 "FALSE" 1 "TRUE" ;
VAL_TABLE_ CustMdEVPedMpCstmAvFlg7 0 "FALSE" 1 "TRUE" ;
VAL_TABLE_ CustMdEVPedMpCstmAvFlg6 0 "FALSE" 1 "TRUE" ;
VAL_TABLE_ CustMdEVPedMpCstmAvFlg5 0 "FALSE" 1 "TRUE" ;
VAL_TABLE_ OnePedDrvCstSetAllwdFlg3 0 "FALSE" 1 "TRUE" ;
VAL_TABLE_ OnePedDrvCstSetAllwdFlg2 0 "FALSE" 1 "TRUE" ;
VAL_TABLE_ OnePedDrvCstSetAllwdFlg1 0 "FALSE" 1 "TRUE" ;
VAL_TABLE_ CustMdEngyRegnCstmSetAv 0 "FALSE" 1 "TRUE" ;
VAL_TABLE_ CustMdEngyRegnCstmAvFlg7 0 "FALSE" 1 "TRUE" ;
VAL_TABLE_ CustMdEngyRegnCstmAvFlg6 0 "FALSE" 1 "TRUE" ;
VAL_TABLE_ CustMdEngyRegnCstmAvFlg5 0 "FALSE" 1 "TRUE" ;
VAL_TABLE_ OnePedDrvCstSetAvlFlg3 0 "FALSE" 1 "TRUE" ;
VAL_TABLE_ OnePedDrvCstSetAvlFlg2 0 "FALSE" 1 "TRUE" ;
VAL_TABLE_ OnePedDrvCstSetAvlFlg1 0 "FALSE" 1 "TRUE" ;
VAL_TABLE_ OnePedDrvCstSetAval 0 "FALSE" 1 "TRUE" ;
VAL_TABLE_ OnePedDrvCstSetAllwdFlg7 0 "FALSE" 1 "TRUE" ;
VAL_TABLE_ OnePedDrvCstSetAllwdFlg6 0 "FALSE" 1 "TRUE" ;
VAL_TABLE_ OnePedDrvCstSetAllwdFlg5 0 "FALSE" 1 "TRUE" ;
VAL_TABLE_ OnePedDrvCstSetAllwdFlg4 0 "FALSE" 1 "TRUE" ;
VAL_TABLE_ PrsnlMdEVPedMpCstmAvFlg3 0 "FALSE" 1 "TRUE" ;
VAL_TABLE_ PrsnlMdEVPedMpCstmAvFlg2 0 "FALSE" 1 "TRUE" ;
VAL_TABLE_ PrsnlMdEVPedMpCstmAvFlg1 0 "FALSE" 1 "TRUE" ;
VAL_TABLE_ OnePedDrvCstSetAvlFlg7 0 "FALSE" 1 "TRUE" ;
VAL_TABLE_ OnePedDrvCstSetAvlFlg6 0 "FALSE" 1 "TRUE" ;
VAL_TABLE_ OnePedDrvCstSetAvlFlg5 0 "FALSE" 1 "TRUE" ;
VAL_TABLE_ OnePedDrvCstSetAvlFlg4 0 "FALSE" 1 "TRUE" ;
VAL_TABLE_ PrsnlMdEngyRegnCstmAvFlg3 0 "FALSE" 1 "TRUE" ;
VAL_TABLE_ PrsnlMdEngyRegnCstmAvFlg2 0 "FALSE" 1 "TRUE" ;
VAL_TABLE_ PrsnlMdEngyRegnCstmAvFlg1 0 "FALSE" 1 "TRUE" ;
VAL_TABLE_ PrsnlMdEVPedMpCstmSetAv 0 "FALSE" 1 "TRUE" ;
VAL_TABLE_ PrsnlMdEVPedMpCstmAvFlg7 0 "FALSE" 1 "TRUE" ;
VAL_TABLE_ PrsnlMdEVPedMpCstmAvFlg6 0 "FALSE" 1 "TRUE" ;
VAL_TABLE_ PrsnlMdEVPedMpCstmAvFlg5 0 "FALSE" 1 "TRUE" ;
VAL_TABLE_ PrsnlMdEVPedMpCstmAvFlg4 0 "FALSE" 1 "TRUE" ;
VAL_TABLE_ PwrFrtStrgeCmptClsrCstAvlFlg2 0 "FALSE" 1 "TRUE" ;
VAL_TABLE_ PwrFrtStrgeCmptClsrCstAvlFlg1 0 "FALSE" 1 "TRUE" ;
VAL_TABLE_ PrsnlMdEngyRegnCstmSetAv 0 "FALSE" 1 "TRUE" ;
VAL_TABLE_ PrsnlMdEngyRegnCstmAvFlg7 0 "FALSE" 1 "TRUE" ;
VAL_TABLE_ PrsnlMdEngyRegnCstmAvFlg6 0 "FALSE" 1 "TRUE" ;
VAL_TABLE_ PrsnlMdEngyRegnCstmAvFlg5 0 "FALSE" 1 "TRUE" ;
VAL_TABLE_ PrsnlMdEngyRegnCstmAvFlg4 0 "FALSE" 1 "TRUE" ;
VAL_TABLE_ VirtCtlAccCktCtlAval 0 "Not Available" 1 "Available" ;
VAL_TABLE_ PwrFrtStrgeCmptClsrCstSetAval 0 "FALSE" 1 "TRUE" ;
VAL_TABLE_ PwrFrtStrgeCmptClsrCstAvlFlg7 0 "FALSE" 1 "TRUE" ;
VAL_TABLE_ PwrFrtStrgeCmptClsrCstAvlFlg6 0 "FALSE" 1 "TRUE" ;
VAL_TABLE_ PwrFrtStrgeCmptClsrCstAvlFlg5 0 "FALSE" 1 "TRUE" ;
VAL_TABLE_ PwrFrtStrgeCmptClsrCstAvlFlg4 0 "FALSE" 1 "TRUE" ;
VAL_TABLE_ PwrFrtStrgeCmptClsrCstAvlFlg3 0 "FALSE" 1 "TRUE" ;
VAL_TABLE_ VirtOnePedDrvUserCtlAllwd 0 "Allowed" 1 "Not Allowed" ;
VAL_TABLE_ VirtOnePedDrvCtlAval 0 "Not Available" 1 "Available" ;
VAL_TABLE_ VirtCtlAuxAlrmSnsCtlAval 0 "Not Available" 1 "Available" ;
VAL_TABLE_ DispdEstdCbnTemp_Inv 0 "FALSE" 1 "TRUE" ;
VAL_TABLE_ HiVltgBatDispTempLvlPct_DuD 0 "FALSE" 1 "TRUE" ;
VAL_TABLE_ CbnPrcndtngSts 0 "No Action" 1 "Inactive" 2 "Active" 3 "Performance Limited" 4 "Cabin At Target" 5 "Disabled" ;
VAL_TABLE_ HiVltgBatPrcndtngSts 0 "No Action" 1 "Inactive" 2 "Active" 3 "Performance Limited" 4 "Battery At Target" 5 "Disabled" ;
VAL_TABLE_ HiVltgBatPrcndtngSts_DuD 0 "FALSE" 1 "TRUE" ;
VAL_TABLE_ CbnPrcndtngSchTempCstSetAval 0 "FALSE" 1 "TRUE" ;
VAL_TABLE_ OnePedDrvCstCurrSetVal 0 "Setting Unknown" 1 "Level 1" 2 "Level 2" 3 "Level 3" 4 "Level 4" ;
VAL_TABLE_ HiVltgBatLoSOCIndReq 0 "No Action" 1 "Warning Level 1" 2 "Warning Level 2" 3 "Warning Level 3" ;
VAL_TABLE_ HiVltgBatLoSOCIndReq_DuD 0 "FALSE" 1 "TRUE" ;
VAL_TABLE_ OnePedDrvCurrSeltnVal 0 "Unknown" 1 "On" 2 "Off" ;
VAL_TABLE_ FrtStrgeCmptClsrLckSts 0 "Unknown" 1 "Unlocked" 2 "Locked" ;
VAL_TABLE_ AuxAlrmSnsCurrSeltnVal 0 "Unknown" 1 "On" 2 "Off" ;
VAL_TABLE_ PwrFrtStrgeCmptClsrCstCurSetVal 0 "Setting Unknown" 1 "Off" 2 "On" 3 "On - Custom Height" ;
VAL_TABLE_ VirtCtlAccCkt3CurrSeltnVal 0 "Unknown" 1 "On" 2 "Off" 3 "Failed" ;
VAL_TABLE_ VirtCtlAccCkt2CurrSeltnVal 0 "Unknown" 1 "On" 2 "Off" 3 "Failed" ;
VAL_TABLE_ VirtCtlAccCkt1CurrSeltnVal 0 "Unknown" 1 "On" 2 "Off" 3 "Failed" ;
VAL_TABLE_ OnePedDrvWrnIndReq 0 "No Action" 1 "Forced Exit" ;
VAL_TABLE_ HVDCFstChrgPerfLtdIndOn 0 "FALSE" 1 "TRUE" ;
VAL_TABLE_ VirtCtlAccCkt6CurrSeltnVal 0 "Unknown" 1 "On" 2 "Off" 3 "Failed" ;
VAL_TABLE_ VirtCtlAccCkt5CurrSeltnVal 0 "Unknown" 1 "On" 2 "Off" 3 "Failed" ;
VAL_TABLE_ VirtCtlAccCkt4CurrSeltnVal 0 "Unknown" 1 "On" 2 "Off" 3 "Failed" ;
VAL_TABLE_ OnePedDrvIndOn 0 "FALSE" 1 "TRUE" ;
VAL_TABLE_ HVDCFstChrgPrepCmpltIndOn 0 "FALSE" 1 "TRUE" ;
VAL_TABLE_ ADASLtdCpbltyStatRsnIndReq 0 "No Indication" 1 "No Communication to Navigation" 2 "No Route Entered" 3 "Sensor Blocked" 4 "Sensor Failed" 5 "Sensor Unavailable" 6 "Camera Blocked" 7 "Camera Failed" 8 "Camera Unavailable" 9 "Turn Signal Failure" 10 "Driver Has Taken Control" 11 "Trailer Connected" ;
VAL_TABLE_ PrplSysMaxPwrModeUnvRsn 0 "No Indication" 1 "Charge Battery" 2 "Temperature Too Cold" 3 "Reason 3" 4 "Reason 4" 5 "Reason 5" 6 "Reason 6" 7 "Reason 7" ;
VAL_TABLE_ ADASMsgDispLocLtdPerfRsnInd 0 "None" 1 "Cluster Display" 2 "Center Stack Display" 3 "Both" ;
VAL_TABLE_ ADASLtdCpbltyStatIndReq 0 "No Indication" 1 "Map Route Not Available" 2 "Low Velocity Maneuvers Not Available" 3 "Drive Straight Only" 4 "Highway Only" 5 "Longitudinal Override" 6 "Lateral Override" ;
VAL_TABLE_ B2RChmEvntStat 0 "No Action" 1 "Active" 2 "Cancel Chime" ;
VAL_TABLE_ POFT_PstnOfstFrmTrmLF_Inv 0 "FALSE" 1 "TRUE" ;
VAL_TABLE_ POFT_PstnOfstFrmTrmLR_Inv 0 "FALSE" 1 "TRUE" ;
VAL_TABLE_ POFT_PstnOfstFrmTrmRF_Inv 0 "FALSE" 1 "TRUE" ;
VAL_TABLE_ POFT_PstnOfstFrmTrmRR_Inv 0 "FALSE" 1 "TRUE" ;
VAL_TABLE_ RideHghtMaxPwrModeOvrrd 0 "FALSE" 1 "TRUE" ;
VAL_TABLE_ PwrFrtStrgeCmptClsrCstChgSetReq 0 "No Action" 1 "Off" 2 "On" 3 "On - Custom Height" ;
VAL_TABLE_ ElecRateSchedSsnStrtMthReq 0 "No Action" 1 "January" 2 "February" 3 "March" 4 "April" 5 "May" 6 "June" 7 "July" 8 "August" 9 "September" 10 "October" 11 "November" 12 "December" ;
VAL_TABLE_ ElecRateSchedSsnReq 0 "No Action" 1 "Summer" 2 "Winter" 3 "Yearly" ;
VAL_TABLE_ InfoFrtLtStHtdCushBkLvlReq 0 "No Action" 1 "Off" 2 "Auto" 3 "Low" 4 "Medium" 5 "High" ;
VAL_TABLE_ InfoFrtLtStHtdBkLvlReq 0 "No Action" 1 "Off" 2 "Auto" 3 "Low" 4 "Medium" 5 "High" ;
VAL_TABLE_ InfoFrtRtStHtdCushBkLvlReq 0 "No Action" 1 "Off" 2 "Auto" 3 "Low" 4 "Medium" 5 "High" ;
VAL_TABLE_ InfoFrtRtStHtdBkLvlReq 0 "No Action" 1 "Off" 2 "Auto" 3 "Low" 4 "Medium" 5 "High" ;
VAL_TABLE_ InfoFrtLtStVntCoolLvlReq 0 "No Action" 1 "Off" 2 "Auto" 3 "Low" 4 "Medium" 5 "High" ;
VAL_TABLE_ InfoRrLtStHtdBkLvlReq 0 "No Action" 1 "Off" 2 "Auto" 3 "Low" 4 "Medium" 5 "High" ;
VAL_TABLE_ InfoFrtRtStVntCoolLvlReq 0 "No Action" 1 "Off" 2 "Auto" 3 "Low" 4 "Medium" 5 "High" ;
VAL_TABLE_ InfoRrRtStHtdBkLvlReq 0 "No Action" 1 "Off" 2 "Auto" 3 "Low" 4 "Medium" 5 "High" ;
VAL_TABLE_ InfoRrLtStVntCoolLvlReq 0 "No Action" 1 "Off" 2 "Auto" 3 "Low" 4 "Medium" 5 "High" ;
VAL_TABLE_ InfoRrLtStHtdCushBkLvlReq 0 "No Action" 1 "Off" 2 "Auto" 3 "Low" 4 "Medium" 5 "High" ;
VAL_TABLE_ InfoRrRtStVntCoolLvlReq 0 "No Action" 1 "Off" 2 "Auto" 3 "Low" 4 "Medium" 5 "High" ;
VAL_TABLE_ InfoRrRtStHtdCushBkLvlReq 0 "No Action" 1 "Off" 2 "Auto" 3 "Low" 4 "Medium" 5 "High" ;
VAL_TABLE_ OnePedDrvCstChgSetReq 0 "No Action" 1 "Level 1" 2 "Level 2" 3 "Level 3" 4 "Level 4" ;
VAL_TABLE_ InfoHtdStrgWhlLvlReq 0 "No Action" 1 "Off" 2 "Auto" 3 "Low" 4 "Medium" 5 "High" ;
VAL_TABLE_ VirtCtlAccCkt2Req 0 "No Action" 1 "Momentary On" 2 "Momentary Lightbar On" 3 "Latch On" 4 "Latch Lightbar On" 5 "Off" ;
VAL_TABLE_ VirtCtlAccCkt1Req 0 "No Action" 1 "Momentary On" 2 "Momentary Lightbar On" 3 "Latch On" 4 "Latch Lightbar On" 5 "Off" ;
VAL_TABLE_ VirtCtlAccCkt5Req 0 "No Action" 1 "Momentary On" 2 "Momentary Lightbar On" 3 "Latch On" 4 "Latch Lightbar On" 5 "Off" ;
VAL_TABLE_ VirtCtlAccCkt4Req 0 "No Action" 1 "Momentary On" 2 "Momentary Lightbar On" 3 "Latch On" 4 "Latch Lightbar On" 5 "Off" ;
VAL_TABLE_ VirtCtlAccCkt3Req 0 "No Action" 1 "Momentary On" 2 "Momentary Lightbar On" 3 "Latch On" 4 "Latch Lightbar On" 5 "Off" ;
VAL_TABLE_ VirtOnePedDrvReq 0 "No Action" 1 "On" 2 "Off" ;
VAL_TABLE_ VirtCtlAccCkt6Req 0 "No Action" 1 "Momentary On" 2 "Momentary Lightbar On" 3 "Latch On" 4 "Latch Lightbar On" 5 "Off" ;
VAL_TABLE_ HVDCFstChrgSoonReq 0 "No Action" 1 "Off" 2 "On" ;
VAL_TABLE_ CustMdEngyRegnCstChngSetReq 0 "NO ACTION" 1 "CUSTOM_MODE_1" 2 "CUSTOM_MODE_2" 3 "CUSTOM_MODE_3" 4 "CUSTOM_MODE_4" 5 "CUSTOM_MODE_5" 6 "CUSTOM_MODE_6" 7 "CUSTOM_MODE_7" ;
VAL_TABLE_ CustMdEVPedMpCstChngSetReq 0 "NO ACTION" 1 "CUSTOM_MODE_1" 2 "CUSTOM_MODE_2" 3 "CUSTOM_MODE_3" 4 "CUSTOM_MODE_4" 5 "CUSTOM_MODE_5" 6 "CUSTOM_MODE_6" 7 "CUSTOM_MODE_7" ;
VAL_TABLE_ CbnPrcndtngSchTempCstSetReqAtv 0 "FALSE" 1 "TRUE" ;
VAL_TABLE_ ChrgCordThftAlrtCstSetReq 0 "No Action" 1 "Off" 2 "On" ;
VAL_TABLE_ PrsnlMdEngyRegnCstChngSetReq 0 "NO ACTION" 1 "PERSONAL_MODE_1" 2 "PERSONAL_MODE_2" 3 "PERSONAL_MODE_3" 4 "PERSONAL_MODE_4" 5 "PERSONAL_MODE_5" 6 "PERSONAL_MODE_6" 7 "PERSONAL_MODE_7" ;
VAL_TABLE_ PrsnlMdEVPedMpCstChngSetReq 0 "NO ACTION" 1 "PERSONAL_MODE_1" 2 "PERSONAL_MODE_2" 3 "PERSONAL_MODE_3" 4 "PERSONAL_MODE_4" 5 "PERSONAL_MODE_5" 6 "PERSONAL_MODE_6" 7 "PERSONAL_MODE_7" ;
VAL_TABLE_ HVBatSOCDspHdlmpCstChgSetReq 0 "No Action" 1 "Off" 2 "On" ;
VAL_TABLE_ RmtVehStrtPwrtrnFlrRsn 0 "None" 1 "Engine Speed High" 2 "Engine Over Temperature" 3 "Powertrain Crank Aborted" 4 "Engine Oil Pressure Low" 5 "Maximum Crank Time Exceeded" 6 "Malfunction Indicator Lamp Illuminated" 7 "RVS Backup Timer Expired" 8 "Accelerator Pedal Position High" 9 "Transmission Range Not Park" 10 "Vehicle Speed Not Zero" 11 "Vehicle Theft Disable" 12 "Transfer Case In Neutral" 13 "Remaining RVS Count Equals Zero" 14 "Low Fuel Level" 15 "NOx Reductant Fluid Level Low or Empty" 16 "Low Fuel Level Due To Grade" ;
VAL_TABLE_ RmtVehStrtBdyFlrRsn 0 "None" 1 "Valet Mode Active" 2 "Powetrain Run Aborted" 3 "Start Stop Switch Monitored Failed Signal is True" 4 "Hood Input Fault" 5 "Hood Ajar" 6 "Hazards Active" 7 "PushButton Starting Fob in Vehicle" 8 "Powertrain Crank Abort" 9 "Brake To Shift Interlock Fault" 10 "Content Theft State" 11 "Vehicle Power Mode not Off" 12 "Remote Vehicle Start Voltage Out Of Range" 13 "RVS Max Crank Time Exceeded" 14 "Convertible Top Not Fully Open or Fully Closed" ;
VAL_TABLE_ TlmHVDCFstChrgSoonReq 0 "No Action" 1 "Off" 2 "On" ;
VAL_TABLE_ TnDrvrOvrspdWrnRmtCstChgSetReq 0 "No Action" 1 "Off" 2 "On" ;
VAL_TABLE_ TnDrStBltShIntlkRtCstLvChgSetRq 0 "No Action" 1 "Off" 2 "On" ;
VAL_TABLE_ VirtKeyCmdFailRsnReq 0 "No Request" 1 "Request RVS Fail Reason" ;
VAL_TABLE_ SuprCruzSbscrptnActv 0 "FALSE" 1 "TRUE" ;
VAL_TABLE_ LIB1TempFlt 0 "No Fault" 1 "Low Severity" 2 "Medium Severity" 3 "High Severity" ;
VAL_TABLE_ LIB1TempFlt_Inv 0 "FALSE" 1 "TRUE" ;
VAL_TABLE_ IndHtrSet 0 "Heater Off" 1 "Heater On" ;
VAL_TABLE_ ICMTrngOncmgTrfcChmEvntStat 0 "No Action" 1 "Active" 2 "Cancel Chime" ;
VAL_TABLE_ ICMRtChmEvntStat 0 "No Action" 1 "Active" 2 "Cancel Chime" ;
VAL_TABLE_ ICMLtChmEvntStat 0 "No Action" 1 "Active" 2 "Cancel Chime" ;
VAL_TABLE_ SuprRmtPrkWrnIndReq 0 "Off" 1 "Searching Parallel Right" 2 "Searching Parallel Left" 3 "Searching Cross Right" 4 "Searching Cross Left" 5 "Spot Found" 6 "Spot Found Parallel Left" 7 "Spot Found Cross Left" 8 "Spot Found Parallel Right" 9 "Spot Found Cross Right" 10 "Move Ahead" 11 "Move Ahead Parallel Left" 12 "Move Ahead Cross Left" 13 "Move Ahead Parallel Right" 14 "Move Ahead Cross Right" 15 "Stop And R Parallel Left" 16 "Stop And R Cross Back Left" 17 "Stop And R Cross Front Left" 18 "Stop And R Parallel Right" 19 "Stop And R Cross Back Right" 20 "Stop And R Cross Front Right" 21 "Search Speed Warning" 22 "Search Deactivated" 23 "Exit Park To Left" 24 "Exit Park To Right" 25 "Select Drive GEAR" 26 "Auto Steering Active" 27 "Auto Parking Active" 28 "Drive Backward" 29 "Backward Move" 30 "Drive Forward" 31 "Forward Move" 32 "Stop" 33 "Shifting" 34 "Position Reached" 35 "Take Control" 36 "ParkIng Complete" 37 "Exit Park Complete" 38 "Deactivated" 39 "Canceled General" 40 "Canceled Moves" 41 "Canceled Speed" 42 "Canceled Interference" 43 "Canceled Exit Park" 44 "Stopping" 45 "Auto Parking Complete" 46 "Release Brake" 47 "In Vehicle Or Remote" 48 "Remote Stay Alert" 49 "Remote Connecting" 50 "Remote Cannot Connect" 51 "Remote No Device" 52 "Remote Shift To Park" 53 "Remote Retry" 54 "Remote Canceled Range" 55 "Remote Canceled Supervision" 56 "Remote Canceled ConnectIon" 57 "Remote Paused Range" 58 "Remote Paused Supervision" 59 "Remote Paused ConnectIon" 60 "Search Drawer Exit" 61 "Search Drawer Park" 62 "Spot Selection Accept" 63 "Unable To Connect" 64 "Cancel Door" 65 "Pause Obstruction" 66 "Cancel Obstruction" 67 "No Exit Spot Found" 68 "Handshake Failure" 69 "Failed To Engage" 70 "Fasten Seatbelt" ;
VAL_TABLE_ SuprRmtPrkFcsReq 0 "No Request" 1 "Focus Request IPC" 2 "Focus Request CSM" 3 "Focus Request VCU" ;
VAL_TABLE_ SuprRmtPrkAutoStrgIconReq 0 "No Icon" 1 "Active" 2 "Deactivated" ;
VAL_TABLE_ SuprRmtPrkUnabletoCnctExtReq 0 "Hidden" 1 "Disabled" 2 "Enabled" 3 "Highlighted" ;
VAL_TABLE_ SuprRmtPrkSptSeltnRmtReq 0 "Hidden" 1 "Disabled" 2 "Enabled" 3 "Highlighted" ;
VAL_TABLE_ SuprRmtPrkSptSeltnKeepLkReq 0 "Hidden" 1 "Disabled" 2 "Enabled" 3 "Highlighted" ;
VAL_TABLE_ SuprRmtPrkSptSeltnAcceptReq 0 "Hidden" 1 "Disabled" 2 "Enabled" 3 "Highlighted" ;
VAL_TABLE_ SuprRmtPrkDctvSftBtnReq 0 "Hidden" 1 "Disabled" 2 "Enabled" 3 "Highlighted" ;
VAL_TABLE_ SuprRmtPrkUnabletoCnctTryAgnReq 0 "Hidden" 1 "Disabled" 2 "Enabled" 3 "Highlighted" ;
VAL_TABLE_ IBS12VEstdBatTemp_Inv 0 "FALSE" 1 "TRUE" ;
VAL_TABLE_ RrStrgOprtlStsAuth 0 "Unknown" 1 "Normal" 2 "Temporarily Unavailable" 3 "Reduced Performance" 4 "Failed" 5 "Normal & Active Safety Control" 6 "Reserved" ;
VAL_TABLE_ RrStrgAlgnCmpltAuth 0 "FALSE" 1 "TRUE" ;
VAL_TABLE_ RrStrgActlPerfMode 0 "No Action" 1 "Normal" 2 "Sport" 3 "Comfort" 4 "Track" 5 "Tow/Haul" 6 "City/Offroad" 7 "Terrain" ;
VAL_TABLE_ RrStrgActlModeAuth 0 "Automatic" 1 "Fixed" 2 "Crab" 3 "None" ;
VAL_TABLE_ RrStrgRdWhlAngAuth_DuD 0 "FALSE" 1 "TRUE" ;
VAL_TABLE_ RrStrgRdWhlAngAuth_Inv 0 "FALSE" 1 "TRUE" ;
VAL_TABLE_ CrtsyLgtSmrtIconReqd 0 "FALSE" 1 "TRUE" ;
VAL_TABLE_ ActvTrlrProfLifetmEcon_DuD 0 "FALSE" 1 "TRUE" ;
VAL_TABLE_ PnCStsDisp 0 "No Action" 1 "No Errors" 2 "Unplug And Replug" 3 "Two Factor Authentication Failure" 4 "Try Different Charging Station" 5 "Install Contract or Private Operator Certificate" 6 "Contract Certificate Invalid" 7 "Service Vehicle" 8 "Certificate Revoked" ;
VAL_TABLE_ ActvTrlrProfLifetmEcon_Inv 0 "FALSE" 1 "TRUE" ;
VAL_TABLE_ PTExPrtclFltrMnlRgnSts 0 "Cleaning Not Required" 1 "Allowed" 2 "Not Allowed" 3 "In Progress" 4 "Complete" 5 "Pending Driver Input" 6 "Not Available" 7 "Do Not Press Pedals" ;
VAL_TABLE_ ICMWrnIndReq 0 "Off" 1 "Left" 2 "Right" 3 "Oncoming" ;
VAL_TABLE_ EngAftRunIndReq 0 "No Action" 1 "No Indication" 2 "Idle Needed" 3 "Overheated" 4 "Interrupted" ;
VAL_TABLE_ PnCEnbldSts 0 "Unknown" 1 "Enabled" 2 "Disabled" ;
VAL_TABLE_ AutoCoolServFllIndReq 0 "No Indication" 1 "ACSF Enabled" 2 "ACSF Completed Successfully" 3 "ACSF Canceled" ;
VAL_TABLE_ RrStrgModeUnvIndReq 0 "No Indication" 1 "Speed Too High" 2 "Incorrect Gear" 3 "Mode Unavailable" 4 "Steering Too Fast" 5 "Automated Driving 1" 6 "Automated Driving 2" ;
VAL_TABLE_ PwrFrtStrgeCmptMtnSts 0 "Unknown" 1 "Closed" 2 "Opening" 3 "Closing" 4 "Stopped - Normal" 5 "Stopped - Obstacle" 6 "Closing - Hold System Fault" 7 "Fully Opened" 8 "Opening Due To Obstacle" 9 "Closing Due To Obstacle" 10 "Released To Ajar" 11 "Released To Open" 12 "System Unavailable" ;
VAL_TABLE_ RrStrgModeSeltnIndOn 0 "FALSE" 1 "TRUE" ;
VAL_TABLE_ PTExPrtclFltrWrn3IndOn 0 "FALSE" 1 "TRUE" ;
VAL_TABLE_ HdLmpSmrtCtlPrmtReqd 0 "FALSE" 1 "TRUE" ;
VAL_TABLE_ ESCUnvTopDnIndOn 0 "FALSE" 1 "TRUE" ;
VAL_TABLE_ RIMObjAtchdIndOn 0 "FALSE" 1 "TRUE" ;
VAL_TABLE_ RIMElecPrkBrkRelIndOn 0 "FALSE" 1 "TRUE" ;
VAL_TABLE_ UpftrVehStrtEnblIndReq 0 "No Indication" 1 "On" 2 "Off" 3 "Not Available" ;
VAL_TABLE_ MaxPwrModeDndIndOn 0 "FALSE" 1 "TRUE" ;
VAL_TABLE_ DrvModeConfIndReq 0 "No Indication" 1 "Baja ESC Reduced" 2 "Terrain ESC Off" 3 "Max Power" 4 "Confirmation 4" 5 "Confirmation 5" 6 "Confirmation 6" 7 "Confirmation 7" ;
VAL_TABLE_ LnchCtlSts 0 "No Action" 1 "Unavailable" 2 "Available" 3 "Armed" 4 "Active" 5 "Generic Unused 5" 6 "Generic Unused 6" 7 "Generic Unused 7" ;
VAL_TABLE_ LnchCtlCchTrgrd 0 "FALSE" 1 "TRUE" ;
VAL_TABLE_ AmbtLgtGblPrxmtyEnCstCurrSetVal 0 "Setting Unknown" 1 "Enable" 2 "Disable" ;
VAL_TABLE_ LnchCtlUnvRsn 0 "No Indication" 1 "Steering Turned" 2 "Generic Unused 2" 3 "Generic Unused 3" 4 "Generic Unused 4" 5 "Generic Unused 5" 6 "Generic Unused 6" 7 "Generic Unused 7" ;
VAL_TABLE_ PSATIP_PriATActlAuth_Inv 0 "FALSE" 1 "TRUE" ;
VAL_TABLE_ SSID1P_LngAccelAuth_Inv 0 "FALSE" 1 "TRUE" ;
VAL_TABLE_ LIB1AvgTemp_Inv 0 "FALSE" 1 "TRUE" ;
VAL_TABLE_ FCATgtObjSeltnDispSnsrCnfd 0 "None" 1 "Low" 2 "Medium" 3 "High" ;
VAL_TABLE_ PnCActnReqCertfctTyp 0 "None" 1 "GM Provisioning Certificate" 2 "Contract Certificate" 3 "V2G Root Certificate" 4 "OCSP Certificate" 5 "Private Operator Root Certificate" 6 "Reserved1" 7 "Reserved2" 8 "Reserved3" 9 "Reserved4" 10 "Reserved5" 11 "Reserved6" 12 "Reserved7" 13 "Reserved8" 14 "All Contract And Private Operator Root Certificates" ;
VAL_TABLE_ PnCActnReqCertfctOp 0 "No Action" 1 "Disable Certificate" 2 "Enable Certificate" 3 "Erase Certificate" 4 "Install Certificate" ;
VAL_TABLE_ InfoDyNtDispModeSeltnCurrSetVal 0 "No Action" 1 "Auto" 2 "Day" 3 "Night" ;
VAL_TABLE_ PnCEnblReq 0 "Unknown" 1 "No Action" 2 "Enable" 3 "Disable" ;
VAL_TABLE_ TrlrProfLifetmEconRstReqd 0 "FALSE" 1 "TRUE" ;
VAL_TABLE_ FCASensCstChgSetReq 0 "No Action" 1 "Off" 2 "Low" 3 "Medium" 4 "High" ;
VAL_TABLE_ PwrtrnExhPrtclFiltManRegnReq 0 "FALSE" 1 "TRUE" ;
VAL_TABLE_ LnDtnWrnSpprssnVirtCtlReq 0 "No Action" 1 "Off" 2 "On" ;
VAL_TABLE_ BlndZnStrgAsstVirtCtlReq 0 "No Action" 1 "Off" 2 "On" ;
VAL_TABLE_ NtVsnDispThmActv 0 "FALSE" 1 "TRUE" ;
VAL_TABLE_ VidAggrgtrSrlzrRestrtReq 0 "FALSE" 1 "TRUE" ;
VAL_TABLE_ PTExPrtclFltrMnlRgnDispPrsnt 0 "FALSE" 1 "TRUE" ;
VAL_TABLE_ PGI4P_ActlAxlTrqSecAuth_Inv 0 "FALSE" 1 "TRUE" ;
VAL_TABLE_ IndHtgACSet 0 "Off" 1 "Heat Only" 2 "Air Conditioning Only" ;
VAL_TABLE_ SuprRmtPrkAval 0 "Not Available" 1 "Available" ;
VAL_TABLE_ Bat12VSysUnstabIndOn 0 "FALSE" 1 "TRUE" ;
VAL_TABLE_ DMSDrwIntnDrvrWrnIndReq 0 "No Indication" 1 "Level 1" 2 "Level 2" 3 "Level 3" 4 "Level 4a" 5 "Level 4b" 6 "Level 4c" 7 "Inattentive Alert" 8 "Drowsy Off" 9 "Inattentive Off" 10 "Failed" 11 "Unavailable" ;
VAL_TABLE_ PPMShwVehOnExtModeSwReqd 0 "FALSE" 1 "TRUE" ;
VAL_TABLE_ DMSTnDrvrDrwIntnOffUnvIndOn 0 "FALSE" 1 "TRUE" ;
VAL_TABLE_ DMSDrwDrvrDispLvl 0 "No Indication" 1 "4 bars" 2 "3 bars" 3 "2 bars" 4 "1 bar" 5 "1 bar pulse" ;
VAL_TABLE_ DMSDrwDrvrCstCurrSetVal 0 "Setting Unknown" 1 "Off" 2 "Normal" 3 "Low Sensitivity" ;
VAL_TABLE_ PPMShwVehEmrgOffSwReqd 0 "FALSE" 1 "TRUE" ;
VAL_TABLE_ PPMVehOffPrssBtnAgnSmrtPrmtReqd 0 "FALSE" 1 "TRUE" ;
VAL_TABLE_ DMSIntnDrvrCstCurrSetVal 0 "Setting Unknown" 1 "Off" 2 "On" ;
VAL_TABLE_ DMSDrwDrvrIndReq 0 "Indicator Off" 1 "White Indicator" 2 "Green Indicator" 3 "Amber Indicator" 4 "Amber Flashing Indicator" 5 "Red Indicator" ;
VAL_TABLE_ DMSIntnDrvrDispFcsInd 0 "Unknown" 1 "Off Road" 2 "On Road" ;
VAL_TABLE_ DMSIntnDrvrIndReq 0 "Indicator Off" 1 "White Indicator" 2 "Green Indicator" 3 "Amber Indicator" 4 "Amber Flashing Indicator" 5 "Red Indicator" ;
VAL_TABLE_ DMSIntnDrvrDispLvl 0 "No Indication" 1 "4 bars" 2 "3 bars" 3 "2 bars" 4 "1 bar" 5 "1 bar pulse" ;
VAL_TABLE_ GNSSVel01EstVelUncrtnty_DuD 0 "FALSE" 1 "TRUE" ;
VAL_TABLE_ GNSSVel01EstVel_Inv 0 "FALSE" 1 "TRUE" ;
VAL_TABLE_ GNSSVel01EstVel_DuD 0 "FALSE" 1 "TRUE" ;
VAL_TABLE_ GNSSVel01EstVelUncrtnty_Inv 0 "FALSE" 1 "TRUE" ;
VAL_TABLE_ GNSSVel01NrthVel_Inv 0 "FALSE" 1 "TRUE" ;
VAL_TABLE_ GNSSVel01NrthVel_DuD 0 "FALSE" 1 "TRUE" ;
VAL_TABLE_ GNSSVel01NrthVelUncrtnty_Inv 0 "FALSE" 1 "TRUE" ;
VAL_TABLE_ GNSSVel01NrthVelUncrtnty_DuD 0 "FALSE" 1 "TRUE" ;
VAL_TABLE_ GNSSVel02UpVelUncrtnty_Inv 0 "FALSE" 1 "TRUE" ;
VAL_TABLE_ GNSSVel02UpVelUncrtnty_DuD 0 "FALSE" 1 "TRUE" ;
VAL_TABLE_ GNSSVel02UpVel_Inv 0 "FALSE" 1 "TRUE" ;
VAL_TABLE_ GNSSVel02UpVel_DuD 0 "FALSE" 1 "TRUE" ;
VAL_TABLE_ APALtSftBtnStsIPC 0 "Not Pressed" 1 "Pressed" ;
VAL_TABLE_ APALtSftBtnSts 0 "Not Pressed" 1 "Pressed" ;
VAL_TABLE_ APAExtPrkSftBtnSts 0 "Not Pressed" 1 "Pressed" ;
VAL_TABLE_ APACrssFrntInSftBtnStat 0 "Not Pressed" 1 "Pressed" ;
VAL_TABLE_ APACrsBkInSftBtnSts 0 "Not Pressed" 1 "Pressed" ;
VAL_TABLE_ APABkBtnSts 0 "No Request" 1 "Back Request" ;
VAL_TABLE_ APASuprPrkSts 0 "No Request" 1 "In Vehicle Request" 2 "Supervised Request" ;
VAL_TABLE_ APASrchingSftBtnSts 0 "Not Pressed" 1 "Pressed" ;
VAL_TABLE_ APARtSftBtnStsIPC 0 "Not Pressed" 1 "Pressed" ;
VAL_TABLE_ APARtSftBtnSts 0 "Not Pressed" 1 "Pressed" ;
VAL_TABLE_ APAParallelPrkSftBtnSts 0 "Not Pressed" 1 "Pressed" ;
VAL_TABLE_ PhnZnEnbl 0 "FALSE" 1 "TRUE" ;
VAL_TABLE_ PTOEngRunTmrCstAvlFlg14 0 "FALSE" 1 "TRUE" ;
VAL_TABLE_ PTOEngRunTmrCstAvlFlg13 0 "FALSE" 1 "TRUE" ;
VAL_TABLE_ PTOEngRunTmrCstAvlFlg12 0 "FALSE" 1 "TRUE" ;
VAL_TABLE_ PTOEngRunTmrCstAvlFlg11 0 "FALSE" 1 "TRUE" ;
VAL_TABLE_ PTOEngRunTmrCstAvlFlg10 0 "FALSE" 1 "TRUE" ;
VAL_TABLE_ PTOEngRunTmrCstAvlFlg1 0 "FALSE" 1 "TRUE" ;
VAL_TABLE_ OffBrdVehImbNtfn 0 "No action" 1 "Warning Level 1" 2 "Warning Level 2" 3 "Warning Level 3" ;
VAL_TABLE_ PTOEngRunTmrCstAvlFlg8 0 "FALSE" 1 "TRUE" ;
VAL_TABLE_ PTOEngRunTmrCstAvlFlg7 0 "FALSE" 1 "TRUE" ;
VAL_TABLE_ PTOEngRunTmrCstAvlFlg6 0 "FALSE" 1 "TRUE" ;
VAL_TABLE_ PTOEngRunTmrCstAvlFlg5 0 "FALSE" 1 "TRUE" ;
VAL_TABLE_ PTOEngRunTmrCstAvlFlg4 0 "FALSE" 1 "TRUE" ;
VAL_TABLE_ PTOEngRunTmrCstAvlFlg3 0 "FALSE" 1 "TRUE" ;
VAL_TABLE_ PTOEngRunTmrCstAvlFlg2 0 "FALSE" 1 "TRUE" ;
VAL_TABLE_ PTOEngRunTmrCstAvlFlg15 0 "FALSE" 1 "TRUE" ;
VAL_TABLE_ PTOSet1SpdCstAvlFlg11 0 "FALSE" 1 "TRUE" ;
VAL_TABLE_ PTOSet1SpdCstAvlFlg10 0 "FALSE" 1 "TRUE" ;
VAL_TABLE_ PTOSet1SpdCstAvlFlg1 0 "FALSE" 1 "TRUE" ;
VAL_TABLE_ PTOModeCstAvlFlg2 0 "FALSE" 1 "TRUE" ;
VAL_TABLE_ PTOModeCstAvlFlg1 0 "FALSE" 1 "TRUE" ;
VAL_TABLE_ PTOEngSpdTypCstAvlFlg2 0 "FALSE" 1 "TRUE" ;
VAL_TABLE_ PTOEngSpdTypCstAvlFlg1 0 "FALSE" 1 "TRUE" ;
VAL_TABLE_ PTOEngRunTmrCstAvlFlg9 0 "FALSE" 1 "TRUE" ;
VAL_TABLE_ PTOSet1SpdCstAvlFlg5 0 "FALSE" 1 "TRUE" ;
VAL_TABLE_ PTOSet1SpdCstAvlFlg4 0 "FALSE" 1 "TRUE" ;
VAL_TABLE_ PTOSet1SpdCstAvlFlg3 0 "FALSE" 1 "TRUE" ;
VAL_TABLE_ PTOSet1SpdCstAvlFlg2 0 "FALSE" 1 "TRUE" ;
VAL_TABLE_ PTOSet1SpdCstAvlFlg15 0 "FALSE" 1 "TRUE" ;
VAL_TABLE_ PTOSet1SpdCstAvlFlg14 0 "FALSE" 1 "TRUE" ;
VAL_TABLE_ PTOSet1SpdCstAvlFlg13 0 "FALSE" 1 "TRUE" ;
VAL_TABLE_ PTOSet1SpdCstAvlFlg12 0 "FALSE" 1 "TRUE" ;
VAL_TABLE_ PTOSet2SpdCstAvlFlg12 0 "FALSE" 1 "TRUE" ;
VAL_TABLE_ PTOSet2SpdCstAvlFlg11 0 "FALSE" 1 "TRUE" ;
VAL_TABLE_ PTOSet2SpdCstAvlFlg10 0 "FALSE" 1 "TRUE" ;
VAL_TABLE_ PTOSet2SpdCstAvlFlg1 0 "FALSE" 1 "TRUE" ;
VAL_TABLE_ PTOSet1SpdCstAvlFlg9 0 "FALSE" 1 "TRUE" ;
VAL_TABLE_ PTOSet1SpdCstAvlFlg8 0 "FALSE" 1 "TRUE" ;
VAL_TABLE_ PTOSet1SpdCstAvlFlg7 0 "FALSE" 1 "TRUE" ;
VAL_TABLE_ PTOSet1SpdCstAvlFlg6 0 "FALSE" 1 "TRUE" ;
VAL_TABLE_ PTOSet2SpdCstAvlFlg6 0 "FALSE" 1 "TRUE" ;
VAL_TABLE_ PTOSet2SpdCstAvlFlg5 0 "FALSE" 1 "TRUE" ;
VAL_TABLE_ PTOSet2SpdCstAvlFlg4 0 "FALSE" 1 "TRUE" ;
VAL_TABLE_ PTOSet2SpdCstAvlFlg3 0 "FALSE" 1 "TRUE" ;
VAL_TABLE_ PTOSet2SpdCstAvlFlg2 0 "FALSE" 1 "TRUE" ;
VAL_TABLE_ PTOSet2SpdCstAvlFlg15 0 "FALSE" 1 "TRUE" ;
VAL_TABLE_ PTOSet2SpdCstAvlFlg14 0 "FALSE" 1 "TRUE" ;
VAL_TABLE_ PTOSet2SpdCstAvlFlg13 0 "FALSE" 1 "TRUE" ;
VAL_TABLE_ PTOStndbySpdCstAvlFlg5 0 "FALSE" 1 "TRUE" ;
VAL_TABLE_ PTOStndbySpdCstAvlFlg4 0 "FALSE" 1 "TRUE" ;
VAL_TABLE_ PTOStndbySpdCstAvlFlg3 0 "FALSE" 1 "TRUE" ;
VAL_TABLE_ PTOStndbySpdCstAvlFlg2 0 "FALSE" 1 "TRUE" ;
VAL_TABLE_ PTOStndbySpdCstAvlFlg1 0 "FALSE" 1 "TRUE" ;
VAL_TABLE_ PTOSet2SpdCstAvlFlg9 0 "FALSE" 1 "TRUE" ;
VAL_TABLE_ PTOSet2SpdCstAvlFlg8 0 "FALSE" 1 "TRUE" ;
VAL_TABLE_ PTOSet2SpdCstAvlFlg7 0 "FALSE" 1 "TRUE" ;
VAL_TABLE_ PTOTpStpSpdCstAvlFlg6 0 "FALSE" 1 "TRUE" ;
VAL_TABLE_ PTOTpStpSpdCstAvlFlg5 0 "FALSE" 1 "TRUE" ;
VAL_TABLE_ PTOTpStpSpdCstAvlFlg4 0 "FALSE" 1 "TRUE" ;
VAL_TABLE_ PTOTpStpSpdCstAvlFlg3 0 "FALSE" 1 "TRUE" ;
VAL_TABLE_ PTOTpStpSpdCstAvlFlg2 0 "FALSE" 1 "TRUE" ;
VAL_TABLE_ PTOTpStpSpdCstAvlFlg1 0 "FALSE" 1 "TRUE" ;
VAL_TABLE_ PTOStndbySpdCstAvlFlg7 0 "FALSE" 1 "TRUE" ;
VAL_TABLE_ PTOStndbySpdCstAvlFlg6 0 "FALSE" 1 "TRUE" ;
VAL_TABLE_ PTOTpStpSpdCstAvlFlg7 0 "FALSE" 1 "TRUE" ;
VAL_TABLE_ VehColdBatPerfIndOn 0 "FALSE" 1 "TRUE" ;
VAL_TABLE_ ActvRrSplrVirtUserCtlAllwd 0 "Allowed" 1 "Not Allowed" ;
VAL_TABLE_ ActvRrSplrVirtCtlAval 0 "Not Available" 1 "Available" ;
VAL_TABLE_ ActvRrSplrVirtCtlCurrSeltnVal 0 "Unknown" 1 "No Indication" 2 "Stowed" 3 "Stowing" 4 "Deployed" 5 "Deploying" 6 "Obstruction Detected" ;
VAL_TABLE_ TrlrJckKnfAlrtSts 0 "Unknown" 1 "No Alert Active" 2 "Phase 1 Alert Active" 3 "Phase 2 Alert Active" ;
VAL_TABLE_ VirtCtlHtdVntStSwRrAval 0 "Not Available" 1 "Available" ;
VAL_TABLE_ VirtCtlHtdVntStSwFrtAval 0 "Not Available" 1 "Available" ;
VAL_TABLE_ InfoOffRdAppInfltDfltAsstEnbld 0 "FALSE" 1 "TRUE" ;
VAL_TABLE_ UpftrSnwPlwIndReq 0 "No Indication" 1 "Active" 2 "Active with Headlamps Disabled" 3 "Not Available" ;
VAL_TABLE_ UpftrRrAprchPrtctnIndReq 0 "No Indication" 1 "Armed" 2 "Deactivated" 3 "Triggered" 4 "Not Available" ;
VAL_TABLE_ LifetmEleclEngyEcon_DuD 0 "FALSE" 1 "TRUE" ;
VAL_TABLE_ ChrgCycEleclEngyUsd_DuD 0 "FALSE" 1 "TRUE" ;
VAL_TABLE_ UpftrRadioMutReqd 0 "FALSE" 1 "TRUE" ;
VAL_TABLE_ UpftrBkupCamActvnReqd 0 "FALSE" 1 "TRUE" ;
VAL_TABLE_ AutoHiBmSmrtIconReqd 0 "FALSE" 1 "TRUE" ;
VAL_TABLE_ RIMUnvTlgtIndOn 0 "FALSE" 1 "TRUE" ;
VAL_TABLE_ PnCBkOfcDatTrgrd 0 "FALSE" 1 "TRUE" ;
VAL_TABLE_ TransOilFiltChgIndOn 0 "FALSE" 1 "TRUE" ;
VAL_TABLE_ InfoOffRdAppInfltDfltAsstReqd 0 "FALSE" 1 "TRUE" ;
VAL_TABLE_ VwgVwprtStsExtd 0 "Unknown" 1 "No Request" 2 "Underbody Forward" 3 "Underbody Rearward" 4 "Underbody Forward Split" 5 "Underbody Forward Rearward Split" ;
VAL_TABLE_ VwgVwprtReqExtd 0 "Unknown" 1 "No Request" 2 "Underbody Forward" 3 "Underbody Rearward" 4 "Underbody Forward Split" 5 "Underbody Forward Rearward Split" ;
VAL_TABLE_ VwgCtlBtnAvlUndrbdyRrwdActv 0 "FALSE" 1 "TRUE" ;
VAL_TABLE_ VwgCtlBtnAvlUndrbdyFrwdActv 0 "FALSE" 1 "TRUE" ;
VAL_TABLE_ VwgVwprtSeltnExtd 0 "Unknown" 1 "No Request" 2 "Underbody Forward" 3 "Underbody Rearward" 4 "Underbody Forward Split" 5 "Underbody Forward Rearward Split" ;
VAL_TABLE_ AtTrnsGrSftDrct 0 "No Shift in Progress" 1 "Upshift in Progress" 2 "Downshift in Progress" ;
VAL_TABLE_ PPMShwVehOffSwRedntReqd 0 "FALSE" 1 "TRUE" ;
VAL_TABLE_ CBIP_ClsnImntBrkgStsAuth 0 "Not Active" 1 "Active" 2 "Failed" ;
VAL_TABLE_ HVBatSOCDspHdlmpCstCurrSetVal 0 "Setting Unknown" 1 "Off" 2 "On" ;
VAL_TABLE_ ElecShfPriLoManSeltnIndReq 0 "No Indication" 1 "Low" 2 "Manual" ;
VAL_TABLE_ VirtCtlPrvcySwAllwd 0 "FALSE" 1 "TRUE" ;
VAL_TABLE_ VirtCtlBkGlsShdCtlRrAllwd 0 "FALSE" 1 "TRUE" ;
VAL_TABLE_ VirtCtlBkGlsShdCtlFrtAllwd 0 "FALSE" 1 "TRUE" ;
VAL_TABLE_ ActvRollCtlRrWrnIndReq 0 "No Indication" 1 "No Impact Derating" 2 "Service" ;
VAL_TABLE_ ActvRollCtlFrtWrnIndReq 0 "No Indication" 1 "No Impact Derating" 2 "Service" ;
VAL_TABLE_ PPMShwVehOffSwMnReqd 0 "FALSE" 1 "TRUE" ;
VAL_TABLE_ ActvRrSplrWrnIndReq 0 "No Indication" 1 "Obstruction" 2 "Temporarily Disabled" 3 "Service" ;
VAL_TABLE_ ICMCstSelCstSetAval 0 "FALSE" 1 "TRUE" ;
VAL_TABLE_ ICMCstAvlFlg7 0 "FALSE" 1 "TRUE" ;
VAL_TABLE_ ICMCstAvlFlg6 0 "FALSE" 1 "TRUE" ;
VAL_TABLE_ ICMCstAvlFlg5 0 "FALSE" 1 "TRUE" ;
VAL_TABLE_ ICMCstAvlFlg4 0 "FALSE" 1 "TRUE" ;
VAL_TABLE_ ICMCstAvlFlg3 0 "FALSE" 1 "TRUE" ;
VAL_TABLE_ ICMCstAvlFlg2 0 "FALSE" 1 "TRUE" ;
VAL_TABLE_ ICMCstAvlFlg1 0 "FALSE" 1 "TRUE" ;
VAL_TABLE_ ICMCstSelCstCurSetVal 0 "Setting Unknown" 1 "Off" 2 "Alert" 3 "Alert Brake" 4 "Alert Brake Steer" ;
VAL_TABLE_ InfoThmSeltnCurrSetVal 0 "Unknown" 1 "None" 2 "Theme 1" 3 "Theme 2" 4 "Theme 3" 5 "Theme 4" 6 "Theme 5" 7 "Theme 6" 8 "Theme 7" 9 "Theme 8" 10 "Theme 9" 11 "Theme 10" 12 "Theme 11" 13 "Theme 12" 14 "Theme 13" 15 "Theme 14" ;
VAL_TABLE_ ICMCstChgSetReq 0 "No Action" 1 "Off" 2 "Alert" 3 "Alert Brake" 4 "Alert Brake Steer" ;
VAL_TABLE_ ActvRrSplrVirtCtlReq 0 "No Action" 1 "Stow" 2 "Deploy" ;
VAL_TABLE_ VirtCkptDispTchFlg2 0 "FALSE" 1 "TRUE" ;
VAL_TABLE_ VirtCkptDispTchFlg1 0 "FALSE" 1 "TRUE" ;
VAL_TABLE_ SRPSptSeltnRmtSftBtnSts 0 "Not Pressed" 1 "Pressed" ;
VAL_TABLE_ SRPSptSeltnKeepLkSftBtnSts 0 "Not Pressed" 1 "Pressed" ;
VAL_TABLE_ SRPSptSeltnAcceptSftBtnSts 0 "Not Pressed" 1 "Pressed" ;
VAL_TABLE_ SuprRmtPrkDctvSoftBtnSts 0 "Not Pressed" 1 "Pressed" ;
VAL_TABLE_ VirtCkptDispTchFlg4 0 "FALSE" 1 "TRUE" ;
VAL_TABLE_ VirtCkptDispTchFlg3 0 "FALSE" 1 "TRUE" ;
VAL_TABLE_ SRPUnableCnctExtSftBtnSts 0 "Not Pressed" 1 "Pressed" ;
VAL_TABLE_ SRPUnableCnctTryAgnSftBtnSts 0 "Not Pressed" 1 "Pressed" ;
VAL_TABLE_ HiVltgSysFltIndOn 0 "FALSE" 1 "TRUE" ;
VAL_TABLE_ HiVltgChrgLtdRsn 0 "No Action" 1 "High Voltage System Fault" 2 "Low Voltage System Fault" 3 "Temperature Out of Bounds" 4 "State of Charge Out of Bounds" 5 "Temporary Limiting Condition" 6 "Utility Power Override" 7 "HVAC System Limiting" 8 "Station Power Limiting" 9 "Normal Derate State of Charge" 10 "Normal Derate Temperature Threshold" 11 "Coupler Lock Not Engaged" ;
VAL_TABLE_ PrplDispExtndCpbltyLvlPct_DuD 0 "FALSE" 1 "TRUE" ;
VAL_TABLE_ PrplDispExtndPwrLvlPct_DuD 0 "FALSE" 1 "TRUE" ;
VAL_TABLE_ InfoWndMtnCtlRRAllwd 0 "FALSE" 1 "TRUE" ;
VAL_TABLE_ InfoWndMtnCtlRFAllwd 0 "FALSE" 1 "TRUE" ;
VAL_TABLE_ InfoWndMtnCtlLRAllwd 0 "FALSE" 1 "TRUE" ;
VAL_TABLE_ InfoWndMtnCtlLFAllwd 0 "FALSE" 1 "TRUE" ;
VAL_TABLE_ InfoSnrfMtnCtlAllwd 0 "FALSE" 1 "TRUE" ;
VAL_TABLE_ InfoFrtSnshdMtnCtlAllwd 0 "FALSE" 1 "TRUE" ;
VAL_TABLE_ FrtSnshdPstnStsInfo 0 "Fully Closed" 1 "Partially Open" 2 "Fully Open" 3 "Comfort Open" ;
VAL_TABLE_ PwrlineCommCtlPilotDC_Inv 0 "FALSE" 1 "TRUE" ;
VAL_TABLE_ HiVltgCouplerPrxmtySts_Inv 0 "FALSE" 1 "TRUE" ;
VAL_TABLE_ HiVltgCouplerPrxmtySts 0 "Unknown" 1 "Disconnected" 2 "Connected" ;
VAL_TABLE_ DMSDrwDrvrCstChgSetReq 0 "No Action" 1 "Off" 2 "Normal" 3 "Low Sensitivity" ;
VAL_TABLE_ NavRteChgOcc 0 "FALSE" 1 "TRUE" ;
VAL_TABLE_ NavRteSts 0 "No Action" 1 "Inactive" 2 "Active" 3 "Predicted" 4 "Learned" ;
VAL_TABLE_ NextChrgDestSts 0 "No Action" 1 "Charge Not Planned" 2 "Charge Planned" 3 "Charge Location Reached" ;
VAL_TABLE_ PnCActnStsCertfctTyp 0 "None" 1 "GM Provisioning Certificate" 2 "Contract Certificate" 3 "V2G Root Certificate" 4 "OCSP Certificate" 5 "Private Operator Root Certificate" 6 "Reserved1" 7 "Reserved2" 8 "Reserved3" 9 "Reserved4" 10 "Reserved5" 11 "Reserved6" 12 "Reserved7" 13 "Reserved8" 14 "All Contract And Private Operator Root Certificates" ;
VAL_TABLE_ PnCActnStsCertfctOpSts 0 "NoAction" 1 "CertificateDisabledSuccessfully" 2 "CertificateDisableFailed" 3 "CertificateEnabledSuccessfully" 4 "CertificateEnableFailed" 5 "CertificateErasedSuccessfully" 6 "CertificateErasureFailed" 7 "CertificateDisableOperationInProgress" 8 "CertificateEnableOperationInProgress" 9 "CertificateEraseOperationInProgress" 10 "SelectedCertificateOperationLocationisOutofBounds" 11 "NoCertificateisInstalledintheRequestedCertificateLocation" 12 "NoCertificateofThisCertificateTypeisInstalledintheEVCC" 13 "CertificateOperationNotSupportedonThisCertificateType" 14 "CertificateOperationCannotbePerformedatThisTime" 15 "CertificateInstallOperationInProgress" 16 "CertificateInstalledSuccessfully" 17 "CertificateInstallFailed" ;
VAL_TABLE_ ElecVehAllWhlDrvUnvWrnIndReq 0 "No Indication" 1 "Temporarily Unavailable" 2 "Faulted" ;
VAL_TABLE_ ElecVehAllWhlDrvUnvIndReq 0 "No Indication" 1 "Limited" 2 "Faulted" ;
VAL_TABLE_ FAXVCLoPrtyFltChmEvntStat 0 "No Action" 1 "Active" 2 "Cancel Chime" ;
VAL_TABLE_ FAXVCInCtlChmEvntStat 0 "No Action" 1 "Active" 2 "Cancel Chime" ;
VAL_TABLE_ FAXVCHiPrtyFltChmEvntStat 0 "No Action" 1 "Active" 2 "Cancel Chime" ;
VAL_TABLE_ AutoCtlrGnrcChmEvntStat 0 "No Action" 1 "Active" 2 "Cancel Chime" ;
VAL_TABLE_ VehNDtctgFAXVCErrChmEvntStat 0 "No Action" 1 "Active" 2 "Cancel Chime" ;
VAL_TABLE_ VehExtdFAXVCModeChmEvntStat 0 "No Action" 1 "Active" 2 "Cancel Chime" ;
VAL_TABLE_ FAXVCSevPrtyFltChmEvntStat 0 "No Action" 1 "Active" 2 "Cancel Chime" ;
VAL_TABLE_ FAXVCMedPrtyFltChmEvntStat 0 "No Action" 1 "Active" 2 "Cancel Chime" ;
VAL_TABLE_ IndHtdArmrstLvlRrRt 0 "Off" 1 "1" 2 "2" 3 "3" 4 "Linked" ;
VAL_TABLE_ UpftrRrAprchPrtctnChmEvntStat 0 "No Action" 1 "Active" 2 "Cancel Chime" ;
VAL_TABLE_ DMSIntnDrvrCstAvlFlg1 0 "FALSE" 1 "TRUE" ;
VAL_TABLE_ DMSDrwIntnDrvrDtnAlrtMutReqd 0 "FALSE" 1 "TRUE" ;
VAL_TABLE_ DMSDrwIntnDrvrLvl1ChmEvntStat 0 "No Action" 1 "Active" 2 "Cancel Chime" ;
VAL_TABLE_ DMSDrwIntnDrvrLvl2ChmEvntStat 0 "No Action" 1 "Active" 2 "Cancel Chime" ;
VAL_TABLE_ DMSIntnDrvrCstSetAval 0 "FALSE" 1 "TRUE" ;
VAL_TABLE_ DMSIntnDrvrCstAvlFlg7 0 "FALSE" 1 "TRUE" ;
VAL_TABLE_ DMSIntnDrvrCstAvlFlg6 0 "FALSE" 1 "TRUE" ;
VAL_TABLE_ DMSIntnDrvrCstAvlFlg5 0 "FALSE" 1 "TRUE" ;
VAL_TABLE_ DMSIntnDrvrCstAvlFlg4 0 "FALSE" 1 "TRUE" ;
VAL_TABLE_ DMSIntnDrvrCstAvlFlg3 0 "FALSE" 1 "TRUE" ;
VAL_TABLE_ DMSIntnDrvrCstAvlFlg2 0 "FALSE" 1 "TRUE" ;
VAL_TABLE_ HVBatSOCDspHdlmpCstAvlFlg1 0 "FALSE" 1 "TRUE" ;
VAL_TABLE_ InfoWndMtnCtlRRAval 0 "Not Available" 1 "Available" ;
VAL_TABLE_ InfoWndMtnCtlRFAval 0 "Not Available" 1 "Available" ;
VAL_TABLE_ InfoWndMtnCtlLRAval 0 "Not Available" 1 "Available" ;
VAL_TABLE_ InfoWndMtnCtlLFAval 0 "Not Available" 1 "Available" ;
VAL_TABLE_ InfoSnrfMtnCtlAval 0 "Not Available" 1 "Available" ;
VAL_TABLE_ VirtCtlIntrCmptRelCtlAval 0 "Not Available" 1 "Available" ;
VAL_TABLE_ Aux1AmbtColrCtlCstAvlFlg100 0 "FALSE" 1 "TRUE" ;
VAL_TABLE_ HVBatSOCDspHdlmpCstSetAval 0 "FALSE" 1 "TRUE" ;
VAL_TABLE_ HVBatSOCDspHdlmpCstAvlFlg7 0 "FALSE" 1 "TRUE" ;
VAL_TABLE_ HVBatSOCDspHdlmpCstAvlFlg6 0 "FALSE" 1 "TRUE" ;
VAL_TABLE_ HVBatSOCDspHdlmpCstAvlFlg5 0 "FALSE" 1 "TRUE" ;
VAL_TABLE_ HVBatSOCDspHdlmpCstAvlFlg4 0 "FALSE" 1 "TRUE" ;
VAL_TABLE_ HVBatSOCDspHdlmpCstAvlFlg3 0 "FALSE" 1 "TRUE" ;
VAL_TABLE_ HVBatSOCDspHdlmpCstAvlFlg2 0 "FALSE" 1 "TRUE" ;
VAL_TABLE_ Aux1AmbtColrCtlCstAvlFlg108 0 "FALSE" 1 "TRUE" ;
VAL_TABLE_ Aux1AmbtColrCtlCstAvlFlg107 0 "FALSE" 1 "TRUE" ;
VAL_TABLE_ Aux1AmbtColrCtlCstAvlFlg106 0 "FALSE" 1 "TRUE" ;
VAL_TABLE_ Aux1AmbtColrCtlCstAvlFlg105 0 "FALSE" 1 "TRUE" ;
VAL_TABLE_ Aux1AmbtColrCtlCstAvlFlg104 0 "FALSE" 1 "TRUE" ;
VAL_TABLE_ Aux1AmbtColrCtlCstAvlFlg103 0 "FALSE" 1 "TRUE" ;
VAL_TABLE_ Aux1AmbtColrCtlCstAvlFlg102 0 "FALSE" 1 "TRUE" ;
VAL_TABLE_ Aux1AmbtColrCtlCstAvlFlg101 0 "FALSE" 1 "TRUE" ;
VAL_TABLE_ Aux1AmbtColrCtlCstAvlFlg116 0 "FALSE" 1 "TRUE" ;
VAL_TABLE_ Aux1AmbtColrCtlCstAvlFlg115 0 "FALSE" 1 "TRUE" ;
VAL_TABLE_ Aux1AmbtColrCtlCstAvlFlg114 0 "FALSE" 1 "TRUE" ;
VAL_TABLE_ Aux1AmbtColrCtlCstAvlFlg113 0 "FALSE" 1 "TRUE" ;
VAL_TABLE_ Aux1AmbtColrCtlCstAvlFlg112 0 "FALSE" 1 "TRUE" ;
VAL_TABLE_ Aux1AmbtColrCtlCstAvlFlg111 0 "FALSE" 1 "TRUE" ;
VAL_TABLE_ Aux1AmbtColrCtlCstAvlFlg110 0 "FALSE" 1 "TRUE" ;
VAL_TABLE_ Aux1AmbtColrCtlCstAvlFlg109 0 "FALSE" 1 "TRUE" ;
VAL_TABLE_ Aux1AmbtColrCtlCstAvlFlg124 0 "FALSE" 1 "TRUE" ;
VAL_TABLE_ Aux1AmbtColrCtlCstAvlFlg123 0 "FALSE" 1 "TRUE" ;
VAL_TABLE_ Aux1AmbtColrCtlCstAvlFlg122 0 "FALSE" 1 "TRUE" ;
VAL_TABLE_ Aux1AmbtColrCtlCstAvlFlg121 0 "FALSE" 1 "TRUE" ;
VAL_TABLE_ Aux1AmbtColrCtlCstAvlFlg120 0 "FALSE" 1 "TRUE" ;
VAL_TABLE_ Aux1AmbtColrCtlCstAvlFlg119 0 "FALSE" 1 "TRUE" ;
VAL_TABLE_ Aux1AmbtColrCtlCstAvlFlg118 0 "FALSE" 1 "TRUE" ;
VAL_TABLE_ Aux1AmbtColrCtlCstAvlFlg117 0 "FALSE" 1 "TRUE" ;
VAL_TABLE_ Aux1AmbtColrCtlCstAvlFlg99 0 "FALSE" 1 "TRUE" ;
VAL_TABLE_ Aux1AmbtColrCtlCstAvlFlg98 0 "FALSE" 1 "TRUE" ;
VAL_TABLE_ Aux1AmbtColrCtlCstAvlFlg97 0 "FALSE" 1 "TRUE" ;
VAL_TABLE_ Aux1AmbtColrCtlCstAvlFlg96 0 "FALSE" 1 "TRUE" ;
VAL_TABLE_ Aux1AmbtColrCtlCstAvlFlg95 0 "FALSE" 1 "TRUE" ;
VAL_TABLE_ Aux1AmbtColrCtlCstAvlFlg127 0 "FALSE" 1 "TRUE" ;
VAL_TABLE_ Aux1AmbtColrCtlCstAvlFlg126 0 "FALSE" 1 "TRUE" ;
VAL_TABLE_ Aux1AmbtColrCtlCstAvlFlg125 0 "FALSE" 1 "TRUE" ;
VAL_TABLE_ VirtCtlIntrCmptRelReqd 0 "FALSE" 1 "TRUE" ;
VAL_TABLE_ RrCtlDispFltIndOn 0 "FALSE" 1 "TRUE" ;
VAL_TABLE_ TlLmpAuxLftOtg 0 "FALSE" 1 "TRUE" ;
VAL_TABLE_ RvrsLmpLtActv 0 "FALSE" 1 "TRUE" ;
VAL_TABLE_ PrkLmpRtOtg 0 "FALSE" 1 "TRUE" ;
VAL_TABLE_ PrkLmpLftOtg 0 "FALSE" 1 "TRUE" ;
VAL_TABLE_ PrkLmpAuxRtOtg 0 "FALSE" 1 "TRUE" ;
VAL_TABLE_ PrkLmpAuxLftOtg 0 "FALSE" 1 "TRUE" ;
VAL_TABLE_ BLS_BrkLmpRtActv 0 "FALSE" 1 "TRUE" ;
VAL_TABLE_ BLS_BrkLmpLtActv 0 "FALSE" 1 "TRUE" ;
VAL_TABLE_ TlLmpRtOtg 0 "FALSE" 1 "TRUE" ;
VAL_TABLE_ TlLmpLftOtg 0 "FALSE" 1 "TRUE" ;
VAL_TABLE_ TlLmpAuxRtOtg 0 "FALSE" 1 "TRUE" ;
VAL_TABLE_ BGI5_TrnLmpRtFncActv 0 "FALSE" 1 "TRUE" ;
VAL_TABLE_ BGI5_TrnLmpLtFncActv 0 "FALSE" 1 "TRUE" ;
VAL_TABLE_ ChmPrdcrQdrntRRSOH 0 "Unknown" 1 "Healthy" 2 "Faulted" ;
VAL_TABLE_ ChmPrdcrQdrntRFSOH 0 "Unknown" 1 "Healthy" 2 "Faulted" ;
VAL_TABLE_ ChmPrdcrQdrntLRSOH 0 "Unknown" 1 "Healthy" 2 "Faulted" ;
VAL_TABLE_ ChmPrdcrQdrntLFSOH 0 "Unknown" 1 "Healthy" 2 "Faulted" ;
VAL_TABLE_ InfoHtdFrtWshldSetChgReqd 0 "FALSE" 1 "TRUE" ;
VAL_TABLE_ InfoHtdFrtWshldSet 0 "No Action" 1 "HFWS_Off" 2 "HFWS_On" 3 "Auto" ;
VAL_TABLE_ DrvModeConfDrvrResp 0 "No Indication" 1 "Baja ESC Confirm" 2 "Baja ESC Cancel" 3 "Terrain ESC Confirm" 4 "Terrain ESC Cancel" 5 "Response 5" 6 "Response 6" 7 "Response 7" 8 "Response 8" 9 "Response 9" 10 "Response 10" 11 "Response 11" 12 "Response 12" 13 "Response 13" 14 "Response 14" 15 "Response 15" ;
VAL_TABLE_ MaxPwrModeConfDrvrResp 0 "No Indication" 1 "Max Power Confirm" 2 "Max Power Cancel" 3 "Response 3" 4 "Response 4" 5 "Response 5" 6 "Response 6" 7 "Response 7" ;
VAL_TABLE_ HVACICRMcrClmStSyncRrRt 0 "FALSE" 1 "TRUE" ;
VAL_TABLE_ HVACICRMcrClmStSyncRrLt 0 "FALSE" 1 "TRUE" ;
VAL_TABLE_ HVACICRMcrClmStSyncFrtRt 0 "FALSE" 1 "TRUE" ;
VAL_TABLE_ HVACICRMcrClmStSyncFrtLt 0 "FALSE" 1 "TRUE" ;
VAL_TABLE_ HVACICRNckScrfLvlRrLt 0 "Off" 1 "1" 2 "2" 3 "3" ;
VAL_TABLE_ HVACICRNckScrfLvlFrtRt 0 "Off" 1 "1" 2 "2" 3 "3" ;
VAL_TABLE_ HVACICRNckScrfLvlFrtLt 0 "Off" 1 "1" 2 "2" 3 "3" ;
VAL_TABLE_ HVACICRFrtRtAutoSetChg 0 "FALSE" 1 "TRUE" ;
VAL_TABLE_ HVACICRBlwLvlRrRtActv 0 "FALSE" 1 "TRUE" ;
VAL_TABLE_ HVACICRBlwLvlFrtRtActv 0 "FALSE" 1 "TRUE" ;
VAL_TABLE_ HVACICRNckScrfLvlRrRt 0 "Off" 1 "1" 2 "2" 3 "3" ;
VAL_TABLE_ HVACICRRrRtAutoSetChg 0 "FALSE" 1 "TRUE" ;
VAL_TABLE_ HVACICRNckScrfLvlRrRtActv 0 "FALSE" 1 "TRUE" ;
VAL_TABLE_ HVACICRNckScrfLvlRrLtActv 0 "FALSE" 1 "TRUE" ;
VAL_TABLE_ HVACICRNckScrfLvlFrtRtActv 0 "FALSE" 1 "TRUE" ;
VAL_TABLE_ HVACICRNckScrfLvlFrtLtActv 0 "FALSE" 1 "TRUE" ;
VAL_TABLE_ SCAPwrDrMtnRRVirtCtlAval 0 "Not Available" 1 "Available" ;
VAL_TABLE_ SCAPwrDrMtnLRVirtCtlAval 0 "Not Available" 1 "Available" ;
VAL_TABLE_ AckCod 0 "FALSE" 1 "TRUE" ;
VAL_TABLE_ AckFlrRsn 0 "Success" 1 "General Login Error" 2 "Login Error With Data Missing" 3 "Live Data Missing" 4 "Supplemental Data Missing" 5 "Reserved 0x05" 6 "Reserved 0x06" 7 "Reserved 0x07" 8 "Reserved 0x08" 9 "Reserved 0x09" 10 "Reserved 0x0A" 11 "Reserved 0x0B" 12 "Reserved 0x0C" 13 "Reserved 0x0D" 14 "Reserved 0x0E" 15 "Reserved 0x0F" 16 "Reserved 0x10" 17 "Reserved 0x11" 18 "Reserved 0x12" 19 "Reserved 0x13" 20 "Reserved 0x14" 21 "Reserved 0x15" 22 "Reserved 0x16" 23 "Reserved 0x17" 24 "Reserved 0x18" 25 "Reserved 0x19" 26 "Reserved 0x1A" 27 "Reserved 0x1B" 28 "Reserved 0x1C" 29 "Reserved 0x1D" 30 "Reserved 0x1E" 31 "Reserved 0x1F" 32 "Reserved 0x20" 33 "Reserved 0x21" 34 "Reserved 0x22" 35 "Reserved 0x23" 36 "Reserved 0x24" 37 "Reserved 0x25" 38 "Reserved 0x26" 39 "Reserved 0x27" 40 "Reserved 0x28" 41 "Reserved 0x29" 42 "Reserved 0x2A" 43 "Reserved 0x2B" 44 "Reserved 0x2C" 45 "Reserved 0x2D" 46 "Reserved 0x2E" 47 "Reserved 0x2F" 48 "Reserved 0x30" 49 "Reserved 0x31" 50 "Reserved 0x32" 51 "Reserved 0x33" 52 "Reserved 0x34" 53 "Reserved 0x35" 54 "Reserved 0x36" 55 "Reserved 0x37" 56 "Reserved 0x38" 57 "Reserved 0x39" 58 "Reserved 0x3A" 59 "Reserved 0x3B" 60 "Reserved 0x3C" 61 "Reserved 0x3D" 62 "Reserved 0x3E" 63 "Reserved 0x3F" 64 "Reserved 0x40" 65 "Reserved 0x41" 66 "Reserved 0x42" 67 "Reserved 0x43" 68 "Reserved 0x44" 69 "Reserved 0x45" 70 "Reserved 0x46" 71 "Reserved 0x47" 72 "Reserved 0x48" 73 "Reserved 0x49" 74 "Reserved 0x4A" 75 "Reserved 0x4B" 76 "Reserved 0x4C" 77 "Reserved 0x4D" 78 "Reserved 0x4E" 79 "Reserved 0x4F" 80 "Reserved 0x50" 81 "Reserved 0x51" 82 "Reserved 0x52" 83 "Reserved 0x53" 84 "Reserved 0x54" 85 "Reserved 0x55" 86 "Reserved 0x56" 87 "Reserved 0x57" 88 "Reserved 0x58" 89 "Reserved 0x59" 90 "Reserved 0x5A" 91 "Reserved 0x5B" 92 "Reserved 0x5C" 93 "Reserved 0x5D" 94 "Reserved 0x5E" 95 "Reserved 0x5F" 96 "Reserved 0x60" 97 "Reserved 0x61" 98 "Reserved 0x62" 99 "Reserved 0x63" 100 "Reserved 0x64" 101 "Reserved 0x65" 102 "Reserved 0x66" 103 "Reserved 0x67" 104 "Reserved 0x68" 105 "Reserved 0x69" 106 "Reserved 0x6A" 107 "Reserved 0x6B" 108 "Reserved 0x6C" 109 "Reserved 0x6D" 110 "Reserved 0x6E" 111 "Reserved 0x6F" 112 "Reserved 0x70" 113 "Reserved 0x71" 114 "Reserved 0x72" 115 "Reserved 0x73" 116 "Reserved 0x74" 117 "Reserved 0x75" 118 "Reserved 0x76" 119 "Reserved 0x77" 120 "Reserved 0x78" 121 "Reserved 0x79" 122 "Reserved 0x7A" 123 "Reserved 0x7B" 124 "Reserved 0x7C" 125 "Reserved 0x7D" 126 "Reserved 0x7E" 127 "Reserved 0x7F" 128 "Reserved 0x80" 129 "Reserved 0x81" 130 "Reserved 0x82" 131 "Reserved 0x83" 132 "Reserved 0x84" 133 "Reserved 0x85" 134 "Reserved 0x86" 135 "Reserved 0x87" 136 "Reserved 0x88" 137 "Reserved 0x89" 138 "Reserved 0x8A" 139 "Reserved 0x8B" 140 "Reserved 0x8C" 141 "Reserved 0x8D" 142 "Reserved 0x8E" 143 "Reserved 0x8F" 144 "Reserved 0x90" 145 "Live Data Check Error" 146 "Supplemental Data Check Error" 147 "General TCP Data Manager Failure" 148 "Reserved 0x94" 149 "Reserved 0x95" 150 "Reserved 0x96" 151 "Reserved 0x97" 152 "Reserved 0x98" 153 "Reserved 0x99" 154 "Reserved 0x9A" 155 "Reserved 0x9B" 156 "Reserved 0x9C" 157 "Reserved 0x9D" 158 "Reserved 0x9E" 159 "Reserved 0x9F" 160 "Reserved 0xA0" 161 "Reserved 0xA1" 162 "Reserved 0xA2" 163 "Reserved 0xA3" 164 "Reserved 0xA4" 165 "Reserved 0xA5" 166 "Reserved 0xA6" 167 "Reserved 0xA7" 168 "Reserved 0xA8" 169 "Reserved 0xA9" 170 "Reserved 0xAA" 171 "Reserved 0xAB" 172 "Reserved 0xAC" 173 "Reserved 0xAD" 174 "Reserved 0xAE" 175 "Reserved 0xAF" 176 "Reserved 0xB0" 177 "Reserved 0xB1" 178 "Reserved 0xB2" 179 "Reserved 0xB3" 180 "Reserved 0xB4" 181 "Reserved 0xB5" 182 "Reserved 0xB6" 183 "Reserved 0xB7" 184 "Reserved 0xB8" 185 "Reserved 0xB9" 186 "Reserved 0xBA" 187 "Reserved 0xBB" 188 "Reserved 0xBC" 189 "Reserved 0xBD" 190 "Reserved 0xBE" 191 "Reserved 0xBF" 192 "Reserved 0xC0" 193 "Reserved 0xC1" 194 "Reserved 0xC2" 195 "Reserved 0xC3" 196 "Reserved 0xC4" 197 "Reserved 0xC5" 198 "Reserved 0xC6" 199 "Reserved 0xC7" 200 "Reserved 0xC8" 201 "Reserved 0xC9" 202 "Reserved 0xCA" 203 "Reserved 0xCB" 204 "Reserved 0xCC" 205 "Reserved 0xCD" 206 "Reserved 0xCE" 207 "Reserved 0xCF" 208 "Reserved 0xD0" 209 "Reserved 0xD1" 210 "Reserved 0xD2" 211 "Reserved 0xD3" 212 "Reserved 0xD4" 213 "Reserved 0xD5" 214 "Reserved 0xD6" 215 "Reserved 0xD7" 216 "Reserved 0xD8" 217 "Reserved 0xD9" 218 "Reserved 0xDA" 219 "Reserved 0xDB" 220 "Reserved 0xDC" 221 "Reserved 0xDD" 222 "Reserved 0xDE" 223 "Reserved 0xDF" 224 "Reserved 0xE0" 225 "Reserved 0xE1" 226 "Reserved 0xE2" 227 "Reserved 0xE3" 228 "Reserved 0xE4" 229 "Reserved 0xE5" 230 "Reserved 0xE6" 231 "Reserved 0xE7" 232 "Reserved 0xE8" 233 "Reserved 0xE9" 234 "Reserved 0xEA" 235 "Reserved 0xEB" 236 "Reserved 0xEC" 237 "Reserved 0xED" 238 "Reserved 0xEE" 239 "Reserved 0xEF" 240 "Reserved 0xF0" 241 "Reserved 0xF1" 242 "Reserved 0xF2" 243 "Reserved 0xF3" 244 "Reserved 0xF4" 245 "Reserved 0xF5" 246 "Reserved 0xF6" 247 "Reserved 0xF7" 248 "Reserved 0xF8" 249 "Reserved 0xF9" 250 "Reserved 0xFA" 251 "Reserved 0xFB" 252 "Reserved 0xFC" 253 "Reserved 0xFD" 254 "Reserved 0xFE" 255 "Reserved 0xFF" ;
VAL_TABLE_ IntrAmbtColrCtlCstAvlFlg34 0 "FALSE" 1 "TRUE" ;
VAL_TABLE_ IntrAmbtColrCtlCstAvlFlg33 0 "FALSE" 1 "TRUE" ;
VAL_TABLE_ IntrAmbtColrCtlCstAvlFlg32 0 "FALSE" 1 "TRUE" ;
VAL_TABLE_ IntrAmbtColrCtlCstAvlFlg42 0 "FALSE" 1 "TRUE" ;
VAL_TABLE_ IntrAmbtColrCtlCstAvlFlg41 0 "FALSE" 1 "TRUE" ;
VAL_TABLE_ IntrAmbtColrCtlCstAvlFlg40 0 "FALSE" 1 "TRUE" ;
VAL_TABLE_ IntrAmbtColrCtlCstAvlFlg39 0 "FALSE" 1 "TRUE" ;
VAL_TABLE_ IntrAmbtColrCtlCstAvlFlg38 0 "FALSE" 1 "TRUE" ;
VAL_TABLE_ IntrAmbtColrCtlCstAvlFlg37 0 "FALSE" 1 "TRUE" ;
VAL_TABLE_ IntrAmbtColrCtlCstAvlFlg36 0 "FALSE" 1 "TRUE" ;
VAL_TABLE_ IntrAmbtColrCtlCstAvlFlg35 0 "FALSE" 1 "TRUE" ;
VAL_TABLE_ IntrAmbtColrCtlCstAvlFlg50 0 "FALSE" 1 "TRUE" ;
VAL_TABLE_ IntrAmbtColrCtlCstAvlFlg49 0 "FALSE" 1 "TRUE" ;
VAL_TABLE_ IntrAmbtColrCtlCstAvlFlg48 0 "FALSE" 1 "TRUE" ;
VAL_TABLE_ IntrAmbtColrCtlCstAvlFlg47 0 "FALSE" 1 "TRUE" ;
VAL_TABLE_ IntrAmbtColrCtlCstAvlFlg46 0 "FALSE" 1 "TRUE" ;
VAL_TABLE_ IntrAmbtColrCtlCstAvlFlg45 0 "FALSE" 1 "TRUE" ;
VAL_TABLE_ IntrAmbtColrCtlCstAvlFlg44 0 "FALSE" 1 "TRUE" ;
VAL_TABLE_ IntrAmbtColrCtlCstAvlFlg43 0 "FALSE" 1 "TRUE" ;
VAL_TABLE_ IntrAmbtColrCtlCstAvlFlg58 0 "FALSE" 1 "TRUE" ;
VAL_TABLE_ IntrAmbtColrCtlCstAvlFlg57 0 "FALSE" 1 "TRUE" ;
VAL_TABLE_ IntrAmbtColrCtlCstAvlFlg56 0 "FALSE" 1 "TRUE" ;
VAL_TABLE_ IntrAmbtColrCtlCstAvlFlg55 0 "FALSE" 1 "TRUE" ;
VAL_TABLE_ IntrAmbtColrCtlCstAvlFlg54 0 "FALSE" 1 "TRUE" ;
VAL_TABLE_ IntrAmbtColrCtlCstAvlFlg53 0 "FALSE" 1 "TRUE" ;
VAL_TABLE_ IntrAmbtColrCtlCstAvlFlg52 0 "FALSE" 1 "TRUE" ;
VAL_TABLE_ IntrAmbtColrCtlCstAvlFlg51 0 "FALSE" 1 "TRUE" ;
VAL_TABLE_ IntrAmbtColrCtlCstAvlFlg66 0 "FALSE" 1 "TRUE" ;
VAL_TABLE_ IntrAmbtColrCtlCstAvlFlg65 0 "FALSE" 1 "TRUE" ;
VAL_TABLE_ IntrAmbtColrCtlCstAvlFlg64 0 "FALSE" 1 "TRUE" ;
VAL_TABLE_ IntrAmbtColrCtlCstAvlFlg63 0 "FALSE" 1 "TRUE" ;
VAL_TABLE_ IntrAmbtColrCtlCstAvlFlg62 0 "FALSE" 1 "TRUE" ;
VAL_TABLE_ IntrAmbtColrCtlCstAvlFlg61 0 "FALSE" 1 "TRUE" ;
VAL_TABLE_ IntrAmbtColrCtlCstAvlFlg60 0 "FALSE" 1 "TRUE" ;
VAL_TABLE_ IntrAmbtColrCtlCstAvlFlg59 0 "FALSE" 1 "TRUE" ;
VAL_TABLE_ IntrAmbtColrCtlCstAvlFlg74 0 "FALSE" 1 "TRUE" ;
VAL_TABLE_ IntrAmbtColrCtlCstAvlFlg73 0 "FALSE" 1 "TRUE" ;
VAL_TABLE_ IntrAmbtColrCtlCstAvlFlg72 0 "FALSE" 1 "TRUE" ;
VAL_TABLE_ IntrAmbtColrCtlCstAvlFlg71 0 "FALSE" 1 "TRUE" ;
VAL_TABLE_ IntrAmbtColrCtlCstAvlFlg70 0 "FALSE" 1 "TRUE" ;
VAL_TABLE_ IntrAmbtColrCtlCstAvlFlg69 0 "FALSE" 1 "TRUE" ;
VAL_TABLE_ IntrAmbtColrCtlCstAvlFlg68 0 "FALSE" 1 "TRUE" ;
VAL_TABLE_ IntrAmbtColrCtlCstAvlFlg67 0 "FALSE" 1 "TRUE" ;
VAL_TABLE_ IntrAmbtColrCtlCstAvlFlg82 0 "FALSE" 1 "TRUE" ;
VAL_TABLE_ IntrAmbtColrCtlCstAvlFlg81 0 "FALSE" 1 "TRUE" ;
VAL_TABLE_ IntrAmbtColrCtlCstAvlFlg80 0 "FALSE" 1 "TRUE" ;
VAL_TABLE_ IntrAmbtColrCtlCstAvlFlg79 0 "FALSE" 1 "TRUE" ;
VAL_TABLE_ IntrAmbtColrCtlCstAvlFlg78 0 "FALSE" 1 "TRUE" ;
VAL_TABLE_ IntrAmbtColrCtlCstAvlFlg77 0 "FALSE" 1 "TRUE" ;
VAL_TABLE_ IntrAmbtColrCtlCstAvlFlg76 0 "FALSE" 1 "TRUE" ;
VAL_TABLE_ IntrAmbtColrCtlCstAvlFlg75 0 "FALSE" 1 "TRUE" ;
VAL_TABLE_ IntrAmbtColrCtlCstAvlFlg107 0 "FALSE" 1 "TRUE" ;
VAL_TABLE_ IntrAmbtColrCtlCstAvlFlg106 0 "FALSE" 1 "TRUE" ;
VAL_TABLE_ IntrAmbtColrCtlCstAvlFlg105 0 "FALSE" 1 "TRUE" ;
VAL_TABLE_ IntrAmbtColrCtlCstAvlFlg104 0 "FALSE" 1 "TRUE" ;
VAL_TABLE_ IntrAmbtColrCtlCstAvlFlg103 0 "FALSE" 1 "TRUE" ;
VAL_TABLE_ IntrAmbtColrCtlCstAvlFlg102 0 "FALSE" 1 "TRUE" ;
VAL_TABLE_ IntrAmbtColrCtlCstAvlFlg101 0 "FALSE" 1 "TRUE" ;
VAL_TABLE_ IntrAmbtColrCtlCstAvlFlg100 0 "FALSE" 1 "TRUE" ;
VAL_TABLE_ IntrAmbtColrCtlCstAvlFlg115 0 "FALSE" 1 "TRUE" ;
VAL_TABLE_ IntrAmbtColrCtlCstAvlFlg114 0 "FALSE" 1 "TRUE" ;
VAL_TABLE_ IntrAmbtColrCtlCstAvlFlg113 0 "FALSE" 1 "TRUE" ;
VAL_TABLE_ IntrAmbtColrCtlCstAvlFlg112 0 "FALSE" 1 "TRUE" ;
VAL_TABLE_ IntrAmbtColrCtlCstAvlFlg111 0 "FALSE" 1 "TRUE" ;
VAL_TABLE_ IntrAmbtColrCtlCstAvlFlg110 0 "FALSE" 1 "TRUE" ;
VAL_TABLE_ IntrAmbtColrCtlCstAvlFlg109 0 "FALSE" 1 "TRUE" ;
VAL_TABLE_ IntrAmbtColrCtlCstAvlFlg108 0 "FALSE" 1 "TRUE" ;
VAL_TABLE_ IntrAmbtColrCtlCstAvlFlg123 0 "FALSE" 1 "TRUE" ;
VAL_TABLE_ IntrAmbtColrCtlCstAvlFlg122 0 "FALSE" 1 "TRUE" ;
VAL_TABLE_ IntrAmbtColrCtlCstAvlFlg121 0 "FALSE" 1 "TRUE" ;
VAL_TABLE_ IntrAmbtColrCtlCstAvlFlg120 0 "FALSE" 1 "TRUE" ;
VAL_TABLE_ IntrAmbtColrCtlCstAvlFlg119 0 "FALSE" 1 "TRUE" ;
VAL_TABLE_ IntrAmbtColrCtlCstAvlFlg118 0 "FALSE" 1 "TRUE" ;
VAL_TABLE_ IntrAmbtColrCtlCstAvlFlg117 0 "FALSE" 1 "TRUE" ;
VAL_TABLE_ IntrAmbtColrCtlCstAvlFlg116 0 "FALSE" 1 "TRUE" ;
VAL_TABLE_ IntrAmbtColrCtlCstAvlFlg86 0 "FALSE" 1 "TRUE" ;
VAL_TABLE_ IntrAmbtColrCtlCstAvlFlg85 0 "FALSE" 1 "TRUE" ;
VAL_TABLE_ IntrAmbtColrCtlCstAvlFlg84 0 "FALSE" 1 "TRUE" ;
VAL_TABLE_ IntrAmbtColrCtlCstAvlFlg83 0 "FALSE" 1 "TRUE" ;
VAL_TABLE_ IntrAmbtColrCtlCstAvlFlg127 0 "FALSE" 1 "TRUE" ;
VAL_TABLE_ IntrAmbtColrCtlCstAvlFlg126 0 "FALSE" 1 "TRUE" ;
VAL_TABLE_ IntrAmbtColrCtlCstAvlFlg125 0 "FALSE" 1 "TRUE" ;
VAL_TABLE_ IntrAmbtColrCtlCstAvlFlg124 0 "FALSE" 1 "TRUE" ;
VAL_TABLE_ IntrAmbtColrCtlCstAvlFlg94 0 "FALSE" 1 "TRUE" ;
VAL_TABLE_ IntrAmbtColrCtlCstAvlFlg93 0 "FALSE" 1 "TRUE" ;
VAL_TABLE_ IntrAmbtColrCtlCstAvlFlg92 0 "FALSE" 1 "TRUE" ;
VAL_TABLE_ IntrAmbtColrCtlCstAvlFlg91 0 "FALSE" 1 "TRUE" ;
VAL_TABLE_ IntrAmbtColrCtlCstAvlFlg90 0 "FALSE" 1 "TRUE" ;
VAL_TABLE_ IntrAmbtColrCtlCstAvlFlg89 0 "FALSE" 1 "TRUE" ;
VAL_TABLE_ IntrAmbtColrCtlCstAvlFlg88 0 "FALSE" 1 "TRUE" ;
VAL_TABLE_ IntrAmbtColrCtlCstAvlFlg87 0 "FALSE" 1 "TRUE" ;
VAL_TABLE_ ElvtdIdlCstSetAvlFlg2 0 "FALSE" 1 "TRUE" ;
VAL_TABLE_ ElvtdIdlCstSetAvlFlg1 0 "FALSE" 1 "TRUE" ;
VAL_TABLE_ ElvtdIdlCstSetAval 0 "FALSE" 1 "TRUE" ;
VAL_TABLE_ IntrAmbtColrCtlCstAvlFlg99 0 "FALSE" 1 "TRUE" ;
VAL_TABLE_ IntrAmbtColrCtlCstAvlFlg98 0 "FALSE" 1 "TRUE" ;
VAL_TABLE_ IntrAmbtColrCtlCstAvlFlg97 0 "FALSE" 1 "TRUE" ;
VAL_TABLE_ IntrAmbtColrCtlCstAvlFlg96 0 "FALSE" 1 "TRUE" ;
VAL_TABLE_ IntrAmbtColrCtlCstAvlFlg95 0 "FALSE" 1 "TRUE" ;
VAL_TABLE_ DMSDrwDrvrCstAvlFlg3 0 "FALSE" 1 "TRUE" ;
VAL_TABLE_ DMSDrwDrvrCstAvlFlg2 0 "FALSE" 1 "TRUE" ;
VAL_TABLE_ DMSDrwDrvrCstAvlFlg1 0 "FALSE" 1 "TRUE" ;
VAL_TABLE_ ElvtdIdlCstSetAvlFlg7 0 "FALSE" 1 "TRUE" ;
VAL_TABLE_ ElvtdIdlCstSetAvlFlg6 0 "FALSE" 1 "TRUE" ;
VAL_TABLE_ ElvtdIdlCstSetAvlFlg5 0 "FALSE" 1 "TRUE" ;
VAL_TABLE_ ElvtdIdlCstSetAvlFlg4 0 "FALSE" 1 "TRUE" ;
VAL_TABLE_ ElvtdIdlCstSetAvlFlg3 0 "FALSE" 1 "TRUE" ;
VAL_TABLE_ VehSpdAcurLvl 0 "Unknown" 1 "Two and Half Percent" 2 "One Percent" ;
VAL_TABLE_ DMSDrwDrvrCstSetAval 0 "FALSE" 1 "TRUE" ;
VAL_TABLE_ DMSDrwDrvrCstAvlFlg7 0 "FALSE" 1 "TRUE" ;
VAL_TABLE_ DMSDrwDrvrCstAvlFlg6 0 "FALSE" 1 "TRUE" ;
VAL_TABLE_ DMSDrwDrvrCstAvlFlg5 0 "FALSE" 1 "TRUE" ;
VAL_TABLE_ DMSDrwDrvrCstAvlFlg4 0 "FALSE" 1 "TRUE" ;
VAL_TABLE_ ExtAudSOH 0 "Unknown" 1 "Partial Loss" 2 "Full Loss" 3 "No Faults Detected" ;
VAL_TABLE_ ExtDispSOH 0 "Unknown" 1 "Partial Loss" 2 "Full Loss" 3 "No Faults Detected" ;
VAL_TABLE_ EmrgCallAudSOH 0 "Unknown" 1 "Partial Loss" 2 "Full Loss" 3 "No Faults Detected" ;
VAL_TABLE_ CbnAudSOH 0 "Unknown" 1 "Partial Loss" 2 "Full Loss" 3 "No Faults Detected" ;
VAL_TABLE_ AmpSOHAEDSPModeCurrStat 0 "No Action" 1 "DSP Mode 0" 2 "DSP Mode 1" 3 "DSP Mode 2" 4 "DSP Mode 3" 5 "DSP Mode 4" 6 "DSP Mode 5" 7 "DSP Mode 6" 8 "DSP Mode 7" ;
VAL_TABLE_ AmpSOHAEVehNoisCmpnAtv 0 "FALSE" 1 "TRUE" ;
VAL_TABLE_ InfoPsngSysLng_Inv 0 "FALSE" 1 "TRUE" ;
VAL_TABLE_ InfoPsngSysLat_Inv 0 "FALSE" 1 "TRUE" ;
VAL_TABLE_ StHtdCushLvlLFSet 0 "Off" 1 "Low" 2 "Medium" 3 "High" ;
VAL_TABLE_ StHtdBkLvlLFSet 0 "Off" 1 "Low" 2 "Medium" 3 "High" ;
VAL_TABLE_ StHtdCushLvlLRSet 0 "Off" 1 "Low" 2 "Medium" 3 "High" ;
VAL_TABLE_ StHtdBkLvlLRSet 0 "Off" 1 "Low" 2 "Medium" 3 "High" ;
VAL_TABLE_ StVntdCoolCushLvlLFSet 0 "Off" 1 "Low" 2 "Medium" 3 "High" ;
VAL_TABLE_ StVntdCoolBkLvlLFSet 0 "Off" 1 "Low" 2 "Medium" 3 "High" ;
VAL_TABLE_ StHtdCushLvlRFSet 0 "Off" 1 "Low" 2 "Medium" 3 "High" ;
VAL_TABLE_ StHtdBkLvlRFSet 0 "Off" 1 "Low" 2 "Medium" 3 "High" ;
VAL_TABLE_ StVntdCoolCushLvlLRSet 0 "Off" 1 "Low" 2 "Medium" 3 "High" ;
VAL_TABLE_ StVntdCoolBkLvlLRSet 0 "Off" 1 "Low" 2 "Medium" 3 "High" ;
VAL_TABLE_ RrDrOpnCmfRclCstSetVal 0 "Setting Unknown" 1 "Off" 2 "On" ;
VAL_TABLE_ StVntdCoolCushLvlRFSet 0 "Off" 1 "Low" 2 "Medium" 3 "High" ;
VAL_TABLE_ StVntdCoolBkLvlRFSet 0 "Off" 1 "Low" 2 "Medium" 3 "High" ;
VAL_TABLE_ StBkHrztlLRVirtCtlAllwd 0 "Not Allowed" 1 "Allowed" ;
VAL_TABLE_ StCushSdBolsLRVirtCtlAllwd 0 "Not Allowed" 1 "Allowed" ;
VAL_TABLE_ StCushRrVertLRVirtCtlAllwd 0 "Not Allowed" 1 "Allowed" ;
VAL_TABLE_ StCushLgthHrztlLRVirtCtlAllwd 0 "Not Allowed" 1 "Allowed" ;
VAL_TABLE_ StCushHrztlLRVirtCtlAllwd 0 "Not Allowed" 1 "Allowed" ;
VAL_TABLE_ StCushFrtVertLRVirtCtlAllwd 0 "Not Allowed" 1 "Allowed" ;
VAL_TABLE_ StBkSdBolsLRVirtCtlAllwd 0 "Not Allowed" 1 "Allowed" ;
VAL_TABLE_ StBkLumbVertLRVirtCtlAllwd 0 "Not Allowed" 1 "Allowed" ;
VAL_TABLE_ StBkLumbHrztlLRVirtCtlAllwd 0 "Not Allowed" 1 "Allowed" ;
VAL_TABLE_ StUpprShldrHrztlLRVirtCtlAllwd 0 "Not Allowed" 1 "Allowed" ;
VAL_TABLE_ StMasgLRVirtCtlAllwd 0 "Not Allowed" 1 "Allowed" ;
VAL_TABLE_ StHdrstVertLRVirtCtlAllwd 0 "Not Allowed" 1 "Allowed" ;
VAL_TABLE_ StHdrstHrztlLRVirtCtlAllwd 0 "Not Allowed" 1 "Allowed" ;
VAL_TABLE_ StMasgIntstyLRLstKnwnSet 0 "Massage Off" 1 "Intensity 1" 2 "Intensity 2" 3 "Intensity 3" 4 "Intensity 4" 5 "Intensity 5" 6 "Intensity 6" 7 "Intensity 7" ;
VAL_TABLE_ StMasgTypLRLstKnwnSet 0 "Massage Off" 1 "Type 1" 2 "Type 2" 3 "Type 3" 4 "Type 4" 5 "Type 5" 6 "Type 6" 7 "Type 7" 8 "Type 8" 9 "Type 9" 10 "Type 10" 11 "Type 11" 12 "Type 12" 13 "Type 13" 14 "Type 14" 15 "Type 15" ;
VAL_TABLE_ SuprRmtPrkFcsStsVCU 0 "No Focus" 1 "Focus" ;
VAL_TABLE_ HVACICROtltFrtRtOtbdArflQnty 0 "0" 1 "25" 2 "50" 3 "75" 4 "100" ;
VAL_TABLE_ HVACICROtltFrtRtInbdArflQnty 0 "0" 1 "25" 2 "50" 3 "75" 4 "100" ;
VAL_TABLE_ HVACICROtltFrtRtStat 0 "Manual" 1 "Auto" 2 "Focused" 3 "Diffused" ;
VAL_TABLE_ HVACICROscMdFrtRtSet 0 "No Action" 1 "Left Right Only" 2 "Up Down Only" 3 "Left Right Up Down" ;
VAL_TABLE_ HVACICRHVACPwrFrtRtChg 0 "FALSE" 1 "TRUE" ;
VAL_TABLE_ HVACICRCkMdOn 0 "FALSE" 1 "TRUE" ;
VAL_TABLE_ HVACICRHVACPwrRrLtChg 0 "FALSE" 1 "TRUE" ;
VAL_TABLE_ HVACICROtltRrLtStat 0 "Manual" 1 "Auto" 2 "Focused" 3 "Diffused" ;
VAL_TABLE_ HVACICROscMdRrLtSet 0 "No Action" 1 "Left Right Only" 2 "Up Down Only" 3 "Left Right Up Down" ;
VAL_TABLE_ HVACICROtltFrtLtOtbdArflQnty 0 "0" 1 "25" 2 "50" 3 "75" 4 "100" ;
VAL_TABLE_ HVACICROtltFrtLtInbdArflQnty 0 "0" 1 "25" 2 "50" 3 "75" 4 "100" ;
VAL_TABLE_ HVACICROtltFrtLtStat 0 "Manual" 1 "Auto" 2 "Focused" 3 "Diffused" ;
VAL_TABLE_ HVACICROscMdFrtLtSet 0 "No Action" 1 "Left Right Only" 2 "Up Down Only" 3 "Left Right Up Down" ;
VAL_TABLE_ HVACICRHVACPwrFrtLtChg 0 "FALSE" 1 "TRUE" ;
VAL_TABLE_ HVACICROscMdRrRtSet 0 "No Action" 1 "Left Right Only" 2 "Up Down Only" 3 "Left Right Up Down" ;
VAL_TABLE_ HVACICRHVACPwrRrRtChg 0 "FALSE" 1 "TRUE" ;
VAL_TABLE_ HVACICROtltRrRtStat 0 "Manual" 1 "Auto" 2 "Focused" 3 "Diffused" ;
VAL_TABLE_ HVACICFRFrtBlwCkt1InvDatDtd 0 "FALSE" 1 "TRUE" ;
VAL_TABLE_ HVACICFRFrtBlwCkt1DatRxd 0 "FALSE" 1 "TRUE" ;
VAL_TABLE_ HVACICFRFrtBlwCkt2InvDatDtd 0 "FALSE" 1 "TRUE" ;
VAL_TABLE_ HVACICFRFrtBlwCkt2DatRxd 0 "FALSE" 1 "TRUE" ;
VAL_TABLE_ HVACICFRFrtLtTempCkt1InvDatDtd 0 "FALSE" 1 "TRUE" ;
VAL_TABLE_ HVACICFRFrtLtTempCkt1DatRxd 0 "FALSE" 1 "TRUE" ;
VAL_TABLE_ HVACICFRFrtLtTempCkt2InvDatDtd 0 "FALSE" 1 "TRUE" ;
VAL_TABLE_ HVACICFRFrtLtTempCkt2DatRxd 0 "FALSE" 1 "TRUE" ;
VAL_TABLE_ HVACICFRFrtLtTempCkt3InvDatDtd 0 "FALSE" 1 "TRUE" ;
VAL_TABLE_ HVACICFRFrtLtTempCkt3DatRxd 0 "FALSE" 1 "TRUE" ;
VAL_TABLE_ HVACICFRFrtRtTempCkt1InvDatDtd 0 "FALSE" 1 "TRUE" ;
VAL_TABLE_ HVACICFRFrtRtTempCkt1DatRxd 0 "FALSE" 1 "TRUE" ;
VAL_TABLE_ HVACICFRFrtRtTempCkt2InvDatDtd 0 "FALSE" 1 "TRUE" ;
VAL_TABLE_ HVACICFRFrtRtTempCkt2DatRxd 0 "FALSE" 1 "TRUE" ;
VAL_TABLE_ HVACICFRFrtRtTempCkt3InvDatDtd 0 "FALSE" 1 "TRUE" ;
VAL_TABLE_ HVACICFRFrtRtTempCkt3DatRxd 0 "FALSE" 1 "TRUE" ;
VAL_TABLE_ HVACICFRBlwLvlFrtSnsdStat1 0 "Uninitialized" 1 "Released" 2 "Pressed" 3 "Indeterminate" 4 "Out of Range Low" 5 "Out of Range High" ;
VAL_TABLE_ HVACICFRTempFrtLtSnsdStat1 0 "Uninitialized" 1 "Released" 2 "Pressed" 3 "Indeterminate" 4 "Out of Range Low" 5 "Out of Range High" ;
VAL_TABLE_ HVACICFRBlwLvlFrtSnsdStat2 0 "Uninitialized" 1 "Released" 2 "Pressed" 3 "Indeterminate" 4 "Out of Range Low" 5 "Out of Range High" ;
VAL_TABLE_ HVACICFRTempFrtRtSnsdStat2 0 "Uninitialized" 1 "Released" 2 "Pressed" 3 "Indeterminate" 4 "Out of Range Low" 5 "Out of Range High" ;
VAL_TABLE_ HVACICFRTempFrtRtSnsdStat1 0 "Uninitialized" 1 "Released" 2 "Pressed" 3 "Indeterminate" 4 "Out of Range Low" 5 "Out of Range High" ;
VAL_TABLE_ HVACICFRTempFrtLtSnsdStat2 0 "Uninitialized" 1 "Released" 2 "Pressed" 3 "Indeterminate" 4 "Out of Range Low" 5 "Out of Range High" ;
VAL_TABLE_ HVACICFRTempFrtRtCorrSts 0 "Indeterminate" 1 "Pass Criteria Met" 2 "Fail Criteria Met" ;
VAL_TABLE_ HVACICFRTempFrtLtCorrSts 0 "Indeterminate" 1 "Pass Criteria Met" 2 "Fail Criteria Met" ;
VAL_TABLE_ HVACICFRBlwLvlFrtCorrSts 0 "Indeterminate" 1 "Pass Criteria Met" 2 "Fail Criteria Met" ;
VAL_TABLE_ HVACICFRTempFrtRtDatErr 0 "FALSE" 1 "TRUE" ;
VAL_TABLE_ HVACICFRTempFrtLtDatErr 0 "FALSE" 1 "TRUE" ;
VAL_TABLE_ HVACICFRMsg2InvDatDtd 0 "FALSE" 1 "TRUE" ;
VAL_TABLE_ HVACICFRMsg2DatRxd 0 "FALSE" 1 "TRUE" ;
VAL_TABLE_ HVACICFRBlwLvlFrtDatErr 0 "FALSE" 1 "TRUE" ;
VAL_TABLE_ HVACICFRFrtHVACAutoSnsdStat 0 "Uninitialized" 1 "Released" 2 "Pressed" 3 "Indeterminate" 4 "Out of Range Low" 5 "Out of Range High" ;
VAL_TABLE_ HVACICFRFrtDefrSnsdStat 0 "Uninitialized" 1 "Released" 2 "Pressed" 3 "Indeterminate" 4 "Out of Range Low" 5 "Out of Range High" ;
VAL_TABLE_ HVACICFRCompSnsdStat 0 "Uninitialized" 1 "Released" 2 "Pressed" 3 "Indeterminate" 4 "Out of Range Low" 5 "Out of Range High" ;
VAL_TABLE_ HVACICFRRrDfgSnsdStat 0 "Uninitialized" 1 "Released" 2 "Pressed" 3 "Indeterminate" 4 "Out of Range Low" 5 "Out of Range High" ;
VAL_TABLE_ HVACICFRRecircSnsdStat 0 "Uninitialized" 1 "Released" 2 "Pressed" 3 "Indeterminate" 4 "Out of Range Low" 5 "Out of Range High" ;
VAL_TABLE_ HVACICFRHtSnsdStat 0 "Uninitialized" 1 "Released" 2 "Pressed" 3 "Indeterminate" 4 "Out of Range Low" 5 "Out of Range High" ;
VAL_TABLE_ HVACICFRFrtHVACAutoDatErr 0 "FALSE" 1 "TRUE" ;
VAL_TABLE_ HVACICFRFrtDefrDatErr 0 "FALSE" 1 "TRUE" ;
VAL_TABLE_ HVACICFRCompSetChg 0 "FALSE" 1 "TRUE" ;
VAL_TABLE_ HVACICFRCompDatErr 0 "FALSE" 1 "TRUE" ;
VAL_TABLE_ HVACICFRRecircSetChg 0 "FALSE" 1 "TRUE" ;
VAL_TABLE_ HVACICFRRecircDatErr 0 "FALSE" 1 "TRUE" ;
VAL_TABLE_ HVACICFRMsg1InvDatDtd 0 "FALSE" 1 "TRUE" ;
VAL_TABLE_ HVACICFRMsg1DatRxd 0 "FALSE" 1 "TRUE" ;
VAL_TABLE_ HVACICFRMaxDefrChg 0 "FALSE" 1 "TRUE" ;
VAL_TABLE_ HVACICFRHtSetChg 0 "FALSE" 1 "TRUE" ;
VAL_TABLE_ HVACICFRHtDatErr 0 "FALSE" 1 "TRUE" ;
VAL_TABLE_ HVACICFRFrtHVACAutoSetChg 0 "FALSE" 1 "TRUE" ;
VAL_TABLE_ HVACICFRRrDfgSetChg 0 "FALSE" 1 "TRUE" ;
VAL_TABLE_ HVACICFRRrDfgDatErr 0 "FALSE" 1 "TRUE" ;
VAL_TABLE_ HVACICFRDiag2InvDatDtd 0 "FALSE" 1 "TRUE" ;
VAL_TABLE_ HVACICFRDiag2DatRxd 0 "FALSE" 1 "TRUE" ;
VAL_TABLE_ HVACICFRDiag1InvDatDtd 0 "FALSE" 1 "TRUE" ;
VAL_TABLE_ HVACICFRDiag1DatRxd 0 "FALSE" 1 "TRUE" ;
VAL_TABLE_ HVACICFRIntrnlCmptErr 0 "Indeterminate" 1 "Pass Criteria Met" 2 "Fail Criteria Met" ;
VAL_TABLE_ InfoCtlFBTchscrnDiag2InvDatDtd 0 "FALSE" 1 "TRUE" ;
VAL_TABLE_ InfoCtlFBTchscrnDiag2DatRxd 0 "FALSE" 1 "TRUE" ;
VAL_TABLE_ InfoCtlFBTchscrnDiag1InvDatDtd 0 "FALSE" 1 "TRUE" ;
VAL_TABLE_ InfoCtlFBTchscrnDiag1DatRxd 0 "FALSE" 1 "TRUE" ;
VAL_TABLE_ InfoCtlFBIntrnlCmpErr 0 "Indeterminate" 1 "Pass Criteria Met" 2 "Fail Criteria Met" ;
VAL_TABLE_ HVACICVRIntrnlCmptErr 0 "Indeterminate" 1 "Pass Criteria Met" 2 "Fail Criteria Met" ;
VAL_TABLE_ StVntdCoolCushLvlRRSet 0 "Off" 1 "Low" 2 "Medium" 3 "High" ;
VAL_TABLE_ StVntdCoolBkLvlRRSet 0 "Off" 1 "Low" 2 "Medium" 3 "High" ;
VAL_TABLE_ StHtdCushLvlRRSet 0 "Off" 1 "Low" 2 "Medium" 3 "High" ;
VAL_TABLE_ StHtdBkLvlRRSet 0 "Off" 1 "Low" 2 "Medium" 3 "High" ;
VAL_TABLE_ DlvryModeActv 0 "FALSE" 1 "TRUE" ;
VAL_TABLE_ RrPedtrnClsnMtgnVisAlrtReq 0 "Off" 1 "Pedestrian Alert" 2 "Pedestrian Notify" ;
VAL_TABLE_ RTESTlmDatUpdtIndActv 0 "FALSE" 1 "TRUE" ;
VAL_TABLE_ SGI2P_AirSpnsnRdHghtTgtStsAuth 0 "Faulted" 1 "Entry/Exit" 2 "Lowered 3" 3 "Lowered 2" 4 "Lowered 1" 5 "Showroom" 6 "Normal" 7 "Raised 1" 8 "Raised 2" 9 "Raised 3" 10 "Cargo" 11 "Trailer Low" 12 "Trailer High" 13 "Car Show" ;
VAL_TABLE_ StVntdCoolBkLvlLRVirtCtlReq 0 "No Request" 1 "Off" 2 "Low" 3 "Medium" 4 "High" ;
VAL_TABLE_ StHtdCushLvlLRVirtCtlReq 0 "No Request" 1 "Off" 2 "Low" 3 "Medium" 4 "High" ;
VAL_TABLE_ StHtdBkLvlLRVirtCtlReq 0 "No Request" 1 "Off" 2 "Low" 3 "Medium" 4 "High" ;
VAL_TABLE_ StHtdCushLvlRFVirtCtlReq 0 "No Request" 1 "Off" 2 "Low" 3 "Medium" 4 "High" ;
VAL_TABLE_ StHtdBkLvlRFVirtCtlReq 0 "No Request" 1 "Off" 2 "Low" 3 "Medium" 4 "High" ;
VAL_TABLE_ StVntdCoolCushLvlLRVirtCtlReq 0 "No Request" 1 "Off" 2 "Low" 3 "Medium" 4 "High" ;
VAL_TABLE_ StVntdCoolCushLvlRFVirtCtlReq 0 "No Request" 1 "Off" 2 "Low" 3 "Medium" 4 "High" ;
VAL_TABLE_ StVntdCoolBkLvlRFVirtCtlReq 0 "No Request" 1 "Off" 2 "Low" 3 "Medium" 4 "High" ;
VAL_TABLE_ StVntdCoolBkLvlRRVirtCtlReq 0 "No Request" 1 "Off" 2 "Low" 3 "Medium" 4 "High" ;
VAL_TABLE_ StHtdCushLvlRRVirtCtlReq 0 "No Request" 1 "Off" 2 "Low" 3 "Medium" 4 "High" ;
VAL_TABLE_ StHtdBkLvlRRVirtCtlReq 0 "No Request" 1 "Off" 2 "Low" 3 "Medium" 4 "High" ;
VAL_TABLE_ StMemLRVirtCtlReq 0 "No Request" 1 "Store Mem 1" 2 "Store Mem 2" 3 "Store Mem 3" 4 "Store Mem 4" 5 "Store Mem 5" 6 "Store Mem 6" 7 "Store Mem 7" 8 "Store Mem 8" 9 "Store Exit 1" 10 "Store Exit 2" 11 "Store Exit 3" 12 "Store Exit 4" 13 "Store Exit 5" 14 "Store Exit 6" 15 "Store Exit 7" 16 "Store Exit 8" 17 "Recall Mem 1" 18 "Recall Mem 2" 19 "Recall Mem 3" 20 "Recall Mem 4" 21 "Recall Mem 5" 22 "Recall Mem 6" 23 "Recall Mem 7" 24 "Recall Mem 8" 25 "Recall Exit 1" 26 "Recall Exit 2" 27 "Recall Exit 3" 28 "Recall Exit 4" 29 "Recall Exit 5" 30 "Recall Exit 6" 31 "Recall Exit 7" 32 "Recall Exit 8" 33 "Stop All Movement" ;
VAL_TABLE_ StVntdCoolCushLvlRRVirtCtlReq 0 "No Request" 1 "Off" 2 "Low" 3 "Medium" 4 "High" ;
VAL_TABLE_ StMemRFVirtCtlReq 0 "No Request" 1 "Store Mem 1" 2 "Store Mem 2" 3 "Store Mem 3" 4 "Store Mem 4" 5 "Store Mem 5" 6 "Store Mem 6" 7 "Store Mem 7" 8 "Store Mem 8" 9 "Store Exit 1" 10 "Store Exit 2" 11 "Store Exit 3" 12 "Store Exit 4" 13 "Store Exit 5" 14 "Store Exit 6" 15 "Store Exit 7" 16 "Store Exit 8" 17 "Recall Mem 1" 18 "Recall Mem 2" 19 "Recall Mem 3" 20 "Recall Mem 4" 21 "Recall Mem 5" 22 "Recall Mem 6" 23 "Recall Mem 7" 24 "Recall Mem 8" 25 "Recall Exit 1" 26 "Recall Exit 2" 27 "Recall Exit 3" 28 "Recall Exit 4" 29 "Recall Exit 5" 30 "Recall Exit 6" 31 "Recall Exit 7" 32 "Recall Exit 8" 33 "Stop All Movement" ;
VAL_TABLE_ RrDrOpnCmfRclCstChgSetReq 0 "No Action" 1 "Off" 2 "On" ;
VAL_TABLE_ StMemRRVirtCtlReq 0 "No Request" 1 "Store Mem 1" 2 "Store Mem 2" 3 "Store Mem 3" 4 "Store Mem 4" 5 "Store Mem 5" 6 "Store Mem 6" 7 "Store Mem 7" 8 "Store Mem 8" 9 "Store Exit 1" 10 "Store Exit 2" 11 "Store Exit 3" 12 "Store Exit 4" 13 "Store Exit 5" 14 "Store Exit 6" 15 "Store Exit 7" 16 "Store Exit 8" 17 "Recall Mem 1" 18 "Recall Mem 2" 19 "Recall Mem 3" 20 "Recall Mem 4" 21 "Recall Mem 5" 22 "Recall Mem 6" 23 "Recall Mem 7" 24 "Recall Mem 8" 25 "Recall Exit 1" 26 "Recall Exit 2" 27 "Recall Exit 3" 28 "Recall Exit 4" 29 "Recall Exit 5" 30 "Recall Exit 6" 31 "Recall Exit 7" 32 "Recall Exit 8" 33 "Stop All Movement" ;
VAL_TABLE_ VirtFrtPsStInfoDspFRstReq 0 "No Action" 1 "Force Reset" ;
VAL_TABLE_ PhnWrlsChrg1DsbldCstChgSetReq 0 "No Action" 1 "Off" 2 "On" ;
VAL_TABLE_ DlvryModeVwgCstChgSetReq 0 "No Action" 1 "Off" 2 "On" ;
VAL_TABLE_ VehNeutAbuseIndReq 0 "No Indication" 1 "Speed Too High" 2 "Distance Too Far" ;
VAL_TABLE_ ClmCtlCbnFrtLtTempSet_Inv 0 "FALSE" 1 "TRUE" ;
VAL_TABLE_ VirtFrtPsStInfoDspPwrBtnCtlAval 0 "Not Available" 1 "Available" ;
VAL_TABLE_ FrtPsStInfoDspPwrBtnCurrSlnVal 0 "Unknown" 1 "On" 2 "Off" ;
VAL_TABLE_ VirtRrStInfoDsp2PwrBtnCtlAval 0 "Not Available" 1 "Available" ;
VAL_TABLE_ VirtRrStInfoDsp1PwrBtnCtlAval 0 "Not Available" 1 "Available" ;
VAL_TABLE_ RrStInfoDsp2PwrBtnCurrSlnVal 0 "Unknown" 1 "On" 2 "Off" ;
VAL_TABLE_ RrStInfoDsp1PwrBtnCurrSlnVal 0 "Unknown" 1 "On" 2 "Off" ;
VAL_TABLE_ PhnWrlsChrg4DsbldCstChgSetReq 0 "No Action" 1 "Off" 2 "On" ;
VAL_TABLE_ PhnWrlsChrg3DsbldCstChgSetReq 0 "No Action" 1 "Off" 2 "On" ;
VAL_TABLE_ PhnWrlsChrg2DsbldCstChgSetReq 0 "No Action" 1 "Off" 2 "On" ;
VAL_TABLE_ VirtRrStInfoDsp2PwrBtnReq 0 "No Action" 1 "Press And Release" 2 "Press And Hold" ;
VAL_TABLE_ VirtRrStInfoDsp1PwrBtnReq 0 "No Action" 1 "Press And Release" 2 "Press And Hold" ;
VAL_TABLE_ VirtFrtPsStInfoDspPwrBtnReq 0 "No Action" 1 "Press And Release" 2 "Press And Hold" ;
VAL_TABLE_ LnKpAsstSeltdVirtCtlReq 0 "No Action" 1 "On" 2 "Off" ;
VAL_TABLE_ VirtRrStInfoDsp2FRstReq 0 "No Action" 1 "Force Reset" ;
VAL_TABLE_ VirtRrStInfoDsp1FRstReq 0 "No Action" 1 "Force Reset" ;
VAL_TABLE_ QdZnAudVolSyncCtlOn 0 "FALSE" 1 "TRUE" ;
VAL_TABLE_ PhnWrlsChrg1DsbldCstSetAval 0 "FALSE" 1 "TRUE" ;
VAL_TABLE_ PhnWrlsChrg1DsbldCstAvlFlg7 0 "FALSE" 1 "TRUE" ;
VAL_TABLE_ PhnWrlsChrg1DsbldCstAvlFlg6 0 "FALSE" 1 "TRUE" ;
VAL_TABLE_ PhnWrlsChrg1DsbldCstAvlFlg5 0 "FALSE" 1 "TRUE" ;
VAL_TABLE_ PhnWrlsChrg1DsbldCstAvlFlg4 0 "FALSE" 1 "TRUE" ;
VAL_TABLE_ PhnWrlsChrg2DsbldCstAvlFlg2 0 "FALSE" 1 "TRUE" ;
VAL_TABLE_ PhnWrlsChrg2DsbldCstAvlFlg1 0 "FALSE" 1 "TRUE" ;
VAL_TABLE_ WrlsChrgSys2ChrgSts 0 "WCS Not Present" 1 "Charging Inactive" 2 "Charging Active" 3 "Charging Complete" 4 "Foreign Object Detected" 5 "WCS Overtemp Shutdown" 6 "Phone Overtemp" 7 "Establishing Communications" ;
VAL_TABLE_ PhnWrlsChrg2DsbldCstCurrSetVal 0 "Setting Unknown" 1 "Off" 2 "On" ;
VAL_TABLE_ PhnWrlsChrg2DsbldCstSetAval 0 "FALSE" 1 "TRUE" ;
VAL_TABLE_ PhnWrlsChrg2DsbldCstAvlFlg7 0 "FALSE" 1 "TRUE" ;
VAL_TABLE_ PhnWrlsChrg2DsbldCstAvlFlg6 0 "FALSE" 1 "TRUE" ;
VAL_TABLE_ PhnWrlsChrg2DsbldCstAvlFlg5 0 "FALSE" 1 "TRUE" ;
VAL_TABLE_ PhnWrlsChrg2DsbldCstAvlFlg4 0 "FALSE" 1 "TRUE" ;
VAL_TABLE_ PhnWrlsChrg2DsbldCstAvlFlg3 0 "FALSE" 1 "TRUE" ;
VAL_TABLE_ PhnWrlsChrg3DsbldCstAvlFlg2 0 "FALSE" 1 "TRUE" ;
VAL_TABLE_ PhnWrlsChrg3DsbldCstAvlFlg1 0 "FALSE" 1 "TRUE" ;

BA_DEF_ SG_  "SignalType" STRING ;
BA_DEF_ SG_  "SignalLongName" STRING ;
BA_DEF_ BO_  "GenMsgCycleTime" INT 0 10000;
BA_DEF_ BO_  "GenMsgSendType" ENUM "cyclicX","spontanX","cyclicIfActiveX","spontanWithDelay","cyclicAndSpontanX","cyclicAndSpontanWithDelay","spontanWithRepetition","cyclicIfActiveAndSpontanWD";
BA_DEF_DEF_  "SignalType" "";
BA_DEF_DEF_  "SignalLongName" "";
BA_DEF_DEF_  "GenMsgCycleTime" 0;
BA_DEF_DEF_  "GenMsgSendType" "cyclicX";
