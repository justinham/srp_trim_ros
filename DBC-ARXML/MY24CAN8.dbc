VERSION ""

NS_ :

BS_:

BU_: WCM4 WCM3 WCM2 WCM VPM VLM VKM VICM VECM VDM VCU_RTOS_ETH VCU_ENTRY_ETH VCU_AGVM_ETH VCU UVM UPM TIM TEST_TOOL_1 TCP_ETH TCP TCM TCCM SRR_SRR_ETH SRR_SRR SRR_SLR_ETH SRR_SLR SRR_RR SRR_RF_ETH SRR_RF SRR_LR_CR SRR_LF_ETH SRR_LF SIB SDM SCL SBZA_R SBZA_L SBM SAM_RR SAM_RF SAM_LR SAM_LF SAM_BH SADS RadioLow_ETH RadioLow RSI_RTOS_ETH RSI RDCM PTM PLCM PFCM PDR_ETH PDR PCM PA ODS2 ODS NVM MTCM_R MTCM_L MSM_RR MSM_P MSM_LR MSM_D MSB2 MSB1 MRCM_R MRCM_L MFC LRR_RR_ETH LRR_LR_ETH LRR_CF_ETH LRR LRL_CF_ETH LIB_48V LIB1 IPC_INT IPC_GP IPC ICS_Info ICCM HVAC_FP_R HVAC_FP_F HUD_CAN HDLM FPI_RTOS_ETH FPI FOPM FCM_LC FCM EPSb EPS_1 EPSRAb EPSRAa EPS EOCM_HC_Superset EOCM_HCP2 EOCM ELM ECP_X1 ECP_S2 ECP_S ECP_MC ECP_H3 ECP_H2 ECP_H1 ECP_E ECM EBCM DMS DEFC DCM CSM_ETH CSM_AV CSM CGM_OTA_ETH CGM BSM_MH BSM_HEV BSM BCM ARS ARB APA AOS AMP ALC AHS AHL_AFL ADIMb ADIMa ACP2_MCU

BO_ 222 FCODP_BrstGrp_Prtctd_Consecuti04: 64 ACP2_MCU
 SG_ FCODPB2P_AutofxHrznAuth : 3|6@0- (1,0) [-32|31] "pixel" EOCM,EOCM_HCP2,EOCM_HC_Superset,HDLM
 SG_ FCODPB2P_AutofxCnvrgncyCntAuth : 5|2@0+ (1,0) [0|3] "" EOCM,EOCM_HCP2,EOCM_HC_Superset,HDLM
 SG_ FCODPB2P_BrstID : 7|2@0+ (1,0) [0|3] "" EOCM,EOCM_HCP2,EOCM_HC_Superset,HDLM
 SG_ FCODPB2P_AutofxYwAuth : 11|7@0- (1,0) [-64|63] "pixel" EOCM,EOCM_HCP2,EOCM_HC_Superset,HDLM
 SG_ FCODPB2P_AutofxOutOfCalAuth : 13|2@0+ (1,0) [0|3] "" EOCM,EOCM_HCP2,EOCM_HC_Superset,HDLM
 SG_ FCODPB2P_FrwdCamSysOprtgStsAuth : 18|3@0+ (1,0) [0|7] "" EOCM,EOCM_HCP2,EOCM_HC_Superset,HDLM
 SG_ FCODPB2P_EnvIllumAuth : 20|2@0+ (1,0) [0|3] "" EOCM,EOCM_HCP2,EOCM_HC_Superset,HDLM
 SG_ FCODPB2P_FVFaildAuth : 24|1@0+ (1,0) [0|1] "" EOCM,EOCM_HCP2,EOCM_HC_Superset,HDLM
 SG_ FCODPB2P_FVBlkgStsAuth : 27|3@0+ (1,0) [0|7] "" EOCM,EOCM_HCP2,EOCM_HC_Superset,HDLM,LRR,SRR_LF,SRR_LR_CR,SRR_RF,SRR_RR,SRR_SLR,SRR_SRR
 SG_ FCODPB2P_FVAdvWthrStsAuth : 31|4@0+ (1,0) [0|9] "" EOCM,EOCM_HCP2,EOCM_HC_Superset,HDLM
 SG_ FCODPB2P_FVLBDtnAqTmStmAuth : 36|11@0+ (1,0) [0|2047] "ms" EOCM,EOCM_HCP2,EOCM_HC_Superset,HDLM
 SG_ FCODPB2P_FVFailDtnStsAuth : 39|3@0+ (1,0) [0|5] "" EOCM,EOCM_HCP2,EOCM_HC_Superset,HDLM
 SG_ FCODPB2P_FVLBTk2ClrAuth : 40|2@0+ (1,0) [0|3] "" EOCM,EOCM_HCP2,EOCM_HC_Superset,HDLM
 SG_ FCODPB2P_FVLBDtnAqTmStmAuth_Inv : 41|1@0+ (1,0) [0|1] "" EOCM,EOCM_HCP2,EOCM_HC_Superset,HDLM
 SG_ FCODPB2P_FVLBTk2CrvAuth : 54|16@0- (9.77e-07,0) [-0.0320143|0.0320134] "1/m" EOCM,EOCM_HCP2,EOCM_HC_Superset,HDLM
 SG_ FCODPB2P_FVLBTk2CrvDrvtAuth : 70|16@0- (3.73e-09,0) [-0.000122225|0.000122221] "1/m^2" EOCM,EOCM_HCP2,EOCM_HC_Superset,HDLM
 SG_ FCODPB2P_FVLBTk2FPSABCQOvrAuth : 86|7@0+ (1,0) [0|127] "%" EOCM,EOCM_HCP2,EOCM_HC_Superset,HDLM
 SG_ FCODPB2P_FVLBTk2FPSBQAuth : 88|7@0+ (1,0) [0|127] "%" EOCM,EOCM_HCP2,EOCM_HC_Superset,HDLM
 SG_ FCODPB2P_FVLBTk2FPSAQAuth : 95|7@0+ (1,0) [0|127] "%" EOCM,EOCM_HCP2,EOCM_HC_Superset,HDLM
 SG_ FCODPB2P_FVLBTk2FPSCQAuth : 97|7@0+ (1,0) [0|127] "%" EOCM,EOCM_HCP2,EOCM_HC_Superset,HDLM
 SG_ FCODPB2P_FVLBTk2HdgAuth : 106|10@0- (0.000977,0) [-0.500224|0.499247] "" EOCM,EOCM_HCP2,EOCM_HC_Superset,HDLM
 SG_ FCODPB2P_FVLBTk2OfstAuth : 112|13@0- (0.003906,0) [-15.999|15.9951] "m" EOCM,EOCM_HCP2,EOCM_HC_Superset,HDLM
 SG_ FCODPB2P_FVLBTk2PstnTypAuth : 131|4@0+ (1,0) [0|12] "" EOCM,EOCM_HCP2,EOCM_HC_Superset,HDLM
 SG_ FCODPB2P_FVLBTk2VRLgDistAuth : 138|7@0+ (1,0) [0|127] "m" EOCM,EOCM_HCP2,EOCM_HC_Superset,HDLM
 SG_ FCODPB2P_FVLBTk2TypAuth : 141|3@0+ (1,0) [0|7] "" EOCM,EOCM_HCP2,EOCM_HC_Superset,HDLM
 SG_ FCODPB2P_FVLBTk2QltyAuth : 143|2@0+ (1,0) [0|3] "" EOCM,EOCM_HCP2,EOCM_HC_Superset,HDLM
 SG_ FCODPB2P_FVLBTk2VSLgDistAuth : 147|7@0+ (1,0) [0|127] "m" EOCM,EOCM_HCP2,EOCM_HC_Superset,HDLM
 SG_ FCODPB2P_FVLBTk2WdthAuth : 156|6@0+ (0.01,0) [0|0.63] "m" EOCM,EOCM_HCP2,EOCM_HC_Superset,HDLM
 SG_ FCODPB2P_FVLLLVRlvtoMrkngAuth : 161|8@0- (0.02,0) [-2.56|2.54] "m/s" EOCM,EOCM_HCP2,EOCM_HC_Superset,HDLM
 SG_ FCODPB2P_FVLLBndryCrsTmAuth : 166|5@0+ (0.1,0) [0|3.1] "s" EOCM,EOCM_HCP2,EOCM_HC_Superset,HDLM
 SG_ FCODPB2P_FVLnDtnOvrallQtyAuth : 168|6@0+ (2,0) [0|126] "%" EOCM,EOCM_HCP2,EOCM_HC_Superset,HDLM
 SG_ FCODPB2P_FVLnChngIndAuth : 169|1@0+ (1,0) [0|1] "" EOCM,EOCM_HCP2,EOCM_HC_Superset,HDLM
 SG_ FCODPB2P_FVLtdAccssRdTypAuth : 178|3@0+ (1,0) [0|2] "" EOCM,EOCM_HCP2,EOCM_HC_Superset,HDLM
 SG_ FCODPB2P_FVPOTk2IDAuth : 186|6@0+ (1,0) [0|63] "" EOCM,EOCM_HCP2,EOCM_HC_Superset,HDLM
 SG_ FCODPB2P_FVPOTk2DynPrpAuth : 189|3@0+ (1,0) [0|4] "" EOCM,EOCM_HCP2,EOCM_HC_Superset,HDLM
 SG_ FCODPB2P_FVPOTk2CnfdStsAuth : 191|2@0+ (1,0) [0|3] "" EOCM,EOCM_HCP2,EOCM_HC_Superset,HDLM
 SG_ FCODPB2P_FVPOTk2InPthPotAuth : 196|6@0+ (2,0) [0|126] "%" EOCM,EOCM_HCP2,EOCM_HC_Superset,HDLM
 SG_ FCODPB2P_FVPOTk2PoILAAuth : 204|9@0- (0.125,0) [-32|31.875] "m/s^2" EOCM,EOCM_HCP2,EOCM_HC_Superset,HDLM
 SG_ FCODPB2P_FVPOTk2MStsAuth : 206|2@0+ (1,0) [0|3] "" EOCM,EOCM_HCP2,EOCM_HC_Superset,HDLM
 SG_ FCODPB2P_FVPOTk2PoILgAAuth : 211|9@0- (0.125,0) [-32|31.875] "m/s^2" EOCM,EOCM_HCP2,EOCM_HC_Superset,HDLM
 SG_ FCODPB2P_FVPOTk2PoILgPsAuth : 218|11@0+ (0.125,0) [0|255.875] "m" EOCM,EOCM_HCP2,EOCM_HC_Superset,HDLM
 SG_ FCODPB2P_FVPOTk2PoILgVAuth : 239|10@0- (0.125,0) [-64|63.875] "m/s" EOCM,EOCM_HCP2,EOCM_HC_Superset,HDLM
 SG_ FCODPB2P_FVPOTk2PoILPsAuth : 245|10@0- (0.125,0) [-64|63.875] "m" EOCM,EOCM_HCP2,EOCM_HC_Superset,HDLM
 SG_ FCODPB2P_FVPOTk2PoILVAuth : 251|9@0- (0.125,0) [-32|31.875] "m/s" EOCM,EOCM_HCP2,EOCM_HC_Superset,HDLM
 SG_ FCODPB2P_FVPOTk2TypCnfdAuth : 256|2@0+ (1,0) [0|3] "" EOCM,EOCM_HCP2,EOCM_HC_Superset,HDLM
 SG_ FCODPB2P_FVPOTk2TypAuth : 258|2@0+ (1,0) [0|2] "" EOCM,EOCM_HCP2,EOCM_HC_Superset,HDLM
 SG_ FCODPB2P_FVRLLVRlvtoMrkngAuth : 265|8@0- (0.02,0) [-2.56|2.54] "m/s" EOCM,EOCM_HCP2,EOCM_HC_Superset,HDLM
 SG_ FCODPB2P_FVRLBndryCrsTmAuth : 270|5@0+ (0.1,0) [0|3.1] "s" EOCM,EOCM_HCP2,EOCM_HC_Superset,HDLM
 SG_ FCODPB2P_FVServAlgnRtnStsAuth : 272|4@0+ (1,0) [0|11] "" EOCM,EOCM_HCP2,EOCM_HC_Superset,HDLM
 SG_ FCODPB2P_FVServAlgnInPrcAuth : 273|1@0+ (1,0) [0|1] "" EOCM,EOCM_HCP2,EOCM_HC_Superset,HDLM
 SG_ FCODPB2P_FVSysSplyVltAuth : 281|8@0+ (0.1,0) [0|25.5] "V" EOCM,EOCM_HCP2,EOCM_HC_Superset,HDLM
 SG_ FCODPB2P_FVSysCalStsAuth : 283|2@0+ (1,0) [0|3] "" EOCM,EOCM_HCP2,EOCM_HC_Superset,HDLM
 SG_ FCODPB2P_FVServRqAuth : 284|1@0+ (1,0) [0|1] "" EOCM,EOCM_HCP2,EOCM_HC_Superset,HDLM
 SG_ FCODPB2P_FVVOTk2BrkLgtStsAuth : 288|2@0+ (1,0) [0|3] "" EOCM,EOCM_HCP2,EOCM_HC_Superset,HDLM
 SG_ FCODPB2P_FVUnvAuth : 289|1@0+ (1,0) [0|1] "" EOCM,EOCM_HCP2,EOCM_HC_Superset,HDLM
 SG_ FCODPB2P_FVVOTk2CnfdStsAuth : 296|2@0+ (1,0) [0|3] "" EOCM,EOCM_HCP2,EOCM_HC_Superset,HDLM
 SG_ FCODPB2P_FVVOTk2CICOPotAuth : 302|6@0+ (2,0) [0|126] "%" EOCM,EOCM_HCP2,EOCM_HC_Superset,HDLM
 SG_ FCODPB2P_FVVOTk2HdgAngAuth : 306|11@0- (0.002,0) [-2.048|2.046] "rad" EOCM,EOCM_HCP2,EOCM_HC_Superset,HDLM
 SG_ FCODPB2P_FVVOTk2DynPrpStsAuth : 307|1@0+ (1,0) [0|1] "" EOCM,EOCM_HCP2,EOCM_HC_Superset,HDLM
 SG_ FCODPB2P_FVVOTk2DynPrpAuth : 310|3@0+ (1,0) [0|6] "" EOCM,EOCM_HCP2,EOCM_HC_Superset,HDLM
 SG_ FCODPB2P_FVVOTk2HdgAngCAuth : 327|13@0- (0.002,0) [-8.192|8.19] "rad" EOCM,EOCM_HCP2,EOCM_HC_Superset,HDLM
 SG_ FCODPB2P_FVVOTk2IDAuth : 330|6@0+ (1,0) [0|63] "" EOCM,EOCM_HCP2,EOCM_HC_Superset,HDLM
 SG_ FCODPB2P_FVVOTk2MStsAuth : 337|2@0+ (1,0) [0|3] "" EOCM,EOCM_HCP2,EOCM_HC_Superset,HDLM
 SG_ FCODPB2P_FVVOTk2LnAsmtAuth : 340|3@0+ (1,0) [0|5] "" EOCM,EOCM_HCP2,EOCM_HC_Superset,HDLM
 SG_ FCODPB2P_FVVOTk2PoILAAuth : 351|9@0- (0.125,0) [-32|31.875] "m/s^2" EOCM,EOCM_HCP2,EOCM_HC_Superset,HDLM
 SG_ FCODPB2P_FVVOTk2PoILgAAuth : 358|9@0- (0.125,0) [-32|31.875] "m/s^2" EOCM,EOCM_HCP2,EOCM_HC_Superset,HDLM
 SG_ FCODPB2P_FVVOTk2PoILgPsAuth : 365|11@0+ (0.125,0) [0|255.875] "m" EOCM,EOCM_HCP2,EOCM_HC_Superset,HDLM
 SG_ FCODPB2P_FVVOTk2PoILgPsCAuth : 370|15@0+ (0.01,0) [0|327.67] "m^2" EOCM,EOCM_HCP2,EOCM_HC_Superset,HDLM
 SG_ FCODPB2P_FVVOTk2PoILgVAuth : 387|11@0- (0.125,0) [-128|127.875] "m/s" EOCM,EOCM_HCP2,EOCM_HC_Superset,HDLM
 SG_ FCODPB2P_FVVOTk2PoILgVCAuth : 392|10@0+ (0.125,0) [0|127.875] "(m/s)^2" EOCM,EOCM_HCP2,EOCM_HC_Superset,HDLM
 SG_ FCODPB2P_FVVOTk2PoILPsAuth : 414|10@0- (0.125,0) [-64|63.875] "m" EOCM,EOCM_HCP2,EOCM_HC_Superset,HDLM
 SG_ FCODPB2P_FVVOTk2PoILPsCAuth : 420|14@0+ (0.01,0) [0|163.83] "m^2" EOCM,EOCM_HCP2,EOCM_HC_Superset,HDLM
 SG_ FCODPB2P_FVVOTk2PoILVAuth : 438|9@0- (0.125,0) [-32|31.875] "m/s" EOCM,EOCM_HCP2,EOCM_HC_Superset,HDLM
 SG_ FCODPB2P_FVVOTk2PoILVCAuth : 445|10@0+ (0.125,0) [0|127.875] "(m/s)^2" EOCM,EOCM_HCP2,EOCM_HC_Superset,HDLM
 SG_ FCODPB2P_FVVOTk2PoIWAuth : 451|7@0+ (0.125,0) [0|15.875] "m" EOCM,EOCM_HCP2,EOCM_HC_Superset,HDLM
 SG_ FCODPB2P_FVVOTk2TypAuth : 457|2@0+ (1,0) [0|3] "" EOCM,EOCM_HCP2,EOCM_HC_Superset,HDLM
 SG_ FCODPB2P_FVVOTk2TSLgtStsAuth : 460|3@0+ (1,0) [0|4] "" EOCM,EOCM_HCP2,EOCM_HC_Superset,HDLM
 SG_ FCODPB2P_RdTypAuth : 465|3@0+ (1,0) [0|7] "" EOCM,EOCM_HCP2,EOCM_HC_Superset,HDLM
 SG_ FCODPB2P_LtdAccssRdTypCnfdAuth : 469|4@0+ (10,0) [0|150] "%" EOCM,EOCM_HCP2,EOCM_HC_Superset,HDLM
 SG_ FCODPB2P_FVVOTk2TypCnfdAuth : 471|2@0+ (1,0) [0|3] "" EOCM,EOCM_HCP2,EOCM_HC_Superset,HDLM
 SG_ FVHiThrtICTrnAcrsPthObjTkID : 472|6@0+ (1,0) [0|63] "" EOCM,EOCM_HCP2,EOCM_HC_Superset,HDLM
 SG_ FVHiThrtICCrsgObjTkID : 478|6@0+ (1,0) [0|63] "" EOCM,EOCM_HCP2,EOCM_HC_Superset,HDLM
 SG_ FVHiThrtICCrsgVehPrfllNw : 480|1@0+ (1,0) [0|1] "" EOCM,EOCM_HCP2,EOCM_HC_Superset,HDLM
 SG_ FVHiThrtICCrsgVehBrkNw : 481|1@0+ (1,0) [0|1] "" EOCM,EOCM_HCP2,EOCM_HC_Superset,HDLM
 SG_ FVHiThrtICCrsgVehAlrtNw : 482|1@0+ (1,0) [0|1] "" EOCM,EOCM_HCP2,EOCM_HC_Superset,HDLM
 SG_ FrwdVsnVehObjTk2DatIntegCkd : 488|2@0+ (1,0) [0|2] "" EOCM,EOCM_HCP2,EOCM_HC_Superset,HDLM
 SG_ FrwdVsnPedtrnObjTk2DatIntegCkd : 490|2@0+ (1,0) [0|2] "" EOCM,EOCM_HCP2,EOCM_HC_Superset,HDLM
 SG_ FrwdVsnLnBdryTk2DatIntegCkd : 492|2@0+ (1,0) [0|2] "" EOCM,EOCM_HCP2,EOCM_HC_Superset,HDLM
 SG_ FVHiThrtICTrnAcrsPthVehPrfllNw : 493|1@0+ (1,0) [0|1] "" EOCM,EOCM_HCP2,EOCM_HC_Superset,HDLM
 SG_ FVHiThrtICTrnAcrsPthVehBrkNw : 494|1@0+ (1,0) [0|1] "" EOCM,EOCM_HCP2,EOCM_HC_Superset,HDLM
 SG_ FVHiThrtICTrnAcrsPthVehAlrtNw : 495|1@0+ (1,0) [0|1] "" EOCM,EOCM_HCP2,EOCM_HC_Superset,HDLM
 SG_ FCODPB2P_Filler : 502|15@0+ (1,0) [0|32767] "" EOCM,EOCM_HCP2,EOCM_HC_Superset,HDLM

BO_ 234 FCODP_BrstGrp_Prtctd_Consecuti05: 64 ACP2_MCU
 SG_ FCODPB3P_FlSfBlrdImgDtnRngAuth : 0|7@0+ (1,0) [0|127] "%" CGM,EOCM,EOCM_HCP2,EOCM_HC_Superset,HDLM
 SG_ FCODPB3P_FlSfBlrdImgDtdAuth : 1|1@0+ (1,0) [0|1] "" CGM,EOCM,EOCM_HCP2,EOCM_HC_Superset,HDLM
 SG_ FCODPB3P_ConstrArRtDtdAuth : 2|1@0+ (1,0) [0|1] "" CGM,EOCM,EOCM_HCP2,EOCM_HC_Superset,HDLM
 SG_ FCODPB3P_ConstrArLtDtdAuth : 3|1@0+ (1,0) [0|1] "" CGM,EOCM,EOCM_HCP2,EOCM_HC_Superset,HDLM
 SG_ FCODPB3P_AmbLnMrksRtAuth : 4|1@0+ (1,0) [0|1] "" CGM,EOCM,EOCM_HCP2,EOCM_HC_Superset,HDLM
 SG_ FCODPB3P_AmbLnMrksLtAuth : 5|1@0+ (1,0) [0|1] "" CGM,EOCM,EOCM_HCP2,EOCM_HC_Superset,HDLM
 SG_ FCODPB3P_BrstID : 7|2@0+ (1,0) [0|3] "" CGM,EOCM,EOCM_HCP2,EOCM_HC_Superset,HDLM
 SG_ FCODPB3P_FlSfFggyScnDtnRngAuth : 8|7@0+ (1,0) [0|127] "%" CGM,EOCM,EOCM_HCP2,EOCM_HC_Superset,HDLM
 SG_ FCODPB3P_FlSfFggyScnDtdAuth : 9|1@0+ (1,0) [0|1] "" CGM,EOCM,EOCM_HCP2,EOCM_HC_Superset,HDLM
 SG_ FCODPB3P_FlSfFllBlkgDtnRngAuth : 16|7@0+ (1,0) [0|127] "%" CGM,EOCM,EOCM_HCP2,EOCM_HC_Superset,HDLM
 SG_ FCODPB3P_FlSfFllBlkgDtdAuth : 17|1@0+ (1,0) [0|1] "" CGM,EOCM,EOCM_HCP2,EOCM_HC_Superset,HDLM
 SG_ FCODPB3P_FlSfLoSnDtnRngAuth : 24|7@0+ (1,0) [0|127] "%" CGM,EOCM,EOCM_HCP2,EOCM_HC_Superset,HDLM
 SG_ FCODPB3P_FlSfLoSnDtdAuth : 25|1@0+ (1,0) [0|1] "" CGM,EOCM,EOCM_HCP2,EOCM_HC_Superset,HDLM
 SG_ FCODPB3P_FlSfPtlBlkgDtnRngAuth : 32|7@0+ (1,0) [0|127] "%" CGM,EOCM,EOCM_HCP2,EOCM_HC_Superset,HDLM
 SG_ FCODPB3P_FlSfPtlBlkgDtdAuth : 33|1@0+ (1,0) [0|1] "" CGM,EOCM,EOCM_HCP2,EOCM_HC_Superset,HDLM
 SG_ FCODPB3P_FlSfSmrdSptDtnRngAuth : 40|7@0+ (1,0) [0|127] "%" CGM,EOCM,EOCM_HCP2,EOCM_HC_Superset,HDLM
 SG_ FCODPB3P_FlSfSmrdSptDtdAuth : 41|1@0+ (1,0) [0|1] "" CGM,EOCM,EOCM_HCP2,EOCM_HC_Superset,HDLM
 SG_ FCODPB3P_FlSfSplshsDtnRngAuth : 48|7@0+ (1,0) [0|127] "%" CGM,EOCM,EOCM_HCP2,EOCM_HC_Superset,HDLM
 SG_ FCODPB3P_FlSfSplshsDtdAuth : 49|1@0+ (1,0) [0|1] "" CGM,EOCM,EOCM_HCP2,EOCM_HC_Superset,HDLM
 SG_ FCODPB3P_FrwyExtRtDtdAuth : 56|1@0+ (1,0) [0|1] "" CGM,EOCM,EOCM_HCP2,EOCM_HC_Superset,HDLM
 SG_ FCODPB3P_FrwyExtLtDtdAuth : 57|1@0+ (1,0) [0|1] "" CGM,EOCM,EOCM_HCP2,EOCM_HC_Superset,HDLM
 SG_ FCODPB3P_FVAcqTmStmAuth : 69|11@0+ (1,0) [0|2047] "ms" CGM,EOCM,EOCM_HCP2,EOCM_HC_Superset,HDLM
 SG_ FCODPB3P_FrwyMrgRtDtdAuth : 70|1@0+ (1,0) [0|1] "" CGM,EOCM,EOCM_HCP2,EOCM_HC_Superset,HDLM
 SG_ FCODPB3P_FrwyMrgLtDtdAuth : 71|1@0+ (1,0) [0|1] "" CGM,EOCM,EOCM_HCP2,EOCM_HC_Superset,HDLM
 SG_ FCODPB3P_FVCIPthVehlOTkIDAuth : 73|6@0+ (1,0) [0|63] "" CGM,EOCM,EOCM_HCP2,EOCM_HC_Superset,HDLM
 SG_ FCODPB3P_FVAcqTmStmAuth_Inv : 74|1@0+ (1,0) [0|1] "" CGM,EOCM,EOCM_HCP2,EOCM_HC_Superset,HDLM
 SG_ FCODPB3P_FVCIPthVehlTTCAuth : 83|10@0+ (0.01,0) [0|10.23] "s" CGM,EOCM,EOCM_HCP2,EOCM_HC_Superset,HDLM
 SG_ FCODPB3P_FVConstrArDtdCnfdAuth : 89|2@0+ (1,0) [0|3] "" CGM,EOCM,EOCM_HCP2,EOCM_HC_Superset,HDLM
 SG_ FCODPB3P_FVHTPOTkIDAuth : 101|6@0+ (1,0) [0|63] "" CGM,EOCM,EOCM_HCP2,EOCM_HC_Superset,HDLM
 SG_ FCODPB3P_FVConstrArDtnStsAuth : 103|2@0+ (1,0) [0|2] "" CGM,EOCM,EOCM_HCP2,EOCM_HC_Superset,HDLM
 SG_ FCODPB3P_FVHTPTTCAuth : 111|10@0+ (0.01,0) [0|10.23] "s" CGM,EOCM,EOCM_HCP2,EOCM_HC_Superset,HDLM
 SG_ FCODPB3P_FVLBTk3CrvAuth : 115|16@0- (9.77e-07,0) [-0.0320143|0.0320134] "1/m" CGM,EOCM,EOCM_HCP2,EOCM_HC_Superset,HDLM
 SG_ FCODPB3P_FVLBTk3ClrAuth : 117|2@0+ (1,0) [0|3] "" CGM,EOCM,EOCM_HCP2,EOCM_HC_Superset,HDLM
 SG_ FCODPB3P_FVLBTk3CrvDrvtAuth : 131|16@0- (3.73e-09,0) [-0.000122225|0.000122221] "1/m^2" CGM,EOCM,EOCM_HCP2,EOCM_HC_Superset,HDLM
 SG_ FCODPB3P_FVLBTk3FPSABCQOvrAuth : 147|7@0+ (1,0) [0|127] "%" CGM,EOCM,EOCM_HCP2,EOCM_HC_Superset,HDLM
 SG_ FCODPB3P_FVLBTk3FPSAQAuth : 156|7@0+ (1,0) [0|127] "%" CGM,EOCM,EOCM_HCP2,EOCM_HC_Superset,HDLM
 SG_ FCODPB3P_FVLBTk3FPSBQAuth : 165|7@0+ (1,0) [0|127] "%" CGM,EOCM,EOCM_HCP2,EOCM_HC_Superset,HDLM
 SG_ FCODPB3P_FVLBTk3FPSCQAuth : 174|7@0+ (1,0) [0|127] "%" CGM,EOCM,EOCM_HCP2,EOCM_HC_Superset,HDLM
 SG_ FCODPB3P_FVLBTk3HdgAuth : 183|10@0- (0.000977,0) [-0.500224|0.499247] "" CGM,EOCM,EOCM_HCP2,EOCM_HC_Superset,HDLM
 SG_ FCODPB3P_FVLBTk3OfstAuth : 189|13@0- (0.003906,0) [-15.999|15.9951] "m" CGM,EOCM,EOCM_HCP2,EOCM_HC_Superset,HDLM
 SG_ FCODPB3P_FVLBTk3PstnTypAuth : 192|4@0+ (1,0) [0|12] "" CGM,EOCM,EOCM_HCP2,EOCM_HC_Superset,HDLM
 SG_ FCODPB3P_FVLBTk3TypAuth : 202|3@0+ (1,0) [0|7] "" CGM,EOCM,EOCM_HCP2,EOCM_HC_Superset,HDLM
 SG_ FCODPB3P_FVLBTk3QltyAuth : 204|2@0+ (1,0) [0|3] "" CGM,EOCM,EOCM_HCP2,EOCM_HC_Superset,HDLM
 SG_ FCODPB3P_FVLBTk3VSLgDistAuth : 208|7@0+ (1,0) [0|127] "m" CGM,EOCM,EOCM_HCP2,EOCM_HC_Superset,HDLM
 SG_ FCODPB3P_FVLBTk3VRLgDistAuth : 215|7@0+ (1,0) [0|127] "m" CGM,EOCM,EOCM_HCP2,EOCM_HC_Superset,HDLM
 SG_ FCODPB3P_FVLBTk3WdthAuth : 217|6@0+ (0.01,0) [0|0.63] "m" CGM,EOCM,EOCM_HCP2,EOCM_HC_Superset,HDLM
 SG_ FCODPB3P_FVPOTk3DynPrpAuth : 225|3@0+ (1,0) [0|4] "" CGM,EOCM,EOCM_HCP2,EOCM_HC_Superset,HDLM
 SG_ FCODPB3P_FVPOTk3CnfdStsAuth : 227|2@0+ (1,0) [0|3] "" CGM,EOCM,EOCM_HCP2,EOCM_HC_Superset,HDLM
 SG_ FCODPB3P_FVPOTk3InPthPotAuth : 232|6@0+ (2,0) [0|126] "%" CGM,EOCM,EOCM_HCP2,EOCM_HC_Superset,HDLM
 SG_ FCODPB3P_FVPOTk3IDAuth : 238|6@0+ (1,0) [0|63] "" CGM,EOCM,EOCM_HCP2,EOCM_HC_Superset,HDLM
 SG_ FCODPB3P_FVPOTk3PoILAAuth : 240|9@0- (0.125,0) [-32|31.875] "m/s^2" CGM,EOCM,EOCM_HCP2,EOCM_HC_Superset,HDLM
 SG_ FCODPB3P_FVPOTk3MStsAuth : 242|2@0+ (1,0) [0|3] "" CGM,EOCM,EOCM_HCP2,EOCM_HC_Superset,HDLM
 SG_ FCODPB3P_FVPOTk3PoILgAAuth : 263|9@0- (0.125,0) [-32|31.875] "m/s^2" CGM,EOCM,EOCM_HCP2,EOCM_HC_Superset,HDLM
 SG_ FCODPB3P_FVPOTk3PoILgPsAuth : 270|11@0+ (0.125,0) [0|255.875] "m" CGM,EOCM,EOCM_HCP2,EOCM_HC_Superset,HDLM
 SG_ FCODPB3P_FVPOTk3PoILgVAuth : 275|10@0- (0.125,0) [-64|63.875] "m/s" CGM,EOCM,EOCM_HCP2,EOCM_HC_Superset,HDLM
 SG_ FCODPB3P_FVPOTk3PoILPsAuth : 281|10@0- (0.125,0) [-64|63.875] "m" CGM,EOCM,EOCM_HCP2,EOCM_HC_Superset,HDLM
 SG_ FCODPB3P_FVPOTk3PoILVAuth : 303|9@0- (0.125,0) [-32|31.875] "m/s" CGM,EOCM,EOCM_HCP2,EOCM_HC_Superset,HDLM
 SG_ FCODPB3P_FVVOTk3BrkLgtStsAuth : 304|2@0+ (1,0) [0|3] "" CGM,EOCM,EOCM_HCP2,EOCM_HC_Superset,HDLM
 SG_ FCODPB3P_FVVCRngCutInRtAuth : 305|1@0+ (1,0) [0|1] "" CGM,EOCM,EOCM_HCP2,EOCM_HC_Superset,HDLM
 SG_ FCODPB3P_FVVCRngCutInLtAuth : 306|1@0+ (1,0) [0|1] "" CGM,EOCM,EOCM_HCP2,EOCM_HC_Superset,HDLM
 SG_ FCODPB3P_FVPOTk3TypCnfdAuth : 308|2@0+ (1,0) [0|3] "" CGM,EOCM,EOCM_HCP2,EOCM_HC_Superset,HDLM
 SG_ FCODPB3P_FVPOTk3TypAuth : 310|2@0+ (1,0) [0|2] "" CGM,EOCM,EOCM_HCP2,EOCM_HC_Superset,HDLM
 SG_ FCODPB3P_FVVOTk3CnfdStsAuth : 312|2@0+ (1,0) [0|3] "" CGM,EOCM,EOCM_HCP2,EOCM_HC_Superset,HDLM
 SG_ FCODPB3P_FVVOTk3CICOPotAuth : 318|6@0+ (2,0) [0|126] "%" CGM,EOCM,EOCM_HCP2,EOCM_HC_Superset,HDLM
 SG_ FCODPB3P_FVVOTk3HdgAngAuth : 322|11@0- (0.002,0) [-2.048|2.046] "rad" CGM,EOCM,EOCM_HCP2,EOCM_HC_Superset,HDLM
 SG_ FCODPB3P_FVVOTk3DynPrpStsAuth : 323|1@0+ (1,0) [0|1] "" CGM,EOCM,EOCM_HCP2,EOCM_HC_Superset,HDLM
 SG_ FCODPB3P_FVVOTk3DynPrpAuth : 326|3@0+ (1,0) [0|6] "" CGM,EOCM,EOCM_HCP2,EOCM_HC_Superset,HDLM
 SG_ FCODPB3P_FVVOTk3HdgAngCAuth : 343|13@0- (0.002,0) [-8.192|8.19] "rad" CGM,EOCM,EOCM_HCP2,EOCM_HC_Superset,HDLM
 SG_ FCODPB3P_FVVOTk3IDAuth : 346|6@0+ (1,0) [0|63] "" CGM,EOCM,EOCM_HCP2,EOCM_HC_Superset,HDLM
 SG_ FCODPB3P_FVVOTk3MStsAuth : 353|2@0+ (1,0) [0|3] "" CGM,EOCM,EOCM_HCP2,EOCM_HC_Superset,HDLM
 SG_ FCODPB3P_FVVOTk3LnAsmtAuth : 356|3@0+ (1,0) [0|5] "" CGM,EOCM,EOCM_HCP2,EOCM_HC_Superset,HDLM
 SG_ FCODPB3P_FVVOTk3PoILAAuth : 367|9@0- (0.125,0) [-32|31.875] "m/s^2" CGM,EOCM,EOCM_HCP2,EOCM_HC_Superset,HDLM
 SG_ FCODPB3P_FVVOTk3PoILgAAuth : 374|9@0- (0.125,0) [-32|31.875] "m/s^2" CGM,EOCM,EOCM_HCP2,EOCM_HC_Superset,HDLM
 SG_ FCODPB3P_FVVOTk3PoILgPsAuth : 381|11@0+ (0.125,0) [0|255.875] "m" CGM,EOCM,EOCM_HCP2,EOCM_HC_Superset,HDLM
 SG_ FCODPB3P_FVVOTk3PoILgPsCAuth : 386|15@0+ (0.01,0) [0|327.67] "m^2" CGM,EOCM,EOCM_HCP2,EOCM_HC_Superset,HDLM
 SG_ FCODPB3P_FVVOTk3PoILgVAuth : 403|11@0- (0.125,0) [-128|127.875] "m/s" CGM,EOCM,EOCM_HCP2,EOCM_HC_Superset,HDLM
 SG_ FCODPB3P_FVVOTk3PoILgVCAuth : 408|10@0+ (0.125,0) [0|127.875] "(m/s)^2" CGM,EOCM,EOCM_HCP2,EOCM_HC_Superset,HDLM
 SG_ FCODPB3P_FVVOTk3PoILPsAuth : 430|10@0- (0.125,0) [-64|63.875] "m" CGM,EOCM,EOCM_HCP2,EOCM_HC_Superset,HDLM
 SG_ FCODPB3P_FVVOTk3PoILPsCAuth : 436|14@0+ (0.01,0) [0|163.83] "m^2" CGM,EOCM,EOCM_HCP2,EOCM_HC_Superset,HDLM
 SG_ FCODPB3P_FVVOTk3PoILVAuth : 454|9@0- (0.125,0) [-32|31.875] "m/s" CGM,EOCM,EOCM_HCP2,EOCM_HC_Superset,HDLM
 SG_ FCODPB3P_FVVOTk3PoILVCAuth : 461|10@0+ (0.125,0) [0|127.875] "(m/s)^2" CGM,EOCM,EOCM_HCP2,EOCM_HC_Superset,HDLM
 SG_ FCODPB3P_FVVOTk3PoIWAuth : 467|7@0+ (0.125,0) [0|15.875] "m" CGM,EOCM,EOCM_HCP2,EOCM_HC_Superset,HDLM
 SG_ FCODPB3P_FVVOTk3TypAuth : 473|2@0+ (1,0) [0|3] "" CGM,EOCM,EOCM_HCP2,EOCM_HC_Superset,HDLM
 SG_ FCODPB3P_FVVOTk3TSLgtStsAuth : 476|3@0+ (1,0) [0|4] "" CGM,EOCM,EOCM_HCP2,EOCM_HC_Superset,HDLM
 SG_ FCODPB3P_OvrhdStrctrDistAuth : 483|10@0+ (0.125,0) [0|127.875] "m" CGM,EOCM,EOCM_HCP2,EOCM_HC_Superset,HDLM
 SG_ FCODPB3P_OvrhdStrctDtdAuth : 484|1@0+ (1,0) [0|1] "" CGM,EOCM,EOCM_HCP2,EOCM_HC_Superset,HDLM
 SG_ FCODPB3P_IntTrffcDtdAuth : 485|1@0+ (1,0) [0|1] "" CGM,EOCM,EOCM_HCP2,EOCM_HC_Superset,HDLM
 SG_ FCODPB3P_FVVOTk3TypCnfdAuth : 487|2@0+ (1,0) [0|3] "" CGM,EOCM,EOCM_HCP2,EOCM_HC_Superset,HDLM
 SG_ FCODPB3P_VehInTnnlCnfdAuth : 488|2@0+ (1,0) [0|3] "" CGM,EOCM,EOCM_HCP2,EOCM_HC_Superset,HDLM
 SG_ FCODPB3P_TrffcLgtDtdAuth : 489|1@0+ (1,0) [0|1] "" CGM,EOCM,EOCM_HCP2,EOCM_HC_Superset,HDLM
 SG_ FrwdVsnVehObjTk3DatIntegCkd : 497|2@0+ (1,0) [0|2] "" CGM,EOCM,EOCM_HCP2,EOCM_HC_Superset,HDLM
 SG_ FrwdVsnPedtrnObjTk3DatIntegCkd : 499|2@0+ (1,0) [0|2] "" CGM,EOCM,EOCM_HCP2,EOCM_HC_Superset,HDLM
 SG_ FrwdVsnLnBdryTk3DatIntegCkd : 501|2@0+ (1,0) [0|2] "" CGM,EOCM,EOCM_HCP2,EOCM_HC_Superset,HDLM
 SG_ FCODPB3P_VehInTnnlDtdAuth : 502|1@0+ (1,0) [0|1] "" CGM,EOCM,EOCM_HCP2,EOCM_HC_Superset,HDLM
 SG_ FCODPB3P_Filler : 511|8@0+ (1,0) [0|255] "" CGM,EOCM,EOCM_HCP2,EOCM_HC_Superset,HDLM

BO_ 221 FCODP_BrstGrp_Prtctd_Consecuti06: 64 ACP2_MCU
 SG_ FCODPB4P_FVLBTk11CrvAuth : 3|16@0- (9.77e-07,0) [-0.0320143|0.0320134] "1/m" EOCM,EOCM_HCP2,EOCM_HC_Superset,HDLM
 SG_ FCODPB4P_FVLBTk11ClrAuth : 5|2@0+ (1,0) [0|3] "" EOCM,EOCM_HCP2,EOCM_HC_Superset,HDLM
 SG_ FCODPB4P_BrstID : 7|2@0+ (1,0) [0|3] "" EOCM,EOCM_HCP2,EOCM_HC_Superset,HDLM
 SG_ FCODPB4P_FVLBTk11CrvDrvtAuth : 19|16@0- (3.73e-09,0) [-0.000122225|0.000122221] "1/m^2" EOCM,EOCM_HCP2,EOCM_HC_Superset,HDLM
 SG_ FCODPB4P_FVLBTk11FPSABCQOvrAuth : 35|7@0+ (1,0) [0|127] "%" EOCM,EOCM_HCP2,EOCM_HC_Superset,HDLM
 SG_ FCODPB4P_FVLBTk11FPSAQAuth : 44|7@0+ (1,0) [0|127] "%" EOCM,EOCM_HCP2,EOCM_HC_Superset,HDLM
 SG_ FCODPB4P_FVLBTk11FPSBQAuth : 53|7@0+ (1,0) [0|127] "%" EOCM,EOCM_HCP2,EOCM_HC_Superset,HDLM
 SG_ FCODPB4P_FVLBTk11FPSCQAuth : 62|7@0+ (1,0) [0|127] "%" EOCM,EOCM_HCP2,EOCM_HC_Superset,HDLM
 SG_ FCODPB4P_FVLBTk11HdgAuth : 71|10@0- (0.000977,0) [-0.500224|0.499247] "" EOCM,EOCM_HCP2,EOCM_HC_Superset,HDLM
 SG_ FCODPB4P_FVLBTk11OfstAuth : 77|13@0- (0.003906,0) [-15.999|15.9951] "m" EOCM,EOCM_HCP2,EOCM_HC_Superset,HDLM
 SG_ FCODPB4P_FVLBTk11PstnTypAuth : 80|4@0+ (1,0) [0|12] "" EOCM,EOCM_HCP2,EOCM_HC_Superset,HDLM
 SG_ FCODPB4P_FVLBTk11TypAuth : 90|3@0+ (1,0) [0|7] "" EOCM,EOCM_HCP2,EOCM_HC_Superset,HDLM
 SG_ FCODPB4P_FVLBTk11QltyAuth : 92|2@0+ (1,0) [0|3] "" EOCM,EOCM_HCP2,EOCM_HC_Superset,HDLM
 SG_ FCODPB4P_FVLBTk11VSLgDistAuth : 96|7@0+ (1,0) [0|127] "m" EOCM,EOCM_HCP2,EOCM_HC_Superset,HDLM
 SG_ FCODPB4P_FVLBTk11VRLgDistAuth : 103|7@0+ (1,0) [0|127] "m" EOCM,EOCM_HCP2,EOCM_HC_Superset,HDLM
 SG_ FCODPB4P_FVLBTk11WdthAuth : 105|6@0+ (0.01,0) [0|0.63] "m" EOCM,EOCM_HCP2,EOCM_HC_Superset,HDLM
 SG_ FCODPB4P_FVLBTk4CrvAuth : 113|16@0- (9.77e-07,0) [-0.0320143|0.0320134] "1/m" EOCM,EOCM_HCP2,EOCM_HC_Superset,HDLM
 SG_ FCODPB4P_FVLBTk4ClrAuth : 115|2@0+ (1,0) [0|3] "" EOCM,EOCM_HCP2,EOCM_HC_Superset,HDLM
 SG_ FCODPB4P_FVLBTk4CrvDrvtAuth : 129|16@0- (3.73e-09,0) [-0.000122225|0.000122221] "1/m^2" EOCM,EOCM_HCP2,EOCM_HC_Superset,HDLM
 SG_ FCODPB4P_FVLBTk4FPSABCQOvrAuth : 145|7@0+ (1,0) [0|127] "%" EOCM,EOCM_HCP2,EOCM_HC_Superset,HDLM
 SG_ FCODPB4P_FVLBTk4FPSAQAuth : 154|7@0+ (1,0) [0|127] "%" EOCM,EOCM_HCP2,EOCM_HC_Superset,HDLM
 SG_ FCODPB4P_FVLBTk4FPSBQAuth : 163|7@0+ (1,0) [0|127] "%" EOCM,EOCM_HCP2,EOCM_HC_Superset,HDLM
 SG_ FCODPB4P_FVLBTk4FPSCQAuth : 172|7@0+ (1,0) [0|127] "%" EOCM,EOCM_HCP2,EOCM_HC_Superset,HDLM
 SG_ FCODPB4P_FVLBTk4HdgAuth : 181|10@0- (0.000977,0) [-0.500224|0.499247] "" EOCM,EOCM_HCP2,EOCM_HC_Superset,HDLM
 SG_ FCODPB4P_FVLBTk4OfstAuth : 187|13@0- (0.003906,0) [-15.999|15.9951] "m" EOCM,EOCM_HCP2,EOCM_HC_Superset,HDLM
 SG_ FCODPB4P_FVLBTk4TypAuth : 200|3@0+ (1,0) [0|7] "" EOCM,EOCM_HCP2,EOCM_HC_Superset,HDLM
 SG_ FCODPB4P_FVLBTk4QltyAuth : 202|2@0+ (1,0) [0|3] "" EOCM,EOCM_HCP2,EOCM_HC_Superset,HDLM
 SG_ FCODPB4P_FVLBTk4PstnTypAuth : 206|4@0+ (1,0) [0|12] "" EOCM,EOCM_HCP2,EOCM_HC_Superset,HDLM
 SG_ FCODPB4P_FVLBTk4VRLgDistAuth : 213|7@0+ (1,0) [0|127] "m" EOCM,EOCM_HCP2,EOCM_HC_Superset,HDLM
 SG_ FCODPB4P_FVLBTk4VSLgDistAuth : 222|7@0+ (1,0) [0|127] "m" EOCM,EOCM_HCP2,EOCM_HC_Superset,HDLM
 SG_ FCODPB4P_FVPOTk4CnfdStsAuth : 225|2@0+ (1,0) [0|3] "" EOCM,EOCM_HCP2,EOCM_HC_Superset,HDLM
 SG_ FCODPB4P_FVLBTk4WdthAuth : 231|6@0+ (0.01,0) [0|0.63] "m" EOCM,EOCM_HCP2,EOCM_HC_Superset,HDLM
 SG_ FCODPB4P_FVPOTk4IDAuth : 236|6@0+ (1,0) [0|63] "" EOCM,EOCM_HCP2,EOCM_HC_Superset,HDLM
 SG_ FCODPB4P_FVPOTk4DynPrpAuth : 239|3@0+ (1,0) [0|4] "" EOCM,EOCM_HCP2,EOCM_HC_Superset,HDLM
 SG_ FCODPB4P_FVPOTk4MStsAuth : 240|2@0+ (1,0) [0|3] "" EOCM,EOCM_HCP2,EOCM_HC_Superset,HDLM
 SG_ FCODPB4P_FVPOTk4InPthPotAuth : 246|6@0+ (2,0) [0|126] "%" EOCM,EOCM_HCP2,EOCM_HC_Superset,HDLM
 SG_ FCODPB4P_FVPOTk4PoILAAuth : 254|9@0- (0.125,0) [-32|31.875] "m/s^2" EOCM,EOCM_HCP2,EOCM_HC_Superset,HDLM
 SG_ FCODPB4P_FVPOTk4PoILgAAuth : 261|9@0- (0.125,0) [-32|31.875] "m/s^2" EOCM,EOCM_HCP2,EOCM_HC_Superset,HDLM
 SG_ FCODPB4P_FVPOTk4PoILgPsAuth : 268|11@0+ (0.125,0) [0|255.875] "m" EOCM,EOCM_HCP2,EOCM_HC_Superset,HDLM
 SG_ FCODPB4P_FVPOTk4PoILgVAuth : 273|10@0- (0.125,0) [-64|63.875] "m/s" EOCM,EOCM_HCP2,EOCM_HC_Superset,HDLM
 SG_ FCODPB4P_FVPOTk4PoILPsAuth : 295|10@0- (0.125,0) [-64|63.875] "m" EOCM,EOCM_HCP2,EOCM_HC_Superset,HDLM
 SG_ FCODPB4P_FVPOTk4PoILVAuth : 301|9@0- (0.125,0) [-32|31.875] "m/s" EOCM,EOCM_HCP2,EOCM_HC_Superset,HDLM
 SG_ FCODPB4P_FVVOTk4BrkLgtStsAuth : 304|2@0+ (1,0) [0|3] "" EOCM,EOCM_HCP2,EOCM_HC_Superset,HDLM
 SG_ FCODPB4P_FVPOTk4TypCnfdAuth : 306|2@0+ (1,0) [0|3] "" EOCM,EOCM_HCP2,EOCM_HC_Superset,HDLM
 SG_ FCODPB4P_FVPOTk4TypAuth : 308|2@0+ (1,0) [0|2] "" EOCM,EOCM_HCP2,EOCM_HC_Superset,HDLM
 SG_ FCODPB4P_FVVOTk4CnfdStsAuth : 312|2@0+ (1,0) [0|3] "" EOCM,EOCM_HCP2,EOCM_HC_Superset,HDLM
 SG_ FCODPB4P_FVVOTk4CICOPotAuth : 318|6@0+ (2,0) [0|126] "%" EOCM,EOCM_HCP2,EOCM_HC_Superset,HDLM
 SG_ FCODPB4P_FVVOTk4HdgAngAuth : 322|11@0- (0.002,0) [-2.048|2.046] "rad" EOCM,EOCM_HCP2,EOCM_HC_Superset,HDLM
 SG_ FCODPB4P_FVVOTk4DynPrpStsAuth : 323|1@0+ (1,0) [0|1] "" EOCM,EOCM_HCP2,EOCM_HC_Superset,HDLM
 SG_ FCODPB4P_FVVOTk4DynPrpAuth : 326|3@0+ (1,0) [0|6] "" EOCM,EOCM_HCP2,EOCM_HC_Superset,HDLM
 SG_ FCODPB4P_FVVOTk4HdgAngCAuth : 343|13@0- (0.002,0) [-8.192|8.19] "rad" EOCM,EOCM_HCP2,EOCM_HC_Superset,HDLM
 SG_ FCODPB4P_FVVOTk4IDAuth : 346|6@0+ (1,0) [0|63] "" EOCM,EOCM_HCP2,EOCM_HC_Superset,HDLM
 SG_ FCODPB4P_FVVOTk4MStsAuth : 353|2@0+ (1,0) [0|3] "" EOCM,EOCM_HCP2,EOCM_HC_Superset,HDLM
 SG_ FCODPB4P_FVVOTk4LnAsmtAuth : 356|3@0+ (1,0) [0|5] "" EOCM,EOCM_HCP2,EOCM_HC_Superset,HDLM
 SG_ FCODPB4P_FVVOTk4PoILAAuth : 367|9@0- (0.125,0) [-32|31.875] "m/s^2" EOCM,EOCM_HCP2,EOCM_HC_Superset,HDLM
 SG_ FCODPB4P_FVVOTk4PoILgAAuth : 374|9@0- (0.125,0) [-32|31.875] "m/s^2" EOCM,EOCM_HCP2,EOCM_HC_Superset,HDLM
 SG_ FCODPB4P_FVVOTk4PoILgPsAuth : 381|11@0+ (0.125,0) [0|255.875] "m" EOCM,EOCM_HCP2,EOCM_HC_Superset,HDLM
 SG_ FCODPB4P_FVVOTk4PoILgPsCAuth : 386|15@0+ (0.01,0) [0|327.67] "m^2" EOCM,EOCM_HCP2,EOCM_HC_Superset,HDLM
 SG_ FCODPB4P_FVVOTk4PoILgVAuth : 403|11@0- (0.125,0) [-128|127.875] "m/s" EOCM,EOCM_HCP2,EOCM_HC_Superset,HDLM
 SG_ FCODPB4P_FVVOTk4PoILgVCAuth : 408|10@0+ (0.125,0) [0|127.875] "(m/s)^2" EOCM,EOCM_HCP2,EOCM_HC_Superset,HDLM
 SG_ FCODPB4P_FVVOTk4PoILPsAuth : 430|10@0- (0.125,0) [-64|63.875] "m" EOCM,EOCM_HCP2,EOCM_HC_Superset,HDLM
 SG_ FCODPB4P_FVVOTk4PoILPsCAuth : 436|14@0+ (0.01,0) [0|163.83] "m^2" EOCM,EOCM_HCP2,EOCM_HC_Superset,HDLM
 SG_ FCODPB4P_FVVOTk4PoILVAuth : 454|9@0- (0.125,0) [-32|31.875] "m/s" EOCM,EOCM_HCP2,EOCM_HC_Superset,HDLM
 SG_ FCODPB4P_FVVOTk4PoILVCAuth : 461|10@0+ (0.125,0) [0|127.875] "(m/s)^2" EOCM,EOCM_HCP2,EOCM_HC_Superset,HDLM
 SG_ FCODPB4P_FVVOTk4PoIWAuth : 467|7@0+ (0.125,0) [0|15.875] "m" EOCM,EOCM_HCP2,EOCM_HC_Superset,HDLM
 SG_ FCODPB4P_FVVOTk4TypAuth : 473|2@0+ (1,0) [0|3] "" EOCM,EOCM_HCP2,EOCM_HC_Superset,HDLM
 SG_ FCODPB4P_FVVOTk4TSLgtStsAuth : 476|3@0+ (1,0) [0|4] "" EOCM,EOCM_HCP2,EOCM_HC_Superset,HDLM
 SG_ FrwdVsnVehObjTk4DatIntegCkd : 481|2@0+ (1,0) [0|2] "" EOCM,EOCM_HCP2,EOCM_HC_Superset,HDLM
 SG_ FrwdVsnPedtrnObjTk4DatIntegCkd : 483|2@0+ (1,0) [0|2] "" EOCM,EOCM_HCP2,EOCM_HC_Superset,HDLM
 SG_ FrwdVsnLnBdryTk4DatIntegCkd : 485|2@0+ (1,0) [0|2] "" EOCM,EOCM_HCP2,EOCM_HC_Superset,HDLM
 SG_ FCODPB4P_FVVOTk4TypCnfdAuth : 487|2@0+ (1,0) [0|3] "" EOCM,EOCM_HCP2,EOCM_HC_Superset,HDLM
 SG_ FCODPB4P_Filler : 495|24@0+ (1,0) [0|1.67772e+007] "" EOCM,EOCM_HCP2,EOCM_HC_Superset,HDLM

BO_ 235 FCODP_BrstGrp_Prtctd_Consecuti07: 64 ACP2_MCU
 SG_ FCODPB5P_FVLBTk10CrvAuth : 3|16@0- (9.77e-07,0) [-0.0320143|0.0320134] "1/m" EOCM,EOCM_HCP2,EOCM_HC_Superset,HDLM
 SG_ FCODPB5P_FVLBTk10ClrAuth : 5|2@0+ (1,0) [0|3] "" EOCM,EOCM_HCP2,EOCM_HC_Superset,HDLM
 SG_ FCODPB5P_BrstID : 7|2@0+ (1,0) [0|3] "" EOCM,EOCM_HCP2,EOCM_HC_Superset,HDLM
 SG_ FCODPB5P_FVLBTk10CrvDrvtAuth : 19|16@0- (3.73e-09,0) [-0.000122225|0.000122221] "1/m^2" EOCM,EOCM_HCP2,EOCM_HC_Superset,HDLM
 SG_ FCODPB5P_FVLBTk10FPSABCQOvrAuth : 35|7@0+ (1,0) [0|127] "%" EOCM,EOCM_HCP2,EOCM_HC_Superset,HDLM
 SG_ FCODPB5P_FVLBTk10FPSAQAuth : 44|7@0+ (1,0) [0|127] "%" EOCM,EOCM_HCP2,EOCM_HC_Superset,HDLM
 SG_ FCODPB5P_FVLBTk10FPSBQAuth : 53|7@0+ (1,0) [0|127] "%" EOCM,EOCM_HCP2,EOCM_HC_Superset,HDLM
 SG_ FCODPB5P_FVLBTk10FPSCQAuth : 62|7@0+ (1,0) [0|127] "%" EOCM,EOCM_HCP2,EOCM_HC_Superset,HDLM
 SG_ FCODPB5P_FVLBTk10HdgAuth : 71|10@0- (0.000977,0) [-0.500224|0.499247] "" EOCM,EOCM_HCP2,EOCM_HC_Superset,HDLM
 SG_ FCODPB5P_FVLBTk10OfstAuth : 77|13@0- (0.003906,0) [-15.999|15.9951] "m" EOCM,EOCM_HCP2,EOCM_HC_Superset,HDLM
 SG_ FCODPB5P_FVLBTk10PstnTypAuth : 80|4@0+ (1,0) [0|12] "" EOCM,EOCM_HCP2,EOCM_HC_Superset,HDLM
 SG_ FCODPB5P_FVLBTk10TypAuth : 90|3@0+ (1,0) [0|7] "" EOCM,EOCM_HCP2,EOCM_HC_Superset,HDLM
 SG_ FCODPB5P_FVLBTk10QltyAuth : 92|2@0+ (1,0) [0|3] "" EOCM,EOCM_HCP2,EOCM_HC_Superset,HDLM
 SG_ FCODPB5P_FVLBTk10VSLgDistAuth : 96|7@0+ (1,0) [0|127] "m" EOCM,EOCM_HCP2,EOCM_HC_Superset,HDLM
 SG_ FCODPB5P_FVLBTk10VRLgDistAuth : 103|7@0+ (1,0) [0|127] "m" EOCM,EOCM_HCP2,EOCM_HC_Superset,HDLM
 SG_ FCODPB5P_FVLBTk10WdthAuth : 105|6@0+ (0.01,0) [0|0.63] "m" EOCM,EOCM_HCP2,EOCM_HC_Superset,HDLM
 SG_ FCODPB5P_FVLBTk5CrvAuth : 113|16@0- (9.77e-07,0) [-0.0320143|0.0320134] "1/m" EOCM,EOCM_HCP2,EOCM_HC_Superset,HDLM
 SG_ FCODPB5P_FVLBTk5ClrAuth : 115|2@0+ (1,0) [0|3] "" EOCM,EOCM_HCP2,EOCM_HC_Superset,HDLM
 SG_ FCODPB5P_FVLBTk5CrvDrvtAuth : 129|16@0- (3.73e-09,0) [-0.000122225|0.000122221] "1/m^2" EOCM,EOCM_HCP2,EOCM_HC_Superset,HDLM
 SG_ FCODPB5P_FVLBTk5FPSABCQOvrAuth : 145|7@0+ (1,0) [0|127] "%" EOCM,EOCM_HCP2,EOCM_HC_Superset,HDLM
 SG_ FCODPB5P_FVLBTk5FPSAQAuth : 154|7@0+ (1,0) [0|127] "%" EOCM,EOCM_HCP2,EOCM_HC_Superset,HDLM
 SG_ FCODPB5P_FVLBTk5FPSBQAuth : 163|7@0+ (1,0) [0|127] "%" EOCM,EOCM_HCP2,EOCM_HC_Superset,HDLM
 SG_ FCODPB5P_FVLBTk5FPSCQAuth : 172|7@0+ (1,0) [0|127] "%" EOCM,EOCM_HCP2,EOCM_HC_Superset,HDLM
 SG_ FCODPB5P_FVLBTk5HdgAuth : 181|10@0- (0.000977,0) [-0.500224|0.499247] "" EOCM,EOCM_HCP2,EOCM_HC_Superset,HDLM
 SG_ FCODPB5P_FVLBTk5OfstAuth : 187|13@0- (0.003906,0) [-15.999|15.9951] "m" EOCM,EOCM_HCP2,EOCM_HC_Superset,HDLM
 SG_ FCODPB5P_FVLBTk5TypAuth : 200|3@0+ (1,0) [0|7] "" EOCM,EOCM_HCP2,EOCM_HC_Superset,HDLM
 SG_ FCODPB5P_FVLBTk5QltyAuth : 202|2@0+ (1,0) [0|3] "" EOCM,EOCM_HCP2,EOCM_HC_Superset,HDLM
 SG_ FCODPB5P_FVLBTk5PstnTypAuth : 206|4@0+ (1,0) [0|12] "" EOCM,EOCM_HCP2,EOCM_HC_Superset,HDLM
 SG_ FCODPB5P_FVLBTk5VRLgDistAuth : 213|7@0+ (1,0) [0|127] "m" EOCM,EOCM_HCP2,EOCM_HC_Superset,HDLM
 SG_ FCODPB5P_FVLBTk5VSLgDistAuth : 222|7@0+ (1,0) [0|127] "m" EOCM,EOCM_HCP2,EOCM_HC_Superset,HDLM
 SG_ FCODPB5P_FVPOTk5CnfdStsAuth : 225|2@0+ (1,0) [0|3] "" EOCM,EOCM_HCP2,EOCM_HC_Superset,HDLM
 SG_ FCODPB5P_FVLBTk5WdthAuth : 231|6@0+ (0.01,0) [0|0.63] "m" EOCM,EOCM_HCP2,EOCM_HC_Superset,HDLM
 SG_ FCODPB5P_FVPOTk5IDAuth : 236|6@0+ (1,0) [0|63] "" EOCM,EOCM_HCP2,EOCM_HC_Superset,HDLM
 SG_ FCODPB5P_FVPOTk5DynPrpAuth : 239|3@0+ (1,0) [0|4] "" EOCM,EOCM_HCP2,EOCM_HC_Superset,HDLM
 SG_ FCODPB5P_FVPOTk5MStsAuth : 240|2@0+ (1,0) [0|3] "" EOCM,EOCM_HCP2,EOCM_HC_Superset,HDLM
 SG_ FCODPB5P_FVPOTk5InPthPotAuth : 246|6@0+ (2,0) [0|126] "%" EOCM,EOCM_HCP2,EOCM_HC_Superset,HDLM
 SG_ FCODPB5P_FVPOTk5PoILAAuth : 254|9@0- (0.125,0) [-32|31.875] "m/s^2" EOCM,EOCM_HCP2,EOCM_HC_Superset,HDLM
 SG_ FCODPB5P_FVPOTk5PoILgAAuth : 261|9@0- (0.125,0) [-32|31.875] "m/s^2" EOCM,EOCM_HCP2,EOCM_HC_Superset,HDLM
 SG_ FCODPB5P_FVPOTk5PoILgPsAuth : 268|11@0+ (0.125,0) [0|255.875] "m" EOCM,EOCM_HCP2,EOCM_HC_Superset,HDLM
 SG_ FCODPB5P_FVPOTk5PoILgVAuth : 273|10@0- (0.125,0) [-64|63.875] "m/s" EOCM,EOCM_HCP2,EOCM_HC_Superset,HDLM
 SG_ FCODPB5P_FVPOTk5PoILPsAuth : 295|10@0- (0.125,0) [-64|63.875] "m" EOCM,EOCM_HCP2,EOCM_HC_Superset,HDLM
 SG_ FCODPB5P_FVPOTk5PoILVAuth : 301|9@0- (0.125,0) [-32|31.875] "m/s" EOCM,EOCM_HCP2,EOCM_HC_Superset,HDLM
 SG_ FCODPB5P_FVVOTk5BrkLgtStsAuth : 304|2@0+ (1,0) [0|3] "" EOCM,EOCM_HCP2,EOCM_HC_Superset,HDLM
 SG_ FCODPB5P_FVPOTk5TypCnfdAuth : 306|2@0+ (1,0) [0|3] "" EOCM,EOCM_HCP2,EOCM_HC_Superset,HDLM
 SG_ FCODPB5P_FVPOTk5TypAuth : 308|2@0+ (1,0) [0|2] "" EOCM,EOCM_HCP2,EOCM_HC_Superset,HDLM
 SG_ FCODPB5P_FVVOTk5CnfdStsAuth : 312|2@0+ (1,0) [0|3] "" EOCM,EOCM_HCP2,EOCM_HC_Superset,HDLM
 SG_ FCODPB5P_FVVOTk5CICOPotAuth : 318|6@0+ (2,0) [0|126] "%" EOCM,EOCM_HCP2,EOCM_HC_Superset,HDLM
 SG_ FCODPB5P_FVVOTk5HdgAngAuth : 322|11@0- (0.002,0) [-2.048|2.046] "rad" EOCM,EOCM_HCP2,EOCM_HC_Superset,HDLM
 SG_ FCODPB5P_FVVOTk5DynPrpStsAuth : 323|1@0+ (1,0) [0|1] "" EOCM,EOCM_HCP2,EOCM_HC_Superset,HDLM
 SG_ FCODPB5P_FVVOTk5DynPrpAuth : 326|3@0+ (1,0) [0|6] "" EOCM,EOCM_HCP2,EOCM_HC_Superset,HDLM
 SG_ FCODPB5P_FVVOTk5HdgAngCAuth : 343|13@0- (0.002,0) [-8.192|8.19] "rad" EOCM,EOCM_HCP2,EOCM_HC_Superset,HDLM
 SG_ FCODPB5P_FVVOTk5IDAuth : 346|6@0+ (1,0) [0|63] "" EOCM,EOCM_HCP2,EOCM_HC_Superset,HDLM
 SG_ FCODPB5P_FVVOTk5MStsAuth : 353|2@0+ (1,0) [0|3] "" EOCM,EOCM_HCP2,EOCM_HC_Superset,HDLM
 SG_ FCODPB5P_FVVOTk5LnAsmtAuth : 356|3@0+ (1,0) [0|5] "" EOCM,EOCM_HCP2,EOCM_HC_Superset,HDLM
 SG_ FCODPB5P_FVVOTk5PoILAAuth : 367|9@0- (0.125,0) [-32|31.875] "m/s^2" EOCM,EOCM_HCP2,EOCM_HC_Superset,HDLM
 SG_ FCODPB5P_FVVOTk5PoILgAAuth : 374|9@0- (0.125,0) [-32|31.875] "m/s^2" EOCM,EOCM_HCP2,EOCM_HC_Superset,HDLM
 SG_ FCODPB5P_FVVOTk5PoILgPsAuth : 381|11@0+ (0.125,0) [0|255.875] "m" EOCM,EOCM_HCP2,EOCM_HC_Superset,HDLM
 SG_ FCODPB5P_FVVOTk5PoILgPsCAuth : 386|15@0+ (0.01,0) [0|327.67] "m^2" EOCM,EOCM_HCP2,EOCM_HC_Superset,HDLM
 SG_ FCODPB5P_FVVOTk5PoILgVAuth : 403|11@0- (0.125,0) [-128|127.875] "m/s" EOCM,EOCM_HCP2,EOCM_HC_Superset,HDLM
 SG_ FCODPB5P_FVVOTk5PoILgVCAuth : 408|10@0+ (0.125,0) [0|127.875] "(m/s)^2" EOCM,EOCM_HCP2,EOCM_HC_Superset,HDLM
 SG_ FCODPB5P_FVVOTk5PoILPsAuth : 430|10@0- (0.125,0) [-64|63.875] "m" EOCM,EOCM_HCP2,EOCM_HC_Superset,HDLM
 SG_ FCODPB5P_FVVOTk5PoILPsCAuth : 436|14@0+ (0.01,0) [0|163.83] "m^2" EOCM,EOCM_HCP2,EOCM_HC_Superset,HDLM
 SG_ FCODPB5P_FVVOTk5PoILVAuth : 454|9@0- (0.125,0) [-32|31.875] "m/s" EOCM,EOCM_HCP2,EOCM_HC_Superset,HDLM
 SG_ FCODPB5P_FVVOTk5PoILVCAuth : 461|10@0+ (0.125,0) [0|127.875] "(m/s)^2" EOCM,EOCM_HCP2,EOCM_HC_Superset,HDLM
 SG_ FCODPB5P_FVVOTk5PoIWAuth : 467|7@0+ (0.125,0) [0|15.875] "m" EOCM,EOCM_HCP2,EOCM_HC_Superset,HDLM
 SG_ FCODPB5P_FVVOTk5TypAuth : 473|2@0+ (1,0) [0|3] "" EOCM,EOCM_HCP2,EOCM_HC_Superset,HDLM
 SG_ FCODPB5P_FVVOTk5TSLgtStsAuth : 476|3@0+ (1,0) [0|4] "" EOCM,EOCM_HCP2,EOCM_HC_Superset,HDLM
 SG_ FrwdVsnVehObjTk5DatIntegCkd : 481|2@0+ (1,0) [0|2] "" EOCM,EOCM_HCP2,EOCM_HC_Superset,HDLM
 SG_ FrwdVsnPedtrnObjTk5DatIntegCkd : 483|2@0+ (1,0) [0|2] "" EOCM,EOCM_HCP2,EOCM_HC_Superset,HDLM
 SG_ FrwdVsnLnBdryTk5DatIntegCkd : 485|2@0+ (1,0) [0|2] "" EOCM,EOCM_HCP2,EOCM_HC_Superset,HDLM
 SG_ FCODPB5P_FVVOTk5TypCnfdAuth : 487|2@0+ (1,0) [0|3] "" EOCM,EOCM_HCP2,EOCM_HC_Superset,HDLM
 SG_ FCODPB5P_Filler : 495|24@0+ (1,0) [0|1.67772e+007] "" EOCM,EOCM_HCP2,EOCM_HC_Superset,HDLM

BO_ 220 FCODP_BrstGrp_Prtctd_Consecuti08: 64 ACP2_MCU
 SG_ FCODPB6P_FVLBTk6CrvAuth : 3|16@0- (9.77e-07,0) [-0.0320143|0.0320134] "1/m" EOCM,EOCM_HCP2,EOCM_HC_Superset,HDLM
 SG_ FCODPB6P_FVLBTk6ClrAuth : 5|2@0+ (1,0) [0|3] "" EOCM,EOCM_HCP2,EOCM_HC_Superset,HDLM
 SG_ FCODPB6P_BrstID : 7|2@0+ (1,0) [0|3] "" EOCM,EOCM_HCP2,EOCM_HC_Superset,HDLM
 SG_ FCODPB6P_FVLBTk6CrvDrvtAuth : 19|16@0- (3.73e-09,0) [-0.000122225|0.000122221] "1/m^2" EOCM,EOCM_HCP2,EOCM_HC_Superset,HDLM
 SG_ FCODPB6P_FVLBTk6FPSABCQOvrAuth : 35|7@0+ (1,0) [0|127] "%" EOCM,EOCM_HCP2,EOCM_HC_Superset,HDLM
 SG_ FCODPB6P_FVLBTk6FPSAQAuth : 44|7@0+ (1,0) [0|127] "%" EOCM,EOCM_HCP2,EOCM_HC_Superset,HDLM
 SG_ FCODPB6P_FVLBTk6FPSBQAuth : 53|7@0+ (1,0) [0|127] "%" EOCM,EOCM_HCP2,EOCM_HC_Superset,HDLM
 SG_ FCODPB6P_FVLBTk6FPSCQAuth : 62|7@0+ (1,0) [0|127] "%" EOCM,EOCM_HCP2,EOCM_HC_Superset,HDLM
 SG_ FCODPB6P_FVLBTk6HdgAuth : 71|10@0- (0.000977,0) [-0.500224|0.499247] "" EOCM,EOCM_HCP2,EOCM_HC_Superset,HDLM
 SG_ FCODPB6P_FVLBTk6OfstAuth : 77|13@0- (0.003906,0) [-15.999|15.9951] "m" EOCM,EOCM_HCP2,EOCM_HC_Superset,HDLM
 SG_ FCODPB6P_FVLBTk6PstnTypAuth : 80|4@0+ (1,0) [0|12] "" EOCM,EOCM_HCP2,EOCM_HC_Superset,HDLM
 SG_ FCODPB6P_FVLBTk6TypAuth : 90|3@0+ (1,0) [0|7] "" EOCM,EOCM_HCP2,EOCM_HC_Superset,HDLM
 SG_ FCODPB6P_FVLBTk6QltyAuth : 92|2@0+ (1,0) [0|3] "" EOCM,EOCM_HCP2,EOCM_HC_Superset,HDLM
 SG_ FCODPB6P_FVLBTk6VSLgDistAuth : 96|7@0+ (1,0) [0|127] "m" EOCM,EOCM_HCP2,EOCM_HC_Superset,HDLM
 SG_ FCODPB6P_FVLBTk6VRLgDistAuth : 103|7@0+ (1,0) [0|127] "m" EOCM,EOCM_HCP2,EOCM_HC_Superset,HDLM
 SG_ FCODPB6P_FVLBTk6WdthAuth : 105|6@0+ (0.01,0) [0|0.63] "m" EOCM,EOCM_HCP2,EOCM_HC_Superset,HDLM
 SG_ FCODPB6P_FVVOTk10CICOPotAuth : 113|6@0+ (2,0) [0|126] "%" EOCM,EOCM_HCP2,EOCM_HC_Superset,HDLM
 SG_ FCODPB6P_FVVOTk10BrkLgtStsAuth : 115|2@0+ (1,0) [0|3] "" EOCM,EOCM_HCP2,EOCM_HC_Superset,HDLM
 SG_ FCODPB6P_FVVOTk10DynPrpAuth : 121|3@0+ (1,0) [0|6] "" EOCM,EOCM_HCP2,EOCM_HC_Superset,HDLM
 SG_ FCODPB6P_FVVOTk10CnfdStsAuth : 123|2@0+ (1,0) [0|3] "" EOCM,EOCM_HCP2,EOCM_HC_Superset,HDLM
 SG_ FCODPB6P_FVVOTk10HdgAngAuth : 133|11@0- (0.002,0) [-2.048|2.046] "rad" EOCM,EOCM_HCP2,EOCM_HC_Superset,HDLM
 SG_ FCODPB6P_FVVOTk10DynPrpStsAuth : 134|1@0+ (1,0) [0|1] "" EOCM,EOCM_HCP2,EOCM_HC_Superset,HDLM
 SG_ FCODPB6P_FVVOTk10HdgAngCAuth : 138|13@0- (0.002,0) [-8.192|8.19] "rad" EOCM,EOCM_HCP2,EOCM_HC_Superset,HDLM
 SG_ FCODPB6P_FVVOTk10IDAuth : 157|6@0+ (1,0) [0|63] "" EOCM,EOCM_HCP2,EOCM_HC_Superset,HDLM
 SG_ FCODPB6P_FVVOTk10PoILAAuth : 162|9@0- (0.125,0) [-32|31.875] "m/s^2" EOCM,EOCM_HCP2,EOCM_HC_Superset,HDLM
 SG_ FCODPB6P_FVVOTk10MStsAuth : 164|2@0+ (1,0) [0|3] "" EOCM,EOCM_HCP2,EOCM_HC_Superset,HDLM
 SG_ FCODPB6P_FVVOTk10LnAsmtAuth : 167|3@0+ (1,0) [0|5] "" EOCM,EOCM_HCP2,EOCM_HC_Superset,HDLM
 SG_ FCODPB6P_FVVOTk10PoILgAAuth : 169|9@0- (0.125,0) [-32|31.875] "m/s^2" EOCM,EOCM_HCP2,EOCM_HC_Superset,HDLM
 SG_ FCODPB6P_FVVOTk10PoILgPsAuth : 176|11@0+ (0.125,0) [0|255.875] "m" EOCM,EOCM_HCP2,EOCM_HC_Superset,HDLM
 SG_ FCODPB6P_FVVOTk10PoILgPsCAuth : 197|15@0+ (0.01,0) [0|327.67] "m^2" EOCM,EOCM_HCP2,EOCM_HC_Superset,HDLM
 SG_ FCODPB6P_FVVOTk10PoILgVAuth : 214|11@0- (0.125,0) [-128|127.875] "m/s" EOCM,EOCM_HCP2,EOCM_HC_Superset,HDLM
 SG_ FCODPB6P_FVVOTk10PoILgVCAuth : 219|10@0+ (0.125,0) [0|127.875] "(m/s)^2" EOCM,EOCM_HCP2,EOCM_HC_Superset,HDLM
 SG_ FCODPB6P_FVVOTk10PoILPsAuth : 225|10@0- (0.125,0) [-64|63.875] "m" EOCM,EOCM_HCP2,EOCM_HC_Superset,HDLM
 SG_ FCODPB6P_FVVOTk10PoILPsCAuth : 247|14@0+ (0.01,0) [0|163.83] "m^2" EOCM,EOCM_HCP2,EOCM_HC_Superset,HDLM
 SG_ FCODPB6P_FVVOTk10PoILVAuth : 249|9@0- (0.125,0) [-32|31.875] "m/s" EOCM,EOCM_HCP2,EOCM_HC_Superset,HDLM
 SG_ FCODPB6P_FVVOTk10PoILVCAuth : 256|10@0+ (0.125,0) [0|127.875] "(m/s)^2" EOCM,EOCM_HCP2,EOCM_HC_Superset,HDLM
 SG_ FCODPB6P_FVVOTk10PoIWAuth : 278|7@0+ (0.125,0) [0|15.875] "m" EOCM,EOCM_HCP2,EOCM_HC_Superset,HDLM
 SG_ FCODPB6P_FVVOTk6BrkLgtStsAuth : 280|2@0+ (1,0) [0|3] "" EOCM,EOCM_HCP2,EOCM_HC_Superset,HDLM
 SG_ FCODPB6P_FVVOTk10TypCnfdAuth : 282|2@0+ (1,0) [0|3] "" EOCM,EOCM_HCP2,EOCM_HC_Superset,HDLM
 SG_ FCODPB6P_FVVOTk10TypAuth : 284|2@0+ (1,0) [0|3] "" EOCM,EOCM_HCP2,EOCM_HC_Superset,HDLM
 SG_ FCODPB6P_FVVOTk10TSLgtStsAuth : 287|3@0+ (1,0) [0|4] "" EOCM,EOCM_HCP2,EOCM_HC_Superset,HDLM
 SG_ FCODPB6P_FVVOTk6CnfdStsAuth : 288|2@0+ (1,0) [0|3] "" EOCM,EOCM_HCP2,EOCM_HC_Superset,HDLM
 SG_ FCODPB6P_FVVOTk6CICOPotAuth : 294|6@0+ (2,0) [0|126] "%" EOCM,EOCM_HCP2,EOCM_HC_Superset,HDLM
 SG_ FCODPB6P_FVVOTk6HdgAngAuth : 298|11@0- (0.002,0) [-2.048|2.046] "rad" EOCM,EOCM_HCP2,EOCM_HC_Superset,HDLM
 SG_ FCODPB6P_FVVOTk6DynPrpStsAuth : 299|1@0+ (1,0) [0|1] "" EOCM,EOCM_HCP2,EOCM_HC_Superset,HDLM
 SG_ FCODPB6P_FVVOTk6DynPrpAuth : 302|3@0+ (1,0) [0|6] "" EOCM,EOCM_HCP2,EOCM_HC_Superset,HDLM
 SG_ FCODPB6P_FVVOTk6HdgAngCAuth : 319|13@0- (0.002,0) [-8.192|8.19] "rad" EOCM,EOCM_HCP2,EOCM_HC_Superset,HDLM
 SG_ FCODPB6P_FVVOTk6IDAuth : 322|6@0+ (1,0) [0|63] "" EOCM,EOCM_HCP2,EOCM_HC_Superset,HDLM
 SG_ FCODPB6P_FVVOTk6MStsAuth : 329|2@0+ (1,0) [0|3] "" EOCM,EOCM_HCP2,EOCM_HC_Superset,HDLM
 SG_ FCODPB6P_FVVOTk6LnAsmtAuth : 332|3@0+ (1,0) [0|5] "" EOCM,EOCM_HCP2,EOCM_HC_Superset,HDLM
 SG_ FCODPB6P_FVVOTk6PoILAAuth : 343|9@0- (0.125,0) [-32|31.875] "m/s^2" EOCM,EOCM_HCP2,EOCM_HC_Superset,HDLM
 SG_ FCODPB6P_FVVOTk6PoILgAAuth : 350|9@0- (0.125,0) [-32|31.875] "m/s^2" EOCM,EOCM_HCP2,EOCM_HC_Superset,HDLM
 SG_ FCODPB6P_FVVOTk6PoILgPsAuth : 357|11@0+ (0.125,0) [0|255.875] "m" EOCM,EOCM_HCP2,EOCM_HC_Superset,HDLM
 SG_ FCODPB6P_FVVOTk6PoILgPsCAuth : 362|15@0+ (0.01,0) [0|327.67] "m^2" EOCM,EOCM_HCP2,EOCM_HC_Superset,HDLM
 SG_ FCODPB6P_FVVOTk6PoILgVAuth : 379|11@0- (0.125,0) [-128|127.875] "m/s" EOCM,EOCM_HCP2,EOCM_HC_Superset,HDLM
 SG_ FCODPB6P_FVVOTk6PoILgVCAuth : 384|10@0+ (0.125,0) [0|127.875] "(m/s)^2" EOCM,EOCM_HCP2,EOCM_HC_Superset,HDLM
 SG_ FCODPB6P_FVVOTk6PoILPsAuth : 406|10@0- (0.125,0) [-64|63.875] "m" EOCM,EOCM_HCP2,EOCM_HC_Superset,HDLM
 SG_ FCODPB6P_FVVOTk6PoILPsCAuth : 412|14@0+ (0.01,0) [0|163.83] "m^2" EOCM,EOCM_HCP2,EOCM_HC_Superset,HDLM
 SG_ FCODPB6P_FVVOTk6PoILVAuth : 430|9@0- (0.125,0) [-32|31.875] "m/s" EOCM,EOCM_HCP2,EOCM_HC_Superset,HDLM
 SG_ FCODPB6P_FVVOTk6PoILVCAuth : 437|10@0+ (0.125,0) [0|127.875] "(m/s)^2" EOCM,EOCM_HCP2,EOCM_HC_Superset,HDLM
 SG_ FCODPB6P_FVVOTk6PoIWAuth : 443|7@0+ (0.125,0) [0|15.875] "m" EOCM,EOCM_HCP2,EOCM_HC_Superset,HDLM
 SG_ FCODPB6P_FVVOTk6TypAuth : 449|2@0+ (1,0) [0|3] "" EOCM,EOCM_HCP2,EOCM_HC_Superset,HDLM
 SG_ FCODPB6P_FVVOTk6TSLgtStsAuth : 452|3@0+ (1,0) [0|4] "" EOCM,EOCM_HCP2,EOCM_HC_Superset,HDLM
 SG_ FCODPB6P_Filler : 457|28@0+ (1,0) [0|2.68435e+008] "" EOCM,EOCM_HCP2,EOCM_HC_Superset,HDLM
 SG_ FrwdVsnVehObjTk6DatIntegCkd : 459|2@0+ (1,0) [0|2] "" EOCM,EOCM_HCP2,EOCM_HC_Superset,HDLM
 SG_ FrwdVsnLnBdryTk6DatIntegCkd : 461|2@0+ (1,0) [0|2] "" EOCM,EOCM_HCP2,EOCM_HC_Superset,HDLM
 SG_ FCODPB6P_FVVOTk6TypCnfdAuth : 463|2@0+ (1,0) [0|3] "" EOCM,EOCM_HCP2,EOCM_HC_Superset,HDLM
 SG_ FCODPB6P_FillerExtnd : 493|22@0+ (1,0) [0|4.1943e+006] "" EOCM,EOCM_HCP2,EOCM_HC_Superset,HDLM

BO_ 236 FCODP_BrstGrp_Prtctd_Consecuti09: 64 ACP2_MCU
 SG_ FCODPB7P_FVLBTk7CrvAuth : 3|16@0- (9.77e-07,0) [-0.0320143|0.0320134] "1/m" EOCM,EOCM_HCP2,EOCM_HC_Superset,HDLM
 SG_ FCODPB7P_FVLBTk7ClrAuth : 5|2@0+ (1,0) [0|3] "" EOCM,EOCM_HCP2,EOCM_HC_Superset,HDLM
 SG_ FCODPB7P_BrstID : 7|2@0+ (1,0) [0|3] "" EOCM,EOCM_HCP2,EOCM_HC_Superset,HDLM
 SG_ FCODPB7P_FVLBTk7CrvDrvtAuth : 19|16@0- (3.73e-09,0) [-0.000122225|0.000122221] "1/m^2" EOCM,EOCM_HCP2,EOCM_HC_Superset,HDLM
 SG_ FCODPB7P_FVLBTk7FPSABCQOvrAuth : 35|7@0+ (1,0) [0|127] "%" EOCM,EOCM_HCP2,EOCM_HC_Superset,HDLM
 SG_ FCODPB7P_FVLBTk7FPSAQAuth : 44|7@0+ (1,0) [0|127] "%" EOCM,EOCM_HCP2,EOCM_HC_Superset,HDLM
 SG_ FCODPB7P_FVLBTk7FPSBQAuth : 53|7@0+ (1,0) [0|127] "%" EOCM,EOCM_HCP2,EOCM_HC_Superset,HDLM
 SG_ FCODPB7P_FVLBTk7FPSCQAuth : 62|7@0+ (1,0) [0|127] "%" EOCM,EOCM_HCP2,EOCM_HC_Superset,HDLM
 SG_ FCODPB7P_FVLBTk7HdgAuth : 71|10@0- (0.000977,0) [-0.500224|0.499247] "" EOCM,EOCM_HCP2,EOCM_HC_Superset,HDLM
 SG_ FCODPB7P_FVLBTk7OfstAuth : 77|13@0- (0.003906,0) [-15.999|15.9951] "m" EOCM,EOCM_HCP2,EOCM_HC_Superset,HDLM
 SG_ FCODPB7P_FVLBTk7PstnTypAuth : 80|4@0+ (1,0) [0|12] "" EOCM,EOCM_HCP2,EOCM_HC_Superset,HDLM
 SG_ FCODPB7P_FVLBTk7TypAuth : 90|3@0+ (1,0) [0|7] "" EOCM,EOCM_HCP2,EOCM_HC_Superset,HDLM
 SG_ FCODPB7P_FVLBTk7QltyAuth : 92|2@0+ (1,0) [0|3] "" EOCM,EOCM_HCP2,EOCM_HC_Superset,HDLM
 SG_ FCODPB7P_FVLBTk7VSLgDistAuth : 96|7@0+ (1,0) [0|127] "m" EOCM,EOCM_HCP2,EOCM_HC_Superset,HDLM
 SG_ FCODPB7P_FVLBTk7VRLgDistAuth : 103|7@0+ (1,0) [0|127] "m" EOCM,EOCM_HCP2,EOCM_HC_Superset,HDLM
 SG_ FCODPB7P_FVLBTk7WdthAuth : 105|6@0+ (0.01,0) [0|0.63] "m" EOCM,EOCM_HCP2,EOCM_HC_Superset,HDLM
 SG_ FCODPB7P_FVLBTk9CrvAuth : 113|16@0- (9.77e-07,0) [-0.0320143|0.0320134] "1/m" EOCM,EOCM_HCP2,EOCM_HC_Superset,HDLM
 SG_ FCODPB7P_FVLBTk9ClrAuth : 115|2@0+ (1,0) [0|3] "" EOCM,EOCM_HCP2,EOCM_HC_Superset,HDLM
 SG_ FCODPB7P_FVLBTk9CrvDrvtAuth : 129|16@0- (3.73e-09,0) [-0.000122225|0.000122221] "1/m^2" EOCM,EOCM_HCP2,EOCM_HC_Superset,HDLM
 SG_ FCODPB7P_FVLBTk9FPSABCQOvrAuth : 145|7@0+ (1,0) [0|127] "%" EOCM,EOCM_HCP2,EOCM_HC_Superset,HDLM
 SG_ FCODPB7P_FVLBTk9FPSAQAuth : 154|7@0+ (1,0) [0|127] "%" EOCM,EOCM_HCP2,EOCM_HC_Superset,HDLM
 SG_ FCODPB7P_FVLBTk9FPSBQAuth : 163|7@0+ (1,0) [0|127] "%" EOCM,EOCM_HCP2,EOCM_HC_Superset,HDLM
 SG_ FCODPB7P_FVLBTk9FPSCQAuth : 172|7@0+ (1,0) [0|127] "%" EOCM,EOCM_HCP2,EOCM_HC_Superset,HDLM
 SG_ FCODPB7P_FVLBTk9HdgAuth : 181|10@0- (0.000977,0) [-0.500224|0.499247] "" EOCM,EOCM_HCP2,EOCM_HC_Superset,HDLM
 SG_ FCODPB7P_FVLBTk9OfstAuth : 187|13@0- (0.003906,0) [-15.999|15.9951] "m" EOCM,EOCM_HCP2,EOCM_HC_Superset,HDLM
 SG_ FCODPB7P_FVLBTk9TypAuth : 200|3@0+ (1,0) [0|7] "" EOCM,EOCM_HCP2,EOCM_HC_Superset,HDLM
 SG_ FCODPB7P_FVLBTk9QltyAuth : 202|2@0+ (1,0) [0|3] "" EOCM,EOCM_HCP2,EOCM_HC_Superset,HDLM
 SG_ FCODPB7P_FVLBTk9PstnTypAuth : 206|4@0+ (1,0) [0|12] "" EOCM,EOCM_HCP2,EOCM_HC_Superset,HDLM
 SG_ FCODPB7P_FVLBTk9VRLgDistAuth : 213|7@0+ (1,0) [0|127] "m" EOCM,EOCM_HCP2,EOCM_HC_Superset,HDLM
 SG_ FCODPB7P_FVLBTk9VSLgDistAuth : 222|7@0+ (1,0) [0|127] "m" EOCM,EOCM_HCP2,EOCM_HC_Superset,HDLM
 SG_ FCODPB7P_FVVOTk7BrkLgtStsAuth : 225|2@0+ (1,0) [0|3] "" EOCM,EOCM_HCP2,EOCM_HC_Superset,HDLM
 SG_ FCODPB7P_FVLBTk9WdthAuth : 231|6@0+ (0.01,0) [0|0.63] "m" EOCM,EOCM_HCP2,EOCM_HC_Superset,HDLM
 SG_ FCODPB7P_FVVOTk7CnfdStsAuth : 233|2@0+ (1,0) [0|3] "" EOCM,EOCM_HCP2,EOCM_HC_Superset,HDLM
 SG_ FCODPB7P_FVVOTk7CICOPotAuth : 239|6@0+ (2,0) [0|126] "%" EOCM,EOCM_HCP2,EOCM_HC_Superset,HDLM
 SG_ FCODPB7P_FVVOTk7HdgAngAuth : 243|11@0- (0.002,0) [-2.048|2.046] "rad" EOCM,EOCM_HCP2,EOCM_HC_Superset,HDLM
 SG_ FCODPB7P_FVVOTk7DynPrpStsAuth : 244|1@0+ (1,0) [0|1] "" EOCM,EOCM_HCP2,EOCM_HC_Superset,HDLM
 SG_ FCODPB7P_FVVOTk7DynPrpAuth : 247|3@0+ (1,0) [0|6] "" EOCM,EOCM_HCP2,EOCM_HC_Superset,HDLM
 SG_ FCODPB7P_FVVOTk7HdgAngCAuth : 248|13@0- (0.002,0) [-8.192|8.19] "rad" EOCM,EOCM_HCP2,EOCM_HC_Superset,HDLM
 SG_ FCODPB7P_FVVOTk7IDAuth : 267|6@0+ (1,0) [0|63] "" EOCM,EOCM_HCP2,EOCM_HC_Superset,HDLM
 SG_ FCODPB7P_FVVOTk7PoILAAuth : 272|9@0- (0.125,0) [-32|31.875] "m/s^2" EOCM,EOCM_HCP2,EOCM_HC_Superset,HDLM
 SG_ FCODPB7P_FVVOTk7MStsAuth : 274|2@0+ (1,0) [0|3] "" EOCM,EOCM_HCP2,EOCM_HC_Superset,HDLM
 SG_ FCODPB7P_FVVOTk7LnAsmtAuth : 277|3@0+ (1,0) [0|5] "" EOCM,EOCM_HCP2,EOCM_HC_Superset,HDLM
 SG_ FCODPB7P_FVVOTk7PoILgAAuth : 295|9@0- (0.125,0) [-32|31.875] "m/s^2" EOCM,EOCM_HCP2,EOCM_HC_Superset,HDLM
 SG_ FCODPB7P_FVVOTk7PoILgPsAuth : 302|11@0+ (0.125,0) [0|255.875] "m" EOCM,EOCM_HCP2,EOCM_HC_Superset,HDLM
 SG_ FCODPB7P_FVVOTk7PoILgPsCAuth : 307|15@0+ (0.01,0) [0|327.67] "m^2" EOCM,EOCM_HCP2,EOCM_HC_Superset,HDLM
 SG_ FCODPB7P_FVVOTk7PoILgVAuth : 324|11@0- (0.125,0) [-128|127.875] "m/s" EOCM,EOCM_HCP2,EOCM_HC_Superset,HDLM
 SG_ FCODPB7P_FVVOTk7PoILgVCAuth : 329|10@0+ (0.125,0) [0|127.875] "(m/s)^2" EOCM,EOCM_HCP2,EOCM_HC_Superset,HDLM
 SG_ FCODPB7P_FVVOTk7PoILPsAuth : 351|10@0- (0.125,0) [-64|63.875] "m" EOCM,EOCM_HCP2,EOCM_HC_Superset,HDLM
 SG_ FCODPB7P_FVVOTk7PoILPsCAuth : 357|14@0+ (0.01,0) [0|163.83] "m^2" EOCM,EOCM_HCP2,EOCM_HC_Superset,HDLM
 SG_ FCODPB7P_FVVOTk7PoILVAuth : 375|9@0- (0.125,0) [-32|31.875] "m/s" EOCM,EOCM_HCP2,EOCM_HC_Superset,HDLM
 SG_ FCODPB7P_FVVOTk7PoILVCAuth : 382|10@0+ (0.125,0) [0|127.875] "(m/s)^2" EOCM,EOCM_HCP2,EOCM_HC_Superset,HDLM
 SG_ FCODPB7P_FVVOTk7PoIWAuth : 388|7@0+ (0.125,0) [0|15.875] "m" EOCM,EOCM_HCP2,EOCM_HC_Superset,HDLM
 SG_ FCODPB7P_FVVOTk7TypCnfdAuth : 392|2@0+ (1,0) [0|3] "" EOCM,EOCM_HCP2,EOCM_HC_Superset,HDLM
 SG_ FCODPB7P_FVVOTk7TypAuth : 394|2@0+ (1,0) [0|3] "" EOCM,EOCM_HCP2,EOCM_HC_Superset,HDLM
 SG_ FCODPB7P_FVVOTk7TSLgtStsAuth : 397|3@0+ (1,0) [0|4] "" EOCM,EOCM_HCP2,EOCM_HC_Superset,HDLM
 SG_ FCODPB7P_Filler : 402|28@0+ (1,0) [0|2.68435e+008] "" EOCM,EOCM_HCP2,EOCM_HC_Superset,HDLM
 SG_ FrwdVsnVehObjTk7DatIntegCkd : 404|2@0+ (1,0) [0|2] "" EOCM,EOCM_HCP2,EOCM_HC_Superset,HDLM
 SG_ FrwdVsnLnBdryTk7DatIntegCkd : 406|2@0+ (1,0) [0|2] "" EOCM,EOCM_HCP2,EOCM_HC_Superset,HDLM
 SG_ FCODPB7P_FillerExtnd : 438|32@0+ (1,0) [0|4.29497e+009] "" EOCM,EOCM_HCP2,EOCM_HC_Superset,HDLM
 SG_ FCODPB7P_FillerExtnd1 : 470|32@0+ (1,0) [0|4.29497e+009] "0" EOCM,EOCM_HCP2,EOCM_HC_Superset,HDLM
 SG_ FCODPB7P_FillerExtnd2 : 502|15@0+ (1,0) [0|32767] "" EOCM,EOCM_HCP2,EOCM_HC_Superset,HDLM

BA_DEF_ SG_  "SignalType" STRING ;
BA_DEF_ SG_  "SignalLongName" STRING ;
BA_DEF_ BO_  "GenMsgCycleTime" INT 0 10000;
BA_DEF_ BO_  "GenMsgSendType" ENUM "cyclicX","spontanX","cyclicIfActiveX","spontanWithDelay","cyclicAndSpontanX","cyclicAndSpontanWithDelay","spontanWithRepetition","cyclicIfActiveAndSpontanWD";
BA_DEF_ BO_  "VFrameFormat" ENUM  "StandardCAN","ExtendedCAN","reserved","reserved","reserved","reserved","reserved","reserved","reserved","reserved","reserved","reserved","reserved","reserved","StandardCAN_FD","ExtendedCAN_FD";
BA_DEF_DEF_  "SignalType" "";
BA_DEF_DEF_  "SignalLongName" "";
BA_DEF_DEF_  "GenMsgCycleTime" 0;
BA_DEF_DEF_  "GenMsgSendType" "cyclicX";
BA_DEF_DEF_  "VFrameFormat" "StandardCAN";
BA_ "VFrameFormat" BO_ 222 14;
BA_ "VFrameFormat" BO_ 234 14;
BA_ "VFrameFormat" BO_ 221 14;
BA_ "VFrameFormat" BO_ 235 14;
BA_ "VFrameFormat" BO_ 220 14;
BA_ "VFrameFormat" BO_ 236 14;
BA_ "SignalLongName" SG_ 222 FCODPB2P_AutofxHrznAuth "Front Camera Object Detection and Processing Burst 2 Protected : Autofix Horizon Authenticated";
BA_ "SignalLongName" SG_ 222 FCODPB2P_AutofxCnvrgncyCntAuth "Front Camera Object Detection and Processing Burst 2 Protected : Autofix Convergency Counter Authenticated";
BA_ "SignalLongName" SG_ 222 FCODPB2P_BrstID "Front Camera Object Detection and Processing Burst 2 Protected : Burst ID";
BA_ "SignalLongName" SG_ 222 FCODPB2P_AutofxYwAuth "Front Camera Object Detection and Processing Burst 2 Protected : Autofix Yaw Authenticated";
BA_ "SignalType" SG_ 222 FCODPB2P_AutofxOutOfCalAuth "ENM";
BA_ "SignalLongName" SG_ 222 FCODPB2P_AutofxOutOfCalAuth "Front Camera Object Detection and Processing Burst 2 Protected : Autofix Out of Calibration Authenticated";
BA_ "SignalType" SG_ 222 FCODPB2P_FrwdCamSysOprtgStsAuth "ENM";
BA_ "SignalLongName" SG_ 222 FCODPB2P_FrwdCamSysOprtgStsAuth "Front Camera Object Detection and Processing Burst 2 Protected : Forward Camera System Operating Status Authenticated";
BA_ "SignalType" SG_ 222 FCODPB2P_EnvIllumAuth "ENM";
BA_ "SignalLongName" SG_ 222 FCODPB2P_EnvIllumAuth "Front Camera Object Detection and Processing Burst 2 Protected : Environment Illumination Authenticated";
BA_ "SignalType" SG_ 222 FCODPB2P_FVFaildAuth "ENM";
BA_ "SignalLongName" SG_ 222 FCODPB2P_FVFaildAuth "Front Camera Object Detection and Processing Burst 2 Protected : Forward Vision Failed Authenticated";
BA_ "SignalType" SG_ 222 FCODPB2P_FVBlkgStsAuth "ENM";
BA_ "SignalLongName" SG_ 222 FCODPB2P_FVBlkgStsAuth "Front Camera Object Detection and Processing Burst 2 Protected : Forward Vision Blockage Status Authenticated";
BA_ "SignalType" SG_ 222 FCODPB2P_FVAdvWthrStsAuth "ENM";
BA_ "SignalLongName" SG_ 222 FCODPB2P_FVAdvWthrStsAuth "Front Camera Object Detection and Processing Burst 2 Protected : Forward Vision Adverse Weather Status Authenticated";
BA_ "SignalLongName" SG_ 222 FCODPB2P_FVLBDtnAqTmStmAuth "Front Camera Object Detection and Processing Burst 2 Protected : Forward Vision Lane Boundary Detection Acquisition Time Stamp Authenticated";
BA_ "SignalType" SG_ 222 FCODPB2P_FVFailDtnStsAuth "ENM";
BA_ "SignalLongName" SG_ 222 FCODPB2P_FVFailDtnStsAuth "Front Camera Object Detection and Processing Burst 2 Protected : Forward Vision Failure Detection Status Authenticated";
BA_ "SignalType" SG_ 222 FCODPB2P_FVLBTk2ClrAuth "ENM";
BA_ "SignalLongName" SG_ 222 FCODPB2P_FVLBTk2ClrAuth "Front Camera Object Detection and Processing Burst 2 Protected : Forward Vision Lane Boundary Track 2 Color Authenticated";
BA_ "SignalType" SG_ 222 FCODPB2P_FVLBDtnAqTmStmAuth_Inv "ENM";
BA_ "SignalLongName" SG_ 222 FCODPB2P_FVLBDtnAqTmStmAuth_Inv "Front Camera Object Detection and Processing Burst 2 Protected : Forward Vision Lane Boundary Detection Acquisition Time Stamp Authenticated Invalid";
BA_ "SignalLongName" SG_ 222 FCODPB2P_FVLBTk2CrvAuth "Front Camera Object Detection and Processing Burst 2 Protected : Forward Vision Lane Boundary Track 2 Curvature Authenticated";
BA_ "SignalLongName" SG_ 222 FCODPB2P_FVLBTk2CrvDrvtAuth "Front Camera Object Detection and Processing Burst 2 Protected : Forward Vision Lane Boundary Track 2 Curvature Derivative Authenticated";
BA_ "SignalLongName" SG_ 222 FCODPB2P_FVLBTk2FPSABCQOvrAuth "Front Camera Object Detection and Processing Burst 2 Protected : Forward Vision Lane Boundary Track 2 First Polynomial Segment ABC Quality Overall Authenticated";
BA_ "SignalLongName" SG_ 222 FCODPB2P_FVLBTk2FPSBQAuth "Front Camera Object Detection and Processing Burst 2 Protected : Forward Vision Lane Boundary Track 2 First Polynomial Segment B Quality Authenticated";
BA_ "SignalLongName" SG_ 222 FCODPB2P_FVLBTk2FPSAQAuth "Front Camera Object Detection and Processing Burst 2 Protected : Forward Vision Lane Boundary Track 2 First Polynomial Segment A Quality Authenticated";
BA_ "SignalLongName" SG_ 222 FCODPB2P_FVLBTk2FPSCQAuth "Front Camera Object Detection and Processing Burst 2 Protected : Forward Vision Lane Boundary Track 2 First Polynomial Segment C Quality Authenticated";
BA_ "SignalLongName" SG_ 222 FCODPB2P_FVLBTk2HdgAuth "Front Camera Object Detection and Processing Burst 2 Protected : Forward Vision Lane Boundary Track 2 Heading Authenticated";
BA_ "SignalLongName" SG_ 222 FCODPB2P_FVLBTk2OfstAuth "Front Camera Object Detection and Processing Burst 2 Protected : Forward Vision Lane Boundary Track 2 Offset Authenticated";
BA_ "SignalType" SG_ 222 FCODPB2P_FVLBTk2PstnTypAuth "ENM";
BA_ "SignalLongName" SG_ 222 FCODPB2P_FVLBTk2PstnTypAuth "Front Camera Object Detection and Processing Burst 2 Protected : Forward Vision Lane Boundary Track 2 Position Type Authenticated";
BA_ "SignalLongName" SG_ 222 FCODPB2P_FVLBTk2VRLgDistAuth "Front Camera Object Detection and Processing Burst 2 Protected : Forward Vision Lane Boundary Track 2 View Range Longitudinal Distance Authenticated";
BA_ "SignalType" SG_ 222 FCODPB2P_FVLBTk2TypAuth "ENM";
BA_ "SignalLongName" SG_ 222 FCODPB2P_FVLBTk2TypAuth "Front Camera Object Detection and Processing Burst 2 Protected : Forward Vision Lane Boundary Track 2 Type Authenticated";
BA_ "SignalType" SG_ 222 FCODPB2P_FVLBTk2QltyAuth "ENM";
BA_ "SignalLongName" SG_ 222 FCODPB2P_FVLBTk2QltyAuth "Front Camera Object Detection and Processing Burst 2 Protected : Forward Vision Lane Boundary Track 2 Quality Authenticated";
BA_ "SignalLongName" SG_ 222 FCODPB2P_FVLBTk2VSLgDistAuth "Front Camera Object Detection and Processing Burst 2 Protected : Forward Vision Lane Boundary Track 2 View Start Longitudinal Distance Authenticated";
BA_ "SignalLongName" SG_ 222 FCODPB2P_FVLBTk2WdthAuth "Front Camera Object Detection and Processing Burst 2 Protected : Forward Vision Lane Boundary Track 2 Width Authenticated";
BA_ "SignalLongName" SG_ 222 FCODPB2P_FVLLLVRlvtoMrkngAuth "Front Camera Object Detection and Processing Burst 2 Protected : Forward Vision Left Lane Lateral Velocity Relative to Marking Authenticated";
BA_ "SignalLongName" SG_ 222 FCODPB2P_FVLLBndryCrsTmAuth "Front Camera Object Detection and Processing Burst 2 Protected : Forward Vision Left Lane Boundary Cross Time Authenticated";
BA_ "SignalLongName" SG_ 222 FCODPB2P_FVLnDtnOvrallQtyAuth "Front Camera Object Detection and Processing Burst 2 Protected : Forward Vision Lane Boundary Detection Overall Quality Authenticated";
BA_ "SignalType" SG_ 222 FCODPB2P_FVLnChngIndAuth "ENM";
BA_ "SignalLongName" SG_ 222 FCODPB2P_FVLnChngIndAuth "Front Camera Object Detection and Processing Burst 2 Protected : Forward Vision Lane Change Indication Authenticated";
BA_ "SignalType" SG_ 222 FCODPB2P_FVLtdAccssRdTypAuth "ENM";
BA_ "SignalLongName" SG_ 222 FCODPB2P_FVLtdAccssRdTypAuth "Front Camera Object Detection and Processing Burst 2 Protected : Front Vision Limited Access Road Type Authenticated";
BA_ "SignalLongName" SG_ 222 FCODPB2P_FVPOTk2IDAuth "Front Camera Object Detection and Processing Burst 2 Protected : Forward Vision Pedestrian Object Track 2 ID Authenticated";
BA_ "SignalType" SG_ 222 FCODPB2P_FVPOTk2DynPrpAuth "ENM";
BA_ "SignalLongName" SG_ 222 FCODPB2P_FVPOTk2DynPrpAuth "Front Camera Object Detection and Processing Burst 2 Protected : Forward Vision Pedestrian Object Track 2 Dynamic Property Authenticated";
BA_ "SignalType" SG_ 222 FCODPB2P_FVPOTk2CnfdStsAuth "ENM";
BA_ "SignalLongName" SG_ 222 FCODPB2P_FVPOTk2CnfdStsAuth "Front Camera Object Detection and Processing Burst 2 Protected : Forward Vision Pedestrian Object Track 2 Confidence Status Authenticated";
BA_ "SignalLongName" SG_ 222 FCODPB2P_FVPOTk2InPthPotAuth "Front Camera Object Detection and Processing Burst 2 Protected : Forward Vision Pedestrian Object Track 2 In Path Potential Authenticated";
BA_ "SignalLongName" SG_ 222 FCODPB2P_FVPOTk2PoILAAuth "Front Camera Object Detection and Processing Burst 2 Protected : Forward Vision Pedestrian Object Track 2 Point of Interest Lateral Acceleration Authenticated";
BA_ "SignalType" SG_ 222 FCODPB2P_FVPOTk2MStsAuth "ENM";
BA_ "SignalLongName" SG_ 222 FCODPB2P_FVPOTk2MStsAuth "Front Camera Object Detection and Processing Burst 2 Protected : Forward Vision Pedestrian Object Track 2 Measurement Status Authenticated";
BA_ "SignalLongName" SG_ 222 FCODPB2P_FVPOTk2PoILgAAuth "Front Camera Object Detection and Processing Burst 2 Protected : Forward Vision Pedestrian Object Track 2 Point of Interest Longitudinal Acceleration Authenticated";
BA_ "SignalLongName" SG_ 222 FCODPB2P_FVPOTk2PoILgPsAuth "Front Camera Object Detection and Processing Burst 2 Protected : Forward Vision Pedestrian Object Track 2 Point of Interest Longitudinal Position Authenticated";
BA_ "SignalLongName" SG_ 222 FCODPB2P_FVPOTk2PoILgVAuth "Front Camera Object Detection and Processing Burst 2 Protected : Forward Vision Pedestrian Object Track 2 Point of Interest Longitudinal Velocity Authenticated";
BA_ "SignalLongName" SG_ 222 FCODPB2P_FVPOTk2PoILPsAuth "Front Camera Object Detection and Processing Burst 2 Protected : Forward Vision Pedestrian Object Track 2 Point of Interest Lateral Position Authenticated";
BA_ "SignalLongName" SG_ 222 FCODPB2P_FVPOTk2PoILVAuth "Front Camera Object Detection and Processing Burst 2 Protected : Forward Vision Pedestrian Object Track 2 Point of Interest Lateral Velocity Authenticated";
BA_ "SignalType" SG_ 222 FCODPB2P_FVPOTk2TypCnfdAuth "ENM";
BA_ "SignalLongName" SG_ 222 FCODPB2P_FVPOTk2TypCnfdAuth "Front Camera Object Detection and Processing Burst 2 Protected : Forward Vision Pedestrian Object Track 2 Type Confidence Authenticated";
BA_ "SignalType" SG_ 222 FCODPB2P_FVPOTk2TypAuth "ENM";
BA_ "SignalLongName" SG_ 222 FCODPB2P_FVPOTk2TypAuth "Front Camera Object Detection and Processing Burst 2 Protected : Forward Vision Pedestrian Object Track 2 Type Authenticated";
BA_ "SignalLongName" SG_ 222 FCODPB2P_FVRLLVRlvtoMrkngAuth "Front Camera Object Detection and Processing Burst 2 Protected : Forward Vision Right Lane Lateral Velocity Relative to Marking Authenticated";
BA_ "SignalLongName" SG_ 222 FCODPB2P_FVRLBndryCrsTmAuth "Front Camera Object Detection and Processing Burst 2 Protected : Forward Vision Right Lane Boundary Cross Time Authenticated";
BA_ "SignalType" SG_ 222 FCODPB2P_FVServAlgnRtnStsAuth "ENM";
BA_ "SignalLongName" SG_ 222 FCODPB2P_FVServAlgnRtnStsAuth "Front Camera Object Detection and Processing Burst 2 Protected : Forward Vision Service Alignment Routine Status Authenticated";
BA_ "SignalType" SG_ 222 FCODPB2P_FVServAlgnInPrcAuth "ENM";
BA_ "SignalLongName" SG_ 222 FCODPB2P_FVServAlgnInPrcAuth "Front Camera Object Detection and Processing Burst 2 Protected : Forward Vision Service Alignment In Process Authenticated";
BA_ "SignalLongName" SG_ 222 FCODPB2P_FVSysSplyVltAuth "Front Camera Object Detection and Processing Burst 2 Protected : Forward Vision System Supply Voltage Authenticated";
BA_ "SignalType" SG_ 222 FCODPB2P_FVSysCalStsAuth "ENM";
BA_ "SignalLongName" SG_ 222 FCODPB2P_FVSysCalStsAuth "Front Camera Object Detection and Processing Burst 2 Protected : Forward Vision System Calibration Status Authenticated";
BA_ "SignalType" SG_ 222 FCODPB2P_FVServRqAuth "ENM";
BA_ "SignalLongName" SG_ 222 FCODPB2P_FVServRqAuth "Front Camera Object Detection and Processing Burst 2 Protected : Forward Vision Service Required Authenticated";
BA_ "SignalType" SG_ 222 FCODPB2P_FVVOTk2BrkLgtStsAuth "ENM";
BA_ "SignalLongName" SG_ 222 FCODPB2P_FVVOTk2BrkLgtStsAuth "Front Camera Object Detection and Processing Burst 2 Protected : Forward Vision Vehicle Object Track 2 Brake Light Status Authenticated";
BA_ "SignalType" SG_ 222 FCODPB2P_FVUnvAuth "ENM";
BA_ "SignalLongName" SG_ 222 FCODPB2P_FVUnvAuth "Front Camera Object Detection and Processing Burst 2 Protected : Forward Vision Unavailable Authenticated";
BA_ "SignalType" SG_ 222 FCODPB2P_FVVOTk2CnfdStsAuth "ENM";
BA_ "SignalLongName" SG_ 222 FCODPB2P_FVVOTk2CnfdStsAuth "Front Camera Object Detection and Processing Burst 2 Protected : Forward Vision Vehicle Object Track 2 Confidence Status Authenticated";
BA_ "SignalLongName" SG_ 222 FCODPB2P_FVVOTk2CICOPotAuth "Front Camera Object Detection and Processing Burst 2 Protected : Forward Vision Vehicle Object Track 2 Cut In Cut Out Potential Authenticated";
BA_ "SignalLongName" SG_ 222 FCODPB2P_FVVOTk2HdgAngAuth "Front Camera Object Detection and Processing Burst 2 Protected : Forward Vision Vehicle Object Track 2 Heading Angle Authenticated";
BA_ "SignalType" SG_ 222 FCODPB2P_FVVOTk2DynPrpStsAuth "ENM";
BA_ "SignalLongName" SG_ 222 FCODPB2P_FVVOTk2DynPrpStsAuth "Front Camera Object Detection and Processing Burst 2 Protected : Forward Vision Vehicle Object Track 2 Dynamic Property Status Authenticated";
BA_ "SignalType" SG_ 222 FCODPB2P_FVVOTk2DynPrpAuth "ENM";
BA_ "SignalLongName" SG_ 222 FCODPB2P_FVVOTk2DynPrpAuth "Front Camera Object Detection and Processing Burst 2 Protected : Forward Vision Vehicle Object Track 2 Dynamic Property Authenticated";
BA_ "SignalLongName" SG_ 222 FCODPB2P_FVVOTk2HdgAngCAuth "Front Camera Object Detection and Processing Burst 2 Protected : Forward Vision Vehicle Object Track 2 Heading Angle Covariance Authenticated";
BA_ "SignalLongName" SG_ 222 FCODPB2P_FVVOTk2IDAuth "Front Camera Object Detection and Processing Burst 2 Protected : Forward Vision Vehicle Object Track 2 ID Authenticated";
BA_ "SignalType" SG_ 222 FCODPB2P_FVVOTk2MStsAuth "ENM";
BA_ "SignalLongName" SG_ 222 FCODPB2P_FVVOTk2MStsAuth "Front Camera Object Detection and Processing Burst 2 Protected : Forward Vision Vehicle Object Track 2 Measurement Status Authenticated";
BA_ "SignalType" SG_ 222 FCODPB2P_FVVOTk2LnAsmtAuth "ENM";
BA_ "SignalLongName" SG_ 222 FCODPB2P_FVVOTk2LnAsmtAuth "Front Camera Object Detection and Processing Burst 2 Protected : Forward Vision Vehicle Object Track 2 Lane Assignment Authenticated";
BA_ "SignalLongName" SG_ 222 FCODPB2P_FVVOTk2PoILAAuth "Front Camera Object Detection and Processing Burst 2 Protected : Forward Vision Vehicle Object Track 2 Point of Interest Lateral Acceleration Authenticated";
BA_ "SignalLongName" SG_ 222 FCODPB2P_FVVOTk2PoILgAAuth "Front Camera Object Detection and Processing Burst 2 Protected : Forward Vision Vehicle Object Track 2 Point of Interest Longitudinal Acceleration Authenticated";
BA_ "SignalLongName" SG_ 222 FCODPB2P_FVVOTk2PoILgPsAuth "Front Camera Object Detection and Processing Burst 2 Protected : Forward Vision Vehicle Object Track 2 Point of Interest Longitudinal Position Authenticated";
BA_ "SignalLongName" SG_ 222 FCODPB2P_FVVOTk2PoILgPsCAuth "Front Camera Object Detection and Processing Burst 2 Protected : Forward Vision Vehicle Object Track 2 Point of Interest Longitudinal Position Covariance Authenticated";
BA_ "SignalLongName" SG_ 222 FCODPB2P_FVVOTk2PoILgVAuth "Front Camera Object Detection and Processing Burst 2 Protected : Forward Vision Vehicle Object Track 2 Point of Interest Longitudinal Velocity Authenticated";
BA_ "SignalLongName" SG_ 222 FCODPB2P_FVVOTk2PoILgVCAuth "Front Camera Object Detection and Processing Burst 2 Protected : Forward Vision Vehicle Object Track 2 Point of Interest Longitudinal Velocity Covariance Authenticated";
BA_ "SignalLongName" SG_ 222 FCODPB2P_FVVOTk2PoILPsAuth "Front Camera Object Detection and Processing Burst 2 Protected : Forward Vision Vehicle Object Track 2 Point of Interest Lateral Position Authenticated";
BA_ "SignalLongName" SG_ 222 FCODPB2P_FVVOTk2PoILPsCAuth "Front Camera Object Detection and Processing Burst 2 Protected : Forward Vision Vehicle Object Track 2 Point of Interest Lateral Position Covariance Authenticated";
BA_ "SignalLongName" SG_ 222 FCODPB2P_FVVOTk2PoILVAuth "Front Camera Object Detection and Processing Burst 2 Protected : Forward Vision Vehicle Object Track 2 Point of Interest Lateral Velocity Authenticated";
BA_ "SignalLongName" SG_ 222 FCODPB2P_FVVOTk2PoILVCAuth "Front Camera Object Detection and Processing Burst 2 Protected : Forward Vision Vehicle Object Track 2 Point of Interest Lateral Velocity Covariance Authenticated";
BA_ "SignalLongName" SG_ 222 FCODPB2P_FVVOTk2PoIWAuth "Front Camera Object Detection and Processing Burst 2 Protected : Forward Vision Vehicle Object Track 2 Point of Interest Width Authenticated";
BA_ "SignalType" SG_ 222 FCODPB2P_FVVOTk2TypAuth "ENM";
BA_ "SignalLongName" SG_ 222 FCODPB2P_FVVOTk2TypAuth "Front Camera Object Detection and Processing Burst 2 Protected : Forward Vision Vehicle Object Track 2 Type Authenticated";
BA_ "SignalType" SG_ 222 FCODPB2P_FVVOTk2TSLgtStsAuth "ENM";
BA_ "SignalLongName" SG_ 222 FCODPB2P_FVVOTk2TSLgtStsAuth "Front Camera Object Detection and Processing Burst 2 Protected : Forward Vision Vehicle Object Track 2 Turn Signal Light Status Authenticated";
BA_ "SignalType" SG_ 222 FCODPB2P_RdTypAuth "ENM";
BA_ "SignalLongName" SG_ 222 FCODPB2P_RdTypAuth "Front Camera Object Detection and Processing Burst 2 Protected : Road Type Authenticated";
BA_ "SignalLongName" SG_ 222 FCODPB2P_LtdAccssRdTypCnfdAuth "Front Camera Object Detection and Processing Burst 2 Protected : Front Vision Limited Access Road Confidence Authenticated";
BA_ "SignalType" SG_ 222 FCODPB2P_FVVOTk2TypCnfdAuth "ENM";
BA_ "SignalLongName" SG_ 222 FCODPB2P_FVVOTk2TypCnfdAuth "Front Camera Object Detection and Processing Burst 2 Protected : Forward Vision Vehicle Object Track 2 Type Confidence Authenticated";
BA_ "SignalLongName" SG_ 222 FVHiThrtICTrnAcrsPthObjTkID "Front Camera Object Detection and Processing Burst 2 Protected : Forward Vision Highest Threat Intersection Collision Turning Across Path Object Track ID";
BA_ "SignalLongName" SG_ 222 FVHiThrtICCrsgObjTkID "Front Camera Object Detection and Processing Burst 2 Protected : Forward Vision Highest Threat Intersection Collision Crossing Object Track ID";
BA_ "SignalType" SG_ 222 FVHiThrtICCrsgVehPrfllNw "ENM";
BA_ "SignalLongName" SG_ 222 FVHiThrtICCrsgVehPrfllNw "Front Camera Object Detection and Processing Burst 2 Protected : Forward Vision Highest Threat Intersection Collision Crossing Vehicle Prefill Now";
BA_ "SignalType" SG_ 222 FVHiThrtICCrsgVehBrkNw "ENM";
BA_ "SignalLongName" SG_ 222 FVHiThrtICCrsgVehBrkNw "Front Camera Object Detection and Processing Burst 2 Protected : Forward Vision Highest Threat Intersection Collision Crossing Vehicle Brake Now";
BA_ "SignalType" SG_ 222 FVHiThrtICCrsgVehAlrtNw "ENM";
BA_ "SignalLongName" SG_ 222 FVHiThrtICCrsgVehAlrtNw "Front Camera Object Detection and Processing Burst 2 Protected : Forward Vision Highest Threat Intersection Collision Crossing Vehicle Alert Now";
BA_ "SignalType" SG_ 222 FrwdVsnVehObjTk2DatIntegCkd "ENM";
BA_ "SignalLongName" SG_ 222 FrwdVsnVehObjTk2DatIntegCkd "Front Camera Object Detection and Processing Burst 2 Protected : Forward Vision Vehicle Object Track 2 Data Integrity Checked";
BA_ "SignalType" SG_ 222 FrwdVsnPedtrnObjTk2DatIntegCkd "ENM";
BA_ "SignalLongName" SG_ 222 FrwdVsnPedtrnObjTk2DatIntegCkd "Front Camera Object Detection and Processing Burst 2 Protected : Forward Vision Pedestrian Object Track 2 Data Integrity Checked";
BA_ "SignalType" SG_ 222 FrwdVsnLnBdryTk2DatIntegCkd "ENM";
BA_ "SignalLongName" SG_ 222 FrwdVsnLnBdryTk2DatIntegCkd "Front Camera Object Detection and Processing Burst 2 Protected : Forward Vision Lane Boundary Track 2 Data Integrity Checked";
BA_ "SignalType" SG_ 222 FVHiThrtICTrnAcrsPthVehPrfllNw "ENM";
BA_ "SignalLongName" SG_ 222 FVHiThrtICTrnAcrsPthVehPrfllNw "Front Camera Object Detection and Processing Burst 2 Protected : Forward Vision Highest Threat Intersection Collision Turning Across Path Vehicle Prefill Now";
BA_ "SignalType" SG_ 222 FVHiThrtICTrnAcrsPthVehBrkNw "ENM";
BA_ "SignalLongName" SG_ 222 FVHiThrtICTrnAcrsPthVehBrkNw "Front Camera Object Detection and Processing Burst 2 Protected : Forward Vision Highest Threat Intersection Collision Turning Across Path Vehicle Brake Now";
BA_ "SignalType" SG_ 222 FVHiThrtICTrnAcrsPthVehAlrtNw "ENM";
BA_ "SignalLongName" SG_ 222 FVHiThrtICTrnAcrsPthVehAlrtNw "Front Camera Object Detection and Processing Burst 2 Protected : Forward Vision Highest Threat Intersection Collision Turning Across Path Vehicle Alert Now";
BA_ "SignalLongName" SG_ 222 FCODPB2P_Filler "Front Camera Object Detection and Processing Burst 2 Protected : Filler";
BA_ "SignalLongName" SG_ 234 FCODPB3P_FlSfBlrdImgDtnRngAuth "Front Camera Object Detection and Processing Burst 3 Protected : Fail Safe Blurred Image Detection Range Authenticated";
BA_ "SignalType" SG_ 234 FCODPB3P_FlSfBlrdImgDtdAuth "ENM";
BA_ "SignalLongName" SG_ 234 FCODPB3P_FlSfBlrdImgDtdAuth "Front Camera Object Detection and Processing Burst 3 Protected : Fail Safe Blurred Image Detected Authenticated";
BA_ "SignalType" SG_ 234 FCODPB3P_ConstrArRtDtdAuth "ENM";
BA_ "SignalLongName" SG_ 234 FCODPB3P_ConstrArRtDtdAuth "Front Camera Object Detection and Processing Burst 3 Protected : Construction Area Right Detected Authenticated";
BA_ "SignalType" SG_ 234 FCODPB3P_ConstrArLtDtdAuth "ENM";
BA_ "SignalLongName" SG_ 234 FCODPB3P_ConstrArLtDtdAuth "Front Camera Object Detection and Processing Burst 3 Protected : Construction Area Left Detected Authenticated";
BA_ "SignalType" SG_ 234 FCODPB3P_AmbLnMrksRtAuth "ENM";
BA_ "SignalLongName" SG_ 234 FCODPB3P_AmbLnMrksRtAuth "Front Camera Object Detection and Processing Burst 3 Protected : Ambiguous Lane Marks Right Authenticated";
BA_ "SignalType" SG_ 234 FCODPB3P_AmbLnMrksLtAuth "ENM";
BA_ "SignalLongName" SG_ 234 FCODPB3P_AmbLnMrksLtAuth "Front Camera Object Detection and Processing Burst 3 Protected : Ambiguous Lane Marks Left Authenticated";
BA_ "SignalLongName" SG_ 234 FCODPB3P_BrstID "Front Camera Object Detection and Processing Burst 3 Protected : Burst ID";
BA_ "SignalLongName" SG_ 234 FCODPB3P_FlSfFggyScnDtnRngAuth "Front Camera Object Detection and Processing Burst 3 Protected : Fail Safe Foggy Scene Detection Range Authenticated";
BA_ "SignalType" SG_ 234 FCODPB3P_FlSfFggyScnDtdAuth "ENM";
BA_ "SignalLongName" SG_ 234 FCODPB3P_FlSfFggyScnDtdAuth "Front Camera Object Detection and Processing Burst 3 Protected : Fail Safe Foggy Scene Detected Authenticated";
BA_ "SignalLongName" SG_ 234 FCODPB3P_FlSfFllBlkgDtnRngAuth "Front Camera Object Detection and Processing Burst 3 Protected : Fail Safe Full Blockage Detection Range Authenticated";
BA_ "SignalType" SG_ 234 FCODPB3P_FlSfFllBlkgDtdAuth "ENM";
BA_ "SignalLongName" SG_ 234 FCODPB3P_FlSfFllBlkgDtdAuth "Front Camera Object Detection and Processing Burst 3 Protected : Fail Safe Full Blockage Detected Authenticated";
BA_ "SignalLongName" SG_ 234 FCODPB3P_FlSfLoSnDtnRngAuth "Front Camera Object Detection and Processing Burst 3 Protected : Fail Safe Low Sun Detection Range Authenticated";
BA_ "SignalType" SG_ 234 FCODPB3P_FlSfLoSnDtdAuth "ENM";
BA_ "SignalLongName" SG_ 234 FCODPB3P_FlSfLoSnDtdAuth "Front Camera Object Detection and Processing Burst 3 Protected : Fail Safe Low Sun Detected Authenticated";
BA_ "SignalLongName" SG_ 234 FCODPB3P_FlSfPtlBlkgDtnRngAuth "Front Camera Object Detection and Processing Burst 3 Protected : Fail Safe Partial Blockage Detection Range Authenticated";
BA_ "SignalType" SG_ 234 FCODPB3P_FlSfPtlBlkgDtdAuth "ENM";
BA_ "SignalLongName" SG_ 234 FCODPB3P_FlSfPtlBlkgDtdAuth "Front Camera Object Detection and Processing Burst 3 Protected : Fail Safe Partial Blockage Detected Authenticated";
BA_ "SignalLongName" SG_ 234 FCODPB3P_FlSfSmrdSptDtnRngAuth "Front Camera Object Detection and Processing Burst 3 Protected : Fail Safe Smeared Spots Detection Range Authenticated";
BA_ "SignalType" SG_ 234 FCODPB3P_FlSfSmrdSptDtdAuth "ENM";
BA_ "SignalLongName" SG_ 234 FCODPB3P_FlSfSmrdSptDtdAuth "Front Camera Object Detection and Processing Burst 3 Protected : Fail Safe Smeared Spots Detected Authenticated";
BA_ "SignalLongName" SG_ 234 FCODPB3P_FlSfSplshsDtnRngAuth "Front Camera Object Detection and Processing Burst 3 Protected : Fail Safe Splashes Detection Range Authenticated";
BA_ "SignalType" SG_ 234 FCODPB3P_FlSfSplshsDtdAuth "ENM";
BA_ "SignalLongName" SG_ 234 FCODPB3P_FlSfSplshsDtdAuth "Front Camera Object Detection and Processing Burst 3 Protected : Fail Safe Splashes Detected Authenticated";
BA_ "SignalType" SG_ 234 FCODPB3P_FrwyExtRtDtdAuth "ENM";
BA_ "SignalLongName" SG_ 234 FCODPB3P_FrwyExtRtDtdAuth "Front Camera Object Detection and Processing Burst 3 Protected : Freeway Exit Right Detected Authenticated";
BA_ "SignalType" SG_ 234 FCODPB3P_FrwyExtLtDtdAuth "ENM";
BA_ "SignalLongName" SG_ 234 FCODPB3P_FrwyExtLtDtdAuth "Front Camera Object Detection and Processing Burst 3 Protected : Freeway Exit Left Detected Authenticated";
BA_ "SignalLongName" SG_ 234 FCODPB3P_FVAcqTmStmAuth "Front Camera Object Detection and Processing Burst 3 Protected : Forward Vision Acquisition Time Stamp Authenticated";
BA_ "SignalType" SG_ 234 FCODPB3P_FrwyMrgRtDtdAuth "ENM";
BA_ "SignalLongName" SG_ 234 FCODPB3P_FrwyMrgRtDtdAuth "Front Camera Object Detection and Processing Burst 3 Protected : Freeway Merge Right Detected Authenticated";
BA_ "SignalType" SG_ 234 FCODPB3P_FrwyMrgLtDtdAuth "ENM";
BA_ "SignalLongName" SG_ 234 FCODPB3P_FrwyMrgLtDtdAuth "Front Camera Object Detection and Processing Burst 3 Protected : Freeway Merge Left Detected Authenticated";
BA_ "SignalLongName" SG_ 234 FCODPB3P_FVCIPthVehlOTkIDAuth "Front Camera Object Detection and Processing Burst 3 Protected : Forward Vision Closest In Path Vehicle Object Track ID Authenticated";
BA_ "SignalType" SG_ 234 FCODPB3P_FVAcqTmStmAuth_Inv "ENM";
BA_ "SignalLongName" SG_ 234 FCODPB3P_FVAcqTmStmAuth_Inv "Front Camera Object Detection and Processing Burst 3 Protected : Forward Vision Acquisition Time Stamp Authenticated Invalid";
BA_ "SignalLongName" SG_ 234 FCODPB3P_FVCIPthVehlTTCAuth "Front Camera Object Detection and Processing Burst 3 Protected : Forward Vision Closest In Path Vehicle Time to Collision Authenticated";
BA_ "SignalType" SG_ 234 FCODPB3P_FVConstrArDtdCnfdAuth "ENM";
BA_ "SignalLongName" SG_ 234 FCODPB3P_FVConstrArDtdCnfdAuth "Front Camera Object Detection and Processing Burst 3 Protected : Forward Vision Construction Area Detection Confidence Authenticated";
BA_ "SignalLongName" SG_ 234 FCODPB3P_FVHTPOTkIDAuth "Front Camera Object Detection and Processing Burst 3 Protected : Forward Vision Highest Threat Pedestrian Object Track ID Authenticated";
BA_ "SignalType" SG_ 234 FCODPB3P_FVConstrArDtnStsAuth "ENM";
BA_ "SignalLongName" SG_ 234 FCODPB3P_FVConstrArDtnStsAuth "Front Camera Object Detection and Processing Burst 3 Protected : Forward Vision Construction Area Detection Status Authenticated";
BA_ "SignalLongName" SG_ 234 FCODPB3P_FVHTPTTCAuth "Front Camera Object Detection and Processing Burst 3 Protected : Forward Vision Highest Threat Pedestrian Time to Collision Authenticated";
BA_ "SignalLongName" SG_ 234 FCODPB3P_FVLBTk3CrvAuth "Front Camera Object Detection and Processing Burst 3 Protected : Forward Vision Lane Boundary Track 3 Curvature Authenticated";
BA_ "SignalType" SG_ 234 FCODPB3P_FVLBTk3ClrAuth "ENM";
BA_ "SignalLongName" SG_ 234 FCODPB3P_FVLBTk3ClrAuth "Front Camera Object Detection and Processing Burst 3 Protected : Forward Vision Lane Boundary Track 3 Color Authenticated";
BA_ "SignalLongName" SG_ 234 FCODPB3P_FVLBTk3CrvDrvtAuth "Front Camera Object Detection and Processing Burst 3 Protected : Forward Vision Lane Boundary Track 3 Curvature Derivative Authenticated";
BA_ "SignalLongName" SG_ 234 FCODPB3P_FVLBTk3FPSABCQOvrAuth "Front Camera Object Detection and Processing Burst 3 Protected : Forward Vision Lane Boundary Track 3 First Polynomial Segment ABC Quality Overall Authenticated";
BA_ "SignalLongName" SG_ 234 FCODPB3P_FVLBTk3FPSAQAuth "Front Camera Object Detection and Processing Burst 3 Protected : Forward Vision Lane Boundary Track 3 First Polynomial Segment A Quality Authenticated";
BA_ "SignalLongName" SG_ 234 FCODPB3P_FVLBTk3FPSBQAuth "Front Camera Object Detection and Processing Burst 3 Protected : Forward Vision Lane Boundary Track 3 First Polynomial Segment B Quality Authenticated";
BA_ "SignalLongName" SG_ 234 FCODPB3P_FVLBTk3FPSCQAuth "Front Camera Object Detection and Processing Burst 3 Protected : Forward Vision Lane Boundary Track 3 First Polynomial Segment C Quality Authenticated";
BA_ "SignalLongName" SG_ 234 FCODPB3P_FVLBTk3HdgAuth "Front Camera Object Detection and Processing Burst 3 Protected : Forward Vision Lane Boundary Track 3 Heading Authenticated";
BA_ "SignalLongName" SG_ 234 FCODPB3P_FVLBTk3OfstAuth "Front Camera Object Detection and Processing Burst 3 Protected : Forward Vision Lane Boundary Track 3 Offset Authenticated";
BA_ "SignalType" SG_ 234 FCODPB3P_FVLBTk3PstnTypAuth "ENM";
BA_ "SignalLongName" SG_ 234 FCODPB3P_FVLBTk3PstnTypAuth "Front Camera Object Detection and Processing Burst 3 Protected : Forward Vision Lane Boundary Track 3 Position Type Authenticated";
BA_ "SignalType" SG_ 234 FCODPB3P_FVLBTk3TypAuth "ENM";
BA_ "SignalLongName" SG_ 234 FCODPB3P_FVLBTk3TypAuth "Front Camera Object Detection and Processing Burst 3 Protected : Forward Vision Lane Boundary Track 3 Type Authenticated";
BA_ "SignalType" SG_ 234 FCODPB3P_FVLBTk3QltyAuth "ENM";
BA_ "SignalLongName" SG_ 234 FCODPB3P_FVLBTk3QltyAuth "Front Camera Object Detection and Processing Burst 3 Protected : Forward Vision Lane Boundary Track 3 Quality Authenticated";
BA_ "SignalLongName" SG_ 234 FCODPB3P_FVLBTk3VSLgDistAuth "Front Camera Object Detection and Processing Burst 3 Protected : Forward Vision Lane Boundary Track 3 View Start Longitudinal Distance Authenticated";
BA_ "SignalLongName" SG_ 234 FCODPB3P_FVLBTk3VRLgDistAuth "Front Camera Object Detection and Processing Burst 3 Protected : Forward Vision Lane Boundary Track 3 View Range Longitudinal Distance Authenticated";
BA_ "SignalLongName" SG_ 234 FCODPB3P_FVLBTk3WdthAuth "Front Camera Object Detection and Processing Burst 3 Protected : Forward Vision Lane Boundary Track 3 Width Authenticated";
BA_ "SignalType" SG_ 234 FCODPB3P_FVPOTk3DynPrpAuth "ENM";
BA_ "SignalLongName" SG_ 234 FCODPB3P_FVPOTk3DynPrpAuth "Front Camera Object Detection and Processing Burst 3 Protected : Forward Vision Pedestrian Object Track 3 Dynamic Property Authenticated";
BA_ "SignalType" SG_ 234 FCODPB3P_FVPOTk3CnfdStsAuth "ENM";
BA_ "SignalLongName" SG_ 234 FCODPB3P_FVPOTk3CnfdStsAuth "Front Camera Object Detection and Processing Burst 3 Protected : Forward Vision Pedestrian Object Track 3 Confidence Status Authenticated";
BA_ "SignalLongName" SG_ 234 FCODPB3P_FVPOTk3InPthPotAuth "Front Camera Object Detection and Processing Burst 3 Protected : Forward Vision Pedestrian Object Track 3 In Path Potential Authenticated";
BA_ "SignalLongName" SG_ 234 FCODPB3P_FVPOTk3IDAuth "Front Camera Object Detection and Processing Burst 3 Protected : Forward Vision Pedestrian Object Track 3 ID Authenticated";
BA_ "SignalLongName" SG_ 234 FCODPB3P_FVPOTk3PoILAAuth "Front Camera Object Detection and Processing Burst 3 Protected : Forward Vision Pedestrian Object Track 3 Point of Interest Lateral Acceleration Authenticated";
BA_ "SignalType" SG_ 234 FCODPB3P_FVPOTk3MStsAuth "ENM";
BA_ "SignalLongName" SG_ 234 FCODPB3P_FVPOTk3MStsAuth "Front Camera Object Detection and Processing Burst 3 Protected : Forward Vision Pedestrian Object Track 3 Measurement Status Authenticated";
BA_ "SignalLongName" SG_ 234 FCODPB3P_FVPOTk3PoILgAAuth "Front Camera Object Detection and Processing Burst 3 Protected : Forward Vision Pedestrian Object Track 3 Point of Interest Longitudinal Acceleration Authenticated";
BA_ "SignalLongName" SG_ 234 FCODPB3P_FVPOTk3PoILgPsAuth "Front Camera Object Detection and Processing Burst 3 Protected : Forward Vision Pedestrian Object Track 3 Point of Interest Longitudinal Position Authenticated";
BA_ "SignalLongName" SG_ 234 FCODPB3P_FVPOTk3PoILgVAuth "Front Camera Object Detection and Processing Burst 3 Protected : Forward Vision Pedestrian Object Track 3 Point of Interest Longitudinal Velocity Authenticated";
BA_ "SignalLongName" SG_ 234 FCODPB3P_FVPOTk3PoILPsAuth "Front Camera Object Detection and Processing Burst 3 Protected : Forward Vision Pedestrian Object Track 3 Point of Interest Lateral Position Authenticated";
BA_ "SignalLongName" SG_ 234 FCODPB3P_FVPOTk3PoILVAuth "Front Camera Object Detection and Processing Burst 3 Protected : Forward Vision Pedestrian Object Track 3 Point of Interest Lateral Velocity Authenticated";
BA_ "SignalType" SG_ 234 FCODPB3P_FVVOTk3BrkLgtStsAuth "ENM";
BA_ "SignalLongName" SG_ 234 FCODPB3P_FVVOTk3BrkLgtStsAuth "Front Camera Object Detection and Processing Burst 3 Protected : Forward Vision Vehicle Object Track 3 Brake Light Status Authenticated";
BA_ "SignalType" SG_ 234 FCODPB3P_FVVCRngCutInRtAuth "ENM";
BA_ "SignalLongName" SG_ 234 FCODPB3P_FVVCRngCutInRtAuth "Front Camera Object Detection and Processing Burst 3 Protected : Forward Vision Vehicle Close Range Cut in Right Authenticated";
BA_ "SignalType" SG_ 234 FCODPB3P_FVVCRngCutInLtAuth "ENM";
BA_ "SignalLongName" SG_ 234 FCODPB3P_FVVCRngCutInLtAuth "Front Camera Object Detection and Processing Burst 3 Protected : Forward Vision Vehicle Close Range Cut in Left Authenticated";
BA_ "SignalType" SG_ 234 FCODPB3P_FVPOTk3TypCnfdAuth "ENM";
BA_ "SignalLongName" SG_ 234 FCODPB3P_FVPOTk3TypCnfdAuth "Front Camera Object Detection and Processing Burst 3 Protected : Forward Vision Pedestrian Object Track 3 Type Confidence Authenticated";
BA_ "SignalType" SG_ 234 FCODPB3P_FVPOTk3TypAuth "ENM";
BA_ "SignalLongName" SG_ 234 FCODPB3P_FVPOTk3TypAuth "Front Camera Object Detection and Processing Burst 3 Protected : Forward Vision Pedestrian Object Track 3 Type Authenticated";
BA_ "SignalType" SG_ 234 FCODPB3P_FVVOTk3CnfdStsAuth "ENM";
BA_ "SignalLongName" SG_ 234 FCODPB3P_FVVOTk3CnfdStsAuth "Front Camera Object Detection and Processing Burst 3 Protected : Forward Vision Vehicle Object Track 3 Confidence Status Authenticated";
BA_ "SignalLongName" SG_ 234 FCODPB3P_FVVOTk3CICOPotAuth "Front Camera Object Detection and Processing Burst 3 Protected : Forward Vision Vehicle Object Track 3 Cut In Cut Out Potential Authenticated";
BA_ "SignalLongName" SG_ 234 FCODPB3P_FVVOTk3HdgAngAuth "Front Camera Object Detection and Processing Burst 3 Protected : Forward Vision Vehicle Object Track 3 Heading Angle Authenticated";
BA_ "SignalType" SG_ 234 FCODPB3P_FVVOTk3DynPrpStsAuth "ENM";
BA_ "SignalLongName" SG_ 234 FCODPB3P_FVVOTk3DynPrpStsAuth "Front Camera Object Detection and Processing Burst 3 Protected : Forward Vision Vehicle Object Track 3 Dynamic Property Status Authenticated";
BA_ "SignalType" SG_ 234 FCODPB3P_FVVOTk3DynPrpAuth "ENM";
BA_ "SignalLongName" SG_ 234 FCODPB3P_FVVOTk3DynPrpAuth "Front Camera Object Detection and Processing Burst 3 Protected : Forward Vision Vehicle Object Track 3 Dynamic Property Authenticated";
BA_ "SignalLongName" SG_ 234 FCODPB3P_FVVOTk3HdgAngCAuth "Front Camera Object Detection and Processing Burst 3 Protected : Forward Vision Vehicle Object Track 3 Heading Angle Covariance Authenticated";
BA_ "SignalLongName" SG_ 234 FCODPB3P_FVVOTk3IDAuth "Front Camera Object Detection and Processing Burst 3 Protected : Forward Vision Vehicle Object Track 3 ID Authenticated";
BA_ "SignalType" SG_ 234 FCODPB3P_FVVOTk3MStsAuth "ENM";
BA_ "SignalLongName" SG_ 234 FCODPB3P_FVVOTk3MStsAuth "Front Camera Object Detection and Processing Burst 3 Protected : Forward Vision Vehicle Object Track 3 Measurement Status Authenticated";
BA_ "SignalType" SG_ 234 FCODPB3P_FVVOTk3LnAsmtAuth "ENM";
BA_ "SignalLongName" SG_ 234 FCODPB3P_FVVOTk3LnAsmtAuth "Front Camera Object Detection and Processing Burst 3 Protected : Forward Vision Vehicle Object Track 3 Lane Assignment Authenticated";
BA_ "SignalLongName" SG_ 234 FCODPB3P_FVVOTk3PoILAAuth "Front Camera Object Detection and Processing Burst 3 Protected : Forward Vision Vehicle Object Track 3 Point of Interest Lateral Acceleration Authenticated";
BA_ "SignalLongName" SG_ 234 FCODPB3P_FVVOTk3PoILgAAuth "Front Camera Object Detection and Processing Burst 3 Protected : Forward Vision Vehicle Object Track 3 Point of Interest Longitudinal Acceleration Authenticated";
BA_ "SignalLongName" SG_ 234 FCODPB3P_FVVOTk3PoILgPsAuth "Front Camera Object Detection and Processing Burst 3 Protected : Forward Vision Vehicle Object Track 3 Point of Interest Longitudinal Position Authenticated";
BA_ "SignalLongName" SG_ 234 FCODPB3P_FVVOTk3PoILgPsCAuth "Front Camera Object Detection and Processing Burst 3 Protected : Forward Vision Vehicle Object Track 3 Point of Interest Longitudinal Position Covariance Authenticated";
BA_ "SignalLongName" SG_ 234 FCODPB3P_FVVOTk3PoILgVAuth "Front Camera Object Detection and Processing Burst 3 Protected : Forward Vision Vehicle Object Track 3 Point of Interest Longitudinal Velocity Authenticated";
BA_ "SignalLongName" SG_ 234 FCODPB3P_FVVOTk3PoILgVCAuth "Front Camera Object Detection and Processing Burst 3 Protected : Forward Vision Vehicle Object Track 3 Point of Interest Longitudinal Velocity Covariance Authenticated";
BA_ "SignalLongName" SG_ 234 FCODPB3P_FVVOTk3PoILPsAuth "Front Camera Object Detection and Processing Burst 3 Protected : Forward Vision Vehicle Object Track 3 Point of Interest Lateral Position Authenticated";
BA_ "SignalLongName" SG_ 234 FCODPB3P_FVVOTk3PoILPsCAuth "Front Camera Object Detection and Processing Burst 3 Protected : Forward Vision Vehicle Object Track 3 Point of Interest Lateral Position Covariance Authenticated";
BA_ "SignalLongName" SG_ 234 FCODPB3P_FVVOTk3PoILVAuth "Front Camera Object Detection and Processing Burst 3 Protected : Forward Vision Vehicle Object Track 3 Point of Interest Lateral Velocity Authenticated";
BA_ "SignalLongName" SG_ 234 FCODPB3P_FVVOTk3PoILVCAuth "Front Camera Object Detection and Processing Burst 3 Protected : Forward Vision Vehicle Object Track 3 Point of Interest Lateral Velocity Covariance Authenticated";
BA_ "SignalLongName" SG_ 234 FCODPB3P_FVVOTk3PoIWAuth "Front Camera Object Detection and Processing Burst 3 Protected : Forward Vision Vehicle Object Track 3 Point of Interest Width Authenticated";
BA_ "SignalType" SG_ 234 FCODPB3P_FVVOTk3TypAuth "ENM";
BA_ "SignalLongName" SG_ 234 FCODPB3P_FVVOTk3TypAuth "Front Camera Object Detection and Processing Burst 3 Protected : Forward Vision Vehicle Object Track 3 Type Authenticated";
BA_ "SignalType" SG_ 234 FCODPB3P_FVVOTk3TSLgtStsAuth "ENM";
BA_ "SignalLongName" SG_ 234 FCODPB3P_FVVOTk3TSLgtStsAuth "Front Camera Object Detection and Processing Burst 3 Protected : Forward Vision Vehicle Object Track 3 Turn Signal Light Status Authenticated";
BA_ "SignalLongName" SG_ 234 FCODPB3P_OvrhdStrctrDistAuth "Front Camera Object Detection and Processing Burst 3 Protected : Overhead Structure Distance Authenticated";
BA_ "SignalType" SG_ 234 FCODPB3P_OvrhdStrctDtdAuth "ENM";
BA_ "SignalLongName" SG_ 234 FCODPB3P_OvrhdStrctDtdAuth "Front Camera Object Detection and Processing Burst 3 Protected : Overhead Structure Detected Authenticated";
BA_ "SignalType" SG_ 234 FCODPB3P_IntTrffcDtdAuth "ENM";
BA_ "SignalLongName" SG_ 234 FCODPB3P_IntTrffcDtdAuth "Front Camera Object Detection and Processing Burst 3 Protected : Intersecting Traffic Detected Authenticated";
BA_ "SignalType" SG_ 234 FCODPB3P_FVVOTk3TypCnfdAuth "ENM";
BA_ "SignalLongName" SG_ 234 FCODPB3P_FVVOTk3TypCnfdAuth "Front Camera Object Detection and Processing Burst 3 Protected : Forward Vision Vehicle Object Track 3 Type Confidence Authenticated";
BA_ "SignalType" SG_ 234 FCODPB3P_VehInTnnlCnfdAuth "ENM";
BA_ "SignalLongName" SG_ 234 FCODPB3P_VehInTnnlCnfdAuth "Front Camera Object Detection and Processing Burst 3 Protected : Vehicle In Tunnel Confidence Authenticated";
BA_ "SignalType" SG_ 234 FCODPB3P_TrffcLgtDtdAuth "ENM";
BA_ "SignalLongName" SG_ 234 FCODPB3P_TrffcLgtDtdAuth "Front Camera Object Detection and Processing Burst 3 Protected : Traffic Light Detected Authenticated";
BA_ "SignalType" SG_ 234 FrwdVsnVehObjTk3DatIntegCkd "ENM";
BA_ "SignalLongName" SG_ 234 FrwdVsnVehObjTk3DatIntegCkd "Front Camera Object Detection and Processing Burst 3 Protected : Forward Vision Vehicle Object Track 3 Data Integrity Checked";
BA_ "SignalType" SG_ 234 FrwdVsnPedtrnObjTk3DatIntegCkd "ENM";
BA_ "SignalLongName" SG_ 234 FrwdVsnPedtrnObjTk3DatIntegCkd "Front Camera Object Detection and Processing Burst 3 Protected : Forward Vision Pedestrian Object Track 3 Data Integrity Checked";
BA_ "SignalType" SG_ 234 FrwdVsnLnBdryTk3DatIntegCkd "ENM";
BA_ "SignalLongName" SG_ 234 FrwdVsnLnBdryTk3DatIntegCkd "Front Camera Object Detection and Processing Burst 3 Protected : Forward Vision Lane Boundary Track 3 Data Integrity Checked";
BA_ "SignalType" SG_ 234 FCODPB3P_VehInTnnlDtdAuth "ENM";
BA_ "SignalLongName" SG_ 234 FCODPB3P_VehInTnnlDtdAuth "Front Camera Object Detection and Processing Burst 3 Protected : Vehicle In Tunnel Detected Authenticated";
BA_ "SignalLongName" SG_ 234 FCODPB3P_Filler "Front Camera Object Detection and Processing Burst 3 Protected : Filler";
BA_ "SignalLongName" SG_ 221 FCODPB4P_FVLBTk11CrvAuth "Front Camera Object Detection and Processing Burst 4 Protected : Forward Vision Lane Boundary Track 11 Curvature Authenticated";
BA_ "SignalType" SG_ 221 FCODPB4P_FVLBTk11ClrAuth "ENM";
BA_ "SignalLongName" SG_ 221 FCODPB4P_FVLBTk11ClrAuth "Front Camera Object Detection and Processing Burst 4 Protected : Forward Vision Lane Boundary Track 11 Color Authenticated";
BA_ "SignalLongName" SG_ 221 FCODPB4P_BrstID "Front Camera Object Detection and Processing Burst 4 Protected : Burst ID";
BA_ "SignalLongName" SG_ 221 FCODPB4P_FVLBTk11CrvDrvtAuth "Front Camera Object Detection and Processing Burst 4 Protected : Forward Vision Lane Boundary Track 11 Curvature Derivative Authenticated";
BA_ "SignalLongName" SG_ 221 FCODPB4P_FVLBTk11FPSABCQOvrAuth "Front Camera Object Detection and Processing Burst 4 Protected : Forward Vision Lane Boundary Track 11 First Polynomial Segment ABC Quality Overall Authenticated";
BA_ "SignalLongName" SG_ 221 FCODPB4P_FVLBTk11FPSAQAuth "Front Camera Object Detection and Processing Burst 4 Protected : Forward Vision Lane Boundary Track 11 First Polynomial Segment A Quality Authenticated";
BA_ "SignalLongName" SG_ 221 FCODPB4P_FVLBTk11FPSBQAuth "Front Camera Object Detection and Processing Burst 4 Protected : Forward Vision Lane Boundary Track 11 First Polynomial Segment B Quality Authenticated";
BA_ "SignalLongName" SG_ 221 FCODPB4P_FVLBTk11FPSCQAuth "Front Camera Object Detection and Processing Burst 4 Protected : Forward Vision Lane Boundary Track 11 First Polynomial Segment C Quality Authenticated";
BA_ "SignalLongName" SG_ 221 FCODPB4P_FVLBTk11HdgAuth "Front Camera Object Detection and Processing Burst 4 Protected : Forward Vision Lane Boundary Track 11 Heading Authenticated";
BA_ "SignalLongName" SG_ 221 FCODPB4P_FVLBTk11OfstAuth "Front Camera Object Detection and Processing Burst 4 Protected : Forward Vision Lane Boundary Track 11 Offset Authenticated";
BA_ "SignalType" SG_ 221 FCODPB4P_FVLBTk11PstnTypAuth "ENM";
BA_ "SignalLongName" SG_ 221 FCODPB4P_FVLBTk11PstnTypAuth "Front Camera Object Detection and Processing Burst 4 Protected : Forward Vision Lane Boundary Track 11 Position Type Authenticated";
BA_ "SignalType" SG_ 221 FCODPB4P_FVLBTk11TypAuth "ENM";
BA_ "SignalLongName" SG_ 221 FCODPB4P_FVLBTk11TypAuth "Front Camera Object Detection and Processing Burst 4 Protected : Forward Vision Lane Boundary Track 11 Type Authenticated";
BA_ "SignalType" SG_ 221 FCODPB4P_FVLBTk11QltyAuth "ENM";
BA_ "SignalLongName" SG_ 221 FCODPB4P_FVLBTk11QltyAuth "Front Camera Object Detection and Processing Burst 4 Protected : Forward Vision Lane Boundary Track 11 Quality Authenticated";
BA_ "SignalLongName" SG_ 221 FCODPB4P_FVLBTk11VSLgDistAuth "Front Camera Object Detection and Processing Burst 4 Protected : Forward Vision Lane Boundary Track 11 View Start Longitudinal Distance Authenticated";
BA_ "SignalLongName" SG_ 221 FCODPB4P_FVLBTk11VRLgDistAuth "Front Camera Object Detection and Processing Burst 4 Protected : Forward Vision Lane Boundary Track 11 View Range Longitudinal Distance Authenticated";
BA_ "SignalLongName" SG_ 221 FCODPB4P_FVLBTk11WdthAuth "Front Camera Object Detection and Processing Burst 4 Protected : Forward Vision Lane Boundary Track 11 Width Authenticated";
BA_ "SignalLongName" SG_ 221 FCODPB4P_FVLBTk4CrvAuth "Front Camera Object Detection and Processing Burst 4 Protected : Forward Vision Lane Boundary Track 4 Curvature Authenticated";
BA_ "SignalType" SG_ 221 FCODPB4P_FVLBTk4ClrAuth "ENM";
BA_ "SignalLongName" SG_ 221 FCODPB4P_FVLBTk4ClrAuth "Front Camera Object Detection and Processing Burst 4 Protected : Forward Vision Lane Boundary Track 4 Color Authenticated";
BA_ "SignalLongName" SG_ 221 FCODPB4P_FVLBTk4CrvDrvtAuth "Front Camera Object Detection and Processing Burst 4 Protected : Forward Vision Lane Boundary Track 4 Curvature Derivative Authenticated";
BA_ "SignalLongName" SG_ 221 FCODPB4P_FVLBTk4FPSABCQOvrAuth "Front Camera Object Detection and Processing Burst 4 Protected : Forward Vision Lane Boundary Track 4 First Polynomial Segment ABC Quality Overall Authenticated";
BA_ "SignalLongName" SG_ 221 FCODPB4P_FVLBTk4FPSAQAuth "Front Camera Object Detection and Processing Burst 4 Protected : Forward Vision Lane Boundary Track 4 First Polynomial Segment A Quality Authenticated";
BA_ "SignalLongName" SG_ 221 FCODPB4P_FVLBTk4FPSBQAuth "Front Camera Object Detection and Processing Burst 4 Protected : Forward Vision Lane Boundary Track 4 First Polynomial Segment B Quality Authenticated";
BA_ "SignalLongName" SG_ 221 FCODPB4P_FVLBTk4FPSCQAuth "Front Camera Object Detection and Processing Burst 4 Protected : Forward Vision Lane Boundary Track 4 First Polynomial Segment C Quality Authenticated";
BA_ "SignalLongName" SG_ 221 FCODPB4P_FVLBTk4HdgAuth "Front Camera Object Detection and Processing Burst 4 Protected : Forward Vision Lane Boundary Track 4 Heading Authenticated";
BA_ "SignalLongName" SG_ 221 FCODPB4P_FVLBTk4OfstAuth "Front Camera Object Detection and Processing Burst 4 Protected : Forward Vision Lane Boundary Track 4 Offset Authenticated";
BA_ "SignalType" SG_ 221 FCODPB4P_FVLBTk4TypAuth "ENM";
BA_ "SignalLongName" SG_ 221 FCODPB4P_FVLBTk4TypAuth "Front Camera Object Detection and Processing Burst 4 Protected : Forward Vision Lane Boundary Track 4 Type Authenticated";
BA_ "SignalType" SG_ 221 FCODPB4P_FVLBTk4QltyAuth "ENM";
BA_ "SignalLongName" SG_ 221 FCODPB4P_FVLBTk4QltyAuth "Front Camera Object Detection and Processing Burst 4 Protected : Forward Vision Lane Boundary Track 4 Quality Authenticated";
BA_ "SignalType" SG_ 221 FCODPB4P_FVLBTk4PstnTypAuth "ENM";
BA_ "SignalLongName" SG_ 221 FCODPB4P_FVLBTk4PstnTypAuth "Front Camera Object Detection and Processing Burst 4 Protected : Forward Vision Lane Boundary Track 4 Position Type Authenticated";
BA_ "SignalLongName" SG_ 221 FCODPB4P_FVLBTk4VRLgDistAuth "Front Camera Object Detection and Processing Burst 4 Protected : Forward Vision Lane Boundary Track 4 View Range Longitudinal Distance Authenticated";
BA_ "SignalLongName" SG_ 221 FCODPB4P_FVLBTk4VSLgDistAuth "Front Camera Object Detection and Processing Burst 4 Protected : Forward Vision Lane Boundary Track 4 View Start Longitudinal Distance Authenticated";
BA_ "SignalType" SG_ 221 FCODPB4P_FVPOTk4CnfdStsAuth "ENM";
BA_ "SignalLongName" SG_ 221 FCODPB4P_FVPOTk4CnfdStsAuth "Front Camera Object Detection and Processing Burst 4 Protected : Forward Vision Pedestrian Object Track 4 Confidence Status Authenticated";
BA_ "SignalLongName" SG_ 221 FCODPB4P_FVLBTk4WdthAuth "Front Camera Object Detection and Processing Burst 4 Protected : Forward Vision Lane Boundary Track 4 Width Authenticated";
BA_ "SignalLongName" SG_ 221 FCODPB4P_FVPOTk4IDAuth "Front Camera Object Detection and Processing Burst 4 Protected : Forward Vision Pedestrian Object Track 4 ID Authenticated";
BA_ "SignalType" SG_ 221 FCODPB4P_FVPOTk4DynPrpAuth "ENM";
BA_ "SignalLongName" SG_ 221 FCODPB4P_FVPOTk4DynPrpAuth "Front Camera Object Detection and Processing Burst 4 Protected : Forward Vision Pedestrian Object Track 4 Dynamic Property Authenticated";
BA_ "SignalType" SG_ 221 FCODPB4P_FVPOTk4MStsAuth "ENM";
BA_ "SignalLongName" SG_ 221 FCODPB4P_FVPOTk4MStsAuth "Front Camera Object Detection and Processing Burst 4 Protected : Forward Vision Pedestrian Object Track 4 Measurement Status Authenticated";
BA_ "SignalLongName" SG_ 221 FCODPB4P_FVPOTk4InPthPotAuth "Front Camera Object Detection and Processing Burst 4 Protected : Forward Vision Pedestrian Object Track 4 In Path Potential Authenticated";
BA_ "SignalLongName" SG_ 221 FCODPB4P_FVPOTk4PoILAAuth "Front Camera Object Detection and Processing Burst 4 Protected : Forward Vision Pedestrian Object Track 4 Point of Interest Lateral Acceleration Authenticated";
BA_ "SignalLongName" SG_ 221 FCODPB4P_FVPOTk4PoILgAAuth "Front Camera Object Detection and Processing Burst 4 Protected : Forward Vision Pedestrian Object Track 4 Point of Interest Longitudinal Acceleration Authenticated";
BA_ "SignalLongName" SG_ 221 FCODPB4P_FVPOTk4PoILgPsAuth "Front Camera Object Detection and Processing Burst 4 Protected : Forward Vision Pedestrian Object Track 4 Point of Interest Longitudinal Position Authenticated";
BA_ "SignalLongName" SG_ 221 FCODPB4P_FVPOTk4PoILgVAuth "Front Camera Object Detection and Processing Burst 4 Protected : Forward Vision Pedestrian Object Track 4 Point of Interest Longitudinal Velocity Authenticated";
BA_ "SignalLongName" SG_ 221 FCODPB4P_FVPOTk4PoILPsAuth "Front Camera Object Detection and Processing Burst 4 Protected : Forward Vision Pedestrian Object Track 4 Point of Interest Lateral Position Authenticated";
BA_ "SignalLongName" SG_ 221 FCODPB4P_FVPOTk4PoILVAuth "Front Camera Object Detection and Processing Burst 4 Protected : Forward Vision Pedestrian Object Track 4 Point of Interest Lateral Velocity Authenticated";
BA_ "SignalType" SG_ 221 FCODPB4P_FVVOTk4BrkLgtStsAuth "ENM";
BA_ "SignalLongName" SG_ 221 FCODPB4P_FVVOTk4BrkLgtStsAuth "Front Camera Object Detection and Processing Burst 4 Protected : Forward Vision Vehicle Object Track 4 Brake Light Status Authenticated";
BA_ "SignalType" SG_ 221 FCODPB4P_FVPOTk4TypCnfdAuth "ENM";
BA_ "SignalLongName" SG_ 221 FCODPB4P_FVPOTk4TypCnfdAuth "Front Camera Object Detection and Processing Burst 4 Protected : Forward Vision Pedestrian Object Track 4 Type Confidence Authenticated";
BA_ "SignalType" SG_ 221 FCODPB4P_FVPOTk4TypAuth "ENM";
BA_ "SignalLongName" SG_ 221 FCODPB4P_FVPOTk4TypAuth "Front Camera Object Detection and Processing Burst 4 Protected : Forward Vision Pedestrian Object Track 4 Type Authenticated";
BA_ "SignalType" SG_ 221 FCODPB4P_FVVOTk4CnfdStsAuth "ENM";
BA_ "SignalLongName" SG_ 221 FCODPB4P_FVVOTk4CnfdStsAuth "Front Camera Object Detection and Processing Burst 4 Protected : Forward Vision Vehicle Object Track 4 Confidence Status Authenticated";
BA_ "SignalLongName" SG_ 221 FCODPB4P_FVVOTk4CICOPotAuth "Front Camera Object Detection and Processing Burst 4 Protected : Forward Vision Vehicle Object Track 4 Cut In Cut Out Potential Authenticated";
BA_ "SignalLongName" SG_ 221 FCODPB4P_FVVOTk4HdgAngAuth "Front Camera Object Detection and Processing Burst 4 Protected : Forward Vision Vehicle Object Track 4 Heading Angle Authenticated";
BA_ "SignalType" SG_ 221 FCODPB4P_FVVOTk4DynPrpStsAuth "ENM";
BA_ "SignalLongName" SG_ 221 FCODPB4P_FVVOTk4DynPrpStsAuth "Front Camera Object Detection and Processing Burst 4 Protected : Forward Vision Vehicle Object Track 4 Dynamic Property Status Authenticated";
BA_ "SignalType" SG_ 221 FCODPB4P_FVVOTk4DynPrpAuth "ENM";
BA_ "SignalLongName" SG_ 221 FCODPB4P_FVVOTk4DynPrpAuth "Front Camera Object Detection and Processing Burst 4 Protected : Forward Vision Vehicle Object Track 4 Dynamic Property Authenticated";
BA_ "SignalLongName" SG_ 221 FCODPB4P_FVVOTk4HdgAngCAuth "Front Camera Object Detection and Processing Burst 4 Protected : Forward Vision Vehicle Object Track 4 Heading Angle Covariance Authenticated";
BA_ "SignalLongName" SG_ 221 FCODPB4P_FVVOTk4IDAuth "Front Camera Object Detection and Processing Burst 4 Protected : Forward Vision Vehicle Object Track 4 ID Authenticated";
BA_ "SignalType" SG_ 221 FCODPB4P_FVVOTk4MStsAuth "ENM";
BA_ "SignalLongName" SG_ 221 FCODPB4P_FVVOTk4MStsAuth "Front Camera Object Detection and Processing Burst 4 Protected : Forward Vision Vehicle Object Track 4 Measurement Status Authenticated";
BA_ "SignalType" SG_ 221 FCODPB4P_FVVOTk4LnAsmtAuth "ENM";
BA_ "SignalLongName" SG_ 221 FCODPB4P_FVVOTk4LnAsmtAuth "Front Camera Object Detection and Processing Burst 4 Protected : Forward Vision Vehicle Object Track 4 Lane Assignment Authenticated";
BA_ "SignalLongName" SG_ 221 FCODPB4P_FVVOTk4PoILAAuth "Front Camera Object Detection and Processing Burst 4 Protected : Forward Vision Vehicle Object Track 4 Point of Interest Lateral Acceleration Authenticated";
BA_ "SignalLongName" SG_ 221 FCODPB4P_FVVOTk4PoILgAAuth "Front Camera Object Detection and Processing Burst 4 Protected : Forward Vision Vehicle Object Track 4 Point of Interest Longitudinal Acceleration Authenticated";
BA_ "SignalLongName" SG_ 221 FCODPB4P_FVVOTk4PoILgPsAuth "Front Camera Object Detection and Processing Burst 4 Protected : Forward Vision Vehicle Object Track 4 Point of Interest Longitudinal Position Authenticated";
BA_ "SignalLongName" SG_ 221 FCODPB4P_FVVOTk4PoILgPsCAuth "Front Camera Object Detection and Processing Burst 4 Protected : Forward Vision Vehicle Object Track 4 Point of Interest Longitudinal Position Covariance Authenticated";
BA_ "SignalLongName" SG_ 221 FCODPB4P_FVVOTk4PoILgVAuth "Front Camera Object Detection and Processing Burst 4 Protected : Forward Vision Vehicle Object Track 4 Point of Interest Longitudinal Velocity Authenticated";
BA_ "SignalLongName" SG_ 221 FCODPB4P_FVVOTk4PoILgVCAuth "Front Camera Object Detection and Processing Burst 4 Protected : Forward Vision Vehicle Object Track 4 Point of Interest Longitudinal Velocity Covariance Authenticated";
BA_ "SignalLongName" SG_ 221 FCODPB4P_FVVOTk4PoILPsAuth "Front Camera Object Detection and Processing Burst 4 Protected : Forward Vision Vehicle Object Track 4 Point of Interest Lateral Position Authenticated";
BA_ "SignalLongName" SG_ 221 FCODPB4P_FVVOTk4PoILPsCAuth "Front Camera Object Detection and Processing Burst 4 Protected : Forward Vision Vehicle Object Track 4 Point of Interest Lateral Position Covariance Authenticated";
BA_ "SignalLongName" SG_ 221 FCODPB4P_FVVOTk4PoILVAuth "Front Camera Object Detection and Processing Burst 4 Protected : Forward Vision Vehicle Object Track 4 Point of Interest Lateral Velocity Authenticated";
BA_ "SignalLongName" SG_ 221 FCODPB4P_FVVOTk4PoILVCAuth "Front Camera Object Detection and Processing Burst 4 Protected : Forward Vision Vehicle Object Track 4 Point of Interest Lateral Velocity Covariance Authenticated";
BA_ "SignalLongName" SG_ 221 FCODPB4P_FVVOTk4PoIWAuth "Front Camera Object Detection and Processing Burst 4 Protected : Forward Vision Vehicle Object Track 4 Point of Interest Width Authenticated";
BA_ "SignalType" SG_ 221 FCODPB4P_FVVOTk4TypAuth "ENM";
BA_ "SignalLongName" SG_ 221 FCODPB4P_FVVOTk4TypAuth "Front Camera Object Detection and Processing Burst 4 Protected : Forward Vision Vehicle Object Track 4 Type Authenticated";
BA_ "SignalType" SG_ 221 FCODPB4P_FVVOTk4TSLgtStsAuth "ENM";
BA_ "SignalLongName" SG_ 221 FCODPB4P_FVVOTk4TSLgtStsAuth "Front Camera Object Detection and Processing Burst 4 Protected : Forward Vision Vehicle Object Track 4 Turn Signal Light Status Authenticated";
BA_ "SignalType" SG_ 221 FrwdVsnVehObjTk4DatIntegCkd "ENM";
BA_ "SignalLongName" SG_ 221 FrwdVsnVehObjTk4DatIntegCkd "Front Camera Object Detection and Processing Burst 4 Protected : Forward Vision Vehicle Object Track 4 Data Integrity Checked";
BA_ "SignalType" SG_ 221 FrwdVsnPedtrnObjTk4DatIntegCkd "ENM";
BA_ "SignalLongName" SG_ 221 FrwdVsnPedtrnObjTk4DatIntegCkd "Front Camera Object Detection and Processing Burst 4 Protected : Forward Vision Pedestrian Object Track 4 Data Integrity Checked";
BA_ "SignalType" SG_ 221 FrwdVsnLnBdryTk4DatIntegCkd "ENM";
BA_ "SignalLongName" SG_ 221 FrwdVsnLnBdryTk4DatIntegCkd "Front Camera Object Detection and Processing Burst 4 Protected : Forward Vision Lane Boundary Track 4 Data Integrity Checked";
BA_ "SignalType" SG_ 221 FCODPB4P_FVVOTk4TypCnfdAuth "ENM";
BA_ "SignalLongName" SG_ 221 FCODPB4P_FVVOTk4TypCnfdAuth "Front Camera Object Detection and Processing Burst 4 Protected : Forward Vision Vehicle Object Track 4 Type Confidence Authenticated";
BA_ "SignalLongName" SG_ 221 FCODPB4P_Filler "Front Camera Object Detection and Processing Burst 4 Protected : Filler";
BA_ "SignalLongName" SG_ 235 FCODPB5P_FVLBTk10CrvAuth "Front Camera Object Detection and Processing Burst 5 Protected : Forward Vision Lane Boundary Track 10 Curvature Authenticated";
BA_ "SignalType" SG_ 235 FCODPB5P_FVLBTk10ClrAuth "ENM";
BA_ "SignalLongName" SG_ 235 FCODPB5P_FVLBTk10ClrAuth "Front Camera Object Detection and Processing Burst 5 Protected : Forward Vision Lane Boundary Track 10 Color Authenticated";
BA_ "SignalLongName" SG_ 235 FCODPB5P_BrstID "Front Camera Object Detection and Processing Burst 5 Protected : Burst ID";
BA_ "SignalLongName" SG_ 235 FCODPB5P_FVLBTk10CrvDrvtAuth "Front Camera Object Detection and Processing Burst 5 Protected : Forward Vision Lane Boundary Track 10 Curvature Derivative Authenticated";
BA_ "SignalLongName" SG_ 235 FCODPB5P_FVLBTk10FPSABCQOvrAuth "Front Camera Object Detection and Processing Burst 5 Protected : Forward Vision Lane Boundary Track 10 First Polynomial Segment ABC Quality Overall Authenticated";
BA_ "SignalLongName" SG_ 235 FCODPB5P_FVLBTk10FPSAQAuth "Front Camera Object Detection and Processing Burst 5 Protected : Forward Vision Lane Boundary Track 10 First Polynomial Segment A Quality Authenticated";
BA_ "SignalLongName" SG_ 235 FCODPB5P_FVLBTk10FPSBQAuth "Front Camera Object Detection and Processing Burst 5 Protected : Forward Vision Lane Boundary Track 10 First Polynomial Segment B Quality Authenticated";
BA_ "SignalLongName" SG_ 235 FCODPB5P_FVLBTk10FPSCQAuth "Front Camera Object Detection and Processing Burst 5 Protected : Forward Vision Lane Boundary Track 10 First Polynomial Segment C Quality Authenticated";
BA_ "SignalLongName" SG_ 235 FCODPB5P_FVLBTk10HdgAuth "Front Camera Object Detection and Processing Burst 5 Protected : Forward Vision Lane Boundary Track 10 Heading Authenticated";
BA_ "SignalLongName" SG_ 235 FCODPB5P_FVLBTk10OfstAuth "Front Camera Object Detection and Processing Burst 5 Protected : Forward Vision Lane Boundary Track 10 Offset Authenticated";
BA_ "SignalType" SG_ 235 FCODPB5P_FVLBTk10PstnTypAuth "ENM";
BA_ "SignalLongName" SG_ 235 FCODPB5P_FVLBTk10PstnTypAuth "Front Camera Object Detection and Processing Burst 5 Protected : Forward Vision Lane Boundary Track 10 Position Type Authenticated";
BA_ "SignalType" SG_ 235 FCODPB5P_FVLBTk10TypAuth "ENM";
BA_ "SignalLongName" SG_ 235 FCODPB5P_FVLBTk10TypAuth "Front Camera Object Detection and Processing Burst 5 Protected : Forward Vision Lane Boundary Track 10 Type Authenticated";
BA_ "SignalType" SG_ 235 FCODPB5P_FVLBTk10QltyAuth "ENM";
BA_ "SignalLongName" SG_ 235 FCODPB5P_FVLBTk10QltyAuth "Front Camera Object Detection and Processing Burst 5 Protected : Forward Vision Lane Boundary Track 10 Quality Authenticated";
BA_ "SignalLongName" SG_ 235 FCODPB5P_FVLBTk10VSLgDistAuth "Front Camera Object Detection and Processing Burst 5 Protected : Forward Vision Lane Boundary Track 10 View Start Longitudinal Distance Authenticated";
BA_ "SignalLongName" SG_ 235 FCODPB5P_FVLBTk10VRLgDistAuth "Front Camera Object Detection and Processing Burst 5 Protected : Forward Vision Lane Boundary Track 10 View Range Longitudinal Distance Authenticated";
BA_ "SignalLongName" SG_ 235 FCODPB5P_FVLBTk10WdthAuth "Front Camera Object Detection and Processing Burst 5 Protected : Forward Vision Lane Boundary Track 10 Width Authenticated";
BA_ "SignalLongName" SG_ 235 FCODPB5P_FVLBTk5CrvAuth "Front Camera Object Detection and Processing Burst 5 Protected : Forward Vision Lane Boundary Track 5 Curvature Authenticated";
BA_ "SignalType" SG_ 235 FCODPB5P_FVLBTk5ClrAuth "ENM";
BA_ "SignalLongName" SG_ 235 FCODPB5P_FVLBTk5ClrAuth "Front Camera Object Detection and Processing Burst 5 Protected : Forward Vision Lane Boundary Track 5 Color Authenticated";
BA_ "SignalLongName" SG_ 235 FCODPB5P_FVLBTk5CrvDrvtAuth "Front Camera Object Detection and Processing Burst 5 Protected : Forward Vision Lane Boundary Track 5 Curvature Derivative Authenticated";
BA_ "SignalLongName" SG_ 235 FCODPB5P_FVLBTk5FPSABCQOvrAuth "Front Camera Object Detection and Processing Burst 5 Protected : Forward Vision Lane Boundary Track 5 First Polynomial Segment ABC Quality Overall Authenticated";
BA_ "SignalLongName" SG_ 235 FCODPB5P_FVLBTk5FPSAQAuth "Front Camera Object Detection and Processing Burst 5 Protected : Forward Vision Lane Boundary Track 5 First Polynomial Segment A Quality Authenticated";
BA_ "SignalLongName" SG_ 235 FCODPB5P_FVLBTk5FPSBQAuth "Front Camera Object Detection and Processing Burst 5 Protected : Forward Vision Lane Boundary Track 5 First Polynomial Segment B Quality Authenticated";
BA_ "SignalLongName" SG_ 235 FCODPB5P_FVLBTk5FPSCQAuth "Front Camera Object Detection and Processing Burst 5 Protected : Forward Vision Lane Boundary Track 5 First Polynomial Segment C Quality Authenticated";
BA_ "SignalLongName" SG_ 235 FCODPB5P_FVLBTk5HdgAuth "Front Camera Object Detection and Processing Burst 5 Protected : Forward Vision Lane Boundary Track 5 Heading Authenticated";
BA_ "SignalLongName" SG_ 235 FCODPB5P_FVLBTk5OfstAuth "Front Camera Object Detection and Processing Burst 5 Protected : Forward Vision Lane Boundary Track 5 Offset Authenticated";
BA_ "SignalType" SG_ 235 FCODPB5P_FVLBTk5TypAuth "ENM";
BA_ "SignalLongName" SG_ 235 FCODPB5P_FVLBTk5TypAuth "Front Camera Object Detection and Processing Burst 5 Protected : Forward Vision Lane Boundary Track 5 Type Authenticated";
BA_ "SignalType" SG_ 235 FCODPB5P_FVLBTk5QltyAuth "ENM";
BA_ "SignalLongName" SG_ 235 FCODPB5P_FVLBTk5QltyAuth "Front Camera Object Detection and Processing Burst 5 Protected : Forward Vision Lane Boundary Track 5 Quality Authenticated";
BA_ "SignalType" SG_ 235 FCODPB5P_FVLBTk5PstnTypAuth "ENM";
BA_ "SignalLongName" SG_ 235 FCODPB5P_FVLBTk5PstnTypAuth "Front Camera Object Detection and Processing Burst 5 Protected : Forward Vision Lane Boundary Track 5 Position Type Authenticated";
BA_ "SignalLongName" SG_ 235 FCODPB5P_FVLBTk5VRLgDistAuth "Front Camera Object Detection and Processing Burst 5 Protected : Forward Vision Lane Boundary Track 5 View Range Longitudinal Distance Authenticated";
BA_ "SignalLongName" SG_ 235 FCODPB5P_FVLBTk5VSLgDistAuth "Front Camera Object Detection and Processing Burst 5 Protected : Forward Vision Lane Boundary Track 5 View Start Longitudinal Distance Authenticated";
BA_ "SignalType" SG_ 235 FCODPB5P_FVPOTk5CnfdStsAuth "ENM";
BA_ "SignalLongName" SG_ 235 FCODPB5P_FVPOTk5CnfdStsAuth "Front Camera Object Detection and Processing Burst 5 Protected : Forward Vision Pedestrian Object Track 5 Confidence Status Authenticated";
BA_ "SignalLongName" SG_ 235 FCODPB5P_FVLBTk5WdthAuth "Front Camera Object Detection and Processing Burst 5 Protected : Forward Vision Lane Boundary Track 5 Width Authenticated";
BA_ "SignalLongName" SG_ 235 FCODPB5P_FVPOTk5IDAuth "Front Camera Object Detection and Processing Burst 5 Protected : Forward Vision Pedestrian Object Track 5 ID Authenticated";
BA_ "SignalType" SG_ 235 FCODPB5P_FVPOTk5DynPrpAuth "ENM";
BA_ "SignalLongName" SG_ 235 FCODPB5P_FVPOTk5DynPrpAuth "Front Camera Object Detection and Processing Burst 5 Protected : Forward Vision Pedestrian Object Track 5 Dynamic Property Authenticated";
BA_ "SignalType" SG_ 235 FCODPB5P_FVPOTk5MStsAuth "ENM";
BA_ "SignalLongName" SG_ 235 FCODPB5P_FVPOTk5MStsAuth "Front Camera Object Detection and Processing Burst 5 Protected : Forward Vision Pedestrian Object Track 5 Measurement Status Authenticated";
BA_ "SignalLongName" SG_ 235 FCODPB5P_FVPOTk5InPthPotAuth "Front Camera Object Detection and Processing Burst 5 Protected : Forward Vision Pedestrian Object Track 5 In Path Potential Authenticated";
BA_ "SignalLongName" SG_ 235 FCODPB5P_FVPOTk5PoILAAuth "Front Camera Object Detection and Processing Burst 5 Protected : Forward Vision Pedestrian Object Track 5 Point of Interest Lateral Acceleration Authenticated";
BA_ "SignalLongName" SG_ 235 FCODPB5P_FVPOTk5PoILgAAuth "Front Camera Object Detection and Processing Burst 5 Protected : Forward Vision Pedestrian Object Track 5 Point of Interest Longitudinal Acceleration Authenticated";
BA_ "SignalLongName" SG_ 235 FCODPB5P_FVPOTk5PoILgPsAuth "Front Camera Object Detection and Processing Burst 5 Protected : Forward Vision Pedestrian Object Track 5 Point of Interest Longitudinal Position Authenticated";
BA_ "SignalLongName" SG_ 235 FCODPB5P_FVPOTk5PoILgVAuth "Front Camera Object Detection and Processing Burst 5 Protected : Forward Vision Pedestrian Object Track 5 Point of Interest Longitudinal Velocity Authenticated";
BA_ "SignalLongName" SG_ 235 FCODPB5P_FVPOTk5PoILPsAuth "Front Camera Object Detection and Processing Burst 5 Protected : Forward Vision Pedestrian Object Track 5 Point of Interest Lateral Position Authenticated";
BA_ "SignalLongName" SG_ 235 FCODPB5P_FVPOTk5PoILVAuth "Front Camera Object Detection and Processing Burst 5 Protected : Forward Vision Pedestrian Object Track 5 Point of Interest Lateral Velocity Authenticated";
BA_ "SignalType" SG_ 235 FCODPB5P_FVVOTk5BrkLgtStsAuth "ENM";
BA_ "SignalLongName" SG_ 235 FCODPB5P_FVVOTk5BrkLgtStsAuth "Front Camera Object Detection and Processing Burst 5 Protected : Forward Vision Vehicle Object Track 5 Brake Light Status Authenticated";
BA_ "SignalType" SG_ 235 FCODPB5P_FVPOTk5TypCnfdAuth "ENM";
BA_ "SignalLongName" SG_ 235 FCODPB5P_FVPOTk5TypCnfdAuth "Front Camera Object Detection and Processing Burst 5 Protected : Forward Vision Pedestrian Object Track 5 Type Confidence Authenticated";
BA_ "SignalType" SG_ 235 FCODPB5P_FVPOTk5TypAuth "ENM";
BA_ "SignalLongName" SG_ 235 FCODPB5P_FVPOTk5TypAuth "Front Camera Object Detection and Processing Burst 5 Protected : Forward Vision Pedestrian Object Track 5 Type Authenticated";
BA_ "SignalType" SG_ 235 FCODPB5P_FVVOTk5CnfdStsAuth "ENM";
BA_ "SignalLongName" SG_ 235 FCODPB5P_FVVOTk5CnfdStsAuth "Front Camera Object Detection and Processing Burst 5 Protected : Forward Vision Vehicle Object Track 5 Confidence Status Authenticated";
BA_ "SignalLongName" SG_ 235 FCODPB5P_FVVOTk5CICOPotAuth "Front Camera Object Detection and Processing Burst 5 Protected : Forward Vision Vehicle Object Track 5 Cut In Cut Out Potential Authenticated";
BA_ "SignalLongName" SG_ 235 FCODPB5P_FVVOTk5HdgAngAuth "Front Camera Object Detection and Processing Burst 5 Protected : Forward Vision Vehicle Object Track 5 Heading Angle Authenticated";
BA_ "SignalType" SG_ 235 FCODPB5P_FVVOTk5DynPrpStsAuth "ENM";
BA_ "SignalLongName" SG_ 235 FCODPB5P_FVVOTk5DynPrpStsAuth "Front Camera Object Detection and Processing Burst 5 Protected : Forward Vision Vehicle Object Track 5 Dynamic Property Status Authenticated";
BA_ "SignalType" SG_ 235 FCODPB5P_FVVOTk5DynPrpAuth "ENM";
BA_ "SignalLongName" SG_ 235 FCODPB5P_FVVOTk5DynPrpAuth "Front Camera Object Detection and Processing Burst 5 Protected : Forward Vision Vehicle Object Track 5 Dynamic Property Authenticated";
BA_ "SignalLongName" SG_ 235 FCODPB5P_FVVOTk5HdgAngCAuth "Front Camera Object Detection and Processing Burst 5 Protected : Forward Vision Vehicle Object Track 5 Heading Angle Covariance Authenticated";
BA_ "SignalLongName" SG_ 235 FCODPB5P_FVVOTk5IDAuth "Front Camera Object Detection and Processing Burst 5 Protected : Forward Vision Vehicle Object Track 5 ID Authenticated";
BA_ "SignalType" SG_ 235 FCODPB5P_FVVOTk5MStsAuth "ENM";
BA_ "SignalLongName" SG_ 235 FCODPB5P_FVVOTk5MStsAuth "Front Camera Object Detection and Processing Burst 5 Protected : Forward Vision Vehicle Object Track 5 Measurement Status Authenticated";
BA_ "SignalType" SG_ 235 FCODPB5P_FVVOTk5LnAsmtAuth "ENM";
BA_ "SignalLongName" SG_ 235 FCODPB5P_FVVOTk5LnAsmtAuth "Front Camera Object Detection and Processing Burst 5 Protected : Forward Vision Vehicle Object Track 5 Lane Assignment Authenticated";
BA_ "SignalLongName" SG_ 235 FCODPB5P_FVVOTk5PoILAAuth "Front Camera Object Detection and Processing Burst 5 Protected : Forward Vision Vehicle Object Track 5 Point of Interest Lateral Acceleration Authenticated";
BA_ "SignalLongName" SG_ 235 FCODPB5P_FVVOTk5PoILgAAuth "Front Camera Object Detection and Processing Burst 5 Protected : Forward Vision Vehicle Object Track 5 Point of Interest Longitudinal Acceleration Authenticated";
BA_ "SignalLongName" SG_ 235 FCODPB5P_FVVOTk5PoILgPsAuth "Front Camera Object Detection and Processing Burst 5 Protected : Forward Vision Vehicle Object Track 5 Point of Interest Longitudinal Position Authenticated";
BA_ "SignalLongName" SG_ 235 FCODPB5P_FVVOTk5PoILgPsCAuth "Front Camera Object Detection and Processing Burst 5 Protected : Forward Vision Vehicle Object Track 5 Point of Interest Longitudinal Position Covariance Authenticated";
BA_ "SignalLongName" SG_ 235 FCODPB5P_FVVOTk5PoILgVAuth "Front Camera Object Detection and Processing Burst 5 Protected : Forward Vision Vehicle Object Track 5 Point of Interest Longitudinal Velocity Authenticated";
BA_ "SignalLongName" SG_ 235 FCODPB5P_FVVOTk5PoILgVCAuth "Front Camera Object Detection and Processing Burst 5 Protected : Forward Vision Vehicle Object Track 5 Point of Interest Longitudinal Velocity Covariance Authenticated";
BA_ "SignalLongName" SG_ 235 FCODPB5P_FVVOTk5PoILPsAuth "Front Camera Object Detection and Processing Burst 5 Protected : Forward Vision Vehicle Object Track 5 Point of Interest Lateral Position Authenticated";
BA_ "SignalLongName" SG_ 235 FCODPB5P_FVVOTk5PoILPsCAuth "Front Camera Object Detection and Processing Burst 5 Protected : Forward Vision Vehicle Object Track 5 Point of Interest Lateral Position Covariance Authenticated";
BA_ "SignalLongName" SG_ 235 FCODPB5P_FVVOTk5PoILVAuth "Front Camera Object Detection and Processing Burst 5 Protected : Forward Vision Vehicle Object Track 5 Point of Interest Lateral Velocity Authenticated";
BA_ "SignalLongName" SG_ 235 FCODPB5P_FVVOTk5PoILVCAuth "Front Camera Object Detection and Processing Burst 5 Protected : Forward Vision Vehicle Object Track 5 Point of Interest Lateral Velocity Covariance Authenticated";
BA_ "SignalLongName" SG_ 235 FCODPB5P_FVVOTk5PoIWAuth "Front Camera Object Detection and Processing Burst 5 Protected : Forward Vision Vehicle Object Track 5 Point of Interest Width Authenticated";
BA_ "SignalType" SG_ 235 FCODPB5P_FVVOTk5TypAuth "ENM";
BA_ "SignalLongName" SG_ 235 FCODPB5P_FVVOTk5TypAuth "Front Camera Object Detection and Processing Burst 5 Protected : Forward Vision Vehicle Object Track 5 Type Authenticated";
BA_ "SignalType" SG_ 235 FCODPB5P_FVVOTk5TSLgtStsAuth "ENM";
BA_ "SignalLongName" SG_ 235 FCODPB5P_FVVOTk5TSLgtStsAuth "Front Camera Object Detection and Processing Burst 5 Protected : Forward Vision Vehicle Object Track 5 Turn Signal Light Status Authenticated";
BA_ "SignalType" SG_ 235 FrwdVsnVehObjTk5DatIntegCkd "ENM";
BA_ "SignalLongName" SG_ 235 FrwdVsnVehObjTk5DatIntegCkd "Front Camera Object Detection and Processing Burst 5 Protected : Forward Vision Vehicle Object Track 5 Data Integrity Checked";
BA_ "SignalType" SG_ 235 FrwdVsnPedtrnObjTk5DatIntegCkd "ENM";
BA_ "SignalLongName" SG_ 235 FrwdVsnPedtrnObjTk5DatIntegCkd "Front Camera Object Detection and Processing Burst 5 Protected : Forward Vision Pedestrian Object Track 5 Data Integrity Checked";
BA_ "SignalType" SG_ 235 FrwdVsnLnBdryTk5DatIntegCkd "ENM";
BA_ "SignalLongName" SG_ 235 FrwdVsnLnBdryTk5DatIntegCkd "Front Camera Object Detection and Processing Burst 5 Protected : Forward Vision Lane Boundary Track 5 Data Integrity Checked";
BA_ "SignalType" SG_ 235 FCODPB5P_FVVOTk5TypCnfdAuth "ENM";
BA_ "SignalLongName" SG_ 235 FCODPB5P_FVVOTk5TypCnfdAuth "Front Camera Object Detection and Processing Burst 5 Protected : Forward Vision Vehicle Object Track 5 Type Confidence Authenticated";
BA_ "SignalLongName" SG_ 235 FCODPB5P_Filler "Front Camera Object Detection and Processing Burst 5 Protected : Filler";
BA_ "SignalLongName" SG_ 220 FCODPB6P_FVLBTk6CrvAuth "Front Camera Object Detection and Processing Burst 6 Protected : Forward Vision Lane Boundary Track 6 Curvature Authenticated";
BA_ "SignalType" SG_ 220 FCODPB6P_FVLBTk6ClrAuth "ENM";
BA_ "SignalLongName" SG_ 220 FCODPB6P_FVLBTk6ClrAuth "Front Camera Object Detection and Processing Burst 6 Protected : Forward Vision Lane Boundary Track 6 Color Authenticated";
BA_ "SignalLongName" SG_ 220 FCODPB6P_BrstID "Front Camera Object Detection and Processing Burst 6 Protected : Burst ID";
BA_ "SignalLongName" SG_ 220 FCODPB6P_FVLBTk6CrvDrvtAuth "Front Camera Object Detection and Processing Burst 6 Protected : Forward Vision Lane Boundary Track 6 Curvature Derivative Authenticated";
BA_ "SignalLongName" SG_ 220 FCODPB6P_FVLBTk6FPSABCQOvrAuth "Front Camera Object Detection and Processing Burst 6 Protected : Forward Vision Lane Boundary Track 6 First Polynomial Segment ABC Quality Overall Authenticated";
BA_ "SignalLongName" SG_ 220 FCODPB6P_FVLBTk6FPSAQAuth "Front Camera Object Detection and Processing Burst 6 Protected : Forward Vision Lane Boundary Track 6 First Polynomial Segment A Quality Authenticated";
BA_ "SignalLongName" SG_ 220 FCODPB6P_FVLBTk6FPSBQAuth "Front Camera Object Detection and Processing Burst 6 Protected : Forward Vision Lane Boundary Track 6 First Polynomial Segment B Quality Authenticated";
BA_ "SignalLongName" SG_ 220 FCODPB6P_FVLBTk6FPSCQAuth "Front Camera Object Detection and Processing Burst 6 Protected : Forward Vision Lane Boundary Track 6 First Polynomial Segment C Quality Authenticated";
BA_ "SignalLongName" SG_ 220 FCODPB6P_FVLBTk6HdgAuth "Front Camera Object Detection and Processing Burst 6 Protected : Forward Vision Lane Boundary Track 6 Heading Authenticated";
BA_ "SignalLongName" SG_ 220 FCODPB6P_FVLBTk6OfstAuth "Front Camera Object Detection and Processing Burst 6 Protected : Forward Vision Lane Boundary Track 6 Offset Authenticated";
BA_ "SignalType" SG_ 220 FCODPB6P_FVLBTk6PstnTypAuth "ENM";
BA_ "SignalLongName" SG_ 220 FCODPB6P_FVLBTk6PstnTypAuth "Front Camera Object Detection and Processing Burst 6 Protected : Forward Vision Lane Boundary Track 6 Position Type Authenticated";
BA_ "SignalType" SG_ 220 FCODPB6P_FVLBTk6TypAuth "ENM";
BA_ "SignalLongName" SG_ 220 FCODPB6P_FVLBTk6TypAuth "Front Camera Object Detection and Processing Burst 6 Protected : Forward Vision Lane Boundary Track 6 Type Authenticated";
BA_ "SignalType" SG_ 220 FCODPB6P_FVLBTk6QltyAuth "ENM";
BA_ "SignalLongName" SG_ 220 FCODPB6P_FVLBTk6QltyAuth "Front Camera Object Detection and Processing Burst 6 Protected : Forward Vision Lane Boundary Track 6 Quality Authenticated";
BA_ "SignalLongName" SG_ 220 FCODPB6P_FVLBTk6VSLgDistAuth "Front Camera Object Detection and Processing Burst 6 Protected : Forward Vision Lane Boundary Track 6 View Start Longitudinal Distance Authenticated";
BA_ "SignalLongName" SG_ 220 FCODPB6P_FVLBTk6VRLgDistAuth "Front Camera Object Detection and Processing Burst 6 Protected : Forward Vision Lane Boundary Track 6 View Range Longitudinal Distance Authenticated";
BA_ "SignalLongName" SG_ 220 FCODPB6P_FVLBTk6WdthAuth "Front Camera Object Detection and Processing Burst 6 Protected : Forward Vision Lane Boundary Track 6 Width Authenticated";
BA_ "SignalLongName" SG_ 220 FCODPB6P_FVVOTk10CICOPotAuth "Front Camera Object Detection and Processing Burst 6 Protected : Forward Vision Vehicle Object Track 10 Cut In Cut Out Potential Authenticated";
BA_ "SignalType" SG_ 220 FCODPB6P_FVVOTk10BrkLgtStsAuth "ENM";
BA_ "SignalLongName" SG_ 220 FCODPB6P_FVVOTk10BrkLgtStsAuth "Front Camera Object Detection and Processing Burst 6 Protected : Forward Vision Vehicle Object Track 10 Brake Light Status Authenticated";
BA_ "SignalType" SG_ 220 FCODPB6P_FVVOTk10DynPrpAuth "ENM";
BA_ "SignalLongName" SG_ 220 FCODPB6P_FVVOTk10DynPrpAuth "Front Camera Object Detection and Processing Burst 6 Protected : Forward Vision Vehicle Object Track 10 Dynamic Property Authenticated";
BA_ "SignalType" SG_ 220 FCODPB6P_FVVOTk10CnfdStsAuth "ENM";
BA_ "SignalLongName" SG_ 220 FCODPB6P_FVVOTk10CnfdStsAuth "Front Camera Object Detection and Processing Burst 6 Protected : Forward Vision Vehicle Object Track 10 Confidence Status Authenticated";
BA_ "SignalLongName" SG_ 220 FCODPB6P_FVVOTk10HdgAngAuth "Front Camera Object Detection and Processing Burst 6 Protected : Forward Vision Vehicle Object Track 10 Heading Angle Authenticated";
BA_ "SignalType" SG_ 220 FCODPB6P_FVVOTk10DynPrpStsAuth "ENM";
BA_ "SignalLongName" SG_ 220 FCODPB6P_FVVOTk10DynPrpStsAuth "Front Camera Object Detection and Processing Burst 6 Protected : Forward Vision Vehicle Object Track 10 Dynamic Property Status Authenticated";
BA_ "SignalLongName" SG_ 220 FCODPB6P_FVVOTk10HdgAngCAuth "Front Camera Object Detection and Processing Burst 6 Protected : Forward Vision Vehicle Object Track 10 Heading Angle Covariance Authenticated";
BA_ "SignalLongName" SG_ 220 FCODPB6P_FVVOTk10IDAuth "Front Camera Object Detection and Processing Burst 6 Protected : Forward Vision Vehicle Object Track 10 ID Authenticated";
BA_ "SignalLongName" SG_ 220 FCODPB6P_FVVOTk10PoILAAuth "Front Camera Object Detection and Processing Burst 6 Protected : Forward Vision Vehicle Object Track 10 Point of Interest Lateral Acceleration Authenticated";
BA_ "SignalType" SG_ 220 FCODPB6P_FVVOTk10MStsAuth "ENM";
BA_ "SignalLongName" SG_ 220 FCODPB6P_FVVOTk10MStsAuth "Front Camera Object Detection and Processing Burst 6 Protected : Forward Vision Vehicle Object Track 10 Measurement Status Authenticated";
BA_ "SignalType" SG_ 220 FCODPB6P_FVVOTk10LnAsmtAuth "ENM";
BA_ "SignalLongName" SG_ 220 FCODPB6P_FVVOTk10LnAsmtAuth "Front Camera Object Detection and Processing Burst 6 Protected : Forward Vision Vehicle Object Track 10 Lane Assignment Authenticated";
BA_ "SignalLongName" SG_ 220 FCODPB6P_FVVOTk10PoILgAAuth "Front Camera Object Detection and Processing Burst 6 Protected : Forward Vision Vehicle Object Track 10 Point of Interest Longitudinal Acceleration Authenticated";
BA_ "SignalLongName" SG_ 220 FCODPB6P_FVVOTk10PoILgPsAuth "Front Camera Object Detection and Processing Burst 6 Protected : Forward Vision Vehicle Object Track 10 Point of Interest Longitudinal Position Authenticated";
BA_ "SignalLongName" SG_ 220 FCODPB6P_FVVOTk10PoILgPsCAuth "Front Camera Object Detection and Processing Burst 6 Protected : Forward Vision Vehicle Object Track 10 Point of Interest Longitudinal Position Covariance Authenticated";
BA_ "SignalLongName" SG_ 220 FCODPB6P_FVVOTk10PoILgVAuth "Front Camera Object Detection and Processing Burst 6 Protected : Forward Vision Vehicle Object Track 10 Point of Interest Longitudinal Velocity Authenticated";
BA_ "SignalLongName" SG_ 220 FCODPB6P_FVVOTk10PoILgVCAuth "Front Camera Object Detection and Processing Burst 6 Protected : Forward Vision Vehicle Object Track 10 Point of Interest Longitudinal Velocity Covariance Authenticated";
BA_ "SignalLongName" SG_ 220 FCODPB6P_FVVOTk10PoILPsAuth "Front Camera Object Detection and Processing Burst 6 Protected : Forward Vision Vehicle Object Track 10 Point of Interest Lateral Position Authenticated";
BA_ "SignalLongName" SG_ 220 FCODPB6P_FVVOTk10PoILPsCAuth "Front Camera Object Detection and Processing Burst 6 Protected : Forward Vision Vehicle Object Track 10 Point of Interest Lateral Position Covariance Authenticated";
BA_ "SignalLongName" SG_ 220 FCODPB6P_FVVOTk10PoILVAuth "Front Camera Object Detection and Processing Burst 6 Protected : Forward Vision Vehicle Object Track 10 Point of Interest Lateral Velocity Authenticated";
BA_ "SignalLongName" SG_ 220 FCODPB6P_FVVOTk10PoILVCAuth "Front Camera Object Detection and Processing Burst 6 Protected : Forward Vision Vehicle Object Track 10 Point of Interest Lateral Velocity Covariance Authenticated";
BA_ "SignalLongName" SG_ 220 FCODPB6P_FVVOTk10PoIWAuth "Front Camera Object Detection and Processing Burst 6 Protected : Forward Vision Vehicle Object Track 10 Point of Interest Width Authenticated";
BA_ "SignalType" SG_ 220 FCODPB6P_FVVOTk6BrkLgtStsAuth "ENM";
BA_ "SignalLongName" SG_ 220 FCODPB6P_FVVOTk6BrkLgtStsAuth "Front Camera Object Detection and Processing Burst 6 Protected : Forward Vision Vehicle Object Track 6 Brake Light Status Authenticated";
BA_ "SignalType" SG_ 220 FCODPB6P_FVVOTk10TypCnfdAuth "ENM";
BA_ "SignalLongName" SG_ 220 FCODPB6P_FVVOTk10TypCnfdAuth "Front Camera Object Detection and Processing Burst 6 Protected : Forward Vision Vehicle Object Track 10 Type Confidence Authenticated";
BA_ "SignalType" SG_ 220 FCODPB6P_FVVOTk10TypAuth "ENM";
BA_ "SignalLongName" SG_ 220 FCODPB6P_FVVOTk10TypAuth "Front Camera Object Detection and Processing Burst 6 Protected : Forward Vision Vehicle Object Track 10 Type Authenticated";
BA_ "SignalType" SG_ 220 FCODPB6P_FVVOTk10TSLgtStsAuth "ENM";
BA_ "SignalLongName" SG_ 220 FCODPB6P_FVVOTk10TSLgtStsAuth "Front Camera Object Detection and Processing Burst 6 Protected : Forward Vision Vehicle Object Track 10 Turn Signal Light Status Authenticated";
BA_ "SignalType" SG_ 220 FCODPB6P_FVVOTk6CnfdStsAuth "ENM";
BA_ "SignalLongName" SG_ 220 FCODPB6P_FVVOTk6CnfdStsAuth "Front Camera Object Detection and Processing Burst 6 Protected : Forward Vision Vehicle Object Track 6 Confidence Status Authenticated";
BA_ "SignalLongName" SG_ 220 FCODPB6P_FVVOTk6CICOPotAuth "Front Camera Object Detection and Processing Burst 6 Protected : Forward Vision Vehicle Object Track 6 Cut In Cut Out Potential Authenticated";
BA_ "SignalLongName" SG_ 220 FCODPB6P_FVVOTk6HdgAngAuth "Front Camera Object Detection and Processing Burst 6 Protected : Forward Vision Vehicle Object Track 6 Heading Angle Authenticated";
BA_ "SignalType" SG_ 220 FCODPB6P_FVVOTk6DynPrpStsAuth "ENM";
BA_ "SignalLongName" SG_ 220 FCODPB6P_FVVOTk6DynPrpStsAuth "Front Camera Object Detection and Processing Burst 6 Protected : Forward Vision Vehicle Object Track 6 Dynamic Property Status Authenticated";
BA_ "SignalType" SG_ 220 FCODPB6P_FVVOTk6DynPrpAuth "ENM";
BA_ "SignalLongName" SG_ 220 FCODPB6P_FVVOTk6DynPrpAuth "Front Camera Object Detection and Processing Burst 6 Protected : Forward Vision Vehicle Object Track 6 Dynamic Property Authenticated";
BA_ "SignalLongName" SG_ 220 FCODPB6P_FVVOTk6HdgAngCAuth "Front Camera Object Detection and Processing Burst 6 Protected : Forward Vision Vehicle Object Track 6 Heading Angle Covariance Authenticated";
BA_ "SignalLongName" SG_ 220 FCODPB6P_FVVOTk6IDAuth "Front Camera Object Detection and Processing Burst 6 Protected : Forward Vision Vehicle Object Track 6 ID Authenticated";
BA_ "SignalType" SG_ 220 FCODPB6P_FVVOTk6MStsAuth "ENM";
BA_ "SignalLongName" SG_ 220 FCODPB6P_FVVOTk6MStsAuth "Front Camera Object Detection and Processing Burst 6 Protected : Forward Vision Vehicle Object Track 6 Measurement Status Authenticated";
BA_ "SignalType" SG_ 220 FCODPB6P_FVVOTk6LnAsmtAuth "ENM";
BA_ "SignalLongName" SG_ 220 FCODPB6P_FVVOTk6LnAsmtAuth "Front Camera Object Detection and Processing Burst 6 Protected : Forward Vision Vehicle Object Track 6 Lane Assignment Authenticated";
BA_ "SignalLongName" SG_ 220 FCODPB6P_FVVOTk6PoILAAuth "Front Camera Object Detection and Processing Burst 6 Protected : Forward Vision Vehicle Object Track 6 Point of Interest Lateral Acceleration Authenticated";
BA_ "SignalLongName" SG_ 220 FCODPB6P_FVVOTk6PoILgAAuth "Front Camera Object Detection and Processing Burst 6 Protected : Forward Vision Vehicle Object Track 6 Point of Interest Longitudinal Acceleration Authenticated";
BA_ "SignalLongName" SG_ 220 FCODPB6P_FVVOTk6PoILgPsAuth "Front Camera Object Detection and Processing Burst 6 Protected : Forward Vision Vehicle Object Track 6 Point of Interest Longitudinal Position Authenticated";
BA_ "SignalLongName" SG_ 220 FCODPB6P_FVVOTk6PoILgPsCAuth "Front Camera Object Detection and Processing Burst 6 Protected : Forward Vision Vehicle Object Track 6 Point of Interest Longitudinal Position Covariance Authenticated";
BA_ "SignalLongName" SG_ 220 FCODPB6P_FVVOTk6PoILgVAuth "Front Camera Object Detection and Processing Burst 6 Protected : Forward Vision Vehicle Object Track 6 Point of Interest Longitudinal Velocity Authenticated";
BA_ "SignalLongName" SG_ 220 FCODPB6P_FVVOTk6PoILgVCAuth "Front Camera Object Detection and Processing Burst 6 Protected : Forward Vision Vehicle Object Track 6 Point of Interest Longitudinal Velocity Covariance Authenticated";
BA_ "SignalLongName" SG_ 220 FCODPB6P_FVVOTk6PoILPsAuth "Front Camera Object Detection and Processing Burst 6 Protected : Forward Vision Vehicle Object Track 6 Point of Interest Lateral Position Authenticated";
BA_ "SignalLongName" SG_ 220 FCODPB6P_FVVOTk6PoILPsCAuth "Front Camera Object Detection and Processing Burst 6 Protected : Forward Vision Vehicle Object Track 6 Point of Interest Lateral Position Covariance Authenticated";
BA_ "SignalLongName" SG_ 220 FCODPB6P_FVVOTk6PoILVAuth "Front Camera Object Detection and Processing Burst 6 Protected : Forward Vision Vehicle Object Track 6 Point of Interest Lateral Velocity Authenticated";
BA_ "SignalLongName" SG_ 220 FCODPB6P_FVVOTk6PoILVCAuth "Front Camera Object Detection and Processing Burst 6 Protected : Forward Vision Vehicle Object Track 6 Point of Interest Lateral Velocity Covariance Authenticated";
BA_ "SignalLongName" SG_ 220 FCODPB6P_FVVOTk6PoIWAuth "Front Camera Object Detection and Processing Burst 6 Protected : Forward Vision Vehicle Object Track 6 Point of Interest Width Authenticated";
BA_ "SignalType" SG_ 220 FCODPB6P_FVVOTk6TypAuth "ENM";
BA_ "SignalLongName" SG_ 220 FCODPB6P_FVVOTk6TypAuth "Front Camera Object Detection and Processing Burst 6 Protected : Forward Vision Vehicle Object Track 6 Type Authenticated";
BA_ "SignalType" SG_ 220 FCODPB6P_FVVOTk6TSLgtStsAuth "ENM";
BA_ "SignalLongName" SG_ 220 FCODPB6P_FVVOTk6TSLgtStsAuth "Front Camera Object Detection and Processing Burst 6 Protected : Forward Vision Vehicle Object Track 6 Turn Signal Light Status Authenticated";
BA_ "SignalLongName" SG_ 220 FCODPB6P_Filler "Front Camera Object Detection and Processing Burst 6 Protected : Filler";
BA_ "SignalType" SG_ 220 FrwdVsnVehObjTk6DatIntegCkd "ENM";
BA_ "SignalLongName" SG_ 220 FrwdVsnVehObjTk6DatIntegCkd "Front Camera Object Detection and Processing Burst 6 Protected : Forward Vision Vehicle Object Track 6 Data Integrity Checked";
BA_ "SignalType" SG_ 220 FrwdVsnLnBdryTk6DatIntegCkd "ENM";
BA_ "SignalLongName" SG_ 220 FrwdVsnLnBdryTk6DatIntegCkd "Front Camera Object Detection and Processing Burst 6 Protected : Forward Vision Lane Boundary Track 6 Data Integrity Checked";
BA_ "SignalType" SG_ 220 FCODPB6P_FVVOTk6TypCnfdAuth "ENM";
BA_ "SignalLongName" SG_ 220 FCODPB6P_FVVOTk6TypCnfdAuth "Front Camera Object Detection and Processing Burst 6 Protected : Forward Vision Vehicle Object Track 6 Type Confidence Authenticated";
BA_ "SignalLongName" SG_ 220 FCODPB6P_FillerExtnd "Front Camera Object Detection and Processing Burst 6 Protected : Filler Extended";
BA_ "SignalLongName" SG_ 236 FCODPB7P_FVLBTk7CrvAuth "Front Camera Object Detection and Processing Burst 7 Protected : Forward Vision Lane Boundary Track 7 Curvature Authenticated";
BA_ "SignalType" SG_ 236 FCODPB7P_FVLBTk7ClrAuth "ENM";
BA_ "SignalLongName" SG_ 236 FCODPB7P_FVLBTk7ClrAuth "Front Camera Object Detection and Processing Burst 7 Protected : Forward Vision Lane Boundary Track 7 Color Authenticated";
BA_ "SignalLongName" SG_ 236 FCODPB7P_BrstID "Front Camera Object Detection and Processing Burst 7 Protected : Burst ID";
BA_ "SignalLongName" SG_ 236 FCODPB7P_FVLBTk7CrvDrvtAuth "Front Camera Object Detection and Processing Burst 7 Protected : Forward Vision Lane Boundary Track 7 Curvature Derivative Authenticated";
BA_ "SignalLongName" SG_ 236 FCODPB7P_FVLBTk7FPSABCQOvrAuth "Front Camera Object Detection and Processing Burst 7 Protected : Forward Vision Lane Boundary Track 7 First Polynomial Segment ABC Quality Overall Authenticated";
BA_ "SignalLongName" SG_ 236 FCODPB7P_FVLBTk7FPSAQAuth "Front Camera Object Detection and Processing Burst 7 Protected : Forward Vision Lane Boundary Track 7 First Polynomial Segment A Quality Authenticated";
BA_ "SignalLongName" SG_ 236 FCODPB7P_FVLBTk7FPSBQAuth "Front Camera Object Detection and Processing Burst 7 Protected : Forward Vision Lane Boundary Track 7 First Polynomial Segment B Quality Authenticated";
BA_ "SignalLongName" SG_ 236 FCODPB7P_FVLBTk7FPSCQAuth "Front Camera Object Detection and Processing Burst 7 Protected : Forward Vision Lane Boundary Track 7 First Polynomial Segment C Quality Authenticated";
BA_ "SignalLongName" SG_ 236 FCODPB7P_FVLBTk7HdgAuth "Front Camera Object Detection and Processing Burst 7 Protected : Forward Vision Lane Boundary Track 7 Heading Authenticated";
BA_ "SignalLongName" SG_ 236 FCODPB7P_FVLBTk7OfstAuth "Front Camera Object Detection and Processing Burst 7 Protected : Forward Vision Lane Boundary Track 7 Offset Authenticated";
BA_ "SignalType" SG_ 236 FCODPB7P_FVLBTk7PstnTypAuth "ENM";
BA_ "SignalLongName" SG_ 236 FCODPB7P_FVLBTk7PstnTypAuth "Front Camera Object Detection and Processing Burst 7 Protected : Forward Vision Lane Boundary Track 7 Position Type Authenticated";
BA_ "SignalType" SG_ 236 FCODPB7P_FVLBTk7TypAuth "ENM";
BA_ "SignalLongName" SG_ 236 FCODPB7P_FVLBTk7TypAuth "Front Camera Object Detection and Processing Burst 7 Protected : Forward Vision Lane Boundary Track 7 Type Authenticated";
BA_ "SignalType" SG_ 236 FCODPB7P_FVLBTk7QltyAuth "ENM";
BA_ "SignalLongName" SG_ 236 FCODPB7P_FVLBTk7QltyAuth "Front Camera Object Detection and Processing Burst 7 Protected : Forward Vision Lane Boundary Track 7 Quality Authenticated";
BA_ "SignalLongName" SG_ 236 FCODPB7P_FVLBTk7VSLgDistAuth "Front Camera Object Detection and Processing Burst 7 Protected : Forward Vision Lane Boundary Track 7 View Start Longitudinal Distance Authenticated";
BA_ "SignalLongName" SG_ 236 FCODPB7P_FVLBTk7VRLgDistAuth "Front Camera Object Detection and Processing Burst 7 Protected : Forward Vision Lane Boundary Track 7 View Range Longitudinal Distance Authenticated";
BA_ "SignalLongName" SG_ 236 FCODPB7P_FVLBTk7WdthAuth "Front Camera Object Detection and Processing Burst 7 Protected : Forward Vision Lane Boundary Track 7 Width Authenticated";
BA_ "SignalLongName" SG_ 236 FCODPB7P_FVLBTk9CrvAuth "Front Camera Object Detection and Processing Burst 7 Protected : Forward Vision Lane Boundary Track 9 Curvature Authenticated";
BA_ "SignalType" SG_ 236 FCODPB7P_FVLBTk9ClrAuth "ENM";
BA_ "SignalLongName" SG_ 236 FCODPB7P_FVLBTk9ClrAuth "Front Camera Object Detection and Processing Burst 7 Protected : Forward Vision Lane Boundary Track 9 Color Authenticated";
BA_ "SignalLongName" SG_ 236 FCODPB7P_FVLBTk9CrvDrvtAuth "Front Camera Object Detection and Processing Burst 7 Protected : Forward Vision Lane Boundary Track 9 Curvature Derivative Authenticated";
BA_ "SignalLongName" SG_ 236 FCODPB7P_FVLBTk9FPSABCQOvrAuth "Front Camera Object Detection and Processing Burst 7 Protected : Forward Vision Lane Boundary Track 9 First Polynomial Segment ABC Quality Overall Authenticated";
BA_ "SignalLongName" SG_ 236 FCODPB7P_FVLBTk9FPSAQAuth "Front Camera Object Detection and Processing Burst 7 Protected : Forward Vision Lane Boundary Track 9 First Polynomial Segment A Quality Authenticated";
BA_ "SignalLongName" SG_ 236 FCODPB7P_FVLBTk9FPSBQAuth "Front Camera Object Detection and Processing Burst 7 Protected : Forward Vision Lane Boundary Track 9 First Polynomial Segment B Quality Authenticated";
BA_ "SignalLongName" SG_ 236 FCODPB7P_FVLBTk9FPSCQAuth "Front Camera Object Detection and Processing Burst 7 Protected : Forward Vision Lane Boundary Track 9 First Polynomial Segment C Quality Authenticated";
BA_ "SignalLongName" SG_ 236 FCODPB7P_FVLBTk9HdgAuth "Front Camera Object Detection and Processing Burst 7 Protected : Forward Vision Lane Boundary Track 9 Heading Authenticated";
BA_ "SignalLongName" SG_ 236 FCODPB7P_FVLBTk9OfstAuth "Front Camera Object Detection and Processing Burst 7 Protected : Forward Vision Lane Boundary Track 9 Offset Authenticated";
BA_ "SignalType" SG_ 236 FCODPB7P_FVLBTk9TypAuth "ENM";
BA_ "SignalLongName" SG_ 236 FCODPB7P_FVLBTk9TypAuth "Front Camera Object Detection and Processing Burst 7 Protected : Forward Vision Lane Boundary Track 9 Type Authenticated";
BA_ "SignalType" SG_ 236 FCODPB7P_FVLBTk9QltyAuth "ENM";
BA_ "SignalLongName" SG_ 236 FCODPB7P_FVLBTk9QltyAuth "Front Camera Object Detection and Processing Burst 7 Protected : Forward Vision Lane Boundary Track 9 Quality Authenticated";
BA_ "SignalType" SG_ 236 FCODPB7P_FVLBTk9PstnTypAuth "ENM";
BA_ "SignalLongName" SG_ 236 FCODPB7P_FVLBTk9PstnTypAuth "Front Camera Object Detection and Processing Burst 7 Protected : Forward Vision Lane Boundary Track 9 Position Type Authenticated";
BA_ "SignalLongName" SG_ 236 FCODPB7P_FVLBTk9VRLgDistAuth "Front Camera Object Detection and Processing Burst 7 Protected : Forward Vision Lane Boundary Track 9 View Range Longitudinal Distance Authenticated";
BA_ "SignalLongName" SG_ 236 FCODPB7P_FVLBTk9VSLgDistAuth "Front Camera Object Detection and Processing Burst 7 Protected : Forward Vision Lane Boundary Track 9 View Start Longitudinal Distance Authenticated";
BA_ "SignalType" SG_ 236 FCODPB7P_FVVOTk7BrkLgtStsAuth "ENM";
BA_ "SignalLongName" SG_ 236 FCODPB7P_FVVOTk7BrkLgtStsAuth "Front Camera Object Detection and Processing Burst 7 Protected : Forward Vision Vehicle Object Track 7 Brake Light Status Authenticated";
BA_ "SignalLongName" SG_ 236 FCODPB7P_FVLBTk9WdthAuth "Front Camera Object Detection and Processing Burst 7 Protected : Forward Vision Lane Boundary Track 9 Width Authenticated";
BA_ "SignalType" SG_ 236 FCODPB7P_FVVOTk7CnfdStsAuth "ENM";
BA_ "SignalLongName" SG_ 236 FCODPB7P_FVVOTk7CnfdStsAuth "Front Camera Object Detection and Processing Burst 7 Protected : Forward Vision Vehicle Object Track 7 Confidence Status Authenticated";
BA_ "SignalLongName" SG_ 236 FCODPB7P_FVVOTk7CICOPotAuth "Front Camera Object Detection and Processing Burst 7 Protected : Forward Vision Vehicle Object Track 7 Cut In Cut Out Potential Authenticated";
BA_ "SignalLongName" SG_ 236 FCODPB7P_FVVOTk7HdgAngAuth "Front Camera Object Detection and Processing Burst 7 Protected : Forward Vision Vehicle Object Track 7 Heading Angle Authenticated";
BA_ "SignalType" SG_ 236 FCODPB7P_FVVOTk7DynPrpStsAuth "ENM";
BA_ "SignalLongName" SG_ 236 FCODPB7P_FVVOTk7DynPrpStsAuth "Front Camera Object Detection and Processing Burst 7 Protected : Forward Vision Vehicle Object Track 7 Dynamic Property Status Authenticated";
BA_ "SignalType" SG_ 236 FCODPB7P_FVVOTk7DynPrpAuth "ENM";
BA_ "SignalLongName" SG_ 236 FCODPB7P_FVVOTk7DynPrpAuth "Front Camera Object Detection and Processing Burst 7 Protected : Forward Vision Vehicle Object Track 7 Dynamic Property Authenticated";
BA_ "SignalLongName" SG_ 236 FCODPB7P_FVVOTk7HdgAngCAuth "Front Camera Object Detection and Processing Burst 7 Protected : Forward Vision Vehicle Object Track 7 Heading Angle Covariance Authenticated";
BA_ "SignalLongName" SG_ 236 FCODPB7P_FVVOTk7IDAuth "Front Camera Object Detection and Processing Burst 7 Protected : Forward Vision Vehicle Object Track 7 ID Authenticated";
BA_ "SignalLongName" SG_ 236 FCODPB7P_FVVOTk7PoILAAuth "Front Camera Object Detection and Processing Burst 7 Protected : Forward Vision Vehicle Object Track 7 Point of Interest Lateral Acceleration Authenticated";
BA_ "SignalType" SG_ 236 FCODPB7P_FVVOTk7MStsAuth "ENM";
BA_ "SignalLongName" SG_ 236 FCODPB7P_FVVOTk7MStsAuth "Front Camera Object Detection and Processing Burst 7 Protected : Forward Vision Vehicle Object Track 7 Measurement Status Authenticated";
BA_ "SignalType" SG_ 236 FCODPB7P_FVVOTk7LnAsmtAuth "ENM";
BA_ "SignalLongName" SG_ 236 FCODPB7P_FVVOTk7LnAsmtAuth "Front Camera Object Detection and Processing Burst 7 Protected : Forward Vision Vehicle Object Track 7 Lane Assignment Authenticated";
BA_ "SignalLongName" SG_ 236 FCODPB7P_FVVOTk7PoILgAAuth "Front Camera Object Detection and Processing Burst 7 Protected : Forward Vision Vehicle Object Track 7 Point of Interest Longitudinal Acceleration Authenticated";
BA_ "SignalLongName" SG_ 236 FCODPB7P_FVVOTk7PoILgPsAuth "Front Camera Object Detection and Processing Burst 7 Protected : Forward Vision Vehicle Object Track 7 Point of Interest Longitudinal Position Authenticated";
BA_ "SignalLongName" SG_ 236 FCODPB7P_FVVOTk7PoILgPsCAuth "Front Camera Object Detection and Processing Burst 7 Protected : Forward Vision Vehicle Object Track 7 Point of Interest Longitudinal Position Covariance Authenticated";
BA_ "SignalLongName" SG_ 236 FCODPB7P_FVVOTk7PoILgVAuth "Front Camera Object Detection and Processing Burst 7 Protected : Forward Vision Vehicle Object Track 7 Point of Interest Longitudinal Velocity Authenticated";
BA_ "SignalLongName" SG_ 236 FCODPB7P_FVVOTk7PoILgVCAuth "Front Camera Object Detection and Processing Burst 7 Protected : Forward Vision Vehicle Object Track 7 Point of Interest Longitudinal Velocity Covariance Authenticated";
BA_ "SignalLongName" SG_ 236 FCODPB7P_FVVOTk7PoILPsAuth "Front Camera Object Detection and Processing Burst 7 Protected : Forward Vision Vehicle Object Track 7 Point of Interest Lateral Position Authenticated";
BA_ "SignalLongName" SG_ 236 FCODPB7P_FVVOTk7PoILPsCAuth "Front Camera Object Detection and Processing Burst 7 Protected : Forward Vision Vehicle Object Track 7 Point of Interest Lateral Position Covariance Authenticated";
BA_ "SignalLongName" SG_ 236 FCODPB7P_FVVOTk7PoILVAuth "Front Camera Object Detection and Processing Burst 7 Protected : Forward Vision Vehicle Object Track 7 Point of Interest Lateral Velocity Authenticated";
BA_ "SignalLongName" SG_ 236 FCODPB7P_FVVOTk7PoILVCAuth "Front Camera Object Detection and Processing Burst 7 Protected : Forward Vision Vehicle Object Track 7 Point of Interest Lateral Velocity Covariance Authenticated";
BA_ "SignalLongName" SG_ 236 FCODPB7P_FVVOTk7PoIWAuth "Front Camera Object Detection and Processing Burst 7 Protected : Forward Vision Vehicle Object Track 7 Point of Interest Width Authenticated";
BA_ "SignalType" SG_ 236 FCODPB7P_FVVOTk7TypCnfdAuth "ENM";
BA_ "SignalLongName" SG_ 236 FCODPB7P_FVVOTk7TypCnfdAuth "Front Camera Object Detection and Processing Burst 7 Protected : Forward Vision Vehicle Object Track 7 Type Confidence Authenticated";
BA_ "SignalType" SG_ 236 FCODPB7P_FVVOTk7TypAuth "ENM";
BA_ "SignalLongName" SG_ 236 FCODPB7P_FVVOTk7TypAuth "Front Camera Object Detection and Processing Burst 7 Protected : Forward Vision Vehicle Object Track 7 Type Authenticated";
BA_ "SignalType" SG_ 236 FCODPB7P_FVVOTk7TSLgtStsAuth "ENM";
BA_ "SignalLongName" SG_ 236 FCODPB7P_FVVOTk7TSLgtStsAuth "Front Camera Object Detection and Processing Burst 7 Protected : Forward Vision Vehicle Object Track 7 Turn Signal Light Status Authenticated";
BA_ "SignalLongName" SG_ 236 FCODPB7P_Filler "Front Camera Object Detection and Processing Burst 7 Protected : Filler";
BA_ "SignalType" SG_ 236 FrwdVsnVehObjTk7DatIntegCkd "ENM";
BA_ "SignalLongName" SG_ 236 FrwdVsnVehObjTk7DatIntegCkd "Front Camera Object Detection and Processing Burst 7 Protected : Forward Vision Vehicle Object Track 7 Data Integrity Checked";
BA_ "SignalType" SG_ 236 FrwdVsnLnBdryTk7DatIntegCkd "ENM";
BA_ "SignalLongName" SG_ 236 FrwdVsnLnBdryTk7DatIntegCkd "Front Camera Object Detection and Processing Burst 7 Protected : Forward Vision Lane Boundary Track 7 Data Integrity Checked";
BA_ "SignalLongName" SG_ 236 FCODPB7P_FillerExtnd "Front Camera Object Detection and Processing Burst 7 Protected : Filler Extended";
BA_ "SignalLongName" SG_ 236 FCODPB7P_FillerExtnd1 "Front Camera Object Detection and Processing Burst 7 Protected : Filler Extended 1";
BA_ "SignalLongName" SG_ 236 FCODPB7P_FillerExtnd2 "Front Camera Object Detection and Processing Burst 7 Protected : Filler Extended 2";
VAL_ 222 FCODPB2P_AutofxOutOfCalAuth 0 "UNKNOWN" 1 "YAW" 2 "HORIZON" 3 "BOTH" ;
VAL_ 222 FCODPB2P_FrwdCamSysOprtgStsAuth 0 "UNKNOWN" 1 "INITIALIZING" 2 "INACTIVE" 3 "ACTIVE" 4 "RESERVED1" 5 "RESERVED2" 6 "RESERVED3" 7 "FAILED" ;
VAL_ 222 FCODPB2P_EnvIllumAuth 0 "UNKNOWN" 1 "LIT ENVIRONMENT DURING NIGHT" 2 "UNLIT ENVIRONMENT DURING NIGHT" 3 "DAYLIGHT" ;
VAL_ 222 FCODPB2P_FVFaildAuth 0 "FALSE" 1 "TRUE" ;
VAL_ 222 FCODPB2P_FVBlkgStsAuth 0 "UNKNOWN" 1 "NOT BLOCKED" 2 "FULL BLOCKAGE" 3 "PARTIAL BLOCKAGE" 4 "RESERVED3" 5 "RESERVED4" 6 "RESERVED5" 7 "RESERVED6" ;
VAL_ 222 FCODPB2P_FVAdvWthrStsAuth 0 "CLEAR WEATHER" 1 "LIGHT FOG" 2 "MEDIUM FOG" 3 "HEAVY FOG" 4 "LIGHT SNOW" 5 "MEDIUM SNOW" 6 "HEAVY SNOW" 7 "LIGHT RAIN" 8 "MEDIUM RAIN" 9 "HEAVY RAIN" ;
VAL_ 222 FCODPB2P_FVFailDtnStsAuth 0 "NO FAILURE" 1 "HARDWARE FAILURE" 2 "SIGNAL SUPERVISION FAILURE" 3 "RECEIVE SIGNAL TIMEOUT" 4 "GENERAL UNAVAILABILITY" 5 "UNKNOWN" ;
VAL_ 222 FCODPB2P_FVLBTk2ClrAuth 0 "UNKNOWN" 1 "WHITE" 2 "YELLOW/ORANGE" 3 "OTHER" ;
VAL_ 222 FCODPB2P_FVLBDtnAqTmStmAuth_Inv 0 "FALSE" 1 "TRUE" ;
VAL_ 222 FCODPB2P_FVLBTk2PstnTypAuth 0 "Unknown" 1 "Host Left Lane" 2 "Host Right Lane" 3 "Next Left Lane" 4 "Next Right Lane" 5 "Second Next Left Lane" 6 "Second Next Right Lane" 7 "Third Next Left Lane" 8 "Third Next Right Lane" 9 "Fourth Next Left Lane" 10 "Fourth Next Right Lane" 11 "Fifth Next Left Lane" 12 "Fifth Next Right Lane" ;
VAL_ 222 FCODPB2P_FVLBTk2TypAuth 0 "UNDECIDED" 1 "SOLID" 2 "DASHED" 3 "ROAD EDGE" 4 "DOUBLE LINE" 5 "BOTTS DOTS" 6 "VIRTUAL" 7 "TRIPLE LINE" ;
VAL_ 222 FCODPB2P_FVLBTk2QltyAuth 0 "VERY LOW QUALITY" 1 "LOW QUALITY" 2 "PREDICTION" 3 "HIGH QUALITY" ;
VAL_ 222 FCODPB2P_FVLnChngIndAuth 0 "FALSE" 1 "TRUE" ;
VAL_ 222 FCODPB2P_FVLtdAccssRdTypAuth 0 "Unknown" 1 "Non Limited Access Road" 2 "Limited Access Road" ;
VAL_ 222 FCODPB2P_FVPOTk2DynPrpAuth 0 "Has Never Moved" 1 "Has Moved But Currently Stopped" 2 "Moving In Same Direction As Host" 3 "Moving In Opposite Direction As Host" 4 "Crossing Path" ;
VAL_ 222 FCODPB2P_FVPOTk2CnfdStsAuth 0 "Highly Speculative" 1 "Speculative" 2 "Confident" 3 "Highly Confident" ;
VAL_ 222 FCODPB2P_FVPOTk2MStsAuth 0 "No Object" 1 "New Object" 2 "Latent Track Not Detected this Cycle" 3 "Measured this Cycle" ;
VAL_ 222 FCODPB2P_FVPOTk2TypCnfdAuth 0 "Highly Speculative" 1 "Speculative" 2 "Confident" 3 "Highly Confident" ;
VAL_ 222 FCODPB2P_FVPOTk2TypAuth 0 "Unknown" 1 "Pedestrian" 2 "Bicycle" ;
VAL_ 222 FCODPB2P_FVServAlgnRtnStsAuth 0 "NOT STARTED" 1 "IN PROGRESS" 2 "SUCCEEDED" 3 "STOPPED BY USER" 4 "FULL BLOCKAGE" 5 "PARTIAL BLOCKAGE" 6 "GENERAL UNAVAILABILITY" 7 "HARDWARE FAILURE" 8 "SIGNAL SUPERVISION FAILURE" 9 "RECEIVE SIGNAL TIMEOUT" 10 "POWER MODE NOT RUN" 11 "FAILED" ;
VAL_ 222 FCODPB2P_FVServAlgnInPrcAuth 0 "FALSE" 1 "TRUE" ;
VAL_ 222 FCODPB2P_FVSysCalStsAuth 0 "NOT CALIBRATED" 1 "CALIBRATED" 2 "DYNAMICALLY CALIBRATED" 3 "UNKNOWN" ;
VAL_ 222 FCODPB2P_FVServRqAuth 0 "FALSE" 1 "TRUE" ;
VAL_ 222 FCODPB2P_FVVOTk2BrkLgtStsAuth 0 "UNKNOWN" 1 "OFF" 2 "ON" 3 "FLASHING" ;
VAL_ 222 FCODPB2P_FVUnvAuth 0 "FALSE" 1 "TRUE" ;
VAL_ 222 FCODPB2P_FVVOTk2CnfdStsAuth 0 "Highly Speculative" 1 "Speculative" 2 "Confident" 3 "Highly Confident" ;
VAL_ 222 FCODPB2P_FVVOTk2DynPrpStsAuth 0 "Stopped" 1 "Not Stopped" ;
VAL_ 222 FCODPB2P_FVVOTk2DynPrpAuth 0 "Has Never Moved" 1 "Has Moved But Currently Stopped" 2 "Moving In Same Direction As Host" 3 "Moving In Opposite Direction As Host" 4 "Crossing From Left To Right" 5 "Crossing From Right To Left" 6 "Unknown" ;
VAL_ 222 FCODPB2P_FVVOTk2MStsAuth 0 "No Object" 1 "New Object" 2 "Latent Track Not Detected this Cycle" 3 "Measured this Cycle" ;
VAL_ 222 FCODPB2P_FVVOTk2LnAsmtAuth 0 "UNKNOWN" 1 "HOST LANE" 2 "RIGHT LANE" 3 "LEFT LANE" 4 "2nd RIGHT LANE" 5 "2nd LEFT LANE" ;
VAL_ 222 FCODPB2P_FVVOTk2TypAuth 0 "Unknown" 1 "Motorcycle" 2 "Vehicle" 3 "Truck" ;
VAL_ 222 FCODPB2P_FVVOTk2TSLgtStsAuth 0 "UNKNOWN" 1 "OFF" 2 "LEFT" 3 "RIGHT" 4 "BOTH" ;
VAL_ 222 FCODPB2P_RdTypAuth 0 "TOWN" 1 "COUNTRY ROAD" 2 "MOTORWAY" 3 "RESERVED1" 4 "RESERVED2" 5 "RESERVED3" 6 "RESERVED 4" 7 "UNDEFINED" ;
VAL_ 222 FCODPB2P_FVVOTk2TypCnfdAuth 0 "Highly Speculative" 1 "Speculative" 2 "Confident" 3 "Highly Confident" ;
VAL_ 222 FVHiThrtICCrsgVehPrfllNw 0 "FALSE" 1 "TRUE" ;
VAL_ 222 FVHiThrtICCrsgVehBrkNw 0 "FALSE" 1 "TRUE" ;
VAL_ 222 FVHiThrtICCrsgVehAlrtNw 0 "FALSE" 1 "TRUE" ;
VAL_ 222 FrwdVsnVehObjTk2DatIntegCkd 0 "Unknown" 1 "Pass" 2 "Fail" ;
VAL_ 222 FrwdVsnPedtrnObjTk2DatIntegCkd 0 "Unknown" 1 "Pass" 2 "Fail" ;
VAL_ 222 FrwdVsnLnBdryTk2DatIntegCkd 0 "Unknown" 1 "Pass" 2 "Fail" ;
VAL_ 222 FVHiThrtICTrnAcrsPthVehPrfllNw 0 "FALSE" 1 "TRUE" ;
VAL_ 222 FVHiThrtICTrnAcrsPthVehBrkNw 0 "FALSE" 1 "TRUE" ;
VAL_ 222 FVHiThrtICTrnAcrsPthVehAlrtNw 0 "FALSE" 1 "TRUE" ;
VAL_ 234 FCODPB3P_FlSfBlrdImgDtdAuth 0 "FALSE" 1 "TRUE" ;
VAL_ 234 FCODPB3P_ConstrArRtDtdAuth 0 "FALSE" 1 "TRUE" ;
VAL_ 234 FCODPB3P_ConstrArLtDtdAuth 0 "FALSE" 1 "TRUE" ;
VAL_ 234 FCODPB3P_AmbLnMrksRtAuth 0 "FALSE" 1 "TRUE" ;
VAL_ 234 FCODPB3P_AmbLnMrksLtAuth 0 "FALSE" 1 "TRUE" ;
VAL_ 234 FCODPB3P_FlSfFggyScnDtdAuth 0 "FALSE" 1 "TRUE" ;
VAL_ 234 FCODPB3P_FlSfFllBlkgDtdAuth 0 "FALSE" 1 "TRUE" ;
VAL_ 234 FCODPB3P_FlSfLoSnDtdAuth 0 "FALSE" 1 "TRUE" ;
VAL_ 234 FCODPB3P_FlSfPtlBlkgDtdAuth 0 "FALSE" 1 "TRUE" ;
VAL_ 234 FCODPB3P_FlSfSmrdSptDtdAuth 0 "FALSE" 1 "TRUE" ;
VAL_ 234 FCODPB3P_FlSfSplshsDtdAuth 0 "FALSE" 1 "TRUE" ;
VAL_ 234 FCODPB3P_FrwyExtRtDtdAuth 0 "FALSE" 1 "TRUE" ;
VAL_ 234 FCODPB3P_FrwyExtLtDtdAuth 0 "FALSE" 1 "TRUE" ;
VAL_ 234 FCODPB3P_FrwyMrgRtDtdAuth 0 "FALSE" 1 "TRUE" ;
VAL_ 234 FCODPB3P_FrwyMrgLtDtdAuth 0 "FALSE" 1 "TRUE" ;
VAL_ 234 FCODPB3P_FVAcqTmStmAuth_Inv 0 "FALSE" 1 "TRUE" ;
VAL_ 234 FCODPB3P_FVConstrArDtdCnfdAuth 0 "Highly Speculative" 1 "Speculative" 2 "Confident" 3 "Highly Confident" ;
VAL_ 234 FCODPB3P_FVConstrArDtnStsAuth 0 "Not Detected" 1 "Detected" 2 "Unknown" ;
VAL_ 234 FCODPB3P_FVLBTk3ClrAuth 0 "UNKNOWN" 1 "WHITE" 2 "YELLOW/ORANGE" 3 "OTHER" ;
VAL_ 234 FCODPB3P_FVLBTk3PstnTypAuth 0 "Unknown" 1 "Host Left Lane" 2 "Host Right Lane" 3 "Next Left Lane" 4 "Next Right Lane" 5 "Second Next Left Lane" 6 "Second Next Right Lane" 7 "Third Next Left Lane" 8 "Third Next Right Lane" 9 "Fourth Next Left Lane" 10 "Fourth Next Right Lane" 11 "Fifth Next Left Lane" 12 "Fifth Next Right Lane" ;
VAL_ 234 FCODPB3P_FVLBTk3TypAuth 0 "UNDECIDED" 1 "SOLID" 2 "DASHED" 3 "ROAD EDGE" 4 "DOUBLE LINE" 5 "BOTTS DOTS" 6 "VIRTUAL" 7 "TRIPLE LINE" ;
VAL_ 234 FCODPB3P_FVLBTk3QltyAuth 0 "VERY LOW QUALITY" 1 "LOW QUALITY" 2 "PREDICTION" 3 "HIGH QUALITY" ;
VAL_ 234 FCODPB3P_FVPOTk3DynPrpAuth 0 "Has Never Moved" 1 "Has Moved But Currently Stopped" 2 "Moving In Same Direction As Host" 3 "Moving In Opposite Direction As Host" 4 "Crossing Path" ;
VAL_ 234 FCODPB3P_FVPOTk3CnfdStsAuth 0 "Highly Speculative" 1 "Speculative" 2 "Confident" 3 "Highly Confident" ;
VAL_ 234 FCODPB3P_FVPOTk3MStsAuth 0 "No Object" 1 "New Object" 2 "Latent Track Not Detected this Cycle" 3 "Measured this Cycle" ;
VAL_ 234 FCODPB3P_FVVOTk3BrkLgtStsAuth 0 "UNKNOWN" 1 "OFF" 2 "ON" 3 "FLASHING" ;
VAL_ 234 FCODPB3P_FVVCRngCutInRtAuth 0 "NO CUT IN" 1 "CUT IN" ;
VAL_ 234 FCODPB3P_FVVCRngCutInLtAuth 0 "NO CUT IN" 1 "CUT IN" ;
VAL_ 234 FCODPB3P_FVPOTk3TypCnfdAuth 0 "Highly Speculative" 1 "Speculative" 2 "Confident" 3 "Highly Confident" ;
VAL_ 234 FCODPB3P_FVPOTk3TypAuth 0 "Unknown" 1 "Pedestrian" 2 "Bicycle" ;
VAL_ 234 FCODPB3P_FVVOTk3CnfdStsAuth 0 "Highly Speculative" 1 "Speculative" 2 "Confident" 3 "Highly Confident" ;
VAL_ 234 FCODPB3P_FVVOTk3DynPrpStsAuth 0 "Stopped" 1 "Not Stopped" ;
VAL_ 234 FCODPB3P_FVVOTk3DynPrpAuth 0 "Has Never Moved" 1 "Has Moved But Currently Stopped" 2 "Moving In Same Direction As Host" 3 "Moving In Opposite Direction As Host" 4 "Crossing From Left To Right" 5 "Crossing From Right To Left" 6 "Unknown" ;
VAL_ 234 FCODPB3P_FVVOTk3MStsAuth 0 "No Object" 1 "New Object" 2 "Latent Track Not Detected this Cycle" 3 "Measured this Cycle" ;
VAL_ 234 FCODPB3P_FVVOTk3LnAsmtAuth 0 "UNKNOWN" 1 "HOST LANE" 2 "RIGHT LANE" 3 "LEFT LANE" 4 "2nd RIGHT LANE" 5 "2nd LEFT LANE" ;
VAL_ 234 FCODPB3P_FVVOTk3TypAuth 0 "Unknown" 1 "Motorcycle" 2 "Vehicle" 3 "Truck" ;
VAL_ 234 FCODPB3P_FVVOTk3TSLgtStsAuth 0 "UNKNOWN" 1 "OFF" 2 "LEFT" 3 "RIGHT" 4 "BOTH" ;
VAL_ 234 FCODPB3P_OvrhdStrctDtdAuth 0 "FALSE" 1 "TRUE" ;
VAL_ 234 FCODPB3P_IntTrffcDtdAuth 0 "FALSE" 1 "TRUE" ;
VAL_ 234 FCODPB3P_FVVOTk3TypCnfdAuth 0 "Highly Speculative" 1 "Speculative" 2 "Confident" 3 "Highly Confident" ;
VAL_ 234 FCODPB3P_VehInTnnlCnfdAuth 0 "Highly Speculative" 1 "Speculative" 2 "Confident" 3 "Highly Confident" ;
VAL_ 234 FCODPB3P_TrffcLgtDtdAuth 0 "FALSE" 1 "TRUE" ;
VAL_ 234 FrwdVsnVehObjTk3DatIntegCkd 0 "Unknown" 1 "Pass" 2 "Fail" ;
VAL_ 234 FrwdVsnPedtrnObjTk3DatIntegCkd 0 "Unknown" 1 "Pass" 2 "Fail" ;
VAL_ 234 FrwdVsnLnBdryTk3DatIntegCkd 0 "Unknown" 1 "Pass" 2 "Fail" ;
VAL_ 234 FCODPB3P_VehInTnnlDtdAuth 0 "FALSE" 1 "TRUE" ;
VAL_ 221 FCODPB4P_FVLBTk11ClrAuth 0 "UNKNOWN" 1 "WHITE" 2 "YELLOW/ORANGE" 3 "OTHER" ;
VAL_ 221 FCODPB4P_FVLBTk11PstnTypAuth 0 "Unknown" 1 "Host Left Lane" 2 "Host Right Lane" 3 "Next Left Lane" 4 "Next Right Lane" 5 "Second Next Left Lane" 6 "Second Next Right Lane" 7 "Third Next Left Lane" 8 "Third Next Right Lane" 9 "Fourth Next Left Lane" 10 "Fourth Next Right Lane" 11 "Fifth Next Left Lane" 12 "Fifth Next Right Lane" ;
VAL_ 221 FCODPB4P_FVLBTk11TypAuth 0 "UNDECIDED" 1 "SOLID" 2 "DASHED" 3 "ROAD EDGE" 4 "DOUBLE LINE" 5 "BOTTS DOTS" 6 "VIRTUAL" 7 "TRIPLE LINE" ;
VAL_ 221 FCODPB4P_FVLBTk11QltyAuth 0 "VERY LOW QUALITY" 1 "LOW QUALITY" 2 "PREDICTION" 3 "HIGH QUALITY" ;
VAL_ 221 FCODPB4P_FVLBTk4ClrAuth 0 "UNKNOWN" 1 "WHITE" 2 "YELLOW/ORANGE" 3 "OTHER" ;
VAL_ 221 FCODPB4P_FVLBTk4TypAuth 0 "UNDECIDED" 1 "SOLID" 2 "DASHED" 3 "ROAD EDGE" 4 "DOUBLE LINE" 5 "BOTTS DOTS" 6 "VIRTUAL" 7 "TRIPLE LINE" ;
VAL_ 221 FCODPB4P_FVLBTk4QltyAuth 0 "VERY LOW QUALITY" 1 "LOW QUALITY" 2 "PREDICTION" 3 "HIGH QUALITY" ;
VAL_ 221 FCODPB4P_FVLBTk4PstnTypAuth 0 "Unknown" 1 "Host Left Lane" 2 "Host Right Lane" 3 "Next Left Lane" 4 "Next Right Lane" 5 "Second Next Left Lane" 6 "Second Next Right Lane" 7 "Third Next Left Lane" 8 "Third Next Right Lane" 9 "Fourth Next Left Lane" 10 "Fourth Next Right Lane" 11 "Fifth Next Left Lane" 12 "Fifth Next Right Lane" ;
VAL_ 221 FCODPB4P_FVPOTk4CnfdStsAuth 0 "Highly Speculative" 1 "Speculative" 2 "Confident" 3 "Highly Confident" ;
VAL_ 221 FCODPB4P_FVPOTk4DynPrpAuth 0 "Has Never Moved" 1 "Has Moved But Currently Stopped" 2 "Moving In Same Direction As Host" 3 "Moving In Opposite Direction As Host" 4 "Crossing Path" ;
VAL_ 221 FCODPB4P_FVPOTk4MStsAuth 0 "No Object" 1 "New Object" 2 "Latent Track Not Detected this Cycle" 3 "Measured this Cycle" ;
VAL_ 221 FCODPB4P_FVVOTk4BrkLgtStsAuth 0 "UNKNOWN" 1 "OFF" 2 "ON" 3 "FLASHING" ;
VAL_ 221 FCODPB4P_FVPOTk4TypCnfdAuth 0 "Highly Speculative" 1 "Speculative" 2 "Confident" 3 "Highly Confident" ;
VAL_ 221 FCODPB4P_FVPOTk4TypAuth 0 "Unknown" 1 "Pedestrian" 2 "Bicycle" ;
VAL_ 221 FCODPB4P_FVVOTk4CnfdStsAuth 0 "Highly Speculative" 1 "Speculative" 2 "Confident" 3 "Highly Confident" ;
VAL_ 221 FCODPB4P_FVVOTk4DynPrpStsAuth 0 "Stopped" 1 "Not Stopped" ;
VAL_ 221 FCODPB4P_FVVOTk4DynPrpAuth 0 "Has Never Moved" 1 "Has Moved But Currently Stopped" 2 "Moving In Same Direction As Host" 3 "Moving In Opposite Direction As Host" 4 "Crossing From Left To Right" 5 "Crossing From Right To Left" 6 "Unknown" ;
VAL_ 221 FCODPB4P_FVVOTk4MStsAuth 0 "No Object" 1 "New Object" 2 "Latent Track Not Detected this Cycle" 3 "Measured this Cycle" ;
VAL_ 221 FCODPB4P_FVVOTk4LnAsmtAuth 0 "UNKNOWN" 1 "HOST LANE" 2 "RIGHT LANE" 3 "LEFT LANE" 4 "2nd RIGHT LANE" 5 "2nd LEFT LANE" ;
VAL_ 221 FCODPB4P_FVVOTk4TypAuth 0 "Unknown" 1 "Motorcycle" 2 "Vehicle" 3 "Truck" ;
VAL_ 221 FCODPB4P_FVVOTk4TSLgtStsAuth 0 "UNKNOWN" 1 "OFF" 2 "LEFT" 3 "RIGHT" 4 "BOTH" ;
VAL_ 221 FrwdVsnVehObjTk4DatIntegCkd 0 "Unknown" 1 "Pass" 2 "Fail" ;
VAL_ 221 FrwdVsnPedtrnObjTk4DatIntegCkd 0 "Unknown" 1 "Pass" 2 "Fail" ;
VAL_ 221 FrwdVsnLnBdryTk4DatIntegCkd 0 "Unknown" 1 "Pass" 2 "Fail" ;
VAL_ 221 FCODPB4P_FVVOTk4TypCnfdAuth 0 "Highly Speculative" 1 "Speculative" 2 "Confident" 3 "Highly Confident" ;
VAL_ 235 FCODPB5P_FVLBTk10ClrAuth 0 "UNKNOWN" 1 "WHITE" 2 "YELLOW/ORANGE" 3 "OTHER" ;
VAL_ 235 FCODPB5P_FVLBTk10PstnTypAuth 0 "Unknown" 1 "Host Left Lane" 2 "Host Right Lane" 3 "Next Left Lane" 4 "Next Right Lane" 5 "Second Next Left Lane" 6 "Second Next Right Lane" 7 "Third Next Left Lane" 8 "Third Next Right Lane" 9 "Fourth Next Left Lane" 10 "Fourth Next Right Lane" 11 "Fifth Next Left Lane" 12 "Fifth Next Right Lane" ;
VAL_ 235 FCODPB5P_FVLBTk10TypAuth 0 "UNDECIDED" 1 "SOLID" 2 "DASHED" 3 "ROAD EDGE" 4 "DOUBLE LINE" 5 "BOTTS DOTS" 6 "VIRTUAL" 7 "TRIPLE LINE" ;
VAL_ 235 FCODPB5P_FVLBTk10QltyAuth 0 "VERY LOW QUALITY" 1 "LOW QUALITY" 2 "PREDICTION" 3 "HIGH QUALITY" ;
VAL_ 235 FCODPB5P_FVLBTk5ClrAuth 0 "UNKNOWN" 1 "WHITE" 2 "YELLOW/ORANGE" 3 "OTHER" ;
VAL_ 235 FCODPB5P_FVLBTk5TypAuth 0 "UNDECIDED" 1 "SOLID" 2 "DASHED" 3 "ROAD EDGE" 4 "DOUBLE LINE" 5 "BOTTS DOTS" 6 "VIRTUAL" 7 "TRIPLE LINE" ;
VAL_ 235 FCODPB5P_FVLBTk5QltyAuth 0 "VERY LOW QUALITY" 1 "LOW QUALITY" 2 "PREDICTION" 3 "HIGH QUALITY" ;
VAL_ 235 FCODPB5P_FVLBTk5PstnTypAuth 0 "Unknown" 1 "Host Left Lane" 2 "Host Right Lane" 3 "Next Left Lane" 4 "Next Right Lane" 5 "Second Next Left Lane" 6 "Second Next Right Lane" 7 "Third Next Left Lane" 8 "Third Next Right Lane" 9 "Fourth Next Left Lane" 10 "Fourth Next Right Lane" 11 "Fifth Next Left Lane" 12 "Fifth Next Right Lane" ;
VAL_ 235 FCODPB5P_FVPOTk5CnfdStsAuth 0 "Highly Speculative" 1 "Speculative" 2 "Confident" 3 "Highly Confident" ;
VAL_ 235 FCODPB5P_FVPOTk5DynPrpAuth 0 "Has Never Moved" 1 "Has Moved But Currently Stopped" 2 "Moving In Same Direction As Host" 3 "Moving In Opposite Direction As Host" 4 "Crossing Path" ;
VAL_ 235 FCODPB5P_FVPOTk5MStsAuth 0 "No Object" 1 "New Object" 2 "Latent Track Not Detected this Cycle" 3 "Measured this Cycle" ;
VAL_ 235 FCODPB5P_FVVOTk5BrkLgtStsAuth 0 "UNKNOWN" 1 "OFF" 2 "ON" 3 "FLASHING" ;
VAL_ 235 FCODPB5P_FVPOTk5TypCnfdAuth 0 "Highly Speculative" 1 "Speculative" 2 "Confident" 3 "Highly Confident" ;
VAL_ 235 FCODPB5P_FVPOTk5TypAuth 0 "Unknown" 1 "Pedestrian" 2 "Bicycle" ;
VAL_ 235 FCODPB5P_FVVOTk5CnfdStsAuth 0 "Highly Speculative" 1 "Speculative" 2 "Confident" 3 "Highly Confident" ;
VAL_ 235 FCODPB5P_FVVOTk5DynPrpStsAuth 0 "Stopped" 1 "Not Stopped" ;
VAL_ 235 FCODPB5P_FVVOTk5DynPrpAuth 0 "Has Never Moved" 1 "Has Moved But Currently Stopped" 2 "Moving In Same Direction As Host" 3 "Moving In Opposite Direction As Host" 4 "Crossing From Left To Right" 5 "Crossing From Right To Left" 6 "Unknown" ;
VAL_ 235 FCODPB5P_FVVOTk5MStsAuth 0 "No Object" 1 "New Object" 2 "Latent Track Not Detected this Cycle" 3 "Measured this Cycle" ;
VAL_ 235 FCODPB5P_FVVOTk5LnAsmtAuth 0 "UNKNOWN" 1 "HOST LANE" 2 "RIGHT LANE" 3 "LEFT LANE" 4 "2nd RIGHT LANE" 5 "2nd LEFT LANE" ;
VAL_ 235 FCODPB5P_FVVOTk5TypAuth 0 "Unknown" 1 "Motorcycle" 2 "Vehicle" 3 "Truck" ;
VAL_ 235 FCODPB5P_FVVOTk5TSLgtStsAuth 0 "UNKNOWN" 1 "OFF" 2 "LEFT" 3 "RIGHT" 4 "BOTH" ;
VAL_ 235 FrwdVsnVehObjTk5DatIntegCkd 0 "Unknown" 1 "Pass" 2 "Fail" ;
VAL_ 235 FrwdVsnPedtrnObjTk5DatIntegCkd 0 "Unknown" 1 "Pass" 2 "Fail" ;
VAL_ 235 FrwdVsnLnBdryTk5DatIntegCkd 0 "Unknown" 1 "Pass" 2 "Fail" ;
VAL_ 235 FCODPB5P_FVVOTk5TypCnfdAuth 0 "Highly Speculative" 1 "Speculative" 2 "Confident" 3 "Highly Confident" ;
VAL_ 220 FCODPB6P_FVLBTk6ClrAuth 0 "UNKNOWN" 1 "WHITE" 2 "YELLOW/ORANGE" 3 "OTHER" ;
VAL_ 220 FCODPB6P_FVLBTk6PstnTypAuth 0 "Unknown" 1 "Host Left Lane" 2 "Host Right Lane" 3 "Next Left Lane" 4 "Next Right Lane" 5 "Second Next Left Lane" 6 "Second Next Right Lane" 7 "Third Next Left Lane" 8 "Third Next Right Lane" 9 "Fourth Next Left Lane" 10 "Fourth Next Right Lane" 11 "Fifth Next Left Lane" 12 "Fifth Next Right Lane" ;
VAL_ 220 FCODPB6P_FVLBTk6TypAuth 0 "UNDECIDED" 1 "SOLID" 2 "DASHED" 3 "ROAD EDGE" 4 "DOUBLE LINE" 5 "BOTTS DOTS" 6 "VIRTUAL" 7 "TRIPLE LINE" ;
VAL_ 220 FCODPB6P_FVLBTk6QltyAuth 0 "VERY LOW QUALITY" 1 "LOW QUALITY" 2 "PREDICTION" 3 "HIGH QUALITY" ;
VAL_ 220 FCODPB6P_FVVOTk10BrkLgtStsAuth 0 "UNKNOWN" 1 "OFF" 2 "ON" 3 "FLASHING" ;
VAL_ 220 FCODPB6P_FVVOTk10DynPrpAuth 0 "Has Never Moved" 1 "Has Moved But Currently Stopped" 2 "Moving In Same Direction As Host" 3 "Moving In Opposite Direction As Host" 4 "Crossing From Left To Right" 5 "Crossing From Right To Left" 6 "Unknown" ;
VAL_ 220 FCODPB6P_FVVOTk10CnfdStsAuth 0 "Highly Speculative" 1 "Speculative" 2 "Confident" 3 "Highly Confident" ;
VAL_ 220 FCODPB6P_FVVOTk10DynPrpStsAuth 0 "Stopped" 1 "Not Stopped" ;
VAL_ 220 FCODPB6P_FVVOTk10MStsAuth 0 "No Object" 1 "New Object" 2 "Latent Track Not Detected this Cycle" 3 "Measured this Cycle" ;
VAL_ 220 FCODPB6P_FVVOTk10LnAsmtAuth 0 "UNKNOWN" 1 "HOST LANE" 2 "RIGHT LANE" 3 "LEFT LANE" 4 "2nd RIGHT LANE" 5 "2nd LEFT LANE" ;
VAL_ 220 FCODPB6P_FVVOTk6BrkLgtStsAuth 0 "UNKNOWN" 1 "OFF" 2 "ON" 3 "FLASHING" ;
VAL_ 220 FCODPB6P_FVVOTk10TypCnfdAuth 0 "Highly Speculative" 1 "Speculative" 2 "Confident" 3 "Highly Confident" ;
VAL_ 220 FCODPB6P_FVVOTk10TypAuth 0 "Unknown" 1 "Motorcycle" 2 "Vehicle" 3 "Truck" ;
VAL_ 220 FCODPB6P_FVVOTk10TSLgtStsAuth 0 "UNKNOWN" 1 "OFF" 2 "LEFT" 3 "RIGHT" 4 "BOTH" ;
VAL_ 220 FCODPB6P_FVVOTk6CnfdStsAuth 0 "Highly Speculative" 1 "Speculative" 2 "Confident" 3 "Highly Confident" ;
VAL_ 220 FCODPB6P_FVVOTk6DynPrpStsAuth 0 "Stopped" 1 "Not Stopped" ;
VAL_ 220 FCODPB6P_FVVOTk6DynPrpAuth 0 "Has Never Moved" 1 "Has Moved But Currently Stopped" 2 "Moving In Same Direction As Host" 3 "Moving In Opposite Direction As Host" 4 "Crossing From Left To Right" 5 "Crossing From Right To Left" 6 "Unknown" ;
VAL_ 220 FCODPB6P_FVVOTk6MStsAuth 0 "No Object" 1 "New Object" 2 "Latent Track Not Detected this Cycle" 3 "Measured this Cycle" ;
VAL_ 220 FCODPB6P_FVVOTk6LnAsmtAuth 0 "UNKNOWN" 1 "HOST LANE" 2 "RIGHT LANE" 3 "LEFT LANE" 4 "2nd RIGHT LANE" 5 "2nd LEFT LANE" ;
VAL_ 220 FCODPB6P_FVVOTk6TypAuth 0 "Unknown" 1 "Motorcycle" 2 "Vehicle" 3 "Truck" ;
VAL_ 220 FCODPB6P_FVVOTk6TSLgtStsAuth 0 "UNKNOWN" 1 "OFF" 2 "LEFT" 3 "RIGHT" 4 "BOTH" ;
VAL_ 220 FrwdVsnVehObjTk6DatIntegCkd 0 "Unknown" 1 "Pass" 2 "Fail" ;
VAL_ 220 FrwdVsnLnBdryTk6DatIntegCkd 0 "Unknown" 1 "Pass" 2 "Fail" ;
VAL_ 220 FCODPB6P_FVVOTk6TypCnfdAuth 0 "Highly Speculative" 1 "Speculative" 2 "Confident" 3 "Highly Confident" ;
VAL_ 236 FCODPB7P_FVLBTk7ClrAuth 0 "UNKNOWN" 1 "WHITE" 2 "YELLOW/ORANGE" 3 "OTHER" ;
VAL_ 236 FCODPB7P_FVLBTk7PstnTypAuth 0 "Unknown" 1 "Host Left Lane" 2 "Host Right Lane" 3 "Next Left Lane" 4 "Next Right Lane" 5 "Second Next Left Lane" 6 "Second Next Right Lane" 7 "Third Next Left Lane" 8 "Third Next Right Lane" 9 "Fourth Next Left Lane" 10 "Fourth Next Right Lane" 11 "Fifth Next Left Lane" 12 "Fifth Next Right Lane" ;
VAL_ 236 FCODPB7P_FVLBTk7TypAuth 0 "UNDECIDED" 1 "SOLID" 2 "DASHED" 3 "ROAD EDGE" 4 "DOUBLE LINE" 5 "BOTTS DOTS" 6 "VIRTUAL" 7 "TRIPLE LINE" ;
VAL_ 236 FCODPB7P_FVLBTk7QltyAuth 0 "VERY LOW QUALITY" 1 "LOW QUALITY" 2 "PREDICTION" 3 "HIGH QUALITY" ;
VAL_ 236 FCODPB7P_FVLBTk9ClrAuth 0 "UNKNOWN" 1 "WHITE" 2 "YELLOW/ORANGE" 3 "OTHER" ;
VAL_ 236 FCODPB7P_FVLBTk9TypAuth 0 "UNDECIDED" 1 "SOLID" 2 "DASHED" 3 "ROAD EDGE" 4 "DOUBLE LINE" 5 "BOTTS DOTS" 6 "VIRTUAL" 7 "TRIPLE LINE" ;
VAL_ 236 FCODPB7P_FVLBTk9QltyAuth 0 "VERY LOW QUALITY" 1 "LOW QUALITY" 2 "PREDICTION" 3 "HIGH QUALITY" ;
VAL_ 236 FCODPB7P_FVLBTk9PstnTypAuth 0 "Unknown" 1 "Host Left Lane" 2 "Host Right Lane" 3 "Next Left Lane" 4 "Next Right Lane" 5 "Second Next Left Lane" 6 "Second Next Right Lane" 7 "Third Next Left Lane" 8 "Third Next Right Lane" 9 "Fourth Next Left Lane" 10 "Fourth Next Right Lane" 11 "Fifth Next Left Lane" 12 "Fifth Next Right Lane" ;
VAL_ 236 FCODPB7P_FVVOTk7BrkLgtStsAuth 0 "UNKNOWN" 1 "OFF" 2 "ON" 3 "FLASHING" ;
VAL_ 236 FCODPB7P_FVVOTk7CnfdStsAuth 0 "Highly Speculative" 1 "Speculative" 2 "Confident" 3 "Highly Confident" ;
VAL_ 236 FCODPB7P_FVVOTk7DynPrpStsAuth 0 "Stopped" 1 "Not Stopped" ;
VAL_ 236 FCODPB7P_FVVOTk7DynPrpAuth 0 "Has Never Moved" 1 "Has Moved But Currently Stopped" 2 "Moving In Same Direction As Host" 3 "Moving In Opposite Direction As Host" 4 "Crossing From Left To Right" 5 "Crossing From Right To Left" 6 "Unknown" ;
VAL_ 236 FCODPB7P_FVVOTk7MStsAuth 0 "No Object" 1 "New Object" 2 "Latent Track Not Detected this Cycle" 3 "Measured this Cycle" ;
VAL_ 236 FCODPB7P_FVVOTk7LnAsmtAuth 0 "UNKNOWN" 1 "HOST LANE" 2 "RIGHT LANE" 3 "LEFT LANE" 4 "2nd RIGHT LANE" 5 "2nd LEFT LANE" ;
VAL_ 236 FCODPB7P_FVVOTk7TypCnfdAuth 0 "Highly Speculative" 1 "Speculative" 2 "Confident" 3 "Highly Confident" ;
VAL_ 236 FCODPB7P_FVVOTk7TypAuth 0 "Unknown" 1 "Motorcycle" 2 "Vehicle" 3 "Truck" ;
VAL_ 236 FCODPB7P_FVVOTk7TSLgtStsAuth 0 "UNKNOWN" 1 "OFF" 2 "LEFT" 3 "RIGHT" 4 "BOTH" ;
VAL_ 236 FrwdVsnVehObjTk7DatIntegCkd 0 "Unknown" 1 "Pass" 2 "Fail" ;
VAL_ 236 FrwdVsnLnBdryTk7DatIntegCkd 0 "Unknown" 1 "Pass" 2 "Fail" ;
