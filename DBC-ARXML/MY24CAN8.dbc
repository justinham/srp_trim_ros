VERSION ""

NS_ :

BS_:

BU_: WCM4 WCM3 WCM2 WCM VPM VLM VKM VICM VECM VDM VCU_RTOS_ETH VCU_ENTRY_ETH VCU_AGVM_ETH VCU UVM UPM TIM TEST_TOOL_1 TCP_ETH TCP TCM TCCM SRR_SRR_ETH SRR_SRR SRR_SLR_ETH SRR_SLR SRR_RR SRR_RF_ETH SRR_RF SRR_LR_CR SRR_LF_ETH SRR_LF SIB SDM SCL SBZA_R SBZA_L SBM SAM_RR SAM_RF SAM_LR SAM_LF SAM_BH SADS RadioLow_ETH RadioLow RSI_RTOS_ETH RSI RDCM PTM PLCM PFCM PDR_ETH PDR PCM PA ODS2 ODS NVM MTCM_R MTCM_L MSM_RR MSM_P MSM_LR MSM_D MSB2 MSB1 MRCM_R MRCM_L MFC LRR_RR_ETH LRR_LR_ETH LRR_CF_ETH LRR LRL_CF_ETH LIB_48V LIB1 IPC_INT IPC_GP IPC ICS_Info ICCM HVAC_FP_R HVAC_FP_F HUD_CAN HDLM FPI_RTOS_ETH FPI FOPM FCM_LC FCM EPSb EPS_1 EPSRAb EPSRAa EPS EOCM_HC_Superset EOCM_HCP2 EOCM ELM ECP_X1 ECP_S2 ECP_S ECP_MC ECP_H3 ECP_H2 ECP_H1 ECP_E ECM EBCM DMS DEFC DCM CSM_ETH CSM_AV CSM CGM_OTA_ETH CGM BSM_MH BSM_HEV BSM BCM ARS ARB APA AOS AMP ALC AHS AHL_AFL ADIMb ADIMa ACP2_MCU
VAL_TABLE_ ACP2_MCU_CAN_8_ClscCANHrtBtActv 0 "FALSE" 1 "TRUE" ;
VAL_TABLE_ ACP3_MCU_CAN8_ClscCANHrtBtActv 0 "FALSE" 1 "TRUE" ;
VAL_TABLE_ ACP4_MCU_CAN8_ClscCANHrtBtActv 0 "FALSE" 1 "TRUE" ;
VAL_TABLE_ ALOI1_AcqTmStm_Inv 0 "FALSE" 1 "TRUE" ;
VAL_TABLE_ ALOI1_CnfdTk1 0 "Highly Speculative" 1 "Speculative" 2 "Confident" 3 "Highly Confident" ;
VAL_TABLE_ ALOI1_DirTk1 0 "Following" 1 "Oncoming" 2 "Following Goup" 3 "Oncoming Group" 4 "Unknown" ;
VAL_TABLE_ ALOI1_CnfdTk4 0 "Highly Speculative" 1 "Speculative" 2 "Confident" 3 "Highly Confident" ;
VAL_TABLE_ ALOI1_CnfdTk3 0 "Highly Speculative" 1 "Speculative" 2 "Confident" 3 "Highly Confident" ;
VAL_TABLE_ ALOI1_CnfdTk2 0 "Highly Speculative" 1 "Speculative" 2 "Confident" 3 "Highly Confident" ;
VAL_TABLE_ ALOI1_DirTk4 0 "Following" 1 "Oncoming" 2 "Following Goup" 3 "Oncoming Group" 4 "Unknown" ;
VAL_TABLE_ ALOI1_DirTk3 0 "Following" 1 "Oncoming" 2 "Following Goup" 3 "Oncoming Group" 4 "Unknown" ;
VAL_TABLE_ ALOI1_DirTk2 0 "Following" 1 "Oncoming" 2 "Following Goup" 3 "Oncoming Group" 4 "Unknown" ;
VAL_TABLE_ ALOI1_MeasStsTk3 0 "No Object" 1 "New Object" 2 "Latent Track Not Detected This Cycle" 3 "Measured This Cycle" ;
VAL_TABLE_ ALOI1_MeasStsTk2 0 "No Object" 1 "New Object" 2 "Latent Track Not Detected This Cycle" 3 "Measured This Cycle" ;
VAL_TABLE_ ALOI1_MeasStsTk1 0 "No Object" 1 "New Object" 2 "Latent Track Not Detected This Cycle" 3 "Measured This Cycle" ;
VAL_TABLE_ ALOI1_MeasStsTk4 0 "No Object" 1 "New Object" 2 "Latent Track Not Detected This Cycle" 3 "Measured This Cycle" ;
VAL_TABLE_ ALOI1_RltvLnTk1 0 "Unknown" 1 "Host Lane" 2 "Right Lane" 3 "Left Lane" ;
VAL_TABLE_ ALOI1_RltvLnTk4 0 "Unknown" 1 "Host Lane" 2 "Right Lane" 3 "Left Lane" ;
VAL_TABLE_ ALOI1_RltvLnTk3 0 "Unknown" 1 "Host Lane" 2 "Right Lane" 3 "Left Lane" ;
VAL_TABLE_ ALOI1_RltvLnTk2 0 "Unknown" 1 "Host Lane" 2 "Right Lane" 3 "Left Lane" ;
VAL_TABLE_ ALOI1_RngTk1_Inv 0 "FALSE" 1 "TRUE" ;
VAL_TABLE_ ALOI1_RngTk2_Inv 0 "FALSE" 1 "TRUE" ;
VAL_TABLE_ ALOI1_RngTk3_Inv 0 "FALSE" 1 "TRUE" ;
VAL_TABLE_ ALOI1_TypTk2 0 "UNKNOWN" 1 "4 WHEEL VEHICLE" 2 "LARGE VEHICLE" 3 "MOTORCYCLE/BICYCLE" 4 "PEDESTRIAN" 5 "FIXED OVERHEAD OBJECT" 6 "FIXED ROADSIDE OBJECT" 7 "NO OBJECT PRESENT" 8 "PEDESTRIAN STANDING OUTSIDE DANGER ZONE" 9 "PEDESTRIAN MOVING OUT OF DANGER ZONE" 10 "PEDESTRIAN MOVING INTO DANGER ZONE" 11 "CHILD CLOSE TO DANGER ZONE" 12 "CLUSTER OBJECT" ;
VAL_TABLE_ ALOI1_TypTk1 0 "UNKNOWN" 1 "4 WHEEL VEHICLE" 2 "LARGE VEHICLE" 3 "MOTORCYCLE/BICYCLE" 4 "PEDESTRIAN" 5 "FIXED OVERHEAD OBJECT" 6 "FIXED ROADSIDE OBJECT" 7 "NO OBJECT PRESENT" 8 "PEDESTRIAN STANDING OUTSIDE DANGER ZONE" 9 "PEDESTRIAN MOVING OUT OF DANGER ZONE" 10 "PEDESTRIAN MOVING INTO DANGER ZONE" 11 "CHILD CLOSE TO DANGER ZONE" 12 "CLUSTER OBJECT" ;
VAL_TABLE_ ALOI1_RngTk4_Inv 0 "FALSE" 1 "TRUE" ;
VAL_TABLE_ ALOI1_TypTk4 0 "UNKNOWN" 1 "4 WHEEL VEHICLE" 2 "LARGE VEHICLE" 3 "MOTORCYCLE/BICYCLE" 4 "PEDESTRIAN" 5 "FIXED OVERHEAD OBJECT" 6 "FIXED ROADSIDE OBJECT" 7 "NO OBJECT PRESENT" 8 "PEDESTRIAN STANDING OUTSIDE DANGER ZONE" 9 "PEDESTRIAN MOVING OUT OF DANGER ZONE" 10 "PEDESTRIAN MOVING INTO DANGER ZONE" 11 "CHILD CLOSE TO DANGER ZONE" 12 "CLUSTER OBJECT" ;
VAL_TABLE_ ALOI1_TypTk3 0 "UNKNOWN" 1 "4 WHEEL VEHICLE" 2 "LARGE VEHICLE" 3 "MOTORCYCLE/BICYCLE" 4 "PEDESTRIAN" 5 "FIXED OVERHEAD OBJECT" 6 "FIXED ROADSIDE OBJECT" 7 "NO OBJECT PRESENT" 8 "PEDESTRIAN STANDING OUTSIDE DANGER ZONE" 9 "PEDESTRIAN MOVING OUT OF DANGER ZONE" 10 "PEDESTRIAN MOVING INTO DANGER ZONE" 11 "CHILD CLOSE TO DANGER ZONE" 12 "CLUSTER OBJECT" ;
VAL_TABLE_ ALOI2_AcqTmStm_Inv 0 "FALSE" 1 "TRUE" ;
VAL_TABLE_ ALOI2_CnfdTk5 0 "Highly Speculative" 1 "Speculative" 2 "Confident" 3 "Highly Confident" ;
VAL_TABLE_ ALOI2_DirTk5 0 "Following" 1 "Oncoming" 2 "Following Goup" 3 "Oncoming Group" 4 "Unknown" ;
VAL_TABLE_ ALOI2_CnfdTk8 0 "Highly Speculative" 1 "Speculative" 2 "Confident" 3 "Highly Confident" ;
VAL_TABLE_ ALOI2_CnfdTk7 0 "Highly Speculative" 1 "Speculative" 2 "Confident" 3 "Highly Confident" ;
VAL_TABLE_ ALOI2_CnfdTk6 0 "Highly Speculative" 1 "Speculative" 2 "Confident" 3 "Highly Confident" ;
VAL_TABLE_ ALOI2_DirTk8 0 "Following" 1 "Oncoming" 2 "Following Goup" 3 "Oncoming Group" 4 "Unknown" ;
VAL_TABLE_ ALOI2_DirTk7 0 "Following" 1 "Oncoming" 2 "Following Goup" 3 "Oncoming Group" 4 "Unknown" ;
VAL_TABLE_ ALOI2_DirTk6 0 "Following" 1 "Oncoming" 2 "Following Goup" 3 "Oncoming Group" 4 "Unknown" ;
VAL_TABLE_ ALOI2_MeasStsTk7 0 "No Object" 1 "New Object" 2 "Latent Track Not Detected This Cycle" 3 "Measured This Cycle" ;
VAL_TABLE_ ALOI2_MeasStsTk6 0 "No Object" 1 "New Object" 2 "Latent Track Not Detected This Cycle" 3 "Measured This Cycle" ;
VAL_TABLE_ ALOI2_MeasStsTk5 0 "No Object" 1 "New Object" 2 "Latent Track Not Detected This Cycle" 3 "Measured This Cycle" ;
VAL_TABLE_ ALOI2_MeasStsTk8 0 "No Object" 1 "New Object" 2 "Latent Track Not Detected This Cycle" 3 "Measured This Cycle" ;
VAL_TABLE_ ALOI2_RltvLnTk5 0 "Unknown" 1 "Host Lane" 2 "Right Lane" 3 "Left Lane" ;
VAL_TABLE_ ALOI2_RltvLnTk8 0 "Unknown" 1 "Host Lane" 2 "Right Lane" 3 "Left Lane" ;
VAL_TABLE_ ALOI2_RltvLnTk7 0 "Unknown" 1 "Host Lane" 2 "Right Lane" 3 "Left Lane" ;
VAL_TABLE_ ALOI2_RltvLnTk6 0 "Unknown" 1 "Host Lane" 2 "Right Lane" 3 "Left Lane" ;
VAL_TABLE_ ALOI2_RngTk5_Inv 0 "FALSE" 1 "TRUE" ;
VAL_TABLE_ ALOI2_RngTk6_Inv 0 "FALSE" 1 "TRUE" ;
VAL_TABLE_ ALOI2_RngTk7_Inv 0 "FALSE" 1 "TRUE" ;
VAL_TABLE_ ALOI2_TypTk6 0 "UNKNOWN" 1 "4 WHEEL VEHICLE" 2 "LARGE VEHICLE" 3 "MOTORCYCLE/BICYCLE" 4 "PEDESTRIAN" 5 "FIXED OVERHEAD OBJECT" 6 "FIXED ROADSIDE OBJECT" 7 "NO OBJECT PRESENT" 8 "PEDESTRIAN STANDING OUTSIDE DANGER ZONE" 9 "PEDESTRIAN MOVING OUT OF DANGER ZONE" 10 "PEDESTRIAN MOVING INTO DANGER ZONE" 11 "CHILD CLOSE TO DANGER ZONE" 12 "CLUSTER OBJECT" ;
VAL_TABLE_ ALOI2_TypTk5 0 "UNKNOWN" 1 "4 WHEEL VEHICLE" 2 "LARGE VEHICLE" 3 "MOTORCYCLE/BICYCLE" 4 "PEDESTRIAN" 5 "FIXED OVERHEAD OBJECT" 6 "FIXED ROADSIDE OBJECT" 7 "NO OBJECT PRESENT" 8 "PEDESTRIAN STANDING OUTSIDE DANGER ZONE" 9 "PEDESTRIAN MOVING OUT OF DANGER ZONE" 10 "PEDESTRIAN MOVING INTO DANGER ZONE" 11 "CHILD CLOSE TO DANGER ZONE" 12 "CLUSTER OBJECT" ;
VAL_TABLE_ ALOI2_RngTk8_Inv 0 "FALSE" 1 "TRUE" ;
VAL_TABLE_ ALOI2_TypTk8 0 "UNKNOWN" 1 "4 WHEEL VEHICLE" 2 "LARGE VEHICLE" 3 "MOTORCYCLE/BICYCLE" 4 "PEDESTRIAN" 5 "FIXED OVERHEAD OBJECT" 6 "FIXED ROADSIDE OBJECT" 7 "NO OBJECT PRESENT" 8 "PEDESTRIAN STANDING OUTSIDE DANGER ZONE" 9 "PEDESTRIAN MOVING OUT OF DANGER ZONE" 10 "PEDESTRIAN MOVING INTO DANGER ZONE" 11 "CHILD CLOSE TO DANGER ZONE" 12 "CLUSTER OBJECT" ;
VAL_TABLE_ ALOI2_TypTk7 0 "UNKNOWN" 1 "4 WHEEL VEHICLE" 2 "LARGE VEHICLE" 3 "MOTORCYCLE/BICYCLE" 4 "PEDESTRIAN" 5 "FIXED OVERHEAD OBJECT" 6 "FIXED ROADSIDE OBJECT" 7 "NO OBJECT PRESENT" 8 "PEDESTRIAN STANDING OUTSIDE DANGER ZONE" 9 "PEDESTRIAN MOVING OUT OF DANGER ZONE" 10 "PEDESTRIAN MOVING INTO DANGER ZONE" 11 "CHILD CLOSE TO DANGER ZONE" 12 "CLUSTER OBJECT" ;
VAL_TABLE_ ARDG1_HstLnLtTyp 0 "Undecided" 1 "Solid" 2 "Dashed" 3 "Road Edge" 4 "Double Line" 5 "Botts Dots" 6 "Virtual" 7 "Triple Line" ;
VAL_TABLE_ ARDG1_HstLnLtQlty 0 "Very Low Quality" 1 "Low Quality" 2 "Prediction" 3 "High Quality" ;
VAL_TABLE_ ARDG1_HstNxtLnLtTyp 0 "Undecided" 1 "Solid" 2 "Dashed" 3 "Road Edge" 4 "Double Line" 5 "Botts Dots" 6 "Virtual" 7 "Triple Line" ;
VAL_TABLE_ ARDG1_HstNxtLnLtQlty 0 "Very Low Quality" 1 "Low Quality" 2 "Prediction" 3 "High Quality" ;
VAL_TABLE_ ARDG1_LtVehAhdMeasSts 0 "No Object" 1 "New Object" 2 "Latent Track Not Detected this Cycle" 3 "Measured this Cycle" ;
VAL_TABLE_ ARDG2_AutfxOutOfCal 0 "Unknown" 1 "Yaw" 2 "Horizon" 3 "Both" ;
VAL_TABLE_ ARDG2_FrwdCamSysOprtgSts 0 "Unknown" 1 "Initializing" 2 "Inactive" 3 "Active" 4 "Programing" 5 "Reserved 1" 6 "Reserved 2" 7 "Failed" ;
VAL_TABLE_ ARDG2_HstVehAhdMeasSts 0 "No Object" 1 "New Object" 2 "Latent Track Not Detected this Cycle" 3 "Measured this Cycle" ;
VAL_TABLE_ ARDG2_FrwdVsnUnv 0 "FALSE" 1 "TRUE" ;
VAL_TABLE_ ARDG2_FrwdVsnTmStm_Inv 0 "FALSE" 1 "TRUE" ;
VAL_TABLE_ ARDG3_HstLnRtTyp 0 "Undecided" 1 "Solid" 2 "Dashed" 3 "Road Edge" 4 "Double Line" 5 "Botts Dots" 6 "Virtual" 7 "Triple Line" ;
VAL_TABLE_ ARDG3_HstLnRtQlty 0 "Very Low Quality" 1 "Low Quality" 2 "Prediction" 3 "High Quality" ;
VAL_TABLE_ ARDG3_HstNxtLnRtTyp 0 "Undecided" 1 "Solid" 2 "Dashed" 3 "Road Edge" 4 "Double Line" 5 "Botts Dots" 6 "Virtual" 7 "Triple Line" ;
VAL_TABLE_ ARDG3_HstNxtLnRtQlty 0 "Very Low Quality" 1 "Low Quality" 2 "Prediction" 3 "High Quality" ;
VAL_TABLE_ ARDG3_RtVehAhdMeasSts 0 "No Object" 1 "New Object" 2 "Latent Track Not Detected this Cycle" 3 "Measured this Cycle" ;
VAL_TABLE_ BSPMP_BkupSysPwrModeAuth_Inv 0 "FALSE" 1 "TRUE" ;
VAL_TABLE_ BSPMP_BkupSysPwrModeAuth 0 "Off" 1 "Accessory" 2 "Run" 3 "Start Request" 4 "Propulsion" ;
VAL_TABLE_ BSPMP_SecRunCrnkCmdActvAuth_Inv 0 "FALSE" 1 "TRUE" ;
VAL_TABLE_ BSPMP_SecRunCrnkCmdActvAuth 0 "FALSE" 1 "TRUE" ;
VAL_TABLE_ BSPMP_SecPwrModePBActvAuth_Inv 0 "FALSE" 1 "TRUE" ;
VAL_TABLE_ BSPMP_SecPwrModePBActvAuth 0 "FALSE" 1 "TRUE" ;
VAL_TABLE_ BSPMP_RmtProgmActvAuth 0 "FALSE" 1 "TRUE" ;
VAL_TABLE_ DTCI_ACP2_MCU_CnfrmdDTC 0 "FALSE" 1 "TRUE" ;
VAL_TABLE_ DTCI_ACP2_MCU_DTCFaultType 0 "Not Supported" 1 "Type A" 2 "Type B" 3 "Type C" ;
VAL_TABLE_ DTCI_ACP2_MCU_TstNCmpltdOpCyc 0 "FALSE" 1 "TRUE" ;
VAL_TABLE_ DTCI_ACP2_MCU_TstNCmpltdLstClr 0 "FALSE" 1 "TRUE" ;
VAL_TABLE_ DTCI_ACP2_MCU_TstFldOpCyc 0 "FALSE" 1 "TRUE" ;
VAL_TABLE_ DTCI_ACP2_MCU_TstFldLstClr 0 "FALSE" 1 "TRUE" ;
VAL_TABLE_ DTCI_ACP2_MCU_TstFld 0 "FALSE" 1 "TRUE" ;
VAL_TABLE_ DTCI_ACP2_MCU_PndngDTC 0 "FALSE" 1 "TRUE" ;
VAL_TABLE_ DTCI_ACP2_MCU_DTCTriggered 0 "FALSE" 1 "TRUE" ;
VAL_TABLE_ DTCI_ACP2_MCU_WrnIndTrggrd 0 "FALSE" 1 "TRUE" ;
VAL_TABLE_ DTCI_ACP2_MCU_WrnIndRqd 0 "FALSE" 1 "TRUE" ;
VAL_TABLE_ DTCI_ACP3_MCU_CnfrmdDTC 0 "FALSE" 1 "TRUE" ;
VAL_TABLE_ DTCI_ACP3_MCU_DTCFaultType 0 "Not Supported" 1 "Type A" 2 "Type B" 3 "Type C" ;
VAL_TABLE_ DTCI_ACP3_MCU_TstNCmpltdOpCyc 0 "FALSE" 1 "TRUE" ;
VAL_TABLE_ DTCI_ACP3_MCU_TstNCmpltdLstClr 0 "FALSE" 1 "TRUE" ;
VAL_TABLE_ DTCI_ACP3_MCU_TstFldOpCyc 0 "FALSE" 1 "TRUE" ;
VAL_TABLE_ DTCI_ACP3_MCU_TstFldLstClr 0 "FALSE" 1 "TRUE" ;
VAL_TABLE_ DTCI_ACP3_MCU_TstFld 0 "FALSE" 1 "TRUE" ;
VAL_TABLE_ DTCI_ACP3_MCU_PndngDTC 0 "FALSE" 1 "TRUE" ;
VAL_TABLE_ DTCI_ACP3_MCU_DTCTriggered 0 "FALSE" 1 "TRUE" ;
VAL_TABLE_ DTCI_ACP3_MCU_WrnIndTrggrd 0 "FALSE" 1 "TRUE" ;
VAL_TABLE_ DTCI_ACP3_MCU_WrnIndRqd 0 "FALSE" 1 "TRUE" ;
VAL_TABLE_ DTCI_ACP4_MCU_CnfrmdDTC 0 "FALSE" 1 "TRUE" ;
VAL_TABLE_ DTCI_ACP4_MCU_DTCFaultType 0 "Not Supported" 1 "Type A" 2 "Type B" 3 "Type C" ;
VAL_TABLE_ DTCI_ACP4_MCU_TstNCmpltdOpCyc 0 "FALSE" 1 "TRUE" ;
VAL_TABLE_ DTCI_ACP4_MCU_TstNCmpltdLstClr 0 "FALSE" 1 "TRUE" ;
VAL_TABLE_ DTCI_ACP4_MCU_TstFldOpCyc 0 "FALSE" 1 "TRUE" ;
VAL_TABLE_ DTCI_ACP4_MCU_TstFldLstClr 0 "FALSE" 1 "TRUE" ;
VAL_TABLE_ DTCI_ACP4_MCU_TstFld 0 "FALSE" 1 "TRUE" ;
VAL_TABLE_ DTCI_ACP4_MCU_PndngDTC 0 "FALSE" 1 "TRUE" ;
VAL_TABLE_ DTCI_ACP4_MCU_DTCTriggered 0 "FALSE" 1 "TRUE" ;
VAL_TABLE_ DTCI_ACP4_MCU_WrnIndTrggrd 0 "FALSE" 1 "TRUE" ;
VAL_TABLE_ DTCI_ACP4_MCU_WrnIndRqd 0 "FALSE" 1 "TRUE" ;
VAL_TABLE_ DTCI_EOCM_HCP2_CnfrmdDTC 0 "FALSE" 1 "TRUE" ;
VAL_TABLE_ DTCI_EOCM_HCP2_DTCFaultType 0 "Not Supported" 1 "Type A" 2 "Type B" 3 "Type C" ;
VAL_TABLE_ DTCI_EOCM_HCP2_TstNCmpltdOpCyc 0 "FALSE" 1 "TRUE" ;
VAL_TABLE_ DTCI_EOCM_HCP2_TstNCmpltdLstClr 0 "FALSE" 1 "TRUE" ;
VAL_TABLE_ DTCI_EOCM_HCP2_TstFldOpCyc 0 "FALSE" 1 "TRUE" ;
VAL_TABLE_ DTCI_EOCM_HCP2_TstFldLstClr 0 "FALSE" 1 "TRUE" ;
VAL_TABLE_ DTCI_EOCM_HCP2_TstFld 0 "FALSE" 1 "TRUE" ;
VAL_TABLE_ DTCI_EOCM_HCP2_PndngDTC 0 "FALSE" 1 "TRUE" ;
VAL_TABLE_ DTCI_EOCM_HCP2_DTCTriggered 0 "FALSE" 1 "TRUE" ;
VAL_TABLE_ DTCI_EOCM_HCP2_WrnIndTrggrd 0 "FALSE" 1 "TRUE" ;
VAL_TABLE_ DTCI_EOCM_HCP2_WrnIndRqd 0 "FALSE" 1 "TRUE" ;
VAL_TABLE_ DTCI_FCM_LC_CnfrmdDTC 0 "FALSE" 1 "TRUE" ;
VAL_TABLE_ DTCI_FCM_LC_DTCFaultType 0 "Not Supported" 1 "Type A" 2 "Type B" 3 "Type C" ;
VAL_TABLE_ DTCI_FCM_LC_TstNCmpltdOpCyc 0 "FALSE" 1 "TRUE" ;
VAL_TABLE_ DTCI_FCM_LC_TstNCmpltdLstClr 0 "FALSE" 1 "TRUE" ;
VAL_TABLE_ DTCI_FCM_LC_TstFldOpCyc 0 "FALSE" 1 "TRUE" ;
VAL_TABLE_ DTCI_FCM_LC_TstFldLstClr 0 "FALSE" 1 "TRUE" ;
VAL_TABLE_ DTCI_FCM_LC_TstFld 0 "FALSE" 1 "TRUE" ;
VAL_TABLE_ DTCI_FCM_LC_PndngDTC 0 "FALSE" 1 "TRUE" ;
VAL_TABLE_ DTCI_FCM_LC_DTCTriggered 0 "FALSE" 1 "TRUE" ;
VAL_TABLE_ DTCI_FCM_LC_WrnIndTrggrd 0 "FALSE" 1 "TRUE" ;
VAL_TABLE_ DTCI_FCM_LC_WrnIndRqd 0 "FALSE" 1 "TRUE" ;
VAL_TABLE_ DTCI_HDLM_CnfrmdDTC 0 "FALSE" 1 "TRUE" ;
VAL_TABLE_ DTCI_HDLM_DTCFaultType 0 "Not Supported" 1 "Type A" 2 "Type B" 3 "Type C" ;
VAL_TABLE_ DTCI_HDLM_TstNCmpltdOpCyc 0 "FALSE" 1 "TRUE" ;
VAL_TABLE_ DTCI_HDLM_TstNCmpltdLstClr 0 "FALSE" 1 "TRUE" ;
VAL_TABLE_ DTCI_HDLM_TstFldOpCyc 0 "FALSE" 1 "TRUE" ;
VAL_TABLE_ DTCI_HDLM_TstFldLstClr 0 "FALSE" 1 "TRUE" ;
VAL_TABLE_ DTCI_HDLM_TstFld 0 "FALSE" 1 "TRUE" ;
VAL_TABLE_ DTCI_HDLM_PndngDTC 0 "FALSE" 1 "TRUE" ;
VAL_TABLE_ DTCI_HDLM_DTCTriggered 0 "FALSE" 1 "TRUE" ;
VAL_TABLE_ DTCI_HDLM_WrnIndTrggrd 0 "FALSE" 1 "TRUE" ;
VAL_TABLE_ DTCI_HDLM_WrnIndRqd 0 "FALSE" 1 "TRUE" ;
VAL_TABLE_ DTCI_LRR_CnfrmdDTC 0 "FALSE" 1 "TRUE" ;
VAL_TABLE_ DTCI_LRR_DTCFaultType 0 "Not Supported" 1 "Type A" 2 "Type B" 3 "Type C" ;
VAL_TABLE_ DTCI_LRR_TstNCmpltdOpCyc 0 "FALSE" 1 "TRUE" ;
VAL_TABLE_ DTCI_LRR_TstNCmpltdLstClr 0 "FALSE" 1 "TRUE" ;
VAL_TABLE_ DTCI_LRR_TstFldOpCyc 0 "FALSE" 1 "TRUE" ;
VAL_TABLE_ DTCI_LRR_TstFldLstClr 0 "FALSE" 1 "TRUE" ;
VAL_TABLE_ DTCI_LRR_TstFld 0 "FALSE" 1 "TRUE" ;
VAL_TABLE_ DTCI_LRR_PndngDTC 0 "FALSE" 1 "TRUE" ;
VAL_TABLE_ DTCI_LRR_DTCTriggered 0 "FALSE" 1 "TRUE" ;
VAL_TABLE_ DTCI_LRR_WrnIndTrggrd 0 "FALSE" 1 "TRUE" ;
VAL_TABLE_ DTCI_LRR_WrnIndRqd 0 "FALSE" 1 "TRUE" ;
VAL_TABLE_ DTCI_SRR_LF_CnfrmdDTC 0 "FALSE" 1 "TRUE" ;
VAL_TABLE_ DTCI_SRR_LF_DTCFaultType 0 "Not Supported" 1 "Type A" 2 "Type B" 3 "Type C" ;
VAL_TABLE_ DTCI_SRR_LF_TstNCmpltdOpCyc 0 "FALSE" 1 "TRUE" ;
VAL_TABLE_ DTCI_SRR_LF_TstNCmpltdLstClr 0 "FALSE" 1 "TRUE" ;
VAL_TABLE_ DTCI_SRR_LF_TstFldOpCyc 0 "FALSE" 1 "TRUE" ;
VAL_TABLE_ DTCI_SRR_LF_TstFldLstClr 0 "FALSE" 1 "TRUE" ;
VAL_TABLE_ DTCI_SRR_LF_TstFld 0 "FALSE" 1 "TRUE" ;
VAL_TABLE_ DTCI_SRR_LF_PndngDTC 0 "FALSE" 1 "TRUE" ;
VAL_TABLE_ DTCI_SRR_LF_DTCTriggered 0 "FALSE" 1 "TRUE" ;
VAL_TABLE_ DTCI_SRR_LF_WrnIndTrggrd 0 "FALSE" 1 "TRUE" ;
VAL_TABLE_ DTCI_SRR_LF_WrnIndRqd 0 "FALSE" 1 "TRUE" ;
VAL_TABLE_ DTCI_SRR_LR_CR_CnfrmdDTC 0 "FALSE" 1 "TRUE" ;
VAL_TABLE_ DTCI_SRR_LR_CR_DTCFaultType 0 "Not Supported" 1 "Type A" 2 "Type B" 3 "Type C" ;
VAL_TABLE_ DTCI_SRR_LR_CR_TstNCmpltdOpCyc 0 "FALSE" 1 "TRUE" ;
VAL_TABLE_ DTCI_SRR_LR_CR_TstNCmpltdLstClr 0 "FALSE" 1 "TRUE" ;
VAL_TABLE_ DTCI_SRR_LR_CR_TstFldOpCyc 0 "FALSE" 1 "TRUE" ;
VAL_TABLE_ DTCI_SRR_LR_CR_TstFldLstClr 0 "FALSE" 1 "TRUE" ;
VAL_TABLE_ DTCI_SRR_LR_CR_TstFld 0 "FALSE" 1 "TRUE" ;
VAL_TABLE_ DTCI_SRR_LR_CR_PndngDTC 0 "FALSE" 1 "TRUE" ;
VAL_TABLE_ DTCI_SRR_LR_CR_DTCTriggered 0 "FALSE" 1 "TRUE" ;
VAL_TABLE_ DTCI_SRR_LR_CR_WrnIndTrggrd 0 "FALSE" 1 "TRUE" ;
VAL_TABLE_ DTCI_SRR_LR_CR_WrnIndRqd 0 "FALSE" 1 "TRUE" ;
VAL_TABLE_ DTCI_SRR_RF_CnfrmdDTC 0 "FALSE" 1 "TRUE" ;
VAL_TABLE_ DTCI_SRR_RF_DTCFaultType 0 "Not Supported" 1 "Type A" 2 "Type B" 3 "Type C" ;
VAL_TABLE_ DTCI_SRR_RF_TstNCmpltdOpCyc 0 "FALSE" 1 "TRUE" ;
VAL_TABLE_ DTCI_SRR_RF_TstNCmpltdLstClr 0 "FALSE" 1 "TRUE" ;
VAL_TABLE_ DTCI_SRR_RF_TstFldOpCyc 0 "FALSE" 1 "TRUE" ;
VAL_TABLE_ DTCI_SRR_RF_TstFldLstClr 0 "FALSE" 1 "TRUE" ;
VAL_TABLE_ DTCI_SRR_RF_TstFld 0 "FALSE" 1 "TRUE" ;
VAL_TABLE_ DTCI_SRR_RF_PndngDTC 0 "FALSE" 1 "TRUE" ;
VAL_TABLE_ DTCI_SRR_RF_DTCTriggered 0 "FALSE" 1 "TRUE" ;
VAL_TABLE_ DTCI_SRR_RF_WrnIndTrggrd 0 "FALSE" 1 "TRUE" ;
VAL_TABLE_ DTCI_SRR_RF_WrnIndRqd 0 "FALSE" 1 "TRUE" ;
VAL_TABLE_ DTCI_SRR_RR_CnfrmdDTC 0 "FALSE" 1 "TRUE" ;
VAL_TABLE_ DTCI_SRR_RR_DTCFaultType 0 "Not Supported" 1 "Type A" 2 "Type B" 3 "Type C" ;
VAL_TABLE_ DTCI_SRR_RR_TstNCmpltdOpCyc 0 "FALSE" 1 "TRUE" ;
VAL_TABLE_ DTCI_SRR_RR_TstNCmpltdLstClr 0 "FALSE" 1 "TRUE" ;
VAL_TABLE_ DTCI_SRR_RR_TstFldOpCyc 0 "FALSE" 1 "TRUE" ;
VAL_TABLE_ DTCI_SRR_RR_TstFldLstClr 0 "FALSE" 1 "TRUE" ;
VAL_TABLE_ DTCI_SRR_RR_TstFld 0 "FALSE" 1 "TRUE" ;
VAL_TABLE_ DTCI_SRR_RR_PndngDTC 0 "FALSE" 1 "TRUE" ;
VAL_TABLE_ DTCI_SRR_RR_DTCTriggered 0 "FALSE" 1 "TRUE" ;
VAL_TABLE_ DTCI_SRR_RR_WrnIndTrggrd 0 "FALSE" 1 "TRUE" ;
VAL_TABLE_ DTCI_SRR_RR_WrnIndRqd 0 "FALSE" 1 "TRUE" ;
VAL_TABLE_ DTCI_SRR_SLR_CnfrmdDTC 0 "FALSE" 1 "TRUE" ;
VAL_TABLE_ DTCI_SRR_SLR_DTCFaultType 0 "Not Supported" 1 "Type A" 2 "Type B" 3 "Type C" ;
VAL_TABLE_ DTCI_SRR_SLR_TstNCmpltdOpCyc 0 "FALSE" 1 "TRUE" ;
VAL_TABLE_ DTCI_SRR_SLR_TstNCmpltdLstClr 0 "FALSE" 1 "TRUE" ;
VAL_TABLE_ DTCI_SRR_SLR_TstFldOpCyc 0 "FALSE" 1 "TRUE" ;
VAL_TABLE_ DTCI_SRR_SLR_TstFldLstClr 0 "FALSE" 1 "TRUE" ;
VAL_TABLE_ DTCI_SRR_SLR_TstFld 0 "FALSE" 1 "TRUE" ;
VAL_TABLE_ DTCI_SRR_SLR_PndngDTC 0 "FALSE" 1 "TRUE" ;
VAL_TABLE_ DTCI_SRR_SLR_DTCTriggered 0 "FALSE" 1 "TRUE" ;
VAL_TABLE_ DTCI_SRR_SLR_WrnIndTrggrd 0 "FALSE" 1 "TRUE" ;
VAL_TABLE_ DTCI_SRR_SLR_WrnIndRqd 0 "FALSE" 1 "TRUE" ;
VAL_TABLE_ DTCI_SRR_SRR_CnfrmdDTC 0 "FALSE" 1 "TRUE" ;
VAL_TABLE_ DTCI_SRR_SRR_DTCFaultType 0 "Not Supported" 1 "Type A" 2 "Type B" 3 "Type C" ;
VAL_TABLE_ DTCI_SRR_SRR_TstNCmpltdOpCyc 0 "FALSE" 1 "TRUE" ;
VAL_TABLE_ DTCI_SRR_SRR_TstNCmpltdLstClr 0 "FALSE" 1 "TRUE" ;
VAL_TABLE_ DTCI_SRR_SRR_TstFldOpCyc 0 "FALSE" 1 "TRUE" ;
VAL_TABLE_ DTCI_SRR_SRR_TstFldLstClr 0 "FALSE" 1 "TRUE" ;
VAL_TABLE_ DTCI_SRR_SRR_TstFld 0 "FALSE" 1 "TRUE" ;
VAL_TABLE_ DTCI_SRR_SRR_PndngDTC 0 "FALSE" 1 "TRUE" ;
VAL_TABLE_ DTCI_SRR_SRR_DTCTriggered 0 "FALSE" 1 "TRUE" ;
VAL_TABLE_ DTCI_SRR_SRR_WrnIndTrggrd 0 "FALSE" 1 "TRUE" ;
VAL_TABLE_ DTCI_SRR_SRR_WrnIndRqd 0 "FALSE" 1 "TRUE" ;
VAL_TABLE_ DTCI_UPM_CnfrmdDTC 0 "FALSE" 1 "TRUE" ;
VAL_TABLE_ DTCI_UPM_DTCFaultType 0 "Not Supported" 1 "Type A" 2 "Type B" 3 "Type C" ;
VAL_TABLE_ DTCI_UPM_TstNCmpltdOpCyc 0 "FALSE" 1 "TRUE" ;
VAL_TABLE_ DTCI_UPM_TstNCmpltdLstClr 0 "FALSE" 1 "TRUE" ;
VAL_TABLE_ DTCI_UPM_TstFldOpCyc 0 "FALSE" 1 "TRUE" ;
VAL_TABLE_ DTCI_UPM_TstFldLstClr 0 "FALSE" 1 "TRUE" ;
VAL_TABLE_ DTCI_UPM_TstFld 0 "FALSE" 1 "TRUE" ;
VAL_TABLE_ DTCI_UPM_PndngDTC 0 "FALSE" 1 "TRUE" ;
VAL_TABLE_ DTCI_UPM_DTCTriggered 0 "FALSE" 1 "TRUE" ;
VAL_TABLE_ DTCI_UPM_WrnIndTrggrd 0 "FALSE" 1 "TRUE" ;
VAL_TABLE_ DTCI_UPM_WrnIndRqd 0 "FALSE" 1 "TRUE" ;
VAL_TABLE_ EASSI_StrtStpSt 0 "Engine Off" 1 "Engine Running" 2 "Engine Starting" 3 "Engine Stopping" ;
VAL_TABLE_ ACCAutoStSpStat 0 "No_Set_Speed_Change" 1 "Proposed_Speed_Limit_Change" 2 "Accepted_Speed_Limit_Change" 3 "Declined_Speed_Limit_Change" ;
VAL_TABLE_ EPBSP_ElecPrkBrkApplStsAuth 0 "Unknown" 1 "Applied" 2 "Released" 3 "Dynamic Apply" 4 "In-Progress" ;
VAL_TABLE_ FIMRIMABP_FIMCISAutBrkRqTypAuth 0 "None" 1 "Brake to Commanded Decel" 2 "Hold" ;
VAL_TABLE_ FIMRIMABP_BrkgReqAuth 0 "FALSE" 1 "TRUE" ;
VAL_TABLE_ RIMATRP_TrqRqstActAuth 0 "FALSE" 1 "TRUE" ;
VAL_TABLE_ FIMRIMABP_ReqActvAuth 0 "FALSE" 1 "TRUE" ;
VAL_TABLE_ FIMRIMABP_RIMAutoBrkgReqTypAuth 0 "None" 1 "Hold" ;
VAL_TABLE_ EOCM_CAN8_ClscCANHrtBtActv 0 "FALSE" 1 "TRUE" ;
VAL_TABLE_ EOCM_HCP1_CAN8_ClscCANHrtBtActv 0 "FALSE" 1 "TRUE" ;
VAL_TABLE_ EOCM_HCP2_CAN8_ClscCANHrtBtActv 0 "FALSE" 1 "TRUE" ;
VAL_TABLE_ FCM_LC_CAN8_ClscCANHrtBtActv 0 "FALSE" 1 "TRUE" ;
VAL_TABLE_ FCODPB11P_FVVOTk10PoI4PsVisAuth 0 "Unknown" 1 "Visible" 2 "Projected" ;
VAL_TABLE_ FCODPB11P_FVVOTk1PoI4PsVisAuth 0 "Unknown" 1 "Visible" 2 "Projected" ;
VAL_TABLE_ FCODPB11P_FVVOTk2PoI4PsVisAuth 0 "Unknown" 1 "Visible" 2 "Projected" ;
VAL_TABLE_ FCODPB11P_FVVOTk3PoI4PsVisAuth 0 "Unknown" 1 "Visible" 2 "Projected" ;
VAL_TABLE_ FCODPB11P_FVVOTk4PoI4PsVisAuth 0 "Unknown" 1 "Visible" 2 "Projected" ;
VAL_TABLE_ FCODPB11P_FVVOTk5PoI4PsVisAuth 0 "Unknown" 1 "Visible" 2 "Projected" ;
VAL_TABLE_ FCODPB11P_FVVOTk6PoI4PsVisAuth 0 "Unknown" 1 "Visible" 2 "Projected" ;
VAL_TABLE_ FCODPB11P_FVVOTk7PoI4PsVisAuth 0 "Unknown" 1 "Visible" 2 "Projected" ;
VAL_TABLE_ FCODPB11P_FVVOTk8PoI4PsVisAuth 0 "Unknown" 1 "Visible" 2 "Projected" ;
VAL_TABLE_ FCODPB11P_FVVOTk9PoI4PsVisAuth 0 "Unknown" 1 "Visible" 2 "Projected" ;
VAL_TABLE_ FCODPB11P_LnTrPtEndTypAuth 0 "Unknown" 1 "Merge End" 2 "Split End" ;
VAL_TABLE_ FCODPB11P_LnTrPtStrtTypAuth 0 "Unknown" 1 "Merge Start" 2 "Split Start" ;
VAL_TABLE_ FCODPB11P_FrwdVsnModeCmdStsAuth 0 "Not Reporting Object Data" 1 "Reporting Object Data" ;
VAL_TABLE_ FrwdVsnLnBdryTk11DatIntegCkd 0 "Unknown" 1 "Pass" 2 "Fail" ;
VAL_TABLE_ FCODPB11P_ShldrDtnRtofVehAuth 0 "Shoulder Not Detected" 1 "Shoulder Detected" 2 "Reserved" 3 "Not Valid" ;
VAL_TABLE_ FCODPB11P_ShldrDtnLtofVehAuth 0 "Shoulder Not Detected" 1 "Shoulder Detected" 2 "Reserved" 3 "Not Valid" ;
VAL_TABLE_ FCODPB12P_FVTS1PsdbyHstVehAuth 0 "FALSE" 1 "TRUE" ;
VAL_TABLE_ FCODPB12P_FVTS1PhysTypAuth 0 "Static" 1 "Variable" 2 "Temporary" ;
VAL_TABLE_ FCODPB12P_FVTS1MeasVldAuth 0 "FALSE" 1 "TRUE" ;
VAL_TABLE_ FCODPB12P_FVTS1FiltTypAuth 0 "Not Filtered" 1 "Irrelevant To Host Driver" 2 "On Vehicle/Truck" 3 "Embedded" ;
VAL_TABLE_ FCODPB12P_FVTS1ZnDtdAuth 0 "FALSE" 1 "TRUE" ;
VAL_TABLE_ FCODPB12P_FVTS2ZnDtdAuth 0 "FALSE" 1 "TRUE" ;
VAL_TABLE_ FCODPB12P_FVTS2PsdbyHstVehAuth 0 "FALSE" 1 "TRUE" ;
VAL_TABLE_ FCODPB12P_FVTS2PhysTypAuth 0 "Static" 1 "Variable" 2 "Temporary" ;
VAL_TABLE_ FCODPB12P_FVTS2MeasVldAuth 0 "FALSE" 1 "TRUE" ;
VAL_TABLE_ FCODPB12P_FVTS2FiltTypAuth 0 "Not Filtered" 1 "Irrelevant To Host Driver" 2 "On Vehicle/Truck" 3 "Embedded" ;
VAL_TABLE_ FCODPB12P_FVTS3ZnDtdAuth 0 "FALSE" 1 "TRUE" ;
VAL_TABLE_ FCODPB12P_FVTS3PsdbyHstVehAuth 0 "FALSE" 1 "TRUE" ;
VAL_TABLE_ FCODPB12P_FVTS3PhysTypAuth 0 "Static" 1 "Variable" 2 "Temporary" ;
VAL_TABLE_ FCODPB12P_FVTS3MeasVldAuth 0 "FALSE" 1 "TRUE" ;
VAL_TABLE_ FCODPB12P_FVTS3FiltTypAuth 0 "Not Filtered" 1 "Irrelevant To Host Driver" 2 "On Vehicle/Truck" 3 "Embedded" ;
VAL_TABLE_ FCODPB12P_FVTS4FiltTypAuth 0 "Not Filtered" 1 "Irrelevant To Host Driver" 2 "On Vehicle/Truck" 3 "Embedded" ;
VAL_TABLE_ FCODPB12P_FVTS4ZnDtdAuth 0 "FALSE" 1 "TRUE" ;
VAL_TABLE_ FCODPB12P_FVTS4PsdbyHstVehAuth 0 "FALSE" 1 "TRUE" ;
VAL_TABLE_ FCODPB12P_FVTS4PhysTypAuth 0 "Static" 1 "Variable" 2 "Temporary" ;
VAL_TABLE_ FCODPB12P_FVTS4MeasVldAuth 0 "FALSE" 1 "TRUE" ;
VAL_TABLE_ FCODPB12P_FVTS5FiltTypAuth 0 "Not Filtered" 1 "Irrelevant To Host Driver" 2 "On Vehicle/Truck" 3 "Embedded" ;
VAL_TABLE_ FCODPB12P_FVTS5ZnDtdAuth 0 "FALSE" 1 "TRUE" ;
VAL_TABLE_ FCODPB12P_FVTS5PsdbyHstVehAuth 0 "FALSE" 1 "TRUE" ;
VAL_TABLE_ FCODPB12P_FVTS5PhysTypAuth 0 "Static" 1 "Variable" 2 "Temporary" ;
VAL_TABLE_ FCODPB12P_FVTS5MeasVldAuth 0 "FALSE" 1 "TRUE" ;
VAL_TABLE_ FCODPB12P_FVTS6MeasVldAuth 0 "FALSE" 1 "TRUE" ;
VAL_TABLE_ FCODPB12P_FVTS6FiltTypAuth 0 "Not Filtered" 1 "Irrelevant To Host Driver" 2 "On Vehicle/Truck" 3 "Embedded" ;
VAL_TABLE_ FCODPB12P_RdBnkCrv1CnfdStsAuth 0 "Highly Speculative" 1 "Speculative" 2 "Confident" 3 "Highly Confident" ;
VAL_TABLE_ FCODPB12P_FVTS6ZnDtdAuth 0 "FALSE" 1 "TRUE" ;
VAL_TABLE_ FCODPB12P_FVTS6PsdbyHstVehAuth 0 "FALSE" 1 "TRUE" ;
VAL_TABLE_ FCODPB12P_FVTS6PhysTypAuth 0 "Static" 1 "Variable" 2 "Temporary" ;
VAL_TABLE_ FCODPB12P_RdBnkCrv2CnfdStsAuth 0 "Highly Speculative" 1 "Speculative" 2 "Confident" 3 "Highly Confident" ;
VAL_TABLE_ FCODPB12P_RdBnkCrv3CnfdStsAuth 0 "Highly Speculative" 1 "Speculative" 2 "Confident" 3 "Highly Confident" ;
VAL_TABLE_ FCODPB13P_FVTS10PsdbyHstVehAuth 0 "FALSE" 1 "TRUE" ;
VAL_TABLE_ FCODPB13P_FVTS10PhysTypAuth 0 "Static" 1 "Variable" 2 "Temporary" ;
VAL_TABLE_ FCODPB13P_FVTS10MeasVldAuth 0 "FALSE" 1 "TRUE" ;
VAL_TABLE_ FCODPB13P_FVTS10FiltTypAuth 0 "Not Filtered" 1 "Irrelevant To Host Driver" 2 "On Vehicle/Truck" 3 "Embedded" ;
VAL_TABLE_ FCODPB13P_FVTS10ZnDtdAuth 0 "FALSE" 1 "TRUE" ;
VAL_TABLE_ FCODPB13P_FVTS7ZnDtdAuth 0 "FALSE" 1 "TRUE" ;
VAL_TABLE_ FCODPB13P_FVTS7PsdbyHstVehAuth 0 "FALSE" 1 "TRUE" ;
VAL_TABLE_ FCODPB13P_FVTS7PhysTypAuth 0 "Static" 1 "Variable" 2 "Temporary" ;
VAL_TABLE_ FCODPB13P_FVTS7MeasVldAuth 0 "FALSE" 1 "TRUE" ;
VAL_TABLE_ FCODPB13P_FVTS7FiltTypAuth 0 "Not Filtered" 1 "Irrelevant To Host Driver" 2 "On Vehicle/Truck" 3 "Embedded" ;
VAL_TABLE_ FCODPB13P_FVTS8ZnDtdAuth 0 "FALSE" 1 "TRUE" ;
VAL_TABLE_ FCODPB13P_FVTS8PsdbyHstVehAuth 0 "FALSE" 1 "TRUE" ;
VAL_TABLE_ FCODPB13P_FVTS8PhysTypAuth 0 "Static" 1 "Variable" 2 "Temporary" ;
VAL_TABLE_ FCODPB13P_FVTS8MeasVldAuth 0 "FALSE" 1 "TRUE" ;
VAL_TABLE_ FCODPB13P_FVTS8FiltTypAuth 0 "Not Filtered" 1 "Irrelevant To Host Driver" 2 "On Vehicle/Truck" 3 "Embedded" ;
VAL_TABLE_ FCODPB13P_FVTS9FiltTypAuth 0 "Not Filtered" 1 "Irrelevant To Host Driver" 2 "On Vehicle/Truck" 3 "Embedded" ;
VAL_TABLE_ FCODPB13P_FVTSTk10CnfdStsAuth 0 "Highly Speculative" 1 "Speculative" 2 "Confident" 3 "Highly Confident" ;
VAL_TABLE_ FCODPB13P_FVTS9ZnDtdAuth 0 "FALSE" 1 "TRUE" ;
VAL_TABLE_ FCODPB13P_FVTS9PsdbyHstVehAuth 0 "FALSE" 1 "TRUE" ;
VAL_TABLE_ FCODPB13P_FVTS9PhysTypAuth 0 "Static" 1 "Variable" 2 "Temporary" ;
VAL_TABLE_ FCODPB13P_FVTS9MeasVldAuth 0 "FALSE" 1 "TRUE" ;
VAL_TABLE_ FCODPB13P_FVTSTk10SupTypAuth 0 "None" 1 "Rain" 2 "Snow" 3 "Trailer" 4 "Time" 5 "Arrow Left" 6 "Arrow Right" 7 "Bend Arrow Left" 8 "Bend Arrow Right" 9 "Truck" 10 "Distance Arrow" 11 "Weight" 12 "Distance In" 13 "Tractor" 14 "Snow Rain" 15 "School" 16 "Rain Cloud" 17 "Fog" 18 "Hazardous" 19 "Material" 20 "Night" 21 "Supp Sign Generic" 22 "Rappel" 23 "Tractor Passable" 24 "Wet Conditions" 25 "Motorcycle" 26 "Bus" 27 "Camper" 28 "Car" 29 "Tank" 30 "Hazard Spot" 31 "Traffic Jam" 32 "Train" 33 "Tram/Street Car" 34 "Noise Prevention" 35 "Residents Only" 36 "Invalid Supp" 37 "School When Flashing" 38 "End of Speed Limit" 39 "Where Workers Present" ;
VAL_TABLE_ FCODPB13P_FVTSTk10MeasStsAuth 0 "No Object" 1 "New Object" 2 "Latent Track Not Detected this Cycle" 3 "Measured this Cycle" ;
VAL_TABLE_ FCODPB13P_FVTSTk10TypAuth 0 "No Sign Detected" 1 "End of Speed Limit" 2 "End of All Restrictions" 3 "Begin of Motorway" 4 "End of Motorway" 5 "Begin of Expressway" 6 "End of Expressway" 7 "Begin of Play Street Zone" 8 "End of Play Street Zone" 9 "Begin of Passing Restriction" 10 "End of Passing Restriction" 11 "No Entry" 12 "Begin of City Limits" 13 "End of City Limits" 14 "Yield" 15 "Crosswalk" 16 "Round About" 17 "Stop Sign" 18 "Yield to Oncoming Traffic" 19 "Pedestrian Zone" 20 "No Stopping Sign" 21 "No Parking Sign" 22 "Begin of No Parking Zone" 23 "End of No Parking Zone" 24 "Invalid Sign" 25 "Unknown Sign" 26 "Speed Limit 5" 27 "Speed Limit 10" 28 "Speed Limit 15" 29 "Speed Limit 20" 30 "Speed Limit 25" 31 "Speed Limit 30" 32 "Speed Limit 35" 33 "Speed Limit 40" 34 "Speed Limit 45" 35 "Speed Limit 50" 36 "Speed Limit 55" 37 "Speed Limit 60" 38 "Speed Limit 65" 39 "Speed Limit 70" 40 "Speed Limit 75" 41 "Speed Limit 80" 42 "Speed Limit 85" 43 "Speed Limit 90" 44 "Speed Limit 95" 45 "Speed Limit 100" 46 "Speed Limit 105" 47 "Speed Limit 110" 48 "Speed Limit 115" 49 "Speed Limit 120" 50 "Speed Limit 125" 51 "Speed Limit 130" 52 "Speed Limit 135" 53 "Speed Limit 140" 54 "Speed Limit 145" 55 "Speed Limit 150" 56 "Attention Sign Construction" 57 "Attention Sign Crosswalk" 58 "Attention Sign Round About" 59 "Attention Sign Children" 60 "Attention Sign Animals Crossing" 61 "Attention Sign General" 62 "Attention Sign Cross-way" 63 "Attention Sign Sharp Turn Left" 64 "Attention Sign Sharp Turn Right" 65 "Attention Sign Winding Road" 66 "Attention Sign Up-Grade" 67 "Attention Sign Down-Grade" 68 "Attention Sign Narrow Road Left" 69 "Attention Sign Narrow Road Right" 70 "Attention Sign Narrow Road Left & Right" 71 "Attention Sign Slippery Raod" 72 "Restricted Access for All Vehicles" 73 "Restricted Access for Cars" 74 "Restricted Access for Cars & Motorcycles" 75 "Restricted Access for Campers" ;
VAL_TABLE_ FCODPB13P_FVTSTk10TypCnfdAuth 0 "Highly Speculative" 1 "Speculative" 2 "Confident" 3 "Highly Confident" ;
VAL_TABLE_ FCODPB13P_FVTSTk1CnfdStsAuth 0 "Highly Speculative" 1 "Speculative" 2 "Confident" 3 "Highly Confident" ;
VAL_TABLE_ FCODPB13P_FVTSTk1MeasStsAuth 0 "No Object" 1 "New Object" 2 "Latent Track Not Detected this Cycle" 3 "Measured this Cycle" ;
VAL_TABLE_ FCODPB13P_FVTSTk1TypAuth 0 "No Sign Detected" 1 "End of Speed Limit" 2 "End of All Restrictions" 3 "Begin of Motorway" 4 "End of Motorway" 5 "Begin of Expressway" 6 "End of Expressway" 7 "Begin of Play Street Zone" 8 "End of Play Street Zone" 9 "Begin of Passing Restriction" 10 "End of Passing Restriction" 11 "No Entry" 12 "Begin of City Limits" 13 "End of City Limits" 14 "Yield" 15 "Crosswalk" 16 "Round About" 17 "Stop Sign" 18 "Yield to Oncoming Traffic" 19 "Pedestrian Zone" 20 "No Stopping Sign" 21 "No Parking Sign" 22 "Begin of No Parking Zone" 23 "End of No Parking Zone" 24 "Invalid Sign" 25 "Unknown Sign" 26 "Speed Limit 5" 27 "Speed Limit 10" 28 "Speed Limit 15" 29 "Speed Limit 20" 30 "Speed Limit 25" 31 "Speed Limit 30" 32 "Speed Limit 35" 33 "Speed Limit 40" 34 "Speed Limit 45" 35 "Speed Limit 50" 36 "Speed Limit 55" 37 "Speed Limit 60" 38 "Speed Limit 65" 39 "Speed Limit 70" 40 "Speed Limit 75" 41 "Speed Limit 80" 42 "Speed Limit 85" 43 "Speed Limit 90" 44 "Speed Limit 95" 45 "Speed Limit 100" 46 "Speed Limit 105" 47 "Speed Limit 110" 48 "Speed Limit 115" 49 "Speed Limit 120" 50 "Speed Limit 125" 51 "Speed Limit 130" 52 "Speed Limit 135" 53 "Speed Limit 140" 54 "Speed Limit 145" 55 "Speed Limit 150" 56 "Attention Sign Construction" 57 "Attention Sign Crosswalk" 58 "Attention Sign Round About" 59 "Attention Sign Children" 60 "Attention Sign Animals Crossing" 61 "Attention Sign General" 62 "Attention Sign Cross-way" 63 "Attention Sign Sharp Turn Left" 64 "Attention Sign Sharp Turn Right" 65 "Attention Sign Winding Road" 66 "Attention Sign Up-Grade" 67 "Attention Sign Down-Grade" 68 "Attention Sign Narrow Road Left" 69 "Attention Sign Narrow Road Right" 70 "Attention Sign Narrow Road Left & Right" 71 "Attention Sign Slippery Raod" 72 "Restricted Access for All Vehicles" 73 "Restricted Access for Cars" 74 "Restricted Access for Cars & Motorcycles" 75 "Restricted Access for Campers" ;
VAL_TABLE_ FCODPB13P_FVTSTk1SupTypAuth 0 "None" 1 "Rain" 2 "Snow" 3 "Trailer" 4 "Time" 5 "Arrow Left" 6 "Arrow Right" 7 "Bend Arrow Left" 8 "Bend Arrow Right" 9 "Truck" 10 "Distance Arrow" 11 "Weight" 12 "Distance In" 13 "Tractor" 14 "Snow Rain" 15 "School" 16 "Rain Cloud" 17 "Fog" 18 "Hazardous" 19 "Material" 20 "Night" 21 "Supp Sign Generic" 22 "Rappel" 23 "Tractor Passable" 24 "Wet Conditions" 25 "Motorcycle" 26 "Bus" 27 "Camper" 28 "Car" 29 "Tank" 30 "Hazard Spot" 31 "Traffic Jam" 32 "Train" 33 "Tram/Street Car" 34 "Noise Prevention" 35 "Residents Only" 36 "Invalid Supp" 37 "School When Flashing" 38 "End of Speed Limit" 39 "Where Workers Present" ;
VAL_TABLE_ FCODPB13P_FVTSTk1TypCnfdAuth 0 "Highly Speculative" 1 "Speculative" 2 "Confident" 3 "Highly Confident" ;
VAL_TABLE_ FCODPB13P_FVTSTk2CnfdStsAuth 0 "Highly Speculative" 1 "Speculative" 2 "Confident" 3 "Highly Confident" ;
VAL_TABLE_ FCODPB13P_FVTSTk2SupTypAuth 0 "None" 1 "Rain" 2 "Snow" 3 "Trailer" 4 "Time" 5 "Arrow Left" 6 "Arrow Right" 7 "Bend Arrow Left" 8 "Bend Arrow Right" 9 "Truck" 10 "Distance Arrow" 11 "Weight" 12 "Distance In" 13 "Tractor" 14 "Snow Rain" 15 "School" 16 "Rain Cloud" 17 "Fog" 18 "Hazardous" 19 "Material" 20 "Night" 21 "Supp Sign Generic" 22 "Rappel" 23 "Tractor Passable" 24 "Wet Conditions" 25 "Motorcycle" 26 "Bus" 27 "Camper" 28 "Car" 29 "Tank" 30 "Hazard Spot" 31 "Traffic Jam" 32 "Train" 33 "Tram/Street Car" 34 "Noise Prevention" 35 "Residents Only" 36 "Invalid Supp" 37 "School When Flashing" 38 "End of Speed Limit" 39 "Where Workers Present" ;
VAL_TABLE_ FCODPB13P_FVTSTk2MeasStsAuth 0 "No Object" 1 "New Object" 2 "Latent Track Not Detected this Cycle" 3 "Measured this Cycle" ;
VAL_TABLE_ FCODPB13P_FVTSTk2TypAuth 0 "No Sign Detected" 1 "End of Speed Limit" 2 "End of All Restrictions" 3 "Begin of Motorway" 4 "End of Motorway" 5 "Begin of Expressway" 6 "End of Expressway" 7 "Begin of Play Street Zone" 8 "End of Play Street Zone" 9 "Begin of Passing Restriction" 10 "End of Passing Restriction" 11 "No Entry" 12 "Begin of City Limits" 13 "End of City Limits" 14 "Yield" 15 "Crosswalk" 16 "Round About" 17 "Stop Sign" 18 "Yield to Oncoming Traffic" 19 "Pedestrian Zone" 20 "No Stopping Sign" 21 "No Parking Sign" 22 "Begin of No Parking Zone" 23 "End of No Parking Zone" 24 "Invalid Sign" 25 "Unknown Sign" 26 "Speed Limit 5" 27 "Speed Limit 10" 28 "Speed Limit 15" 29 "Speed Limit 20" 30 "Speed Limit 25" 31 "Speed Limit 30" 32 "Speed Limit 35" 33 "Speed Limit 40" 34 "Speed Limit 45" 35 "Speed Limit 50" 36 "Speed Limit 55" 37 "Speed Limit 60" 38 "Speed Limit 65" 39 "Speed Limit 70" 40 "Speed Limit 75" 41 "Speed Limit 80" 42 "Speed Limit 85" 43 "Speed Limit 90" 44 "Speed Limit 95" 45 "Speed Limit 100" 46 "Speed Limit 105" 47 "Speed Limit 110" 48 "Speed Limit 115" 49 "Speed Limit 120" 50 "Speed Limit 125" 51 "Speed Limit 130" 52 "Speed Limit 135" 53 "Speed Limit 140" 54 "Speed Limit 145" 55 "Speed Limit 150" 56 "Attention Sign Construction" 57 "Attention Sign Crosswalk" 58 "Attention Sign Round About" 59 "Attention Sign Children" 60 "Attention Sign Animals Crossing" 61 "Attention Sign General" 62 "Attention Sign Cross-way" 63 "Attention Sign Sharp Turn Left" 64 "Attention Sign Sharp Turn Right" 65 "Attention Sign Winding Road" 66 "Attention Sign Up-Grade" 67 "Attention Sign Down-Grade" 68 "Attention Sign Narrow Road Left" 69 "Attention Sign Narrow Road Right" 70 "Attention Sign Narrow Road Left & Right" 71 "Attention Sign Slippery Raod" 72 "Restricted Access for All Vehicles" 73 "Restricted Access for Cars" 74 "Restricted Access for Cars & Motorcycles" 75 "Restricted Access for Campers" ;
VAL_TABLE_ FCODPB13P_FVTSTk2TypCnfdAuth 0 "Highly Speculative" 1 "Speculative" 2 "Confident" 3 "Highly Confident" ;
VAL_TABLE_ FCODPB13P_FVTSTk3CnfdStsAuth 0 "Highly Speculative" 1 "Speculative" 2 "Confident" 3 "Highly Confident" ;
VAL_TABLE_ FCODPB13P_FVTSTk3SupTypAuth 0 "None" 1 "Rain" 2 "Snow" 3 "Trailer" 4 "Time" 5 "Arrow Left" 6 "Arrow Right" 7 "Bend Arrow Left" 8 "Bend Arrow Right" 9 "Truck" 10 "Distance Arrow" 11 "Weight" 12 "Distance In" 13 "Tractor" 14 "Snow Rain" 15 "School" 16 "Rain Cloud" 17 "Fog" 18 "Hazardous" 19 "Material" 20 "Night" 21 "Supp Sign Generic" 22 "Rappel" 23 "Tractor Passable" 24 "Wet Conditions" 25 "Motorcycle" 26 "Bus" 27 "Camper" 28 "Car" 29 "Tank" 30 "Hazard Spot" 31 "Traffic Jam" 32 "Train" 33 "Tram/Street Car" 34 "Noise Prevention" 35 "Residents Only" 36 "Invalid Supp" 37 "School When Flashing" 38 "End of Speed Limit" 39 "Where Workers Present" ;
VAL_TABLE_ FCODPB13P_FVTSTk3MeasStsAuth 0 "No Object" 1 "New Object" 2 "Latent Track Not Detected this Cycle" 3 "Measured this Cycle" ;
VAL_TABLE_ FCODPB13P_FVTSTk3TypAuth 0 "No Sign Detected" 1 "End of Speed Limit" 2 "End of All Restrictions" 3 "Begin of Motorway" 4 "End of Motorway" 5 "Begin of Expressway" 6 "End of Expressway" 7 "Begin of Play Street Zone" 8 "End of Play Street Zone" 9 "Begin of Passing Restriction" 10 "End of Passing Restriction" 11 "No Entry" 12 "Begin of City Limits" 13 "End of City Limits" 14 "Yield" 15 "Crosswalk" 16 "Round About" 17 "Stop Sign" 18 "Yield to Oncoming Traffic" 19 "Pedestrian Zone" 20 "No Stopping Sign" 21 "No Parking Sign" 22 "Begin of No Parking Zone" 23 "End of No Parking Zone" 24 "Invalid Sign" 25 "Unknown Sign" 26 "Speed Limit 5" 27 "Speed Limit 10" 28 "Speed Limit 15" 29 "Speed Limit 20" 30 "Speed Limit 25" 31 "Speed Limit 30" 32 "Speed Limit 35" 33 "Speed Limit 40" 34 "Speed Limit 45" 35 "Speed Limit 50" 36 "Speed Limit 55" 37 "Speed Limit 60" 38 "Speed Limit 65" 39 "Speed Limit 70" 40 "Speed Limit 75" 41 "Speed Limit 80" 42 "Speed Limit 85" 43 "Speed Limit 90" 44 "Speed Limit 95" 45 "Speed Limit 100" 46 "Speed Limit 105" 47 "Speed Limit 110" 48 "Speed Limit 115" 49 "Speed Limit 120" 50 "Speed Limit 125" 51 "Speed Limit 130" 52 "Speed Limit 135" 53 "Speed Limit 140" 54 "Speed Limit 145" 55 "Speed Limit 150" 56 "Attention Sign Construction" 57 "Attention Sign Crosswalk" 58 "Attention Sign Round About" 59 "Attention Sign Children" 60 "Attention Sign Animals Crossing" 61 "Attention Sign General" 62 "Attention Sign Cross-way" 63 "Attention Sign Sharp Turn Left" 64 "Attention Sign Sharp Turn Right" 65 "Attention Sign Winding Road" 66 "Attention Sign Up-Grade" 67 "Attention Sign Down-Grade" 68 "Attention Sign Narrow Road Left" 69 "Attention Sign Narrow Road Right" 70 "Attention Sign Narrow Road Left & Right" 71 "Attention Sign Slippery Raod" 72 "Restricted Access for All Vehicles" 73 "Restricted Access for Cars" 74 "Restricted Access for Cars & Motorcycles" 75 "Restricted Access for Campers" ;
VAL_TABLE_ FCODPB13P_FVTSTk3TypCnfdAuth 0 "Highly Speculative" 1 "Speculative" 2 "Confident" 3 "Highly Confident" ;
VAL_TABLE_ FCODPB13P_FVTSTk4CnfdStsAuth 0 "Highly Speculative" 1 "Speculative" 2 "Confident" 3 "Highly Confident" ;
VAL_TABLE_ FCODPB13P_FVTSTk4MeasStsAuth 0 "No Object" 1 "New Object" 2 "Latent Track Not Detected this Cycle" 3 "Measured this Cycle" ;
VAL_TABLE_ FCODPB13P_FVTSTk4TypAuth 0 "No Sign Detected" 1 "End of Speed Limit" 2 "End of All Restrictions" 3 "Begin of Motorway" 4 "End of Motorway" 5 "Begin of Expressway" 6 "End of Expressway" 7 "Begin of Play Street Zone" 8 "End of Play Street Zone" 9 "Begin of Passing Restriction" 10 "End of Passing Restriction" 11 "No Entry" 12 "Begin of City Limits" 13 "End of City Limits" 14 "Yield" 15 "Crosswalk" 16 "Round About" 17 "Stop Sign" 18 "Yield to Oncoming Traffic" 19 "Pedestrian Zone" 20 "No Stopping Sign" 21 "No Parking Sign" 22 "Begin of No Parking Zone" 23 "End of No Parking Zone" 24 "Invalid Sign" 25 "Unknown Sign" 26 "Speed Limit 5" 27 "Speed Limit 10" 28 "Speed Limit 15" 29 "Speed Limit 20" 30 "Speed Limit 25" 31 "Speed Limit 30" 32 "Speed Limit 35" 33 "Speed Limit 40" 34 "Speed Limit 45" 35 "Speed Limit 50" 36 "Speed Limit 55" 37 "Speed Limit 60" 38 "Speed Limit 65" 39 "Speed Limit 70" 40 "Speed Limit 75" 41 "Speed Limit 80" 42 "Speed Limit 85" 43 "Speed Limit 90" 44 "Speed Limit 95" 45 "Speed Limit 100" 46 "Speed Limit 105" 47 "Speed Limit 110" 48 "Speed Limit 115" 49 "Speed Limit 120" 50 "Speed Limit 125" 51 "Speed Limit 130" 52 "Speed Limit 135" 53 "Speed Limit 140" 54 "Speed Limit 145" 55 "Speed Limit 150" 56 "Attention Sign Construction" 57 "Attention Sign Crosswalk" 58 "Attention Sign Round About" 59 "Attention Sign Children" 60 "Attention Sign Animals Crossing" 61 "Attention Sign General" 62 "Attention Sign Cross-way" 63 "Attention Sign Sharp Turn Left" 64 "Attention Sign Sharp Turn Right" 65 "Attention Sign Winding Road" 66 "Attention Sign Up-Grade" 67 "Attention Sign Down-Grade" 68 "Attention Sign Narrow Road Left" 69 "Attention Sign Narrow Road Right" 70 "Attention Sign Narrow Road Left & Right" 71 "Attention Sign Slippery Raod" 72 "Restricted Access for All Vehicles" 73 "Restricted Access for Cars" 74 "Restricted Access for Cars & Motorcycles" 75 "Restricted Access for Campers" ;
VAL_TABLE_ FCODPB13P_FVTSTk4SupTypAuth 0 "None" 1 "Rain" 2 "Snow" 3 "Trailer" 4 "Time" 5 "Arrow Left" 6 "Arrow Right" 7 "Bend Arrow Left" 8 "Bend Arrow Right" 9 "Truck" 10 "Distance Arrow" 11 "Weight" 12 "Distance In" 13 "Tractor" 14 "Snow Rain" 15 "School" 16 "Rain Cloud" 17 "Fog" 18 "Hazardous" 19 "Material" 20 "Night" 21 "Supp Sign Generic" 22 "Rappel" 23 "Tractor Passable" 24 "Wet Conditions" 25 "Motorcycle" 26 "Bus" 27 "Camper" 28 "Car" 29 "Tank" 30 "Hazard Spot" 31 "Traffic Jam" 32 "Train" 33 "Tram/Street Car" 34 "Noise Prevention" 35 "Residents Only" 36 "Invalid Supp" 37 "School When Flashing" 38 "End of Speed Limit" 39 "Where Workers Present" ;
VAL_TABLE_ FCODPB13P_FVTSTk4TypCnfdAuth 0 "Highly Speculative" 1 "Speculative" 2 "Confident" 3 "Highly Confident" ;
VAL_TABLE_ FCODPB13P_FVTSTk5CnfdStsAuth 0 "Highly Speculative" 1 "Speculative" 2 "Confident" 3 "Highly Confident" ;
VAL_TABLE_ FCODPB13P_FVTSTk5SupTypAuth 0 "None" 1 "Rain" 2 "Snow" 3 "Trailer" 4 "Time" 5 "Arrow Left" 6 "Arrow Right" 7 "Bend Arrow Left" 8 "Bend Arrow Right" 9 "Truck" 10 "Distance Arrow" 11 "Weight" 12 "Distance In" 13 "Tractor" 14 "Snow Rain" 15 "School" 16 "Rain Cloud" 17 "Fog" 18 "Hazardous" 19 "Material" 20 "Night" 21 "Supp Sign Generic" 22 "Rappel" 23 "Tractor Passable" 24 "Wet Conditions" 25 "Motorcycle" 26 "Bus" 27 "Camper" 28 "Car" 29 "Tank" 30 "Hazard Spot" 31 "Traffic Jam" 32 "Train" 33 "Tram/Street Car" 34 "Noise Prevention" 35 "Residents Only" 36 "Invalid Supp" 37 "School When Flashing" 38 "End of Speed Limit" 39 "Where Workers Present" ;
VAL_TABLE_ FCODPB13P_FVTSTk5MeasStsAuth 0 "No Object" 1 "New Object" 2 "Latent Track Not Detected this Cycle" 3 "Measured this Cycle" ;
VAL_TABLE_ FCODPB13P_FVTSTk5TypAuth 0 "No Sign Detected" 1 "End of Speed Limit" 2 "End of All Restrictions" 3 "Begin of Motorway" 4 "End of Motorway" 5 "Begin of Expressway" 6 "End of Expressway" 7 "Begin of Play Street Zone" 8 "End of Play Street Zone" 9 "Begin of Passing Restriction" 10 "End of Passing Restriction" 11 "No Entry" 12 "Begin of City Limits" 13 "End of City Limits" 14 "Yield" 15 "Crosswalk" 16 "Round About" 17 "Stop Sign" 18 "Yield to Oncoming Traffic" 19 "Pedestrian Zone" 20 "No Stopping Sign" 21 "No Parking Sign" 22 "Begin of No Parking Zone" 23 "End of No Parking Zone" 24 "Invalid Sign" 25 "Unknown Sign" 26 "Speed Limit 5" 27 "Speed Limit 10" 28 "Speed Limit 15" 29 "Speed Limit 20" 30 "Speed Limit 25" 31 "Speed Limit 30" 32 "Speed Limit 35" 33 "Speed Limit 40" 34 "Speed Limit 45" 35 "Speed Limit 50" 36 "Speed Limit 55" 37 "Speed Limit 60" 38 "Speed Limit 65" 39 "Speed Limit 70" 40 "Speed Limit 75" 41 "Speed Limit 80" 42 "Speed Limit 85" 43 "Speed Limit 90" 44 "Speed Limit 95" 45 "Speed Limit 100" 46 "Speed Limit 105" 47 "Speed Limit 110" 48 "Speed Limit 115" 49 "Speed Limit 120" 50 "Speed Limit 125" 51 "Speed Limit 130" 52 "Speed Limit 135" 53 "Speed Limit 140" 54 "Speed Limit 145" 55 "Speed Limit 150" 56 "Attention Sign Construction" 57 "Attention Sign Crosswalk" 58 "Attention Sign Round About" 59 "Attention Sign Children" 60 "Attention Sign Animals Crossing" 61 "Attention Sign General" 62 "Attention Sign Cross-way" 63 "Attention Sign Sharp Turn Left" 64 "Attention Sign Sharp Turn Right" 65 "Attention Sign Winding Road" 66 "Attention Sign Up-Grade" 67 "Attention Sign Down-Grade" 68 "Attention Sign Narrow Road Left" 69 "Attention Sign Narrow Road Right" 70 "Attention Sign Narrow Road Left & Right" 71 "Attention Sign Slippery Raod" 72 "Restricted Access for All Vehicles" 73 "Restricted Access for Cars" 74 "Restricted Access for Cars & Motorcycles" 75 "Restricted Access for Campers" ;
VAL_TABLE_ FCODPB13P_FVTSTk5TypCnfdAuth 0 "Highly Speculative" 1 "Speculative" 2 "Confident" 3 "Highly Confident" ;
VAL_TABLE_ FCODPB13P_FVTSTk6CnfdStsAuth 0 "Highly Speculative" 1 "Speculative" 2 "Confident" 3 "Highly Confident" ;
VAL_TABLE_ FCODPB13P_FVTSTk6SupTypAuth 0 "None" 1 "Rain" 2 "Snow" 3 "Trailer" 4 "Time" 5 "Arrow Left" 6 "Arrow Right" 7 "Bend Arrow Left" 8 "Bend Arrow Right" 9 "Truck" 10 "Distance Arrow" 11 "Weight" 12 "Distance In" 13 "Tractor" 14 "Snow Rain" 15 "School" 16 "Rain Cloud" 17 "Fog" 18 "Hazardous" 19 "Material" 20 "Night" 21 "Supp Sign Generic" 22 "Rappel" 23 "Tractor Passable" 24 "Wet Conditions" 25 "Motorcycle" 26 "Bus" 27 "Camper" 28 "Car" 29 "Tank" 30 "Hazard Spot" 31 "Traffic Jam" 32 "Train" 33 "Tram/Street Car" 34 "Noise Prevention" 35 "Residents Only" 36 "Invalid Supp" 37 "School When Flashing" 38 "End of Speed Limit" 39 "Where Workers Present" ;
VAL_TABLE_ FCODPB13P_FVTSTk6MeasStsAuth 0 "No Object" 1 "New Object" 2 "Latent Track Not Detected this Cycle" 3 "Measured this Cycle" ;
VAL_TABLE_ FCODPB13P_FVTSTk6TypCnfdAuth 0 "Highly Speculative" 1 "Speculative" 2 "Confident" 3 "Highly Confident" ;
VAL_TABLE_ FCODPB13P_FVTSTk6TypAuth 0 "No Sign Detected" 1 "End of Speed Limit" 2 "End of All Restrictions" 3 "Begin of Motorway" 4 "End of Motorway" 5 "Begin of Expressway" 6 "End of Expressway" 7 "Begin of Play Street Zone" 8 "End of Play Street Zone" 9 "Begin of Passing Restriction" 10 "End of Passing Restriction" 11 "No Entry" 12 "Begin of City Limits" 13 "End of City Limits" 14 "Yield" 15 "Crosswalk" 16 "Round About" 17 "Stop Sign" 18 "Yield to Oncoming Traffic" 19 "Pedestrian Zone" 20 "No Stopping Sign" 21 "No Parking Sign" 22 "Begin of No Parking Zone" 23 "End of No Parking Zone" 24 "Invalid Sign" 25 "Unknown Sign" 26 "Speed Limit 5" 27 "Speed Limit 10" 28 "Speed Limit 15" 29 "Speed Limit 20" 30 "Speed Limit 25" 31 "Speed Limit 30" 32 "Speed Limit 35" 33 "Speed Limit 40" 34 "Speed Limit 45" 35 "Speed Limit 50" 36 "Speed Limit 55" 37 "Speed Limit 60" 38 "Speed Limit 65" 39 "Speed Limit 70" 40 "Speed Limit 75" 41 "Speed Limit 80" 42 "Speed Limit 85" 43 "Speed Limit 90" 44 "Speed Limit 95" 45 "Speed Limit 100" 46 "Speed Limit 105" 47 "Speed Limit 110" 48 "Speed Limit 115" 49 "Speed Limit 120" 50 "Speed Limit 125" 51 "Speed Limit 130" 52 "Speed Limit 135" 53 "Speed Limit 140" 54 "Speed Limit 145" 55 "Speed Limit 150" 56 "Attention Sign Construction" 57 "Attention Sign Crosswalk" 58 "Attention Sign Round About" 59 "Attention Sign Children" 60 "Attention Sign Animals Crossing" 61 "Attention Sign General" 62 "Attention Sign Cross-way" 63 "Attention Sign Sharp Turn Left" 64 "Attention Sign Sharp Turn Right" 65 "Attention Sign Winding Road" 66 "Attention Sign Up-Grade" 67 "Attention Sign Down-Grade" 68 "Attention Sign Narrow Road Left" 69 "Attention Sign Narrow Road Right" 70 "Attention Sign Narrow Road Left & Right" 71 "Attention Sign Slippery Raod" 72 "Restricted Access for All Vehicles" 73 "Restricted Access for Cars" 74 "Restricted Access for Cars & Motorcycles" 75 "Restricted Access for Campers" ;
VAL_TABLE_ FCODPB13P_FVTSTk7CnfdStsAuth 0 "Highly Speculative" 1 "Speculative" 2 "Confident" 3 "Highly Confident" ;
VAL_TABLE_ FCODPB13P_FVTSTk7SupTypAuth 0 "None" 1 "Rain" 2 "Snow" 3 "Trailer" 4 "Time" 5 "Arrow Left" 6 "Arrow Right" 7 "Bend Arrow Left" 8 "Bend Arrow Right" 9 "Truck" 10 "Distance Arrow" 11 "Weight" 12 "Distance In" 13 "Tractor" 14 "Snow Rain" 15 "School" 16 "Rain Cloud" 17 "Fog" 18 "Hazardous" 19 "Material" 20 "Night" 21 "Supp Sign Generic" 22 "Rappel" 23 "Tractor Passable" 24 "Wet Conditions" 25 "Motorcycle" 26 "Bus" 27 "Camper" 28 "Car" 29 "Tank" 30 "Hazard Spot" 31 "Traffic Jam" 32 "Train" 33 "Tram/Street Car" 34 "Noise Prevention" 35 "Residents Only" 36 "Invalid Supp" 37 "School When Flashing" 38 "End of Speed Limit" 39 "Where Workers Present" ;
VAL_TABLE_ FCODPB13P_FVTSTk7MeasStsAuth 0 "No Object" 1 "New Object" 2 "Latent Track Not Detected this Cycle" 3 "Measured this Cycle" ;
VAL_TABLE_ FCODPB13P_FVTSTk7TypAuth 0 "No Sign Detected" 1 "End of Speed Limit" 2 "End of All Restrictions" 3 "Begin of Motorway" 4 "End of Motorway" 5 "Begin of Expressway" 6 "End of Expressway" 7 "Begin of Play Street Zone" 8 "End of Play Street Zone" 9 "Begin of Passing Restriction" 10 "End of Passing Restriction" 11 "No Entry" 12 "Begin of City Limits" 13 "End of City Limits" 14 "Yield" 15 "Crosswalk" 16 "Round About" 17 "Stop Sign" 18 "Yield to Oncoming Traffic" 19 "Pedestrian Zone" 20 "No Stopping Sign" 21 "No Parking Sign" 22 "Begin of No Parking Zone" 23 "End of No Parking Zone" 24 "Invalid Sign" 25 "Unknown Sign" 26 "Speed Limit 5" 27 "Speed Limit 10" 28 "Speed Limit 15" 29 "Speed Limit 20" 30 "Speed Limit 25" 31 "Speed Limit 30" 32 "Speed Limit 35" 33 "Speed Limit 40" 34 "Speed Limit 45" 35 "Speed Limit 50" 36 "Speed Limit 55" 37 "Speed Limit 60" 38 "Speed Limit 65" 39 "Speed Limit 70" 40 "Speed Limit 75" 41 "Speed Limit 80" 42 "Speed Limit 85" 43 "Speed Limit 90" 44 "Speed Limit 95" 45 "Speed Limit 100" 46 "Speed Limit 105" 47 "Speed Limit 110" 48 "Speed Limit 115" 49 "Speed Limit 120" 50 "Speed Limit 125" 51 "Speed Limit 130" 52 "Speed Limit 135" 53 "Speed Limit 140" 54 "Speed Limit 145" 55 "Speed Limit 150" 56 "Attention Sign Construction" 57 "Attention Sign Crosswalk" 58 "Attention Sign Round About" 59 "Attention Sign Children" 60 "Attention Sign Animals Crossing" 61 "Attention Sign General" 62 "Attention Sign Cross-way" 63 "Attention Sign Sharp Turn Left" 64 "Attention Sign Sharp Turn Right" 65 "Attention Sign Winding Road" 66 "Attention Sign Up-Grade" 67 "Attention Sign Down-Grade" 68 "Attention Sign Narrow Road Left" 69 "Attention Sign Narrow Road Right" 70 "Attention Sign Narrow Road Left & Right" 71 "Attention Sign Slippery Raod" 72 "Restricted Access for All Vehicles" 73 "Restricted Access for Cars" 74 "Restricted Access for Cars & Motorcycles" 75 "Restricted Access for Campers" ;
VAL_TABLE_ FCODPB13P_FVTSTk7TypCnfdAuth 0 "Highly Speculative" 1 "Speculative" 2 "Confident" 3 "Highly Confident" ;
VAL_TABLE_ FCODPB14P_CnstrObj10CnfdStsAuth 0 "Highly Speculative" 1 "Speculative" 2 "Confident" 3 "Highly Confident" ;
VAL_TABLE_ FCODPB14P_CnstrObj11CnfdStsAuth 0 "Highly Speculative" 1 "Speculative" 2 "Confident" 3 "Highly Confident" ;
VAL_TABLE_ FCODPB14P_CnstrObj10TypAuth 0 "Unknown" 1 "Barrels" 2 "Cones" 3 "Marker Object" ;
VAL_TABLE_ FCODPB14P_CnstrObj12CnfdStsAuth 0 "Highly Speculative" 1 "Speculative" 2 "Confident" 3 "Highly Confident" ;
VAL_TABLE_ FCODPB14P_CnstrObj11TypAuth 0 "Unknown" 1 "Barrels" 2 "Cones" 3 "Marker Object" ;
VAL_TABLE_ FCODPB14P_CnstrObj12TypAuth 0 "Unknown" 1 "Barrels" 2 "Cones" 3 "Marker Object" ;
VAL_TABLE_ FCODPB14P_CnstrObj13CnfdStsAuth 0 "Highly Speculative" 1 "Speculative" 2 "Confident" 3 "Highly Confident" ;
VAL_TABLE_ FCODPB14P_CnstrObj14CnfdStsAuth 0 "Highly Speculative" 1 "Speculative" 2 "Confident" 3 "Highly Confident" ;
VAL_TABLE_ FCODPB14P_CnstrObj13TypAuth 0 "Unknown" 1 "Barrels" 2 "Cones" 3 "Marker Object" ;
VAL_TABLE_ FCODPB14P_CnstrObj15CnfdStsAuth 0 "Highly Speculative" 1 "Speculative" 2 "Confident" 3 "Highly Confident" ;
VAL_TABLE_ FCODPB14P_CnstrObj14TypAuth 0 "Unknown" 1 "Barrels" 2 "Cones" 3 "Marker Object" ;
VAL_TABLE_ FCODPB14P_CnstrObj1CnfdStsAuth 0 "Highly Speculative" 1 "Speculative" 2 "Confident" 3 "Highly Confident" ;
VAL_TABLE_ FCODPB14P_CnstrObj15TypAuth 0 "Unknown" 1 "Barrels" 2 "Cones" 3 "Marker Object" ;
VAL_TABLE_ FCODPB14P_CnstrObj1TypAuth 0 "Unknown" 1 "Barrels" 2 "Cones" 3 "Marker Object" ;
VAL_TABLE_ FCODPB14P_CnstrObj2CnfdStsAuth 0 "Highly Speculative" 1 "Speculative" 2 "Confident" 3 "Highly Confident" ;
VAL_TABLE_ FCODPB14P_CnstrObj3CnfdStsAuth 0 "Highly Speculative" 1 "Speculative" 2 "Confident" 3 "Highly Confident" ;
VAL_TABLE_ FCODPB14P_CnstrObj2TypAuth 0 "Unknown" 1 "Barrels" 2 "Cones" 3 "Marker Object" ;
VAL_TABLE_ FCODPB14P_CnstrObj4CnfdStsAuth 0 "Highly Speculative" 1 "Speculative" 2 "Confident" 3 "Highly Confident" ;
VAL_TABLE_ FCODPB14P_CnstrObj3TypAuth 0 "Unknown" 1 "Barrels" 2 "Cones" 3 "Marker Object" ;
VAL_TABLE_ FCODPB14P_CnstrObj5CnfdStsAuth 0 "Highly Speculative" 1 "Speculative" 2 "Confident" 3 "Highly Confident" ;
VAL_TABLE_ FCODPB14P_CnstrObj4TypAuth 0 "Unknown" 1 "Barrels" 2 "Cones" 3 "Marker Object" ;
VAL_TABLE_ FCODPB14P_CnstrObj5TypAuth 0 "Unknown" 1 "Barrels" 2 "Cones" 3 "Marker Object" ;
VAL_TABLE_ FCODPB14P_CnstrObj6CnfdStsAuth 0 "Highly Speculative" 1 "Speculative" 2 "Confident" 3 "Highly Confident" ;
VAL_TABLE_ FCODPB14P_CnstrObj7CnfdStsAuth 0 "Highly Speculative" 1 "Speculative" 2 "Confident" 3 "Highly Confident" ;
VAL_TABLE_ FCODPB14P_CnstrObj6TypAuth 0 "Unknown" 1 "Barrels" 2 "Cones" 3 "Marker Object" ;
VAL_TABLE_ FCODPB14P_CnstrObj8CnfdStsAuth 0 "Highly Speculative" 1 "Speculative" 2 "Confident" 3 "Highly Confident" ;
VAL_TABLE_ FCODPB14P_CnstrObj7TypAuth 0 "Unknown" 1 "Barrels" 2 "Cones" 3 "Marker Object" ;
VAL_TABLE_ FCODPB14P_CnstrObj9CnfdStsAuth 0 "Highly Speculative" 1 "Speculative" 2 "Confident" 3 "Highly Confident" ;
VAL_TABLE_ FCODPB14P_CnstrObj8TypAuth 0 "Unknown" 1 "Barrels" 2 "Cones" 3 "Marker Object" ;
VAL_TABLE_ FCODPB14P_CnstrObj9TypAuth 0 "Unknown" 1 "Barrels" 2 "Cones" 3 "Marker Object" ;
VAL_TABLE_ FCODPB14P_FVTSTk8CnfdStsAuth 0 "Highly Speculative" 1 "Speculative" 2 "Confident" 3 "Highly Confident" ;
VAL_TABLE_ FCODPB14P_FVTSTk8SupTypAuth 0 "None" 1 "Rain" 2 "Snow" 3 "Trailer" 4 "Time" 5 "Arrow Left" 6 "Arrow Right" 7 "Bend Arrow Left" 8 "Bend Arrow Right" 9 "Truck" 10 "Distance Arrow" 11 "Weight" 12 "Distance In" 13 "Tractor" 14 "Snow Rain" 15 "School" 16 "Rain Cloud" 17 "Fog" 18 "Hazardous" 19 "Material" 20 "Night" 21 "Supp Sign Generic" 22 "Rappel" 23 "Tractor Passable" 24 "Wet Conditions" 25 "Motorcycle" 26 "Bus" 27 "Camper" 28 "Car" 29 "Tank" 30 "Hazard Spot" 31 "Traffic Jam" 32 "Train" 33 "Tram/Street Car" 34 "Noise Prevention" 35 "Residents Only" 36 "Invalid Supp" 37 "School When Flashing" 38 "End of Speed Limit" 39 "Where Workers Present" ;
VAL_TABLE_ FCODPB14P_FVTSTk8MeasStsAuth 0 "No Object" 1 "New Object" 2 "Latent Track Not Detected this Cycle" 3 "Measured this Cycle" ;
VAL_TABLE_ FCODPB14P_FVTSTk8TypAuth 0 "No Sign Detected" 1 "End of Speed Limit" 2 "End of All Restrictions" 3 "Begin of Motorway" 4 "End of Motorway" 5 "Begin of Expressway" 6 "End of Expressway" 7 "Begin of Play Street Zone" 8 "End of Play Street Zone" 9 "Begin of Passing Restriction" 10 "End of Passing Restriction" 11 "No Entry" 12 "Begin of City Limits" 13 "End of City Limits" 14 "Yield" 15 "Crosswalk" 16 "Round About" 17 "Stop Sign" 18 "Yield to Oncoming Traffic" 19 "Pedestrian Zone" 20 "No Stopping Sign" 21 "No Parking Sign" 22 "Begin of No Parking Zone" 23 "End of No Parking Zone" 24 "Invalid Sign" 25 "Unknown Sign" 26 "Speed Limit 5" 27 "Speed Limit 10" 28 "Speed Limit 15" 29 "Speed Limit 20" 30 "Speed Limit 25" 31 "Speed Limit 30" 32 "Speed Limit 35" 33 "Speed Limit 40" 34 "Speed Limit 45" 35 "Speed Limit 50" 36 "Speed Limit 55" 37 "Speed Limit 60" 38 "Speed Limit 65" 39 "Speed Limit 70" 40 "Speed Limit 75" 41 "Speed Limit 80" 42 "Speed Limit 85" 43 "Speed Limit 90" 44 "Speed Limit 95" 45 "Speed Limit 100" 46 "Speed Limit 105" 47 "Speed Limit 110" 48 "Speed Limit 115" 49 "Speed Limit 120" 50 "Speed Limit 125" 51 "Speed Limit 130" 52 "Speed Limit 135" 53 "Speed Limit 140" 54 "Speed Limit 145" 55 "Speed Limit 150" 56 "Attention Sign Construction" 57 "Attention Sign Crosswalk" 58 "Attention Sign Round About" 59 "Attention Sign Children" 60 "Attention Sign Animals Crossing" 61 "Attention Sign General" 62 "Attention Sign Cross-way" 63 "Attention Sign Sharp Turn Left" 64 "Attention Sign Sharp Turn Right" 65 "Attention Sign Winding Road" 66 "Attention Sign Up-Grade" 67 "Attention Sign Down-Grade" 68 "Attention Sign Narrow Road Left" 69 "Attention Sign Narrow Road Right" 70 "Attention Sign Narrow Road Left & Right" 71 "Attention Sign Slippery Raod" 72 "Restricted Access for All Vehicles" 73 "Restricted Access for Cars" 74 "Restricted Access for Cars & Motorcycles" 75 "Restricted Access for Campers" ;
VAL_TABLE_ FCODPB14P_FVTSTk8TypCnfdAuth 0 "Highly Speculative" 1 "Speculative" 2 "Confident" 3 "Highly Confident" ;
VAL_TABLE_ FCODPB14P_FVTSTk9CnfdStsAuth 0 "Highly Speculative" 1 "Speculative" 2 "Confident" 3 "Highly Confident" ;
VAL_TABLE_ FCODPB14P_FVTSTk9SupTypAuth 0 "None" 1 "Rain" 2 "Snow" 3 "Trailer" 4 "Time" 5 "Arrow Left" 6 "Arrow Right" 7 "Bend Arrow Left" 8 "Bend Arrow Right" 9 "Truck" 10 "Distance Arrow" 11 "Weight" 12 "Distance In" 13 "Tractor" 14 "Snow Rain" 15 "School" 16 "Rain Cloud" 17 "Fog" 18 "Hazardous" 19 "Material" 20 "Night" 21 "Supp Sign Generic" 22 "Rappel" 23 "Tractor Passable" 24 "Wet Conditions" 25 "Motorcycle" 26 "Bus" 27 "Camper" 28 "Car" 29 "Tank" 30 "Hazard Spot" 31 "Traffic Jam" 32 "Train" 33 "Tram/Street Car" 34 "Noise Prevention" 35 "Residents Only" 36 "Invalid Supp" 37 "School When Flashing" 38 "End of Speed Limit" 39 "Where Workers Present" ;
VAL_TABLE_ FCODPB14P_FVTSTk9MeasStsAuth 0 "No Object" 1 "New Object" 2 "Latent Track Not Detected this Cycle" 3 "Measured this Cycle" ;
VAL_TABLE_ FCODPB14P_FVTSTk9TypAuth 0 "No Sign Detected" 1 "End of Speed Limit" 2 "End of All Restrictions" 3 "Begin of Motorway" 4 "End of Motorway" 5 "Begin of Expressway" 6 "End of Expressway" 7 "Begin of Play Street Zone" 8 "End of Play Street Zone" 9 "Begin of Passing Restriction" 10 "End of Passing Restriction" 11 "No Entry" 12 "Begin of City Limits" 13 "End of City Limits" 14 "Yield" 15 "Crosswalk" 16 "Round About" 17 "Stop Sign" 18 "Yield to Oncoming Traffic" 19 "Pedestrian Zone" 20 "No Stopping Sign" 21 "No Parking Sign" 22 "Begin of No Parking Zone" 23 "End of No Parking Zone" 24 "Invalid Sign" 25 "Unknown Sign" 26 "Speed Limit 5" 27 "Speed Limit 10" 28 "Speed Limit 15" 29 "Speed Limit 20" 30 "Speed Limit 25" 31 "Speed Limit 30" 32 "Speed Limit 35" 33 "Speed Limit 40" 34 "Speed Limit 45" 35 "Speed Limit 50" 36 "Speed Limit 55" 37 "Speed Limit 60" 38 "Speed Limit 65" 39 "Speed Limit 70" 40 "Speed Limit 75" 41 "Speed Limit 80" 42 "Speed Limit 85" 43 "Speed Limit 90" 44 "Speed Limit 95" 45 "Speed Limit 100" 46 "Speed Limit 105" 47 "Speed Limit 110" 48 "Speed Limit 115" 49 "Speed Limit 120" 50 "Speed Limit 125" 51 "Speed Limit 130" 52 "Speed Limit 135" 53 "Speed Limit 140" 54 "Speed Limit 145" 55 "Speed Limit 150" 56 "Attention Sign Construction" 57 "Attention Sign Crosswalk" 58 "Attention Sign Round About" 59 "Attention Sign Children" 60 "Attention Sign Animals Crossing" 61 "Attention Sign General" 62 "Attention Sign Cross-way" 63 "Attention Sign Sharp Turn Left" 64 "Attention Sign Sharp Turn Right" 65 "Attention Sign Winding Road" 66 "Attention Sign Up-Grade" 67 "Attention Sign Down-Grade" 68 "Attention Sign Narrow Road Left" 69 "Attention Sign Narrow Road Right" 70 "Attention Sign Narrow Road Left & Right" 71 "Attention Sign Slippery Raod" 72 "Restricted Access for All Vehicles" 73 "Restricted Access for Cars" 74 "Restricted Access for Cars & Motorcycles" 75 "Restricted Access for Campers" ;
VAL_TABLE_ FCODPB14P_FVTSTk9TypCnfdAuth 0 "Highly Speculative" 1 "Speculative" 2 "Confident" 3 "Highly Confident" ;
VAL_TABLE_ FCODPB2P_AutofxOutOfCalAuth 0 "UNKNOWN" 1 "YAW" 2 "HORIZON" 3 "BOTH" ;
VAL_TABLE_ FCODPB2P_FrwdCamSysOprtgStsAuth 0 "UNKNOWN" 1 "INITIALIZING" 2 "INACTIVE" 3 "ACTIVE" 4 "RESERVED1" 5 "RESERVED2" 6 "RESERVED3" 7 "FAILED" ;
VAL_TABLE_ FCODPB2P_EnvIllumAuth 0 "UNKNOWN" 1 "LIT ENVIRONMENT DURING NIGHT" 2 "UNLIT ENVIRONMENT DURING NIGHT" 3 "DAYLIGHT" ;
VAL_TABLE_ FCODPB2P_FVFaildAuth 0 "FALSE" 1 "TRUE" ;
VAL_TABLE_ FCODPB2P_FVBlkgStsAuth 0 "UNKNOWN" 1 "NOT BLOCKED" 2 "FULL BLOCKAGE" 3 "PARTIAL BLOCKAGE" 4 "RESERVED3" 5 "RESERVED4" 6 "RESERVED5" 7 "RESERVED6" ;
VAL_TABLE_ FCODPB2P_FVAdvWthrStsAuth 0 "CLEAR WEATHER" 1 "LIGHT FOG" 2 "MEDIUM FOG" 3 "HEAVY FOG" 4 "LIGHT SNOW" 5 "MEDIUM SNOW" 6 "HEAVY SNOW" 7 "LIGHT RAIN" 8 "MEDIUM RAIN" 9 "HEAVY RAIN" ;
VAL_TABLE_ FCODPB2P_FVFailDtnStsAuth 0 "NO FAILURE" 1 "HARDWARE FAILURE" 2 "SIGNAL SUPERVISION FAILURE" 3 "RECEIVE SIGNAL TIMEOUT" 4 "GENERAL UNAVAILABILITY" 5 "UNKNOWN" ;
VAL_TABLE_ FCODPB2P_FVLBTk2ClrAuth 0 "UNKNOWN" 1 "WHITE" 2 "YELLOW/ORANGE" 3 "OTHER" ;
VAL_TABLE_ FCODPB2P_FVLBDtnAqTmStmAuth_Inv 0 "FALSE" 1 "TRUE" ;
VAL_TABLE_ FCODPB2P_FVLBTk2PstnTypAuth 0 "Unknown" 1 "Host Left Lane" 2 "Host Right Lane" 3 "Next Left Lane" 4 "Next Right Lane" 5 "Second Next Left Lane" 6 "Second Next Right Lane" 7 "Third Next Left Lane" 8 "Third Next Right Lane" 9 "Fourth Next Left Lane" 10 "Fourth Next Right Lane" 11 "Fifth Next Left Lane" 12 "Fifth Next Right Lane" ;
VAL_TABLE_ FCODPB2P_FVLBTk2TypAuth 0 "UNDECIDED" 1 "SOLID" 2 "DASHED" 3 "ROAD EDGE" 4 "DOUBLE LINE" 5 "BOTTS DOTS" 6 "VIRTUAL" 7 "TRIPLE LINE" ;
VAL_TABLE_ FCODPB2P_FVLBTk2QltyAuth 0 "VERY LOW QUALITY" 1 "LOW QUALITY" 2 "PREDICTION" 3 "HIGH QUALITY" ;
VAL_TABLE_ FCODPB2P_FVLnChngIndAuth 0 "FALSE" 1 "TRUE" ;
VAL_TABLE_ FCODPB2P_FVLtdAccssRdTypAuth 0 "Unknown" 1 "Non Limited Access Road" 2 "Limited Access Road" ;
VAL_TABLE_ FCODPB2P_FVPOTk2DynPrpAuth 0 "Has Never Moved" 1 "Has Moved But Currently Stopped" 2 "Moving In Same Direction As Host" 3 "Moving In Opposite Direction As Host" 4 "Crossing Path" ;
VAL_TABLE_ FCODPB2P_FVPOTk2CnfdStsAuth 0 "Highly Speculative" 1 "Speculative" 2 "Confident" 3 "Highly Confident" ;
VAL_TABLE_ FCODPB2P_FVPOTk2MStsAuth 0 "No Object" 1 "New Object" 2 "Latent Track Not Detected this Cycle" 3 "Measured this Cycle" ;
VAL_TABLE_ FCODPB2P_FVPOTk2TypCnfdAuth 0 "Highly Speculative" 1 "Speculative" 2 "Confident" 3 "Highly Confident" ;
VAL_TABLE_ FCODPB2P_FVPOTk2TypAuth 0 "Unknown" 1 "Pedestrian" 2 "Bicycle" ;
VAL_TABLE_ FCODPB2P_FVServAlgnRtnStsAuth 0 "NOT STARTED" 1 "IN PROGRESS" 2 "SUCCEEDED" 3 "STOPPED BY USER" 4 "FULL BLOCKAGE" 5 "PARTIAL BLOCKAGE" 6 "GENERAL UNAVAILABILITY" 7 "HARDWARE FAILURE" 8 "SIGNAL SUPERVISION FAILURE" 9 "RECEIVE SIGNAL TIMEOUT" 10 "POWER MODE NOT RUN" 11 "FAILED" ;
VAL_TABLE_ FCODPB2P_FVServAlgnInPrcAuth 0 "FALSE" 1 "TRUE" ;
VAL_TABLE_ FCODPB2P_FVSysCalStsAuth 0 "NOT CALIBRATED" 1 "CALIBRATED" 2 "DYNAMICALLY CALIBRATED" 3 "UNKNOWN" ;
VAL_TABLE_ FCODPB2P_FVServRqAuth 0 "FALSE" 1 "TRUE" ;
VAL_TABLE_ FCODPB2P_FVVOTk2BrkLgtStsAuth 0 "UNKNOWN" 1 "OFF" 2 "ON" 3 "FLASHING" ;
VAL_TABLE_ FCODPB2P_FVUnvAuth 0 "FALSE" 1 "TRUE" ;
VAL_TABLE_ FCODPB2P_FVVOTk2CnfdStsAuth 0 "Highly Speculative" 1 "Speculative" 2 "Confident" 3 "Highly Confident" ;
VAL_TABLE_ FCODPB2P_FVVOTk2DynPrpStsAuth 0 "Stopped" 1 "Not Stopped" ;
VAL_TABLE_ FCODPB2P_FVVOTk2DynPrpAuth 0 "Has Never Moved" 1 "Has Moved But Currently Stopped" 2 "Moving In Same Direction As Host" 3 "Moving In Opposite Direction As Host" 4 "Crossing From Left To Right" 5 "Crossing From Right To Left" 6 "Unknown" ;
VAL_TABLE_ FCODPB2P_FVVOTk2MStsAuth 0 "No Object" 1 "New Object" 2 "Latent Track Not Detected this Cycle" 3 "Measured this Cycle" ;
VAL_TABLE_ FCODPB2P_FVVOTk2LnAsmtAuth 0 "UNKNOWN" 1 "HOST LANE" 2 "RIGHT LANE" 3 "LEFT LANE" 4 "2nd RIGHT LANE" 5 "2nd LEFT LANE" ;
VAL_TABLE_ FCODPB2P_FVVOTk2TypAuth 0 "Unknown" 1 "Motorcycle" 2 "Vehicle" 3 "Truck" ;
VAL_TABLE_ FCODPB2P_FVVOTk2TSLgtStsAuth 0 "UNKNOWN" 1 "OFF" 2 "LEFT" 3 "RIGHT" 4 "BOTH" ;
VAL_TABLE_ FCODPB2P_RdTypAuth 0 "TOWN" 1 "COUNTRY ROAD" 2 "MOTORWAY" 3 "RESERVED1" 4 "RESERVED2" 5 "RESERVED3" 6 "RESERVED 4" 7 "UNDEFINED" ;
VAL_TABLE_ FCODPB2P_FVVOTk2TypCnfdAuth 0 "Highly Speculative" 1 "Speculative" 2 "Confident" 3 "Highly Confident" ;
VAL_TABLE_ FVHiThrtICCrsgVehPrfllNw 0 "FALSE" 1 "TRUE" ;
VAL_TABLE_ FVHiThrtICCrsgVehBrkNw 0 "FALSE" 1 "TRUE" ;
VAL_TABLE_ FVHiThrtICCrsgVehAlrtNw 0 "FALSE" 1 "TRUE" ;
VAL_TABLE_ FrwdVsnVehObjTk2DatIntegCkd 0 "Unknown" 1 "Pass" 2 "Fail" ;
VAL_TABLE_ FrwdVsnPedtrnObjTk2DatIntegCkd 0 "Unknown" 1 "Pass" 2 "Fail" ;
VAL_TABLE_ FrwdVsnLnBdryTk2DatIntegCkd 0 "Unknown" 1 "Pass" 2 "Fail" ;
VAL_TABLE_ FVHiThrtICTrnAcrsPthVehPrfllNw 0 "FALSE" 1 "TRUE" ;
VAL_TABLE_ FVHiThrtICTrnAcrsPthVehBrkNw 0 "FALSE" 1 "TRUE" ;
VAL_TABLE_ FVHiThrtICTrnAcrsPthVehAlrtNw 0 "FALSE" 1 "TRUE" ;
VAL_TABLE_ FCODPB3P_FlSfBlrdImgDtdAuth 0 "FALSE" 1 "TRUE" ;
VAL_TABLE_ FCODPB3P_ConstrArRtDtdAuth 0 "FALSE" 1 "TRUE" ;
VAL_TABLE_ FCODPB3P_ConstrArLtDtdAuth 0 "FALSE" 1 "TRUE" ;
VAL_TABLE_ FCODPB3P_AmbLnMrksRtAuth 0 "FALSE" 1 "TRUE" ;
VAL_TABLE_ FCODPB3P_AmbLnMrksLtAuth 0 "FALSE" 1 "TRUE" ;
VAL_TABLE_ FCODPB3P_FlSfFggyScnDtdAuth 0 "FALSE" 1 "TRUE" ;
VAL_TABLE_ FCODPB3P_FlSfFllBlkgDtdAuth 0 "FALSE" 1 "TRUE" ;
VAL_TABLE_ FCODPB3P_FlSfLoSnDtdAuth 0 "FALSE" 1 "TRUE" ;
VAL_TABLE_ FCODPB3P_FlSfPtlBlkgDtdAuth 0 "FALSE" 1 "TRUE" ;
VAL_TABLE_ FCODPB3P_FlSfSmrdSptDtdAuth 0 "FALSE" 1 "TRUE" ;
VAL_TABLE_ FCODPB3P_FlSfSplshsDtdAuth 0 "FALSE" 1 "TRUE" ;
VAL_TABLE_ FCODPB3P_FrwyExtRtDtdAuth 0 "FALSE" 1 "TRUE" ;
VAL_TABLE_ FCODPB3P_FrwyExtLtDtdAuth 0 "FALSE" 1 "TRUE" ;
VAL_TABLE_ FCODPB3P_FrwyMrgRtDtdAuth 0 "FALSE" 1 "TRUE" ;
VAL_TABLE_ FCODPB3P_FrwyMrgLtDtdAuth 0 "FALSE" 1 "TRUE" ;
VAL_TABLE_ FCODPB3P_FVAcqTmStmAuth_Inv 0 "FALSE" 1 "TRUE" ;
VAL_TABLE_ FCODPB3P_FVConstrArDtdCnfdAuth 0 "Highly Speculative" 1 "Speculative" 2 "Confident" 3 "Highly Confident" ;
VAL_TABLE_ FCODPB3P_FVConstrArDtnStsAuth 0 "Not Detected" 1 "Detected" 2 "Unknown" ;
VAL_TABLE_ FCODPB3P_FVLBTk3ClrAuth 0 "UNKNOWN" 1 "WHITE" 2 "YELLOW/ORANGE" 3 "OTHER" ;
VAL_TABLE_ FCODPB3P_FVLBTk3PstnTypAuth 0 "Unknown" 1 "Host Left Lane" 2 "Host Right Lane" 3 "Next Left Lane" 4 "Next Right Lane" 5 "Second Next Left Lane" 6 "Second Next Right Lane" 7 "Third Next Left Lane" 8 "Third Next Right Lane" 9 "Fourth Next Left Lane" 10 "Fourth Next Right Lane" 11 "Fifth Next Left Lane" 12 "Fifth Next Right Lane" ;
VAL_TABLE_ FCODPB3P_FVLBTk3TypAuth 0 "UNDECIDED" 1 "SOLID" 2 "DASHED" 3 "ROAD EDGE" 4 "DOUBLE LINE" 5 "BOTTS DOTS" 6 "VIRTUAL" 7 "TRIPLE LINE" ;
VAL_TABLE_ FCODPB3P_FVLBTk3QltyAuth 0 "VERY LOW QUALITY" 1 "LOW QUALITY" 2 "PREDICTION" 3 "HIGH QUALITY" ;
VAL_TABLE_ FCODPB3P_FVPOTk3DynPrpAuth 0 "Has Never Moved" 1 "Has Moved But Currently Stopped" 2 "Moving In Same Direction As Host" 3 "Moving In Opposite Direction As Host" 4 "Crossing Path" ;
VAL_TABLE_ FCODPB3P_FVPOTk3CnfdStsAuth 0 "Highly Speculative" 1 "Speculative" 2 "Confident" 3 "Highly Confident" ;
VAL_TABLE_ FCODPB3P_FVPOTk3MStsAuth 0 "No Object" 1 "New Object" 2 "Latent Track Not Detected this Cycle" 3 "Measured this Cycle" ;
VAL_TABLE_ FCODPB3P_FVVOTk3BrkLgtStsAuth 0 "UNKNOWN" 1 "OFF" 2 "ON" 3 "FLASHING" ;
VAL_TABLE_ FCODPB3P_FVVCRngCutInRtAuth 0 "NO CUT IN" 1 "CUT IN" ;
VAL_TABLE_ FCODPB3P_FVVCRngCutInLtAuth 0 "NO CUT IN" 1 "CUT IN" ;
VAL_TABLE_ FCODPB3P_FVPOTk3TypCnfdAuth 0 "Highly Speculative" 1 "Speculative" 2 "Confident" 3 "Highly Confident" ;
VAL_TABLE_ FCODPB3P_FVPOTk3TypAuth 0 "Unknown" 1 "Pedestrian" 2 "Bicycle" ;
VAL_TABLE_ FCODPB3P_FVVOTk3CnfdStsAuth 0 "Highly Speculative" 1 "Speculative" 2 "Confident" 3 "Highly Confident" ;
VAL_TABLE_ FCODPB3P_FVVOTk3DynPrpStsAuth 0 "Stopped" 1 "Not Stopped" ;
VAL_TABLE_ FCODPB3P_FVVOTk3DynPrpAuth 0 "Has Never Moved" 1 "Has Moved But Currently Stopped" 2 "Moving In Same Direction As Host" 3 "Moving In Opposite Direction As Host" 4 "Crossing From Left To Right" 5 "Crossing From Right To Left" 6 "Unknown" ;
VAL_TABLE_ FCODPB3P_FVVOTk3MStsAuth 0 "No Object" 1 "New Object" 2 "Latent Track Not Detected this Cycle" 3 "Measured this Cycle" ;
VAL_TABLE_ FCODPB3P_FVVOTk3LnAsmtAuth 0 "UNKNOWN" 1 "HOST LANE" 2 "RIGHT LANE" 3 "LEFT LANE" 4 "2nd RIGHT LANE" 5 "2nd LEFT LANE" ;
VAL_TABLE_ FCODPB3P_FVVOTk3TypAuth 0 "Unknown" 1 "Motorcycle" 2 "Vehicle" 3 "Truck" ;
VAL_TABLE_ FCODPB3P_FVVOTk3TSLgtStsAuth 0 "UNKNOWN" 1 "OFF" 2 "LEFT" 3 "RIGHT" 4 "BOTH" ;
VAL_TABLE_ FCODPB3P_OvrhdStrctDtdAuth 0 "FALSE" 1 "TRUE" ;
VAL_TABLE_ FCODPB3P_IntTrffcDtdAuth 0 "FALSE" 1 "TRUE" ;
VAL_TABLE_ FCODPB3P_FVVOTk3TypCnfdAuth 0 "Highly Speculative" 1 "Speculative" 2 "Confident" 3 "Highly Confident" ;
VAL_TABLE_ FCODPB3P_VehInTnnlCnfdAuth 0 "Highly Speculative" 1 "Speculative" 2 "Confident" 3 "Highly Confident" ;
VAL_TABLE_ FCODPB3P_TrffcLgtDtdAuth 0 "FALSE" 1 "TRUE" ;
VAL_TABLE_ FrwdVsnVehObjTk3DatIntegCkd 0 "Unknown" 1 "Pass" 2 "Fail" ;
VAL_TABLE_ FrwdVsnPedtrnObjTk3DatIntegCkd 0 "Unknown" 1 "Pass" 2 "Fail" ;
VAL_TABLE_ FrwdVsnLnBdryTk3DatIntegCkd 0 "Unknown" 1 "Pass" 2 "Fail" ;
VAL_TABLE_ FCODPB3P_VehInTnnlDtdAuth 0 "FALSE" 1 "TRUE" ;
VAL_TABLE_ FCODPB4P_FVLBTk11ClrAuth 0 "UNKNOWN" 1 "WHITE" 2 "YELLOW/ORANGE" 3 "OTHER" ;
VAL_TABLE_ FCODPB4P_FVLBTk11PstnTypAuth 0 "Unknown" 1 "Host Left Lane" 2 "Host Right Lane" 3 "Next Left Lane" 4 "Next Right Lane" 5 "Second Next Left Lane" 6 "Second Next Right Lane" 7 "Third Next Left Lane" 8 "Third Next Right Lane" 9 "Fourth Next Left Lane" 10 "Fourth Next Right Lane" 11 "Fifth Next Left Lane" 12 "Fifth Next Right Lane" ;
VAL_TABLE_ FCODPB4P_FVLBTk11TypAuth 0 "UNDECIDED" 1 "SOLID" 2 "DASHED" 3 "ROAD EDGE" 4 "DOUBLE LINE" 5 "BOTTS DOTS" 6 "VIRTUAL" 7 "TRIPLE LINE" ;
VAL_TABLE_ FCODPB4P_FVLBTk11QltyAuth 0 "VERY LOW QUALITY" 1 "LOW QUALITY" 2 "PREDICTION" 3 "HIGH QUALITY" ;
VAL_TABLE_ FCODPB4P_FVLBTk4ClrAuth 0 "UNKNOWN" 1 "WHITE" 2 "YELLOW/ORANGE" 3 "OTHER" ;
VAL_TABLE_ FCODPB4P_FVLBTk4TypAuth 0 "UNDECIDED" 1 "SOLID" 2 "DASHED" 3 "ROAD EDGE" 4 "DOUBLE LINE" 5 "BOTTS DOTS" 6 "VIRTUAL" 7 "TRIPLE LINE" ;
VAL_TABLE_ FCODPB4P_FVLBTk4QltyAuth 0 "VERY LOW QUALITY" 1 "LOW QUALITY" 2 "PREDICTION" 3 "HIGH QUALITY" ;
VAL_TABLE_ FCODPB4P_FVLBTk4PstnTypAuth 0 "Unknown" 1 "Host Left Lane" 2 "Host Right Lane" 3 "Next Left Lane" 4 "Next Right Lane" 5 "Second Next Left Lane" 6 "Second Next Right Lane" 7 "Third Next Left Lane" 8 "Third Next Right Lane" 9 "Fourth Next Left Lane" 10 "Fourth Next Right Lane" 11 "Fifth Next Left Lane" 12 "Fifth Next Right Lane" ;
VAL_TABLE_ FCODPB4P_FVPOTk4CnfdStsAuth 0 "Highly Speculative" 1 "Speculative" 2 "Confident" 3 "Highly Confident" ;
VAL_TABLE_ FCODPB4P_FVPOTk4DynPrpAuth 0 "Has Never Moved" 1 "Has Moved But Currently Stopped" 2 "Moving In Same Direction As Host" 3 "Moving In Opposite Direction As Host" 4 "Crossing Path" ;
VAL_TABLE_ FCODPB4P_FVPOTk4MStsAuth 0 "No Object" 1 "New Object" 2 "Latent Track Not Detected this Cycle" 3 "Measured this Cycle" ;
VAL_TABLE_ FCODPB4P_FVVOTk4BrkLgtStsAuth 0 "UNKNOWN" 1 "OFF" 2 "ON" 3 "FLASHING" ;
VAL_TABLE_ FCODPB4P_FVPOTk4TypCnfdAuth 0 "Highly Speculative" 1 "Speculative" 2 "Confident" 3 "Highly Confident" ;
VAL_TABLE_ FCODPB4P_FVPOTk4TypAuth 0 "Unknown" 1 "Pedestrian" 2 "Bicycle" ;
VAL_TABLE_ FCODPB4P_FVVOTk4CnfdStsAuth 0 "Highly Speculative" 1 "Speculative" 2 "Confident" 3 "Highly Confident" ;
VAL_TABLE_ FCODPB4P_FVVOTk4DynPrpStsAuth 0 "Stopped" 1 "Not Stopped" ;
VAL_TABLE_ FCODPB4P_FVVOTk4DynPrpAuth 0 "Has Never Moved" 1 "Has Moved But Currently Stopped" 2 "Moving In Same Direction As Host" 3 "Moving In Opposite Direction As Host" 4 "Crossing From Left To Right" 5 "Crossing From Right To Left" 6 "Unknown" ;
VAL_TABLE_ FCODPB4P_FVVOTk4MStsAuth 0 "No Object" 1 "New Object" 2 "Latent Track Not Detected this Cycle" 3 "Measured this Cycle" ;
VAL_TABLE_ FCODPB4P_FVVOTk4LnAsmtAuth 0 "UNKNOWN" 1 "HOST LANE" 2 "RIGHT LANE" 3 "LEFT LANE" 4 "2nd RIGHT LANE" 5 "2nd LEFT LANE" ;
VAL_TABLE_ FCODPB4P_FVVOTk4TypAuth 0 "Unknown" 1 "Motorcycle" 2 "Vehicle" 3 "Truck" ;
VAL_TABLE_ FCODPB4P_FVVOTk4TSLgtStsAuth 0 "UNKNOWN" 1 "OFF" 2 "LEFT" 3 "RIGHT" 4 "BOTH" ;
VAL_TABLE_ FrwdVsnVehObjTk4DatIntegCkd 0 "Unknown" 1 "Pass" 2 "Fail" ;
VAL_TABLE_ FrwdVsnPedtrnObjTk4DatIntegCkd 0 "Unknown" 1 "Pass" 2 "Fail" ;
VAL_TABLE_ FrwdVsnLnBdryTk4DatIntegCkd 0 "Unknown" 1 "Pass" 2 "Fail" ;
VAL_TABLE_ FCODPB4P_FVVOTk4TypCnfdAuth 0 "Highly Speculative" 1 "Speculative" 2 "Confident" 3 "Highly Confident" ;
VAL_TABLE_ FCODPB5P_FVLBTk10ClrAuth 0 "UNKNOWN" 1 "WHITE" 2 "YELLOW/ORANGE" 3 "OTHER" ;
VAL_TABLE_ FCODPB5P_FVLBTk10PstnTypAuth 0 "Unknown" 1 "Host Left Lane" 2 "Host Right Lane" 3 "Next Left Lane" 4 "Next Right Lane" 5 "Second Next Left Lane" 6 "Second Next Right Lane" 7 "Third Next Left Lane" 8 "Third Next Right Lane" 9 "Fourth Next Left Lane" 10 "Fourth Next Right Lane" 11 "Fifth Next Left Lane" 12 "Fifth Next Right Lane" ;
VAL_TABLE_ FCODPB5P_FVLBTk10TypAuth 0 "UNDECIDED" 1 "SOLID" 2 "DASHED" 3 "ROAD EDGE" 4 "DOUBLE LINE" 5 "BOTTS DOTS" 6 "VIRTUAL" 7 "TRIPLE LINE" ;
VAL_TABLE_ FCODPB5P_FVLBTk10QltyAuth 0 "VERY LOW QUALITY" 1 "LOW QUALITY" 2 "PREDICTION" 3 "HIGH QUALITY" ;
VAL_TABLE_ FCODPB5P_FVLBTk5ClrAuth 0 "UNKNOWN" 1 "WHITE" 2 "YELLOW/ORANGE" 3 "OTHER" ;
VAL_TABLE_ FCODPB5P_FVLBTk5TypAuth 0 "UNDECIDED" 1 "SOLID" 2 "DASHED" 3 "ROAD EDGE" 4 "DOUBLE LINE" 5 "BOTTS DOTS" 6 "VIRTUAL" 7 "TRIPLE LINE" ;
VAL_TABLE_ FCODPB5P_FVLBTk5QltyAuth 0 "VERY LOW QUALITY" 1 "LOW QUALITY" 2 "PREDICTION" 3 "HIGH QUALITY" ;
VAL_TABLE_ FCODPB5P_FVLBTk5PstnTypAuth 0 "Unknown" 1 "Host Left Lane" 2 "Host Right Lane" 3 "Next Left Lane" 4 "Next Right Lane" 5 "Second Next Left Lane" 6 "Second Next Right Lane" 7 "Third Next Left Lane" 8 "Third Next Right Lane" 9 "Fourth Next Left Lane" 10 "Fourth Next Right Lane" 11 "Fifth Next Left Lane" 12 "Fifth Next Right Lane" ;
VAL_TABLE_ FCODPB5P_FVPOTk5CnfdStsAuth 0 "Highly Speculative" 1 "Speculative" 2 "Confident" 3 "Highly Confident" ;
VAL_TABLE_ FCODPB5P_FVPOTk5DynPrpAuth 0 "Has Never Moved" 1 "Has Moved But Currently Stopped" 2 "Moving In Same Direction As Host" 3 "Moving In Opposite Direction As Host" 4 "Crossing Path" ;
VAL_TABLE_ FCODPB5P_FVPOTk5MStsAuth 0 "No Object" 1 "New Object" 2 "Latent Track Not Detected this Cycle" 3 "Measured this Cycle" ;
VAL_TABLE_ FCODPB5P_FVVOTk5BrkLgtStsAuth 0 "UNKNOWN" 1 "OFF" 2 "ON" 3 "FLASHING" ;
VAL_TABLE_ FCODPB5P_FVPOTk5TypCnfdAuth 0 "Highly Speculative" 1 "Speculative" 2 "Confident" 3 "Highly Confident" ;
VAL_TABLE_ FCODPB5P_FVPOTk5TypAuth 0 "Unknown" 1 "Pedestrian" 2 "Bicycle" ;
VAL_TABLE_ FCODPB5P_FVVOTk5CnfdStsAuth 0 "Highly Speculative" 1 "Speculative" 2 "Confident" 3 "Highly Confident" ;
VAL_TABLE_ FCODPB5P_FVVOTk5DynPrpStsAuth 0 "Stopped" 1 "Not Stopped" ;
VAL_TABLE_ FCODPB5P_FVVOTk5DynPrpAuth 0 "Has Never Moved" 1 "Has Moved But Currently Stopped" 2 "Moving In Same Direction As Host" 3 "Moving In Opposite Direction As Host" 4 "Crossing From Left To Right" 5 "Crossing From Right To Left" 6 "Unknown" ;
VAL_TABLE_ FCODPB5P_FVVOTk5MStsAuth 0 "No Object" 1 "New Object" 2 "Latent Track Not Detected this Cycle" 3 "Measured this Cycle" ;
VAL_TABLE_ FCODPB5P_FVVOTk5LnAsmtAuth 0 "UNKNOWN" 1 "HOST LANE" 2 "RIGHT LANE" 3 "LEFT LANE" 4 "2nd RIGHT LANE" 5 "2nd LEFT LANE" ;
VAL_TABLE_ FCODPB5P_FVVOTk5TypAuth 0 "Unknown" 1 "Motorcycle" 2 "Vehicle" 3 "Truck" ;
VAL_TABLE_ FCODPB5P_FVVOTk5TSLgtStsAuth 0 "UNKNOWN" 1 "OFF" 2 "LEFT" 3 "RIGHT" 4 "BOTH" ;
VAL_TABLE_ FrwdVsnVehObjTk5DatIntegCkd 0 "Unknown" 1 "Pass" 2 "Fail" ;
VAL_TABLE_ FrwdVsnPedtrnObjTk5DatIntegCkd 0 "Unknown" 1 "Pass" 2 "Fail" ;
VAL_TABLE_ FrwdVsnLnBdryTk5DatIntegCkd 0 "Unknown" 1 "Pass" 2 "Fail" ;
VAL_TABLE_ FCODPB5P_FVVOTk5TypCnfdAuth 0 "Highly Speculative" 1 "Speculative" 2 "Confident" 3 "Highly Confident" ;
VAL_TABLE_ FCODPB6P_FVLBTk6ClrAuth 0 "UNKNOWN" 1 "WHITE" 2 "YELLOW/ORANGE" 3 "OTHER" ;
VAL_TABLE_ FCODPB6P_FVLBTk6PstnTypAuth 0 "Unknown" 1 "Host Left Lane" 2 "Host Right Lane" 3 "Next Left Lane" 4 "Next Right Lane" 5 "Second Next Left Lane" 6 "Second Next Right Lane" 7 "Third Next Left Lane" 8 "Third Next Right Lane" 9 "Fourth Next Left Lane" 10 "Fourth Next Right Lane" 11 "Fifth Next Left Lane" 12 "Fifth Next Right Lane" ;
VAL_TABLE_ FCODPB6P_FVLBTk6TypAuth 0 "UNDECIDED" 1 "SOLID" 2 "DASHED" 3 "ROAD EDGE" 4 "DOUBLE LINE" 5 "BOTTS DOTS" 6 "VIRTUAL" 7 "TRIPLE LINE" ;
VAL_TABLE_ FCODPB6P_FVLBTk6QltyAuth 0 "VERY LOW QUALITY" 1 "LOW QUALITY" 2 "PREDICTION" 3 "HIGH QUALITY" ;
VAL_TABLE_ FCODPB6P_FVVOTk10BrkLgtStsAuth 0 "UNKNOWN" 1 "OFF" 2 "ON" 3 "FLASHING" ;
VAL_TABLE_ FCODPB6P_FVVOTk10DynPrpAuth 0 "Has Never Moved" 1 "Has Moved But Currently Stopped" 2 "Moving In Same Direction As Host" 3 "Moving In Opposite Direction As Host" 4 "Crossing From Left To Right" 5 "Crossing From Right To Left" 6 "Unknown" ;
VAL_TABLE_ FCODPB6P_FVVOTk10CnfdStsAuth 0 "Highly Speculative" 1 "Speculative" 2 "Confident" 3 "Highly Confident" ;
VAL_TABLE_ FCODPB6P_FVVOTk10DynPrpStsAuth 0 "Stopped" 1 "Not Stopped" ;
VAL_TABLE_ FCODPB6P_FVVOTk10MStsAuth 0 "No Object" 1 "New Object" 2 "Latent Track Not Detected this Cycle" 3 "Measured this Cycle" ;
VAL_TABLE_ FCODPB6P_FVVOTk10LnAsmtAuth 0 "UNKNOWN" 1 "HOST LANE" 2 "RIGHT LANE" 3 "LEFT LANE" 4 "2nd RIGHT LANE" 5 "2nd LEFT LANE" ;
VAL_TABLE_ FCODPB6P_FVVOTk6BrkLgtStsAuth 0 "UNKNOWN" 1 "OFF" 2 "ON" 3 "FLASHING" ;
VAL_TABLE_ FCODPB6P_FVVOTk10TypCnfdAuth 0 "Highly Speculative" 1 "Speculative" 2 "Confident" 3 "Highly Confident" ;
VAL_TABLE_ FCODPB6P_FVVOTk10TypAuth 0 "Unknown" 1 "Motorcycle" 2 "Vehicle" 3 "Truck" ;
VAL_TABLE_ FCODPB6P_FVVOTk10TSLgtStsAuth 0 "UNKNOWN" 1 "OFF" 2 "LEFT" 3 "RIGHT" 4 "BOTH" ;
VAL_TABLE_ FCODPB6P_FVVOTk6CnfdStsAuth 0 "Highly Speculative" 1 "Speculative" 2 "Confident" 3 "Highly Confident" ;
VAL_TABLE_ FCODPB6P_FVVOTk6DynPrpStsAuth 0 "Stopped" 1 "Not Stopped" ;
VAL_TABLE_ FCODPB6P_FVVOTk6DynPrpAuth 0 "Has Never Moved" 1 "Has Moved But Currently Stopped" 2 "Moving In Same Direction As Host" 3 "Moving In Opposite Direction As Host" 4 "Crossing From Left To Right" 5 "Crossing From Right To Left" 6 "Unknown" ;
VAL_TABLE_ FCODPB6P_FVVOTk6MStsAuth 0 "No Object" 1 "New Object" 2 "Latent Track Not Detected this Cycle" 3 "Measured this Cycle" ;
VAL_TABLE_ FCODPB6P_FVVOTk6LnAsmtAuth 0 "UNKNOWN" 1 "HOST LANE" 2 "RIGHT LANE" 3 "LEFT LANE" 4 "2nd RIGHT LANE" 5 "2nd LEFT LANE" ;
VAL_TABLE_ FCODPB6P_FVVOTk6TypAuth 0 "Unknown" 1 "Motorcycle" 2 "Vehicle" 3 "Truck" ;
VAL_TABLE_ FCODPB6P_FVVOTk6TSLgtStsAuth 0 "UNKNOWN" 1 "OFF" 2 "LEFT" 3 "RIGHT" 4 "BOTH" ;
VAL_TABLE_ FrwdVsnVehObjTk6DatIntegCkd 0 "Unknown" 1 "Pass" 2 "Fail" ;
VAL_TABLE_ FrwdVsnLnBdryTk6DatIntegCkd 0 "Unknown" 1 "Pass" 2 "Fail" ;
VAL_TABLE_ FCODPB6P_FVVOTk6TypCnfdAuth 0 "Highly Speculative" 1 "Speculative" 2 "Confident" 3 "Highly Confident" ;
VAL_TABLE_ FCODPB7P_FVLBTk7ClrAuth 0 "UNKNOWN" 1 "WHITE" 2 "YELLOW/ORANGE" 3 "OTHER" ;
VAL_TABLE_ FCODPB7P_FVLBTk7PstnTypAuth 0 "Unknown" 1 "Host Left Lane" 2 "Host Right Lane" 3 "Next Left Lane" 4 "Next Right Lane" 5 "Second Next Left Lane" 6 "Second Next Right Lane" 7 "Third Next Left Lane" 8 "Third Next Right Lane" 9 "Fourth Next Left Lane" 10 "Fourth Next Right Lane" 11 "Fifth Next Left Lane" 12 "Fifth Next Right Lane" ;
VAL_TABLE_ FCODPB7P_FVLBTk7TypAuth 0 "UNDECIDED" 1 "SOLID" 2 "DASHED" 3 "ROAD EDGE" 4 "DOUBLE LINE" 5 "BOTTS DOTS" 6 "VIRTUAL" 7 "TRIPLE LINE" ;
VAL_TABLE_ FCODPB7P_FVLBTk7QltyAuth 0 "VERY LOW QUALITY" 1 "LOW QUALITY" 2 "PREDICTION" 3 "HIGH QUALITY" ;
VAL_TABLE_ FCODPB7P_FVLBTk9ClrAuth 0 "UNKNOWN" 1 "WHITE" 2 "YELLOW/ORANGE" 3 "OTHER" ;
VAL_TABLE_ FCODPB7P_FVLBTk9TypAuth 0 "UNDECIDED" 1 "SOLID" 2 "DASHED" 3 "ROAD EDGE" 4 "DOUBLE LINE" 5 "BOTTS DOTS" 6 "VIRTUAL" 7 "TRIPLE LINE" ;
VAL_TABLE_ FCODPB7P_FVLBTk9QltyAuth 0 "VERY LOW QUALITY" 1 "LOW QUALITY" 2 "PREDICTION" 3 "HIGH QUALITY" ;
VAL_TABLE_ FCODPB7P_FVLBTk9PstnTypAuth 0 "Unknown" 1 "Host Left Lane" 2 "Host Right Lane" 3 "Next Left Lane" 4 "Next Right Lane" 5 "Second Next Left Lane" 6 "Second Next Right Lane" 7 "Third Next Left Lane" 8 "Third Next Right Lane" 9 "Fourth Next Left Lane" 10 "Fourth Next Right Lane" 11 "Fifth Next Left Lane" 12 "Fifth Next Right Lane" ;
VAL_TABLE_ FCODPB7P_FVVOTk7BrkLgtStsAuth 0 "UNKNOWN" 1 "OFF" 2 "ON" 3 "FLASHING" ;
VAL_TABLE_ FCODPB7P_FVVOTk7CnfdStsAuth 0 "Highly Speculative" 1 "Speculative" 2 "Confident" 3 "Highly Confident" ;
VAL_TABLE_ FCODPB7P_FVVOTk7DynPrpStsAuth 0 "Stopped" 1 "Not Stopped" ;
VAL_TABLE_ FCODPB7P_FVVOTk7DynPrpAuth 0 "Has Never Moved" 1 "Has Moved But Currently Stopped" 2 "Moving In Same Direction As Host" 3 "Moving In Opposite Direction As Host" 4 "Crossing From Left To Right" 5 "Crossing From Right To Left" 6 "Unknown" ;
VAL_TABLE_ FCODPB7P_FVVOTk7MStsAuth 0 "No Object" 1 "New Object" 2 "Latent Track Not Detected this Cycle" 3 "Measured this Cycle" ;
VAL_TABLE_ FCODPB7P_FVVOTk7LnAsmtAuth 0 "UNKNOWN" 1 "HOST LANE" 2 "RIGHT LANE" 3 "LEFT LANE" 4 "2nd RIGHT LANE" 5 "2nd LEFT LANE" ;
VAL_TABLE_ FCODPB7P_FVVOTk7TypCnfdAuth 0 "Highly Speculative" 1 "Speculative" 2 "Confident" 3 "Highly Confident" ;
VAL_TABLE_ FCODPB7P_FVVOTk7TypAuth 0 "Unknown" 1 "Motorcycle" 2 "Vehicle" 3 "Truck" ;
VAL_TABLE_ FCODPB7P_FVVOTk7TSLgtStsAuth 0 "UNKNOWN" 1 "OFF" 2 "LEFT" 3 "RIGHT" 4 "BOTH" ;
VAL_TABLE_ FrwdVsnVehObjTk7DatIntegCkd 0 "Unknown" 1 "Pass" 2 "Fail" ;
VAL_TABLE_ FrwdVsnLnBdryTk7DatIntegCkd 0 "Unknown" 1 "Pass" 2 "Fail" ;
VAL_TABLE_ FCODPB8P_FVLBTk8ClrAuth 0 "UNKNOWN" 1 "WHITE" 2 "YELLOW/ORANGE" 3 "OTHER" ;
VAL_TABLE_ FCODPB8P_FVLBTk8PstnTypAuth 0 "Unknown" 1 "Host Left Lane" 2 "Host Right Lane" 3 "Next Left Lane" 4 "Next Right Lane" 5 "Second Next Left Lane" 6 "Second Next Right Lane" 7 "Third Next Left Lane" 8 "Third Next Right Lane" 9 "Fourth Next Left Lane" 10 "Fourth Next Right Lane" 11 "Fifth Next Left Lane" 12 "Fifth Next Right Lane" ;
VAL_TABLE_ FCODPB8P_FVLBTk8TypAuth 0 "UNDECIDED" 1 "SOLID" 2 "DASHED" 3 "ROAD EDGE" 4 "DOUBLE LINE" 5 "BOTTS DOTS" 6 "VIRTUAL" 7 "TRIPLE LINE" ;
VAL_TABLE_ FCODPB8P_FVLBTk8QltyAuth 0 "VERY LOW QUALITY" 1 "LOW QUALITY" 2 "PREDICTION" 3 "HIGH QUALITY" ;
VAL_TABLE_ FCODPB8P_FVVOTk8BrkLgtStsAuth 0 "UNKNOWN" 1 "OFF" 2 "ON" 3 "FLASHING" ;
VAL_TABLE_ FCODPB8P_FVVOTk8DynPrpAuth 0 "Has Never Moved" 1 "Has Moved But Currently Stopped" 2 "Moving In Same Direction As Host" 3 "Moving In Opposite Direction As Host" 4 "Crossing From Left To Right" 5 "Crossing From Right To Left" 6 "Unknown" ;
VAL_TABLE_ FCODPB8P_FVVOTk8CnfdStsAuth 0 "Highly Speculative" 1 "Speculative" 2 "Confident" 3 "Highly Confident" ;
VAL_TABLE_ FCODPB8P_FVVOTk8DynPrpStsAuth 0 "Stopped" 1 "Not Stopped" ;
VAL_TABLE_ FCODPB8P_FVVOTk8MStsAuth 0 "No Object" 1 "New Object" 2 "Latent Track Not Detected this Cycle" 3 "Measured this Cycle" ;
VAL_TABLE_ FCODPB8P_FVVOTk8LnAsmtAuth 0 "UNKNOWN" 1 "HOST LANE" 2 "RIGHT LANE" 3 "LEFT LANE" 4 "2nd RIGHT LANE" 5 "2nd LEFT LANE" ;
VAL_TABLE_ FCODPB8P_FVVOTk9BrkLgtStsAuth 0 "UNKNOWN" 1 "OFF" 2 "ON" 3 "FLASHING" ;
VAL_TABLE_ FCODPB8P_FVVOTk8TypCnfdAuth 0 "Highly Speculative" 1 "Speculative" 2 "Confident" 3 "Highly Confident" ;
VAL_TABLE_ FCODPB8P_FVVOTk8TypAuth 0 "Unknown" 1 "Motorcycle" 2 "Vehicle" 3 "Truck" ;
VAL_TABLE_ FCODPB8P_FVVOTk8TSLgtStsAuth 0 "UNKNOWN" 1 "OFF" 2 "LEFT" 3 "RIGHT" 4 "BOTH" ;
VAL_TABLE_ FCODPB8P_FVVOTk9CnfdStsAuth 0 "Highly Speculative" 1 "Speculative" 2 "Confident" 3 "Highly Confident" ;
VAL_TABLE_ FCODPB8P_FVVOTk9DynPrpStsAuth 0 "Stopped" 1 "Not Stopped" ;
VAL_TABLE_ FCODPB8P_FVVOTk9DynPrpAuth 0 "Has Never Moved" 1 "Has Moved But Currently Stopped" 2 "Moving In Same Direction As Host" 3 "Moving In Opposite Direction As Host" 4 "Crossing From Left To Right" 5 "Crossing From Right To Left" 6 "Unknown" ;
VAL_TABLE_ FCODPB8P_FVVOTk9MStsAuth 0 "No Object" 1 "New Object" 2 "Latent Track Not Detected this Cycle" 3 "Measured this Cycle" ;
VAL_TABLE_ FCODPB8P_FVVOTk9LnAsmtAuth 0 "UNKNOWN" 1 "HOST LANE" 2 "RIGHT LANE" 3 "LEFT LANE" 4 "2nd RIGHT LANE" 5 "2nd LEFT LANE" ;
VAL_TABLE_ FCODPB8P_FVVOTk9TypAuth 0 "Unknown" 1 "Motorcycle" 2 "Vehicle" 3 "Truck" ;
VAL_TABLE_ FCODPB8P_FVVOTk9TSLgtStsAuth 0 "UNKNOWN" 1 "OFF" 2 "LEFT" 3 "RIGHT" 4 "BOTH" ;
VAL_TABLE_ FrwdVsnVehObjTk8DatIntegCkd 0 "Unknown" 1 "Pass" 2 "Fail" ;
VAL_TABLE_ FrwdVsnLnBdryTk8DatIntegCkd 0 "Unknown" 1 "Pass" 2 "Fail" ;
VAL_TABLE_ FCODPB8P_FVVOTk9TypCnfdAuth 0 "Highly Speculative" 1 "Speculative" 2 "Confident" 3 "Highly Confident" ;
VAL_TABLE_ FCODPB9P_FVCIPthVehAlrtNwAuth 0 "FALSE" 1 "TRUE" ;
VAL_TABLE_ FCODPB9P_FVCIPthVehAhdNwAuth 0 "FALSE" 1 "TRUE" ;
VAL_TABLE_ FCODPB9P_FrwdDistIndDgrdAuth 0 "FALSE" 1 "TRUE" ;
VAL_TABLE_ FCODPB9P_FrwdClsnAlrtDgrdAuth 0 "FALSE" 1 "TRUE" ;
VAL_TABLE_ FCODPB9P_ClsnImntBrkgDgrdAuth 0 "FALSE" 1 "TRUE" ;
VAL_TABLE_ FCODPB9P_AdpCruzCtlDgrdAuth 0 "FALSE" 1 "TRUE" ;
VAL_TABLE_ FCODPB9P_FVHTPNtfyNwAuth 0 "FALSE" 1 "TRUE" ;
VAL_TABLE_ FCODPB9P_FVHTPBrkNwAuth 0 "FALSE" 1 "TRUE" ;
VAL_TABLE_ FCODPB9P_FVHTPAlrtNwAuth 0 "FALSE" 1 "TRUE" ;
VAL_TABLE_ FCODPB9P_FVCIPthVehBrkNwAuth 0 "FALSE" 1 "TRUE" ;
VAL_TABLE_ FCODPB9P_FVLFTk1TypAuth 0 "Lane Fusion" 1 "HPP Left" 2 "HPP Center" 3 "HPP Right" ;
VAL_TABLE_ FCODPB9P_FVLFTk2TypAuth 0 "Lane Fusion" 1 "HPP Left" 2 "HPP Center" 3 "HPP Right" ;
VAL_TABLE_ FCODPB9P_FVLFTk3TypAuth 0 "Lane Fusion" 1 "HPP Left" 2 "HPP Center" 3 "HPP Right" ;
VAL_TABLE_ FCODPB9P_PedtrnClsnBrkgDgrdAuth 0 "FALSE" 1 "TRUE" ;
VAL_TABLE_ FCODPB9P_PedtrnClsnAlrtDgrdAuth 0 "FALSE" 1 "TRUE" ;
VAL_TABLE_ FCODPB9P_LnKeepAsstDgrdAuth 0 "FALSE" 1 "TRUE" ;
VAL_TABLE_ FCODPB9P_LnCntrDgrdAuth 0 "FALSE" 1 "TRUE" ;
VAL_TABLE_ FCODPB9P_IntsctClsnMtgnDgrdAuth 0 "FALSE" 1 "TRUE" ;
VAL_TABLE_ FCODPB9P_FVLFTk4TypAuth 0 "Lane Fusion" 1 "HPP Left" 2 "HPP Center" 3 "HPP Right" ;
VAL_TABLE_ FrwdVsnVehObjTk9DatIntegCkd 0 "Unknown" 1 "Pass" 2 "Fail" ;
VAL_TABLE_ FrwdVsnLnBdryTk9DatIntegCkd 0 "Unknown" 1 "Pass" 2 "Fail" ;
VAL_TABLE_ FCODPB9P_FVHTPPrfllNwAuth 0 "FALSE" 1 "TRUE" ;
VAL_TABLE_ FCODPB9P_FVCIPthVehPrfllNwAuth 0 "FALSE" 1 "TRUE" ;
VAL_TABLE_ FCODPB9P_PedtrnNtfnDgrdAuth 0 "FALSE" 1 "TRUE" ;
VAL_TABLE_ FCODPB10P_FVVOTk10PoI1PsVisAuth 0 "Unknown" 1 "Visible" 2 "Projected" ;
VAL_TABLE_ FCODPB10P_FVVOTk10PoI2PsVisAuth 0 "Unknown" 1 "Visible" 2 "Projected" ;
VAL_TABLE_ FCODPB10P_FVVOTk1PoI1PsVisAuth 0 "Unknown" 1 "Visible" 2 "Projected" ;
VAL_TABLE_ FCODPB10P_FVVOTk10PoI3PsVisAuth 0 "Unknown" 1 "Visible" 2 "Projected" ;
VAL_TABLE_ FCODPB10P_FVVOTk1PoI2PsVisAuth 0 "Unknown" 1 "Visible" 2 "Projected" ;
VAL_TABLE_ FCODPB10P_FVVOTk2PoI1PsVisAuth 0 "Unknown" 1 "Visible" 2 "Projected" ;
VAL_TABLE_ FCODPB10P_FVVOTk1PoI3PsVisAuth 0 "Unknown" 1 "Visible" 2 "Projected" ;
VAL_TABLE_ FCODPB10P_FVVOTk2PoI2PsVisAuth 0 "Unknown" 1 "Visible" 2 "Projected" ;
VAL_TABLE_ FCODPB10P_FVVOTk3PoI1PsVisAuth 0 "Unknown" 1 "Visible" 2 "Projected" ;
VAL_TABLE_ FCODPB10P_FVVOTk2PoI3PsVisAuth 0 "Unknown" 1 "Visible" 2 "Projected" ;
VAL_TABLE_ FCODPB10P_FVVOTk3PoI2PsVisAuth 0 "Unknown" 1 "Visible" 2 "Projected" ;
VAL_TABLE_ FCODPB10P_FVVOTk4PoI1PsVisAuth 0 "Unknown" 1 "Visible" 2 "Projected" ;
VAL_TABLE_ FCODPB10P_FVVOTk3PoI3PsVisAuth 0 "Unknown" 1 "Visible" 2 "Projected" ;
VAL_TABLE_ FCODPB10P_FVVOTk4PoI2PsVisAuth 0 "Unknown" 1 "Visible" 2 "Projected" ;
VAL_TABLE_ FCODPB10P_FVVOTk5PoI1PsVisAuth 0 "Unknown" 1 "Visible" 2 "Projected" ;
VAL_TABLE_ FCODPB10P_FVVOTk4PoI3PsVisAuth 0 "Unknown" 1 "Visible" 2 "Projected" ;
VAL_TABLE_ FCODPB10P_FVVOTk5PoI2PsVisAuth 0 "Unknown" 1 "Visible" 2 "Projected" ;
VAL_TABLE_ FCODPB10P_FVVOTk6PoI1PsVisAuth 0 "Unknown" 1 "Visible" 2 "Projected" ;
VAL_TABLE_ FCODPB10P_FVVOTk5PoI3PsVisAuth 0 "Unknown" 1 "Visible" 2 "Projected" ;
VAL_TABLE_ FCODPB10P_FVVOTk6PoI2PsVisAuth 0 "Unknown" 1 "Visible" 2 "Projected" ;
VAL_TABLE_ FCODPB10P_FVVOTk7PoI1PsVisAuth 0 "Unknown" 1 "Visible" 2 "Projected" ;
VAL_TABLE_ FCODPB10P_FVVOTk6PoI3PsVisAuth 0 "Unknown" 1 "Visible" 2 "Projected" ;
VAL_TABLE_ FCODPB10P_FVVOTk7PoI2PsVisAuth 0 "Unknown" 1 "Visible" 2 "Projected" ;
VAL_TABLE_ FCODPB10P_FVVOTk8PoI1PsVisAuth 0 "Unknown" 1 "Visible" 2 "Projected" ;
VAL_TABLE_ FCODPB10P_FVVOTk7PoI3PsVisAuth 0 "Unknown" 1 "Visible" 2 "Projected" ;
VAL_TABLE_ FCODPB10P_FVVOTk8PoI2PsVisAuth 0 "Unknown" 1 "Visible" 2 "Projected" ;
VAL_TABLE_ FCODPB10P_FVVOTk9PoI1PsVisAuth 0 "Unknown" 1 "Visible" 2 "Projected" ;
VAL_TABLE_ FCODPB10P_FVVOTk8PoI3PsVisAuth 0 "Unknown" 1 "Visible" 2 "Projected" ;
VAL_TABLE_ FCODPB10P_FVVOTk9PoI2PsVisAuth 0 "Unknown" 1 "Visible" 2 "Projected" ;
VAL_TABLE_ FrwdVsnVehObjTk10DatIntegCkd 0 "Unknown" 1 "Pass" 2 "Fail" ;
VAL_TABLE_ FrwdVsnLnBdryTk10DatIntegCkd 0 "Unknown" 1 "Pass" 2 "Fail" ;
VAL_TABLE_ FCODPB10P_FVVOTk9PoI3PsVisAuth 0 "Unknown" 1 "Visible" 2 "Projected" ;
VAL_TABLE_ FCODPB1P_FVLBTk1ClrAuth 0 "UNKNOWN" 1 "WHITE" 2 "YELLOW/ORANGE" 3 "OTHER" ;
VAL_TABLE_ FCODPB1P_FVLBTk1PstnTypAuth 0 "Unknown" 1 "Host Left Lane" 2 "Host Right Lane" 3 "Next Left Lane" 4 "Next Right Lane" 5 "Second Next Left Lane" 6 "Second Next Right Lane" 7 "Third Next Left Lane" 8 "Third Next Right Lane" 9 "Fourth Next Left Lane" 10 "Fourth Next Right Lane" 11 "Fifth Next Left Lane" 12 "Fifth Next Right Lane" ;
VAL_TABLE_ FCODPB1P_FVLBTk1TypAuth 0 "UNDECIDED" 1 "SOLID" 2 "DASHED" 3 "ROAD EDGE" 4 "DOUBLE LINE" 5 "BOTTS DOTS" 6 "VIRTUAL" 7 "TRIPLE LINE" ;
VAL_TABLE_ FCODPB1P_FVLBTk1QltyAuth 0 "VERY LOW QUALITY" 1 "LOW QUALITY" 2 "PREDICTION" 3 "HIGH QUALITY" ;
VAL_TABLE_ FCODPB1P_FVPOTk1DynPrpAuth 0 "Has Never Moved" 1 "Has Moved But Currently Stopped" 2 "Moving In Same Direction As Host" 3 "Moving In Opposite Direction As Host" 4 "Crossing Path" ;
VAL_TABLE_ FCODPB1P_FVPOTk1CnfdStsAuth 0 "Highly Speculative" 1 "Speculative" 2 "Confident" 3 "Highly Confident" ;
VAL_TABLE_ FCODPB1P_FVPOTk1MStsAuth 0 "No Object" 1 "New Object" 2 "Latent Track Not Detected this Cycle" 3 "Measured this Cycle" ;
VAL_TABLE_ FCODPB1P_FVVOTk1BrkLgtStsAuth 0 "UNKNOWN" 1 "OFF" 2 "ON" 3 "FLASHING" ;
VAL_TABLE_ FCODPB1P_FVPOTk1TypCnfdAuth 0 "Highly Speculative" 1 "Speculative" 2 "Confident" 3 "Highly Confident" ;
VAL_TABLE_ FCODPB1P_FVPOTk1TypAuth 0 "Unknown" 1 "Pedestrian" 2 "Bicycle" ;
VAL_TABLE_ FCODPB1P_FVVOTk1DynPrpAuth 0 "Has Never Moved" 1 "Has Moved But Currently Stopped" 2 "Moving In Same Direction As Host" 3 "Moving In Opposite Direction As Host" 4 "Crossing From Left To Right" 5 "Crossing From Right To Left" 6 "Unknown" ;
VAL_TABLE_ FCODPB1P_FVVOTk1CnfdStsAuth 0 "Highly Speculative" 1 "Speculative" 2 "Confident" 3 "Highly Confident" ;
VAL_TABLE_ FCODPB1P_FVVOTk1DynPrpStsAuth 0 "Stopped" 1 "Not Stopped" ;
VAL_TABLE_ FCODPB1P_FVVOTk1MStsAuth 0 "No Object" 1 "New Object" 2 "Latent Track Not Detected this Cycle" 3 "Measured this Cycle" ;
VAL_TABLE_ FCODPB1P_FVVOTk1LnAsmtAuth 0 "UNKNOWN" 1 "HOST LANE" 2 "RIGHT LANE" 3 "LEFT LANE" 4 "2nd RIGHT LANE" 5 "2nd LEFT LANE" ;
VAL_TABLE_ FCODPB1P_FVVOTk1TypCnfdAuth 0 "Highly Speculative" 1 "Speculative" 2 "Confident" 3 "Highly Confident" ;
VAL_TABLE_ FCODPB1P_FVVOTk1TypAuth 0 "Unknown" 1 "Motorcycle" 2 "Vehicle" 3 "Truck" ;
VAL_TABLE_ FCODPB1P_FVVOTk1TSLgtStsAuth 0 "UNKNOWN" 1 "OFF" 2 "LEFT" 3 "RIGHT" 4 "BOTH" ;
VAL_TABLE_ FrwdVsnPedtrnObjTk1DatIntegCkd 0 "Unknown" 1 "Pass" 2 "Fail" ;
VAL_TABLE_ FrwdVsnLnBdryTk1DatIntegCkd 0 "Unknown" 1 "Pass" 2 "Fail" ;
VAL_TABLE_ FrwdVsnVehObjTk1DatIntegCkd 0 "Unknown" 1 "Pass" 2 "Fail" ;
VAL_TABLE_ GPSC_PPSLat_Inv 0 "FALSE" 1 "TRUE" ;
VAL_TABLE_ GPSC_PPSLong_Inv 0 "FALSE" 1 "TRUE" ;
VAL_TABLE_ HDLM_CAN8_ClscCANHrtBtActv 0 "FALSE" 1 "TRUE" ;
VAL_TABLE_ HVPPP_FrwdVsnModeCmdAuth 0 "Not Reporting Object Data" 1 "Reporting Object Data" ;
VAL_TABLE_ HVPPP_HstVehLatVelAuth_Inv 0 "FALSE" 1 "TRUE" ;
VAL_TABLE_ HVPPP_HstVehLngVelAuth_Inv 0 "FALSE" 1 "TRUE" ;
VAL_TABLE_ HVPPP_HstVehPathModeAuth 0 "Disabled" 1 "Low Speed" 2 "High Speed" ;
VAL_TABLE_ HVPPP_HstVehTrvlDirAuth 0 "Unknown" 1 "Forward or Stopped on a Forward Gear" 2 "Reversed or Stopped in a Reverse Gear" 3 "Other" ;
VAL_TABLE_ HVPPP_HstVehVelAuth_Inv 0 "FALSE" 1 "TRUE" ;
VAL_TABLE_ HVPPP_LngRngRadarModeCmdAuth 0 "Not Radiating" 1 "Not Reporting Object Data" 2 "Reporting" ;
VAL_TABLE_ HVPPP_HstVehYawRateAuth_Inv 0 "FALSE" 1 "TRUE" ;
VAL_TABLE_ HVPPP_ShrtRngRadarModeCmdAuth 0 "Not Radiating" 1 "Not Reporting Object Data" 2 "Reporting Object Data" ;
VAL_TABLE_ HVPPP_ObjsRetndRrwdSnsrsAuth 0 "Unknown" 1 "Objects Reported" 2 "No Objects Reported" ;
VAL_TABLE_ HVPPP_ObjsRetndFrwdSnsrsAuth 0 "Unknown" 1 "Objects Reported" 2 "No Objects Reported" ;
VAL_TABLE_ DrvrMonSysModeCmd 0 "Not Radiating" 1 "Not Reporting Object Data" 2 "Reporting Object Data" ;
VAL_TABLE_ LnFllwgFtrStatAuth 0 "Off" 1 "Unavailable" 2 "Disabled" 3 "Enabled" 4 "Active" 5 "Cautionary" 6 "Override" 7 "Degraded" 8 "No Return" 9 "Ended" 10 "Non-Responsive Driver" ;
VAL_TABLE_ HstVehRideHghtOfst_Inv 0 "FALSE" 1 "TRUE" ;
VAL_TABLE_ HstVehRideHghtOfstSts 0 "In Range" 1 "Out of Range" ;
VAL_TABLE_ GeofncngRstrctdZnStsGtd 0 "Unknown" 1 "Restricted" 2 "Unrestricted" ;
VAL_TABLE_ HstVehFrtRdWhlAng_Inv 0 "FALSE" 1 "TRUE" ;
VAL_TABLE_ HVPPBG2P_HstVehTrvlDirAuth 0 "Unknown" 1 "Forward or Stopped on a Forward Gear" 2 "Reversed or Stopped in a Reverse Gear" 3 "Other" ;
VAL_TABLE_ HVPPBG2P_HstVehRideHghtOfstSts 0 "In Range" 1 "Out of Range" ;
VAL_TABLE_ HVPPBG2P_HstVehRideHghtOfst_Inv 0 "FALSE" 1 "TRUE" ;
VAL_TABLE_ SBZAlrtCstAvlFlg7 0 "FALSE" 1 "TRUE" ;
VAL_TABLE_ SBZAlrtCstAvlFlg6 0 "FALSE" 1 "TRUE" ;
VAL_TABLE_ SBZAlrtCstAvlFlg5 0 "FALSE" 1 "TRUE" ;
VAL_TABLE_ SBZAlrtCstAvlFlg4 0 "FALSE" 1 "TRUE" ;
VAL_TABLE_ SBZAlrtCstAvlFlg3 0 "FALSE" 1 "TRUE" ;
VAL_TABLE_ SBZAlrtCstAvlFlg2 0 "FALSE" 1 "TRUE" ;
VAL_TABLE_ SBZAlrtCstAvlFlg1 0 "FALSE" 1 "TRUE" ;
VAL_TABLE_ LnChgAlrtLmtdTrlrIndOn 0 "FALSE" 1 "TRUE" ;
VAL_TABLE_ ServSdDtcSysIndOn 0 "FALSE" 1 "TRUE" ;
VAL_TABLE_ SdDtcTempUnvIndOn 0 "FALSE" 1 "TRUE" ;
VAL_TABLE_ SBZAlrtOffIndOn 0 "FALSE" 1 "TRUE" ;
VAL_TABLE_ SBZAlrtCstStAvl 0 "FALSE" 1 "TRUE" ;
VAL_TABLE_ TrffcLgtAsstWrnChmEvntStat 0 "NO_ACTION" 1 "ACTIVE" 2 "CANCEL_CHIME" 3 "RESERVED_1" ;
VAL_TABLE_ TrffcLgtAsstCstCurrSetVal 0 "SETTING_UNKNOWN" 1 "OFF" 2 "ALERT" 3 "RESERVED_3" 4 "RESERVED_4" 5 "RESERVED_5" 6 "RESERVED_6" 7 "RESERVED_7" ;
VAL_TABLE_ GlrFrHgBmRspTypCstCurSetVal 0 "SETTING_UNKNOWN" 1 "AUTOMATIC_HIGH_BEAM" 2 "GLARE_FREE_HIGH_BEAM" 3 "RESERVED_3" 4 "\?? RESERVED_4" 5 "RESERVED_5" 6 "RESERVED_6" 7 "RESERVED_7" ;
VAL_TABLE_ GlrFrHgBmRspTypCstAvlFlg7 0 "FALSE" 1 "TRUE" ;
VAL_TABLE_ GlrFrHgBmRspTypCstAvlFlg6 0 "FALSE" 1 "TRUE" ;
VAL_TABLE_ GlrFrHgBmRspTypCstAvlFlg5 0 "FALSE" 1 "TRUE" ;
VAL_TABLE_ GlrFrHgBmRspTypCstAvlFlg4 0 "FALSE" 1 "TRUE" ;
VAL_TABLE_ GlrFrHgBmRspTypCstAvlFlg3 0 "FALSE" 1 "TRUE" ;
VAL_TABLE_ GlrFrHgBmRspTypCstAvlFlg2 0 "FALSE" 1 "TRUE" ;
VAL_TABLE_ GlrFrHgBmRspTypCstAvlFlg1 0 "FALSE" 1 "TRUE" ;
VAL_TABLE_ AutoHgBmCtrlIO 0 "FALSE" 1 "TRUE" ;
VAL_TABLE_ TrffcLgtAsstCstAvlFlg7 0 "FALSE" 1 "TRUE" ;
VAL_TABLE_ TrffcLgtAsstCstAvlFlg6 0 "FALSE" 1 "TRUE" ;
VAL_TABLE_ TrffcLgtAsstCstAvlFlg5 0 "FALSE" 1 "TRUE" ;
VAL_TABLE_ TrffcLgtAsstCstAvlFlg4 0 "FALSE" 1 "TRUE" ;
VAL_TABLE_ TrffcLgtAsstCstAvlFlg3 0 "FALSE" 1 "TRUE" ;
VAL_TABLE_ TrffcLgtAsstCstAvlFlg2 0 "FALSE" 1 "TRUE" ;
VAL_TABLE_ TrffcLgtAsstCstAvlFlg1 0 "FALSE" 1 "TRUE" ;
VAL_TABLE_ GlrFrHgBmRspTypCstStAvl 0 "FALSE" 1 "TRUE" ;
VAL_TABLE_ TrffcLgtAsstCstSetAval 0 "FALSE" 1 "TRUE" ;
VAL_TABLE_ TSMEurDispSgn2Mn 0 "UnKnown" 1 "No Sign Detected" 2 "End of Speed Limit" 3 "End of All Restrictions" 4 "Begin of Motorway" 5 "End of Motorway" 6 "Begin of Expressway" 7 "End of Expressway" 8 "Begin of Play Street Zone" 9 "End of Play Street Zone" 10 "Begin of Passing Restriction" 11 "End of Passing Restriction" 12 "No Entry" 13 "Begin of City Limits" 14 "End of City Limits" 15 "Speed Limit 5" 16 "Speed Limit 10" 17 "Speed Limit 15" 18 "Speed Limit 20" 19 "Speed Limit 25" 20 "Speed Limit 30" 21 "Speed Limit 35" 22 "Speed Limit 40" 23 "Speed Limit 45" 24 "Speed Limit 50" 25 "Speed Limit 55" 26 "Speed Limit 60" 27 "Speed Limit 65" 28 "Speed Limit 70" 29 "Speed Limit 75" 30 "Speed Limit 80" 31 "Speed Limit 85" 32 "Speed Limit 90" 33 "Speed Limit 95" 34 "Speed Limit 100" 35 "Speed Limit 105" 36 "Speed Limit 110" 37 "Speed Limit 115" 38 "Speed Limit 120" 39 "Speed Limit 125" 40 "Speed Limit 130" 41 "Speed Limit 135" 42 "Speed Limit 140" 43 "Speed Limit 145" 44 "Speed Limit 150" 45 "Speed Limit 155" 46 "Speed Limit 160" 47 "Speed Limit 165" 48 "Speed Limit 170" 49 "Speed Limit 175" 50 "Speed Limit 180" 51 "Speed Limit 185" 52 "Speed Limit 190" 53 "Speed Limit 195" 54 "Speed Limit 200" ;
VAL_TABLE_ TSMEurDispSgn1Mn 0 "UnKnown" 1 "No Sign Detected" 2 "End of Speed Limit" 3 "End of All Restrictions" 4 "Begin of Motorway" 5 "End of Motorway" 6 "Begin of Expressway" 7 "End of Expressway" 8 "Begin of Play Street Zone" 9 "End of Play Street Zone" 10 "Begin of Passing Restriction" 11 "End of Passing Restriction" 12 "No Entry" 13 "Begin of City Limits" 14 "End of City Limits" 15 "Speed Limit 5" 16 "Speed Limit 10" 17 "Speed Limit 15" 18 "Speed Limit 20" 19 "Speed Limit 25" 20 "Speed Limit 30" 21 "Speed Limit 35" 22 "Speed Limit 40" 23 "Speed Limit 45" 24 "Speed Limit 50" 25 "Speed Limit 55" 26 "Speed Limit 60" 27 "Speed Limit 65" 28 "Speed Limit 70" 29 "Speed Limit 75" 30 "Speed Limit 80" 31 "Speed Limit 85" 32 "Speed Limit 90" 33 "Speed Limit 95" 34 "Speed Limit 100" 35 "Speed Limit 105" 36 "Speed Limit 110" 37 "Speed Limit 115" 38 "Speed Limit 120" 39 "Speed Limit 125" 40 "Speed Limit 130" 41 "Speed Limit 135" 42 "Speed Limit 140" 43 "Speed Limit 145" 44 "Speed Limit 150" 45 "Speed Limit 155" 46 "Speed Limit 160" 47 "Speed Limit 165" 48 "Speed Limit 170" 49 "Speed Limit 175" 50 "Speed Limit 180" 51 "Speed Limit 185" 52 "Speed Limit 190" 53 "Speed Limit 195" 54 "Speed Limit 200" ;
VAL_TABLE_ TSMUSAndCADispSgn1Mn 0 "UnKnown" 1 "No Sign Detected" 2 "Begin of Passing Restriction US" 3 "End of Passing Restriction US" 4 "Begin of Passing Restriction Canada" 5 "End of Passing Restriction Canada" 6 "Speed Limit 5" 7 "Speed Limit 10" 8 "Speed Limit 15" 9 "Speed Limit 20" 10 "Speed Limit 25" 11 "Speed Limit 30" 12 "Speed Limit 35" 13 "Speed Limit 40" 14 "Speed Limit 45" 15 "Speed Limit 50" 16 "Speed Limit 55" 17 "Speed Limit 60" 18 "Speed Limit 65" 19 "Speed Limit 70" 20 "Speed Limit 75" 21 "Speed Limit 80" 22 "Speed Limit 85" 23 "Speed Limit 90" 24 "Speed Limit 95" 25 "Speed Limit 100" 26 "Speed Limit 105" 27 "Speed Limit 110" 28 "Speed Limit 115" 29 "Speed Limit 120" 30 "Speed Limit 125" 31 "Speed Limit 130" 32 "Speed Limit 135" 33 "Speed Limit 140" 34 "Speed Limit 145" 35 "Speed Limit 150" 36 "Speed Limit 155" 37 "Speed Limit 160" 38 "Speed Limit 165" 39 "Speed Limit 170" 40 "Speed Limit 175" 41 "Speed Limit 180" 42 "Speed Limit 185" 43 "Speed Limit 190" 44 "Speed Limit 195" 45 "Speed Limit 200" ;
VAL_TABLE_ TSMUSAndCADispSgn2Mn 0 "UnKnown" 1 "No Sign Detected" 2 "Begin of Passing Restriction US" 3 "End of Passing Restriction US" 4 "Begin of Passing Restriction Canada" 5 "End of Passing Restriction Canada" 6 "Speed Limit 5" 7 "Speed Limit 10" 8 "Speed Limit 15" 9 "Speed Limit 20" 10 "Speed Limit 25" 11 "Speed Limit 30" 12 "Speed Limit 35" 13 "Speed Limit 40" 14 "Speed Limit 45" 15 "Speed Limit 50" 16 "Speed Limit 55" 17 "Speed Limit 60" 18 "Speed Limit 65" 19 "Speed Limit 70" 20 "Speed Limit 75" 21 "Speed Limit 80" 22 "Speed Limit 85" 23 "Speed Limit 90" 24 "Speed Limit 95" 25 "Speed Limit 100" 26 "Speed Limit 105" 27 "Speed Limit 110" 28 "Speed Limit 115" 29 "Speed Limit 120" 30 "Speed Limit 125" 31 "Speed Limit 130" 32 "Speed Limit 135" 33 "Speed Limit 140" 34 "Speed Limit 145" 35 "Speed Limit 150" 36 "Speed Limit 155" 37 "Speed Limit 160" 38 "Speed Limit 165" 39 "Speed Limit 170" 40 "Speed Limit 175" 41 "Speed Limit 180" 42 "Speed Limit 185" 43 "Speed Limit 190" 44 "Speed Limit 195" 45 "Speed Limit 200" ;
VAL_TABLE_ TSMEurDispSgn2AddOn 0 "UnKnown" 1 "None" 2 "Supp Sign Generic" 3 "Rain" 4 "Snow" 5 "Snow Rain" 6 "Rain Cloud" 7 "Fog" 8 "Time" 9 "Wet Conditions" 10 "Trailer" 11 "Tractor Passable" 12 "Arrow Left" 13 "Arrow Right" 14 "Distance Arrow" 15 "School" ;
VAL_TABLE_ TSMEurDispSgn1AddOn 0 "UnKnown" 1 "None" 2 "Supp Sign Generic" 3 "Rain" 4 "Snow" 5 "Snow Rain" 6 "Rain Cloud" 7 "Fog" 8 "Time" 9 "Wet Conditions" 10 "Trailer" 11 "Tractor Passable" 12 "Arrow Left" 13 "Arrow Right" 14 "Distance Arrow" 15 "School" ;
VAL_TABLE_ FrwdVsFlDtcnIndOn 0 "FALSE" 1 "TRUE" ;
VAL_TABLE_ FrwdVsAdvWthrIndOn 0 "FALSE" 1 "TRUE" ;
VAL_TABLE_ TSMUSAndCADispSgn2AddOn 0 "None" 1 "Supp Sign Generic" 2 "School" 3 "School When Flashing" 4 "End of Speed Limit" 5 "Where Workers Present" ;
VAL_TABLE_ TSMUSAndCADispSgn1AddOn 0 "None" 1 "Supp Sign Generic" 2 "School" 3 "School When Flashing" 4 "End of Speed Limit" 5 "Where Workers Present" ;
VAL_TABLE_ TrffcLgtAsstHUDWrnIndOn 0 "FALSE" 1 "TRUE" ;
VAL_TABLE_ TrffcLgtAsstClstrWrnIndOn 0 "FALSE" 1 "TRUE" ;
VAL_TABLE_ TSMSgnNtfnIndOn 0 "FALSE" 1 "TRUE" ;
VAL_TABLE_ TSMPDAMnSgnFlshgReq 0 "FALSE" 1 "TRUE" ;
VAL_TABLE_ TSMNoEntryIndOn 0 "FALSE" 1 "TRUE" ;
VAL_TABLE_ TSMIcePsblIndOn 0 "FALSE" 1 "TRUE" ;
VAL_TABLE_ TSMAddTrfSgnAvIndOn 0 "FALSE" 1 "TRUE" ;
VAL_TABLE_ FrwdVsFllBlckIndOn 0 "FALSE" 1 "TRUE" ;
VAL_TABLE_ TrffcLgtAsstRLADWrnIndOn 0 "FALSE" 1 "TRUE" ;
VAL_TABLE_ SBZALCAVisIndStatLt 0 "FLASHING" 1 "SOLID" 2 "OFF" ;
VAL_TABLE_ SBZALCAVisIndStatRt 0 "FLASHING" 1 "SOLID" 2 "OFF" ;
VAL_TABLE_ AutoHgBmActReq 0 "FALSE" 1 "TRUE" ;
VAL_TABLE_ LtFstAprchgVehObjDtd 0 "FALSE" 1 "TRUE" ;
VAL_TABLE_ RrCrsTrfcAlrtLftIndCtrl 0 "ON" 1 "OFF" 2 "FLASH" ;
VAL_TABLE_ RrCrsTrfcAlrtCstCrStVal 0 "SETTING_UNKNOWN" 1 "OFF" 2 "ALERT" 3 "ALERT and BRAKE" 4 "RESERVED_4" 5 "RESERVED_5" 6 "RESERVED_6" 7 "RESERVED_7" ;
VAL_TABLE_ LnChgAlrtCstCrStVal 0 "SETTING_UNKNOWN" 1 "OFF" 2 "ON" 3 "RESERVED_3" 4 "RESERVED_4" 5 "RESERVED_5" 6 "RESERVED_6" 7 "RESERVED_7" ;
VAL_TABLE_ LtSdVehObjDtd 0 "FALSE" 1 "TRUE" ;
VAL_TABLE_ SBZALCAOvrllOplSts 0 "NORMAL OPERATION" 1 "NEEDS SERVICE" 2 "TEMPORARY UNAVAILABLE" ;
VAL_TABLE_ RCTBAD_BrkgReqd 0 "FALSE" 1 "TRUE" ;
VAL_TABLE_ RCTBAD_BrkgReqTyp 0 "None" 1 "Hold" ;
VAL_TABLE_ SBZAlrtCstCrStVal 0 "SETTING_UNKNOWN" 1 "OFF" 2 "ON" 3 "RESERVED_3" 4 "RESERVED_4" 5 "RESERVED_5" 6 "RESERVED_6" 7 "RESERVED_7" ;
VAL_TABLE_ ByclDtnCstCurrSetVal 0 "Setting Unknown" 1 "Off" 2 "Alert" ;
VAL_TABLE_ ByclDtnArbdIndStat 0 "No Indication" 1 "Off" 2 "Right Level 1" 3 "Left Level 1" 4 "Right Level 2" 5 "Left Level 2" 6 "Left and Right Level 1" 7 "Left and Right Level 2" ;
VAL_TABLE_ ByclDtnCstAvlFlg1 0 "FALSE" 1 "TRUE" ;
VAL_TABLE_ RrCrsTrfcAlrtLtSdChmEvntStat 0 "NO_ACTION" 1 "ACTIVE" 2 "CANCEL_CHIME" ;
VAL_TABLE_ ByclDtnArbdLvl2ChmEvntStat 0 "No Action" 1 "Active" 2 "Cancel Chime" ;
VAL_TABLE_ ByclDtnArbdLvl1ChmEvntStat 0 "No Action" 1 "Active" 2 "Cancel Chime" ;
VAL_TABLE_ LnChgAlrtCstAvlFlg1 0 "FALSE" 1 "TRUE" ;
VAL_TABLE_ ByclDtnCstSetAval 0 "FALSE" 1 "TRUE" ;
VAL_TABLE_ ByclDtnCstAvlFlg7 0 "FALSE" 1 "TRUE" ;
VAL_TABLE_ ByclDtnCstAvlFlg6 0 "FALSE" 1 "TRUE" ;
VAL_TABLE_ ByclDtnCstAvlFlg5 0 "FALSE" 1 "TRUE" ;
VAL_TABLE_ ByclDtnCstAvlFlg4 0 "FALSE" 1 "TRUE" ;
VAL_TABLE_ ByclDtnCstAvlFlg3 0 "FALSE" 1 "TRUE" ;
VAL_TABLE_ ByclDtnCstAvlFlg2 0 "FALSE" 1 "TRUE" ;
VAL_TABLE_ LnChgAlrtSysOffIndOn 0 "FALSE" 1 "TRUE" ;
VAL_TABLE_ LnChgAlrtCstStAvl 0 "FALSE" 1 "TRUE" ;
VAL_TABLE_ LnChgAlrtCstAvlFlg7 0 "FALSE" 1 "TRUE" ;
VAL_TABLE_ LnChgAlrtCstAvlFlg6 0 "FALSE" 1 "TRUE" ;
VAL_TABLE_ LnChgAlrtCstAvlFlg5 0 "FALSE" 1 "TRUE" ;
VAL_TABLE_ LnChgAlrtCstAvlFlg4 0 "FALSE" 1 "TRUE" ;
VAL_TABLE_ LnChgAlrtCstAvlFlg3 0 "FALSE" 1 "TRUE" ;
VAL_TABLE_ LnChgAlrtCstAvlFlg2 0 "FALSE" 1 "TRUE" ;
VAL_TABLE_ RrCrsTrfcAlrtCstStAvl 0 "FALSE" 1 "TRUE" ;
VAL_TABLE_ RrCrsTrfcAlrtCstAvlFlg7 0 "FALSE" 1 "TRUE" ;
VAL_TABLE_ RrCrsTrfcAlrtCstAvlFlg6 0 "FALSE" 1 "TRUE" ;
VAL_TABLE_ RrCrsTrfcAlrtCstAvlFlg5 0 "FALSE" 1 "TRUE" ;
VAL_TABLE_ RrCrsTrfcAlrtCstAvlFlg4 0 "FALSE" 1 "TRUE" ;
VAL_TABLE_ RrCrsTrfcAlrtCstAvlFlg3 0 "FALSE" 1 "TRUE" ;
VAL_TABLE_ RrCrsTrfcAlrtCstAvlFlg2 0 "FALSE" 1 "TRUE" ;
VAL_TABLE_ RrCrsTrfcAlrtCstAvlFlg1 0 "FALSE" 1 "TRUE" ;
VAL_TABLE_ RrCrsTrfcBrkgAutoBrkgRelIndOn 0 "FALSE" 1 "TRUE" ;
VAL_TABLE_ RrCrsTrfcAutoBrkgOffIndOn 0 "FALSE" 1 "TRUE" ;
VAL_TABLE_ RrCrsTrfcAlrtOffIndOn 0 "FALSE" 1 "TRUE" ;
VAL_TABLE_ RtFstAprchgVehObjDtd 0 "FALSE" 1 "TRUE" ;
VAL_TABLE_ RtSdVehObjDtd 0 "FALSE" 1 "TRUE" ;
VAL_TABLE_ RrCrsTrfcAlrtRtSdChmEvntStat 0 "NO_ACTION" 1 "ACTIVE" 2 "CANCEL_CHIME" ;
VAL_TABLE_ RrCrsTrfcAlrtRgIndCtrl 0 "ON" 1 "OFF" 2 "FLASH" ;
VAL_TABLE_ PAOG1_Hght1 0 "Unknown" 1 "Traversable" 2 "High Object" 3 "Low Object" ;
VAL_TABLE_ PAOG1_Cnfd1 0 "Highly Speculative" 1 "Speculative" 2 "Confident" 3 "Highly Confident" ;
VAL_TABLE_ PAOG1_Typ1 0 "NoObject" 1 "Straight_0Corner" 2 "Straight_1Corner" 3 "Straight_2Corners" 4 "Point" 5 "Curbstone" 6 "Blind Area" ;
VAL_TABLE_ PAOG2_Hght2 0 "Unknown" 1 "Traversable" 2 "High Object" 3 "Low Object" ;
VAL_TABLE_ PAOG2_Cnfd2 0 "Highly Speculative" 1 "Speculative" 2 "Confident" 3 "Highly Confident" ;
VAL_TABLE_ PAOG2_Typ2 0 "NoObject" 1 "Straight_0Corner" 2 "Straight_1Corner" 3 "Straight_2Corners" 4 "Point" 5 "Curbstone" 6 "Blind Area" ;
VAL_TABLE_ PAOG3_Hght3 0 "Unknown" 1 "Traversable" 2 "High Object" 3 "Low Object" ;
VAL_TABLE_ PAOG3_Cnfd3 0 "Highly Speculative" 1 "Speculative" 2 "Confident" 3 "Highly Confident" ;
VAL_TABLE_ PAOG3_Typ3 0 "NoObject" 1 "Straight_0Corner" 2 "Straight_1Corner" 3 "Straight_2Corners" 4 "Point" 5 "Curbstone" 6 "Blind Area" ;
VAL_TABLE_ LRRODPB2P_POTk2DynPrpAuth 0 "Has Never Moved" 1 "Has Moved But Currently Stopped" 2 "Moving In Same Direction As Host" 3 "Moving In Opposite Direction As Host" 4 "Crossing Path" ;
VAL_TABLE_ LRRODPB2P_POTk2CnfdStsAuth 0 "Highly Speculative" 1 "Speculative" 2 "Confident" 3 "Highly Confident" ;
VAL_TABLE_ LRRODPB2P_POTk2MStsAuth 0 "No Object" 1 "New Object" 2 "Latent Track Not Detected this Cycle" 3 "Measured this Cycle" ;
VAL_TABLE_ LRRODPB2P_POTk2TypCnfdAuth 0 "Highly Speculative" 1 "Speculative" 2 "Confident" 3 "Highly Confident" ;
VAL_TABLE_ LRRODPB2P_POTk2TypAuth 0 "Unknown" 1 "Pedestrian" 2 "Bicycle" ;
VAL_TABLE_ LRRODPB2P_VOTk3DynPrpStsAuth 0 "Stopped" 1 "Not Stopped" ;
VAL_TABLE_ LRRODPB2P_VOTk3DynPrpAuth 0 "Has Never Moved" 1 "Moving In Same Direction As Host" 2 "Moving In Opposite Direction As Host" 3 "Crossing From Left To Right" 4 "Crossing From Right To Left" ;
VAL_TABLE_ LRRODPB2P_VOTk3CnfdStsAuth 0 "Highly Speculative" 1 "Speculative" 2 "Confident" 3 "Highly Confident" ;
VAL_TABLE_ LRRODPB2P_VOTk3MStsAuth 0 "No Object" 1 "New Object" 2 "Latent Track Not Detected this Cycle" 3 "Measured this Cycle" ;
VAL_TABLE_ LRRODPB2P_VOTk3TypCnfdAuth 0 "Highly Speculative" 1 "Speculative" 2 "Confident" 3 "Highly Confident" ;
VAL_TABLE_ LRRODPB2P_VOTk4DynPrpStsAuth 0 "Stopped" 1 "Not Stopped" ;
VAL_TABLE_ LRRODPB2P_VOTk4DynPrpAuth 0 "Has Never Moved" 1 "Moving In Same Direction As Host" 2 "Moving In Opposite Direction As Host" 3 "Crossing From Left To Right" 4 "Crossing From Right To Left" ;
VAL_TABLE_ LRRODPB2P_VOTk4CnfdStsAuth 0 "Highly Speculative" 1 "Speculative" 2 "Confident" 3 "Highly Confident" ;
VAL_TABLE_ LRRODPB2P_VOTk4MStsAuth 0 "No Object" 1 "New Object" 2 "Latent Track Not Detected this Cycle" 3 "Measured this Cycle" ;
VAL_TABLE_ LRRODPB2P_VOTk4TypCnfdAuth 0 "Highly Speculative" 1 "Speculative" 2 "Confident" 3 "Highly Confident" ;
VAL_TABLE_ LRRODPB2P_VOTk5CnfdStsAuth 0 "Highly Speculative" 1 "Speculative" 2 "Confident" 3 "Highly Confident" ;
VAL_TABLE_ LRRODPB2P_VOTk5DynPrpStsAuth 0 "Stopped" 1 "Not Stopped" ;
VAL_TABLE_ LRRODPB2P_VOTk5DynPrpAuth 0 "Has Never Moved" 1 "Moving In Same Direction As Host" 2 "Moving In Opposite Direction As Host" 3 "Crossing From Left To Right" 4 "Crossing From Right To Left" ;
VAL_TABLE_ LRRODPB2P_VOTk5MStsAuth 0 "No Object" 1 "New Object" 2 "Latent Track Not Detected this Cycle" 3 "Measured this Cycle" ;
VAL_TABLE_ LRRODPB2P_VOTk5TypCnfdAuth 0 "Highly Speculative" 1 "Speculative" 2 "Confident" 3 "Highly Confident" ;
VAL_TABLE_ LRRODPB3P_POTk3DynPrpAuth 0 "Has Never Moved" 1 "Has Moved But Currently Stopped" 2 "Moving In Same Direction As Host" 3 "Moving In Opposite Direction As Host" 4 "Crossing Path" ;
VAL_TABLE_ LRRODPB3P_POTk3CnfdStsAuth 0 "Highly Speculative" 1 "Speculative" 2 "Confident" 3 "Highly Confident" ;
VAL_TABLE_ LRRODPB3P_POTk3MStsAuth 0 "No Object" 1 "New Object" 2 "Latent Track Not Detected this Cycle" 3 "Measured this Cycle" ;
VAL_TABLE_ LRRODPB3P_POTk3TypCnfdAuth 0 "Highly Speculative" 1 "Speculative" 2 "Confident" 3 "Highly Confident" ;
VAL_TABLE_ LRRODPB3P_POTk3TypAuth 0 "Unknown" 1 "Pedestrian" 2 "Bicycle" ;
VAL_TABLE_ LRRODPB3P_VOTk6DynPrpStsAuth 0 "Stopped" 1 "Not Stopped" ;
VAL_TABLE_ LRRODPB3P_VOTk6DynPrpAuth 0 "Has Never Moved" 1 "Moving In Same Direction As Host" 2 "Moving In Opposite Direction As Host" 3 "Crossing From Left To Right" 4 "Crossing From Right To Left" ;
VAL_TABLE_ LRRODPB3P_VOTk6CnfdStsAuth 0 "Highly Speculative" 1 "Speculative" 2 "Confident" 3 "Highly Confident" ;
VAL_TABLE_ LRRODPB3P_VOTk6MStsAuth 0 "No Object" 1 "New Object" 2 "Latent Track Not Detected this Cycle" 3 "Measured this Cycle" ;
VAL_TABLE_ LRRODPB3P_VOTk6TypCnfdAuth 0 "Highly Speculative" 1 "Speculative" 2 "Confident" 3 "Highly Confident" ;
VAL_TABLE_ LRRODPB3P_VOTk7DynPrpStsAuth 0 "Stopped" 1 "Not Stopped" ;
VAL_TABLE_ LRRODPB3P_VOTk7DynPrpAuth 0 "Has Never Moved" 1 "Moving In Same Direction As Host" 2 "Moving In Opposite Direction As Host" 3 "Crossing From Left To Right" 4 "Crossing From Right To Left" ;
VAL_TABLE_ LRRODPB3P_VOTk7CnfdStsAuth 0 "Highly Speculative" 1 "Speculative" 2 "Confident" 3 "Highly Confident" ;
VAL_TABLE_ LRRODPB3P_VOTk7MStsAuth 0 "No Object" 1 "New Object" 2 "Latent Track Not Detected this Cycle" 3 "Measured this Cycle" ;
VAL_TABLE_ LRRODPB3P_VOTk7TypCnfdAuth 0 "Highly Speculative" 1 "Speculative" 2 "Confident" 3 "Highly Confident" ;
VAL_TABLE_ LRRODPB3P_VOTk8CnfdStsAuth 0 "Highly Speculative" 1 "Speculative" 2 "Confident" 3 "Highly Confident" ;
VAL_TABLE_ LRRODPB3P_VOTk8DynPrpStsAuth 0 "Stopped" 1 "Not Stopped" ;
VAL_TABLE_ LRRODPB3P_VOTk8DynPrpAuth 0 "Has Never Moved" 1 "Moving In Same Direction As Host" 2 "Moving In Opposite Direction As Host" 3 "Crossing From Left To Right" 4 "Crossing From Right To Left" ;
VAL_TABLE_ LRRODPB3P_VOTk8MStsAuth 0 "No Object" 1 "New Object" 2 "Latent Track Not Detected this Cycle" 3 "Measured this Cycle" ;
VAL_TABLE_ LRRODPB3P_VOTk8TypCnfdAuth 0 "Highly Speculative" 1 "Speculative" 2 "Confident" 3 "Highly Confident" ;
VAL_TABLE_ LRRODPB4P_POTk4DynPrpAuth 0 "Has Never Moved" 1 "Has Moved But Currently Stopped" 2 "Moving In Same Direction As Host" 3 "Moving In Opposite Direction As Host" 4 "Crossing Path" ;
VAL_TABLE_ LRRODPB4P_POTk4CnfdStsAuth 0 "Highly Speculative" 1 "Speculative" 2 "Confident" 3 "Highly Confident" ;
VAL_TABLE_ LRRODPB4P_POTk4MStsAuth 0 "No Object" 1 "New Object" 2 "Latent Track Not Detected this Cycle" 3 "Measured this Cycle" ;
VAL_TABLE_ LRRODPB4P_POTk5DynPrpAuth 0 "Has Never Moved" 1 "Has Moved But Currently Stopped" 2 "Moving In Same Direction As Host" 3 "Moving In Opposite Direction As Host" 4 "Crossing Path" ;
VAL_TABLE_ LRRODPB4P_POTk5CnfdStsAuth 0 "Highly Speculative" 1 "Speculative" 2 "Confident" 3 "Highly Confident" ;
VAL_TABLE_ LRRODPB4P_POTk4TypCnfdAuth 0 "Highly Speculative" 1 "Speculative" 2 "Confident" 3 "Highly Confident" ;
VAL_TABLE_ LRRODPB4P_POTk4TypAuth 0 "Unknown" 1 "Pedestrian" 2 "Bicycle" ;
VAL_TABLE_ LRRODPB4P_POTk5MStsAuth 0 "No Object" 1 "New Object" 2 "Latent Track Not Detected this Cycle" 3 "Measured this Cycle" ;
VAL_TABLE_ LRRODPB4P_POTk5TypCnfdAuth 0 "Highly Speculative" 1 "Speculative" 2 "Confident" 3 "Highly Confident" ;
VAL_TABLE_ LRRODPB4P_POTk5TypAuth 0 "Unknown" 1 "Pedestrian" 2 "Bicycle" ;
VAL_TABLE_ LRRODPB4P_VOTk10DynPrpAuth 0 "Has Never Moved" 1 "Moving In Same Direction As Host" 2 "Moving In Opposite Direction As Host" 3 "Crossing From Left To Right" 4 "Crossing From Right To Left" ;
VAL_TABLE_ LRRODPB4P_VOTk10CnfdStsAuth 0 "Highly Speculative" 1 "Speculative" 2 "Confident" 3 "Highly Confident" ;
VAL_TABLE_ LRRODPB4P_VOTk10DynPrpStsAuth 0 "Stopped" 1 "Not Stopped" ;
VAL_TABLE_ LRRODPB4P_VOTk10MStsAuth 0 "No Object" 1 "New Object" 2 "Latent Track Not Detected this Cycle" 3 "Measured this Cycle" ;
VAL_TABLE_ LRRODPB4P_VOTk10TypCnfdAuth 0 "Highly Speculative" 1 "Speculative" 2 "Confident" 3 "Highly Confident" ;
VAL_TABLE_ LRRODPB4P_VOTk9DynPrpStsAuth 0 "Stopped" 1 "Not Stopped" ;
VAL_TABLE_ LRRODPB4P_VOTk9DynPrpAuth 0 "Has Never Moved" 1 "Moving In Same Direction As Host" 2 "Moving In Opposite Direction As Host" 3 "Crossing From Left To Right" 4 "Crossing From Right To Left" ;
VAL_TABLE_ LRRODPB4P_VOTk9CnfdStsAuth 0 "Highly Speculative" 1 "Speculative" 2 "Confident" 3 "Highly Confident" ;
VAL_TABLE_ LRRODPB4P_VOTk9MStsAuth 0 "No Object" 1 "New Object" 2 "Latent Track Not Detected this Cycle" 3 "Measured this Cycle" ;
VAL_TABLE_ LRRODPB4P_VOTk9TypCnfdAuth 0 "Highly Speculative" 1 "Speculative" 2 "Confident" 3 "Highly Confident" ;
VAL_TABLE_ LRRODPB5P_IOTk10ElvtnAuth 0 "Not Elevated" 1 "Elevation Speculative" 2 "Elevation Confident" 3 "Elevation Very Confident" ;
VAL_TABLE_ LRRODPB5P_IOTk10CnfdStsAuth 0 "Highly Speculative" 1 "Speculative" 2 "Confident" 3 "Highly Confident" ;
VAL_TABLE_ LRRODPB5P_IOTk10MStsAuth 0 "No Object" 1 "New Object" 2 "Latent Track Not Detected this Cycle" 3 "Measured this Cycle" ;
VAL_TABLE_ LRRODPB5P_IOTk1CnfdStsAuth 0 "Highly Speculative" 1 "Speculative" 2 "Confident" 3 "Highly Confident" ;
VAL_TABLE_ LRRODPB5P_IOTk10TypCnfdAuth 0 "Highly Speculative" 1 "Speculative" 2 "Confident" 3 "Highly Confident" ;
VAL_TABLE_ LRRODPB5P_IOTk10TypAuth 0 "Unknown" 1 "Guard Rail" 2 "Tunnel" 3 "Traffic Sign" 4 "Bridge" 5 "Pole" ;
VAL_TABLE_ LRRODPB5P_IOTk1ElvtnAuth 0 "Not Elevated" 1 "Elevation Speculative" 2 "Elevation Confident" 3 "Elevation Very Confident" ;
VAL_TABLE_ LRRODPB5P_IOTk1MStsAuth 0 "No Object" 1 "New Object" 2 "Latent Track Not Detected this Cycle" 3 "Measured this Cycle" ;
VAL_TABLE_ LRRODPB5P_IOTk1TypAuth 0 "Unknown" 1 "Guard Rail" 2 "Tunnel" 3 "Traffic Sign" 4 "Bridge" 5 "Pole" ;
VAL_TABLE_ LRRODPB5P_IOTk2ElvtnAuth 0 "Not Elevated" 1 "Elevation Speculative" 2 "Elevation Confident" 3 "Elevation Very Confident" ;
VAL_TABLE_ LRRODPB5P_IOTk2CnfdStsAuth 0 "Highly Speculative" 1 "Speculative" 2 "Confident" 3 "Highly Confident" ;
VAL_TABLE_ LRRODPB5P_IOTk1TypCnfdAuth 0 "Highly Speculative" 1 "Speculative" 2 "Confident" 3 "Highly Confident" ;
VAL_TABLE_ LRRODPB5P_IOTk2MStsAuth 0 "No Object" 1 "New Object" 2 "Latent Track Not Detected this Cycle" 3 "Measured this Cycle" ;
VAL_TABLE_ LRRODPB5P_IOTk2TypCnfdAuth 0 "Highly Speculative" 1 "Speculative" 2 "Confident" 3 "Highly Confident" ;
VAL_TABLE_ LRRODPB5P_IOTk2TypAuth 0 "Unknown" 1 "Guard Rail" 2 "Tunnel" 3 "Traffic Sign" 4 "Bridge" 5 "Pole" ;
VAL_TABLE_ LRRODPB5P_IOTk3ElvtnAuth 0 "Not Elevated" 1 "Elevation Speculative" 2 "Elevation Confident" 3 "Elevation Very Confident" ;
VAL_TABLE_ LRRODPB5P_IOTk3CnfdStsAuth 0 "Highly Speculative" 1 "Speculative" 2 "Confident" 3 "Highly Confident" ;
VAL_TABLE_ LRRODPB5P_IOTk3MStsAuth 0 "No Object" 1 "New Object" 2 "Latent Track Not Detected this Cycle" 3 "Measured this Cycle" ;
VAL_TABLE_ LRRODPB5P_IOTk4CnfdStsAuth 0 "Highly Speculative" 1 "Speculative" 2 "Confident" 3 "Highly Confident" ;
VAL_TABLE_ LRRODPB5P_IOTk3TypCnfdAuth 0 "Highly Speculative" 1 "Speculative" 2 "Confident" 3 "Highly Confident" ;
VAL_TABLE_ LRRODPB5P_IOTk3TypAuth 0 "Unknown" 1 "Guard Rail" 2 "Tunnel" 3 "Traffic Sign" 4 "Bridge" 5 "Pole" ;
VAL_TABLE_ LRRODPB5P_IOTk4ElvtnAuth 0 "Not Elevated" 1 "Elevation Speculative" 2 "Elevation Confident" 3 "Elevation Very Confident" ;
VAL_TABLE_ LRRODPB5P_IOTk4MStsAuth 0 "No Object" 1 "New Object" 2 "Latent Track Not Detected this Cycle" 3 "Measured this Cycle" ;
VAL_TABLE_ LRRODPB5P_IOTk4TypAuth 0 "Unknown" 1 "Guard Rail" 2 "Tunnel" 3 "Traffic Sign" 4 "Bridge" 5 "Pole" ;
VAL_TABLE_ LRRODPB5P_IOTk5ElvtnAuth 0 "Not Elevated" 1 "Elevation Speculative" 2 "Elevation Confident" 3 "Elevation Very Confident" ;
VAL_TABLE_ LRRODPB5P_IOTk5CnfdStsAuth 0 "Highly Speculative" 1 "Speculative" 2 "Confident" 3 "Highly Confident" ;
VAL_TABLE_ LRRODPB5P_IOTk4TypCnfdAuth 0 "Highly Speculative" 1 "Speculative" 2 "Confident" 3 "Highly Confident" ;
VAL_TABLE_ LRRODPB5P_IOTk5MStsAuth 0 "No Object" 1 "New Object" 2 "Latent Track Not Detected this Cycle" 3 "Measured this Cycle" ;
VAL_TABLE_ LRRODPB5P_IOTk5TypCnfdAuth 0 "Highly Speculative" 1 "Speculative" 2 "Confident" 3 "Highly Confident" ;
VAL_TABLE_ LRRODPB5P_IOTk5TypAuth 0 "Unknown" 1 "Guard Rail" 2 "Tunnel" 3 "Traffic Sign" 4 "Bridge" 5 "Pole" ;
VAL_TABLE_ LRRODPB5P_IOTk6ElvtnAuth 0 "Not Elevated" 1 "Elevation Speculative" 2 "Elevation Confident" 3 "Elevation Very Confident" ;
VAL_TABLE_ LRRODPB5P_IOTk6CnfdStsAuth 0 "Highly Speculative" 1 "Speculative" 2 "Confident" 3 "Highly Confident" ;
VAL_TABLE_ LRRODPB5P_IOTk6MStsAuth 0 "No Object" 1 "New Object" 2 "Latent Track Not Detected this Cycle" 3 "Measured this Cycle" ;
VAL_TABLE_ LRRODPB5P_IOTk7ElvtnAuth 0 "Not Elevated" 1 "Elevation Speculative" 2 "Elevation Confident" 3 "Elevation Very Confident" ;
VAL_TABLE_ LRRODPB5P_IOTk7CnfdStsAuth 0 "Highly Speculative" 1 "Speculative" 2 "Confident" 3 "Highly Confident" ;
VAL_TABLE_ LRRODPB5P_IOTk6TypCnfdAuth 0 "Highly Speculative" 1 "Speculative" 2 "Confident" 3 "Highly Confident" ;
VAL_TABLE_ LRRODPB5P_IOTk6TypAuth 0 "Unknown" 1 "Guard Rail" 2 "Tunnel" 3 "Traffic Sign" 4 "Bridge" 5 "Pole" ;
VAL_TABLE_ LRRODPB5P_IOTk7MStsAuth 0 "No Object" 1 "New Object" 2 "Latent Track Not Detected this Cycle" 3 "Measured this Cycle" ;
VAL_TABLE_ LRRODPB5P_IOTk7TypAuth 0 "Unknown" 1 "Guard Rail" 2 "Tunnel" 3 "Traffic Sign" 4 "Bridge" 5 "Pole" ;
VAL_TABLE_ LRRODPB5P_IOTk8ElvtnAuth 0 "Not Elevated" 1 "Elevation Speculative" 2 "Elevation Confident" 3 "Elevation Very Confident" ;
VAL_TABLE_ LRRODPB5P_IOTk8CnfdStsAuth 0 "Highly Speculative" 1 "Speculative" 2 "Confident" 3 "Highly Confident" ;
VAL_TABLE_ LRRODPB5P_IOTk7TypCnfdAuth 0 "Highly Speculative" 1 "Speculative" 2 "Confident" 3 "Highly Confident" ;
VAL_TABLE_ LRRODPB5P_IOTk8MStsAuth 0 "No Object" 1 "New Object" 2 "Latent Track Not Detected this Cycle" 3 "Measured this Cycle" ;
VAL_TABLE_ LRRODPB5P_IOTk9CnfdStsAuth 0 "Highly Speculative" 1 "Speculative" 2 "Confident" 3 "Highly Confident" ;
VAL_TABLE_ LRRODPB5P_IOTk8TypCnfdAuth 0 "Highly Speculative" 1 "Speculative" 2 "Confident" 3 "Highly Confident" ;
VAL_TABLE_ LRRODPB5P_IOTk8TypAuth 0 "Unknown" 1 "Guard Rail" 2 "Tunnel" 3 "Traffic Sign" 4 "Bridge" 5 "Pole" ;
VAL_TABLE_ LRRODPB5P_IOTk9ElvtnAuth 0 "Not Elevated" 1 "Elevation Speculative" 2 "Elevation Confident" 3 "Elevation Very Confident" ;
VAL_TABLE_ LRRODPB5P_IOTk9MStsAuth 0 "No Object" 1 "New Object" 2 "Latent Track Not Detected this Cycle" 3 "Measured this Cycle" ;
VAL_TABLE_ LRRODPB5P_IOTk9TypAuth 0 "Unknown" 1 "Guard Rail" 2 "Tunnel" 3 "Traffic Sign" 4 "Bridge" 5 "Pole" ;
VAL_TABLE_ LRRODPB5P_IOTk9TypCnfdAuth 0 "Highly Speculative" 1 "Speculative" 2 "Confident" 3 "Highly Confident" ;
VAL_TABLE_ LRRODPB1P_ConstrArDtnCnfdAuth 0 "Highly Speculative" 1 "Speculative" 2 "Confident" 3 "Highly Confident" ;
VAL_TABLE_ LRRODPB1P_AcqTmStmAuth_Inv 0 "FALSE" 1 "TRUE" ;
VAL_TABLE_ LRRODPB1P_POTk1DynPrpAuth 0 "Has Never Moved" 1 "Has Moved But Currently Stopped" 2 "Moving In Same Direction As Host" 3 "Moving In Opposite Direction As Host" 4 "Crossing Path" ;
VAL_TABLE_ LRRODPB1P_POTk1CnfdStsAuth 0 "Highly Speculative" 1 "Speculative" 2 "Confident" 3 "Highly Confident" ;
VAL_TABLE_ LRRODPB1P_MdCmdStsAuth 0 "Not Radiating" 1 "Reporting Object Data" 2 "Not Reporting Object Data" ;
VAL_TABLE_ LRRODPB1P_InTnnlDtnAuth 0 "FALSE" 1 "TRUE" ;
VAL_TABLE_ LRRODPB1P_ConstrArDtnStsAuth 0 "Not Detected" 1 "Detected" 2 "Unknown" ;
VAL_TABLE_ LRRODPB1P_POTk1MStsAuth 0 "No Object" 1 "New Object" 2 "Latent Track Not Detected this Cycle" 3 "Measured this Cycle" ;
VAL_TABLE_ LRRODPB1P_RdTypAuth 0 "Unknown" 1 "City" 2 "Secondary Road" 3 "Highway" 4 "Construction Zone Entry" 5 "Construction Zone Exit" ;
VAL_TABLE_ LRRODPB1P_POTk1TypCnfdAuth 0 "Highly Speculative" 1 "Speculative" 2 "Confident" 3 "Highly Confident" ;
VAL_TABLE_ LRRODPB1P_POTk1TypAuth 0 "Unknown" 1 "Pedestrian" 2 "Bicycle" ;
VAL_TABLE_ LRRODPB1P_ServRqrdAuth 0 "FALSE" 1 "TRUE" ;
VAL_TABLE_ LRRODPB1P_ServAlgnInPrcAuth 0 "FALSE" 1 "TRUE" ;
VAL_TABLE_ LRRODPB1P_RngModeStatuStsAuth 0 "Near Range" 1 "Mid Range" 2 "Far Range" ;
VAL_TABLE_ LRRODPB1P_RdTypCnfdAuth 0 "Highly Speculative" 1 "Speculative" 2 "Confident" 3 "Highly Confident" ;
VAL_TABLE_ LRRODPB1P_SnsrUnvAuth 0 "FALSE" 1 "TRUE" ;
VAL_TABLE_ LRRODPB1P_SnsrBlckdAuth 0 "FALSE" 1 "TRUE" ;
VAL_TABLE_ LRRODPB1P_VOTk1DynPrpStsAuth 0 "Stopped" 1 "Not Stopped" ;
VAL_TABLE_ LRRODPB1P_VOTk1DynPrpAuth 0 "Has Never Moved" 1 "Moving In Same Direction As Host" 2 "Moving In Opposite Direction As Host" 3 "Crossing From Left To Right" 4 "Crossing From Right To Left" ;
VAL_TABLE_ LRRODPB1P_VOTk1CnfdStsAuth 0 "Highly Speculative" 1 "Speculative" 2 "Confident" 3 "Highly Confident" ;
VAL_TABLE_ LRRODPB1P_VOTk1MStsAuth 0 "No Object" 1 "New Object" 2 "Latent Track Not Detected this Cycle" 3 "Measured this Cycle" ;
VAL_TABLE_ LRRODPB1P_VOTk1TypCnfdAuth 0 "Highly Speculative" 1 "Speculative" 2 "Confident" 3 "Highly Confident" ;
VAL_TABLE_ LRRODPB1P_VOTk2CnfdStsAuth 0 "Highly Speculative" 1 "Speculative" 2 "Confident" 3 "Highly Confident" ;
VAL_TABLE_ LRRODPB1P_VOTk2DynPrpStsAuth 0 "Stopped" 1 "Not Stopped" ;
VAL_TABLE_ LRRODPB1P_VOTk2DynPrpAuth 0 "Has Never Moved" 1 "Moving In Same Direction As Host" 2 "Moving In Opposite Direction As Host" 3 "Crossing From Left To Right" 4 "Crossing From Right To Left" ;
VAL_TABLE_ LRRODPB1P_VOTk2MStsAuth 0 "No Object" 1 "New Object" 2 "Latent Track Not Detected this Cycle" 3 "Measured this Cycle" ;
VAL_TABLE_ LRRODPB1P_VOTk2TypCnfdAuth 0 "Highly Speculative" 1 "Speculative" 2 "Confident" 3 "Highly Confident" ;
VAL_TABLE_ LRRODPB6P_REOTkLtCnfdStsAuth 0 "Highly Speculative" 1 "Speculative" 2 "Confident" 3 "Highly Confident" ;
VAL_TABLE_ LRRODPB6P_REOTkLtTypAuth 0 "Unknown" 1 "Barriers" 2 "Guard Rails" 3 "Bridge Abutments" 4 "Edge of Road" 5 "Open Area" ;
VAL_TABLE_ LRRODPB6P_REOTkRtCnfdStsAuth 0 "Highly Speculative" 1 "Speculative" 2 "Confident" 3 "Highly Confident" ;
VAL_TABLE_ LRRODPB6P_REOTkLtTypCnfdAuth 0 "Highly Speculative" 1 "Speculative" 2 "Confident" 3 "Highly Confident" ;
VAL_TABLE_ LRRODPB6P_REOTkRtTypAuth 0 "Unknown" 1 "Barriers" 2 "Guard Rails" 3 "Bridge Abutments" 4 "Edge of Road" 5 "Open Area" ;
VAL_TABLE_ LRRODPB6P_REOTkRtTypCnfdAuth 0 "Highly Speculative" 1 "Speculative" 2 "Confident" 3 "Highly Confident" ;
VAL_TABLE_ LRR_CAN8_ClscCANHrtBtActv 0 "FALSE" 1 "TRUE" ;
VAL_TABLE_ PrkAsstCustSeltn 0 "Off" 1 "On" 2 "Failed" ;
VAL_TABLE_ PAOprtlSts 0 "Unavailable" 1 "Available" 2 "Failed" ;
VAL_TABLE_ PrkAsstONOFFCstCrStVal 0 "SETTING_UNKNOWN" 1 "OFF" 2 "ALERT" 3 "ALERT_BRAKE" 4 "RESERVED_4" 5 "RESERVED_5" 6 "RESERVED_6" 7 "RESERVED_7" ;
VAL_TABLE_ RrwdImpMtgnAval 0 "FALSE" 1 "TRUE" ;
VAL_TABLE_ ADASIS_NAVILINK_SpdLmtPsdSpd_DuD 0 "FALSE" 1 "TRUE" ;
VAL_TABLE_ ADASIS_NAVILINK_DigMpVerYr 0 "2000" 1 "2001" 2 "2002" 3 "2003" 4 "2004" 5 "2005" 6 "2006" 7 "2007" 8 "2008" 9 "2009" 10 "2010" 11 "2011" 12 "2012" 13 "2013" 14 "2014" 15 "2015" 16 "2016" 17 "2017" 18 "2018" 19 "2019" 20 "2020" 21 "2021" 22 "2022" 23 "2023" 24 "2024" 25 "2025" 26 "2026" 27 "2027" 28 "2028" 29 "2029" 30 "2030" 31 "2031" 32 "2032" 33 "2033" 34 "2034" 35 "2035" 36 "2036" 37 "2037" 38 "2038" 39 "2039" 40 "2040" 41 "2041" 42 "2042" 43 "2043" 44 "2044" 45 "2045" 46 "2046" 47 "2047" 48 "2048" 49 "2049" 50 "2050" 51 "2051" 52 "2052" 53 "2053" 54 "2054" 55 "2055" 56 "2056" 57 "2057" 58 "2058" 59 "2059" 60 "2060" 61 "2061" 62 "2062" 63 "NOT APPLICABLE" ;
VAL_TABLE_ ADASIS_NAVILINK_DigMpCndlSpdLmt 0 "UNKNOWN" 1 "<= 5 KM/H [MPH]" 2 "7 KM/H [MPH]" 3 "10 KM/H [MPH]" 4 "15 KM/H [MPH]" 5 "20 KM/H [MPH]" 6 "25 KM/H [MPH]" 7 "30 KM/H [MPH]" 8 "35 KM/H [MPH]" 9 "40 KM/H [MPH]" 10 "45 KM/H [MPH]" 11 "50 KM/H [MPH]" 12 "55 KM/H [MPH]" 13 "60 KM/H" 14 "MPH]65 KM/H [MPH]" 15 "70 KM/H [MPH]" 16 "75 KM/H [MPH]" 17 "80 KM/H [MPH]" 18 "85 KM/H [MPH]" 19 "90 KM/H [MPH]" 20 "95 KM/H [MPH]" 21 "100 KM/H [MPH]" 22 "105 KM/H [MPH]" 23 "110 KM/H [MPH]" 24 "115 KM/H [MPH]" 25 "120 KM/H[MPH]" 26 "130 KM/H [MPH]" 27 "140 KM/H [MPH]" 28 "150 KM/H [MPH]" 29 "160 KM/H [MPH]" 30 "UNLIMITED" 31 "NOT AVAILABLE" ;
VAL_TABLE_ ADASIS_NAVILINK_DgtlMpSpdCtgry 0 "> 130 KPH OR > 80 MPH" 1 "101-130 KPH OR 65\???80 MPH" 2 "91-100 KPH OR 55\???64 MPH" 3 "71-90 KPH OR 41\???54 MPH" 4 "51-70 KPH OR 31\???40 MPH" 5 "31-50 KPH OR 21\???30 MPH" 6 "11-30 KPH OR 6 \???20 MPH" 7 "<11 KPH OR < 6 MPH" 8 "UNKNOWN" ;
VAL_TABLE_ ADASIS_NAVILINK_DigMpVerQtr 0 "QUARTER 1" 1 "QUARTER 2" 2 "QUARTER 3" 3 "QUARTER 4" ;
VAL_TABLE_ ADASIS_NAVILINK_FncRdClss 0 "LOCAL" 1 "SFREEWAY" 2 "FREEWAY" 3 "PED-MALL" 4 "HIGHWAY" 5 "ARTERIAL" 6 "ALLEY" 7 "COLLECTOR" ;
VAL_TABLE_ ADASIS_NAVILINK_DigMpEfSpdLmTyp 0 "IMPLICIT" 1 "ON TRAFFIC SIGN" 2 "ONLY BY NIGHT" 3 "ONLY BY DAY" 4 "TIME OF DAY" 5 "ONLY BY RAIN" 6 "ONLY BY SNOW OR FOG" 7 "UNKOWN" ;
VAL_TABLE_ ADASIS_NAVILINK_SprtdLnRd 0 "ROAD IS NOT CONTROLLED ACCESS ROAD" 1 "ROAD IS CONTROLLED ACCESS ROAD" ;
VAL_TABLE_ ADASIS_NAVILINK_SpdLmtUnt 0 "MILES/H" 1 "KM/H" ;
VAL_TABLE_ ADASIS_NAVILINK_MpDtAv 0 "NOT VALID" 1 "VALID" ;
VAL_TABLE_ ADASIS_NAVILINK_DigMpPstSpdLmAs 0 "NOT ASSURED" 1 "ASSURED" ;
VAL_TABLE_ ADASIS_NAVILINK_DigMpDrvngSd 0 "DRIVING SIDE LEFT" 1 "DRIVING SIDE RIGHT" ;
VAL_TABLE_ ADASIS_NAVILINK_LnCtgry 0 "NO INFO AVAILABLE" 1 "ONE LANE" 2 "TWO OR THREE LANES" 3 "FOUR OR MORE LANES" ;
VAL_TABLE_ SWIP_StrgWhlAngAuth_DuD 0 "FALSE" 1 "TRUE" ;
VAL_TABLE_ SWIP_StrgWhlAngAuth_Inv 0 "FALSE" 1 "TRUE" ;
VAL_TABLE_ BGI3P_BrkPedPstnAuth_Inv 0 "FALSE" 1 "TRUE" ;
VAL_TABLE_ DRCDNDP_DRCAvgDrvnAuth_Inv 0 "FALSE" 1 "TRUE" ;
VAL_TABLE_ ACCBRP_ACCActvAuth 0 "FALSE" 1 "TRUE" ;
VAL_TABLE_ VehPathTrnPrdctn_Inv 0 "FALSE" 1 "TRUE" ;
VAL_TABLE_ VehPathTrnPrdctn 0 "Unknown" 1 "Right Turn" 2 "Left Turn" 3 "Straight" ;
VAL_TABLE_ BGI1P_OutsdAmbtLgtLvlStsAuth 0 "Unknown" 1 "Day" 2 "Night" ;
VAL_TABLE_ DrSeltdSpdLmtrAutoMdSpLmStsAuth 0 "No Set Speed Change" 1 "Proposed Speed Limit Change" 2 "Accepted Speed Limit Change" 3 "Declined Speed Limit Change" ;
VAL_TABLE_ GPSQM_PPSMode_Inv 0 "FALSE" 1 "TRUE" ;
VAL_TABLE_ GPSQM_PPSMode 0 "GNSS Standalone" 1 "GNSS and SBAS" 2 "GNSS and RTX" 3 "GNSS and DR" 4 "GNSS and SBAS and DR" 5 "GNSS and RTX and DR" 6 "DR ONLY" 7 "GNSS and RTX and DR and MM" ;
VAL_TABLE_ ACCSysSlctdMd 0 "Cruise Control Mode Switching Not Supported" 1 "Adaptive Cruise Control" 2 "Enhanced Cruise Control" ;
VAL_TABLE_ VehConPrvdrLrnSts 0 "Learn Unknown" 1 "Learn Complete" 2 "Learn Incomplete" ;
VAL_TABLE_ TrlrConnStat 0 "Not Connected" 1 "Connected" ;
VAL_TABLE_ ELWWIP_WprFrtFtrReqAuth 0 "Wiper Front Stop" 1 "Wiper Front Crank Suspend" 2 "Wiper Front Depressed Park" 3 "Wiper Front Park" 4 "Wiper Front Winter Park" 5 "Wiper Front Service Park" 6 "Wiper Front Intermittent 5" 7 "Wiper Front Intermittent 4" 8 "Wiper Front Intermittent 3" 9 "Wiper Front Intermittent 2" 10 "Wiper Front Intermittent 1" 11 "Wiper Front Low Wipe" 12 "Wiper Front High Wipe" ;
VAL_TABLE_ HMII1P_ChmSysSOHAuth 0 "Unknown" 1 "Healthy" 2 "Faulted" ;
VAL_TABLE_ OATP_OtsAirTmpCrValAuth_Inv 0 "FALSE" 1 "TRUE" ;
VAL_TABLE_ ADASIS_NAVILINK_DgtlMpEfSpdLm 0 "UNKNOWN" 1 "<= 5 KM/H [MPH]" 2 "7 KM/H [MPH]" 3 "10 KM/H [MPH]" 4 "15 KM/H [MPH]" 5 "20 KM/H [MPH]" 6 "25 KM/H [MPH]" 7 "30 KM/H [MPH]" 8 "35 KM/H [MPH]" 9 "40 KM/H [MPH]" 10 "45 KM/H [MPH]" 11 "50 KM/H [MPH]" 12 "55 KM/H [MPH]" 13 "60 KM/H" 14 "MPH]65 KM/H [MPH]" 15 "70 KM/H [MPH]" 16 "75 KM/H [MPH]" 17 "80 KM/H [MPH]" 18 "85 KM/H [MPH]" 19 "90 KM/H [MPH]" 20 "95 KM/H [MPH]" 21 "100 KM/H [MPH]" 22 "105 KM/H [MPH]" 23 "110 KM/H [MPH]" 24 "115 KM/H [MPH]" 25 "120 KM/H[MPH]" 26 "130 KM/H [MPH]" 27 "140 KM/H [MPH]" 28 "150 KM/H [MPH]" 29 "160 KM/H [MPH]" 30 "UNLIMITED" 31 "NOT AVAILABLE" ;
VAL_TABLE_ ADASIS_NAVILINK_CntryCd 0 "AD" 1 "AT" 2 "BE" 3 "CZ" 4 "DK" 5 "EE" 6 "FR" 7 "DE" 8 "GR" 9 "HU" 10 "IE" 11 "IT" 12 "BY" 13 "BG" 14 "CY" 15 "MT" 16 "HR" 17 "TR" 18 "RS" 19 "ME" 20 "LV" 21 "LT" 22 "LU" 23 "NL" 24 "NO" 25 "PL" 26 "PT" 27 "UK" 28 "SK" 29 "SI" 30 "ES" 31 "SE" 32 "CH" 33 "RO" 34 "RU" 35 "UA" 36 "BA" 37 "AL" 38 "MD" 39 "IS" 40 "MK" 41 "US" 42 "ZA" 43 "AU" 44 "NZ" 45 "KR" 46 "CN" 47 "CA" 48 "MX" 49 "FI" 50 "OTHER" 51 "UNKNOWN" ;
VAL_TABLE_ ADASIS_NAVILINK_DgtlMpPsngRst 0 "NO PASSING RESTRICTIONS" 1 "GENERAL NO OVERTAKE" 2 "FLUCTUATING (E.G. LED SIGNS)" 3 "CONDITIONAL PASSENGER CAR WITH TRAILER" 4 "CONDITIONAL TRACTORS ARE ALLOWED TO OVERTAKE" 5 "CONDITIONAL WHEN WET" 6 "CONDITIONAL WHEN SNOW" 7 "UNKNOWN CONDITION" ;
VAL_TABLE_ HSP_DrvAlrtTypCstCurrSetValAuth 0 "SETTING_UNKNOWN" 1 "CHIME" 2 "SEAT" ;
VAL_TABLE_ GlrFrHgBmRspTypCstChgSetReq 0 "NO_ACTION" 1 "AUTOMATIC_HIGH_BEAM" 2 "GLARE_FREE_HIGH_BEAM" 3 "RESERVED_3" 4 "RESERVED_4" 5 "RESERVED_5" 6 "RESERVED_6" 7 "RESERVED_7" ;
VAL_TABLE_ ADASIS_NAVILINK_DgMpCnSpdLmTyp 0 "LANE DEPENDENT" 1 "ONLY BY FOG" 2 "ONLY BY NIGHT" 3 "ONLY BY DAY" 4 "BY TIME OF DAY" 5 "ONLY BY RAIN" 6 "ONLY BY SNOW" 7 "UNKNOWN" ;
VAL_TABLE_ TDAP_DrvrIdfrAuth 0 "Driver 1" 1 "Driver 2" 2 "Driver 3" 3 "Driver 4" 4 "Driver 5" 5 "Driver 6" 6 "Driver 7" 7 "Unknown" ;
VAL_TABLE_ RrCrsTrfcAlrtCstChngSetReq 0 "NO_ACTION" 1 "OFF" 2 "ALERT" 3 "ALERT AND BRAKE" 4 "RESERVED_4" 5 "RESERVED_5" 6 "RESERVED_6" 7 "RESERVED_7" ;
VAL_TABLE_ DispMeasSysExtnd 0 "US" 1 "IMPERIAL" 2 "Metric KM/L" 3 "Metric L/100KM" ;
VAL_TABLE_ VMMP_VehMtnMvmtStatAuth 0 "Parked" 1 "Neutral" 2 "Forward" 3 "Reverse" 4 "Invalid" ;
VAL_TABLE_ TrffcLgtAsstCstChgSetReq 0 "NO_ACTION" 1 "OFF" 2 "ALERT" 3 "RESERVED_3" 4 "RESERVED_4" 5 "RESERVED_5" 6 "RESERVED_6" 7 "RESERVED_7" ;
VAL_TABLE_ DrvDrAjrStat 0 "FALSE" 1 "TRUE" ;
VAL_TABLE_ CoDrvDrAjrStat 0 "FALSE" 1 "TRUE" ;
VAL_TABLE_ ADASIS_NAVILINK_CntrldAccssRd 0 "ROAD IS NOT CONTROLLED ACCESS ROAD" 1 "ROAD IS CONTROLLED ACCESS ROAD" ;
VAL_TABLE_ ADASIS_NAVILINK_BldUpFlg 0 "NOT VALID" 1 "VALID" ;
VAL_TABLE_ RrCrsTrfcBrkgSysSts 0 "Not Active" 1 "Active" 2 "Failed" ;
VAL_TABLE_ HSP_HptcStOprtlStsAuth 0 "Normal Operation" 1 "Unknown" 2 "Failed" ;
VAL_TABLE_ TSMPageDispActv 0 "FALSE" 1 "TRUE" ;
VAL_TABLE_ TSMCustRstReq 0 "FALSE" 1 "TRUE" ;
VAL_TABLE_ TDAP_TeenDrvrActvAuth 0 "FALSE" 1 "TRUE" ;
VAL_TABLE_ RstrCstDfltReq 0 "FALSE" 1 "TRUE" ;
VAL_TABLE_ RRDrAjrStat 0 "FALSE" 1 "TRUE" ;
VAL_TABLE_ LowBmAct 0 "FALSE" 1 "TRUE" ;
VAL_TABLE_ LRDrAjrStat 0 "FALSE" 1 "TRUE" ;
VAL_TABLE_ HighBmAct 0 "FALSE" 1 "TRUE" ;
VAL_TABLE_ TrnSigSwRtActv 0 "FALSE" 1 "TRUE" ;
VAL_TABLE_ TrnSigSwLtActv 0 "FALSE" 1 "TRUE" ;
VAL_TABLE_ TimeDispFormat 0 "12 Hour Mode" 1 "24 Hour Mode" ;
VAL_TABLE_ TSMWrngPopUpSts 0 "TSM Warning Off" 1 "TSM Warning On" ;
VAL_TABLE_ TSMSgnNtfnWrnDispd 0 "FALSE" 1 "TRUE" ;
VAL_TABLE_ LnChgAlrtCstChngSetReq 0 "NO_ACTION" 1 "OFF" 2 "ON" 3 "RESERVED_3" 4 "RESERVED_4" 5 "RESERVED_5" 6 "RESERVED_6" 7 "RESERVED_7" ;
VAL_TABLE_ ByclDtnCstChgSetReq 0 "No Action" 1 "Off" 2 "Alert" ;
VAL_TABLE_ LnDprtrWrnCtlSdThrtLtMirIndReq 0 "Off" 1 "Solid" 2 "Flashing" 3 "No Action" ;
VAL_TABLE_ AutoBmSlctAllwd 0 "FALSE" 1 "TRUE" ;
VAL_TABLE_ AutoBmSlctAllwd_Inv 0 "FALSE" 1 "TRUE" ;
VAL_TABLE_ SBZAlrtCstChngSetReq 0 "NO_ACTION" 1 "OFF" 2 "ON" 3 "RESERVED_3" 4 "RESERVED_4" 5 "RESERVED_5" 6 "RESERVED_6" 7 "RESERVED_7" ;
VAL_TABLE_ SBZVisIndExtrnCktFltPrRtGtd_Inv 0 "FALSE" 1 "TRUE" ;
VAL_TABLE_ SBZVisIndExtrnCktFltPrLtGtd 0 "FALSE" 1 "TRUE" ;
VAL_TABLE_ SBZVisIndExtrnCktFltPrLtGtd_Inv 0 "FALSE" 1 "TRUE" ;
VAL_TABLE_ LogisticModeStatus 0 "Off" 1 "Plant" 2 "Transport Mode" 3 "Storage Mode" ;
VAL_TABLE_ LnDprtrWrnCtlSdThrtRtMirIndReq 0 "Off" 1 "Solid" 2 "Flashing" 3 "No Action" ;
VAL_TABLE_ FgLmpFrtRtCmd 0 "FALSE" 1 "TRUE" ;
VAL_TABLE_ FgLmpFrtLftCmd 0 "FALSE" 1 "TRUE" ;
VAL_TABLE_ DrvrSeltdTrlrPrsnt 0 "Trailer Present" 1 "No Trailer" ;
VAL_TABLE_ TrlrHtchTyp 0 "Unknown" 1 "Conventional" 2 "5th Wheel" 3 "Gooseneck" ;
VAL_TABLE_ SBZVisIndExtrnCktFltPrRtGtd 0 "FALSE" 1 "TRUE" ;
VAL_TABLE_ CldrMth 0 "Unknown" 1 "January" 2 "February" 3 "March" 4 "April" 5 "May" 6 "June" 7 "July" 8 "August" 9 "September" 10 "October" 11 "November" 12 "December" ;
VAL_TABLE_ VODVP_VehOdoDispValAuth_Inv 0 "FALSE" 1 "TRUE" ;
VAL_TABLE_ ACCAutoSetSpdCstCurrSetVal 0 "Setting Unknown" 1 "Off" 2 "On" ;
VAL_TABLE_ RrCrsTrfcLtWrnLvl 0 "No Information" 1 "Information" 2 "Warning" 3 "Brake" ;
VAL_TABLE_ SBZALCACRrActv 0 "FALSE" 1 "TRUE" ;
VAL_TABLE_ LtSdObjDtdAdjTrlr 0 "FALSE" 1 "TRUE" ;
VAL_TABLE_ SBZALCACRrOprtlSts 0 "Normal Operation" 1 "Needs Service" 2 "Temporary Unavailable" ;
VAL_TABLE_ RrCrsTrfcLtSts 0 "Off" 1 "Passive" 2 "Active" 3 "Error" ;
VAL_TABLE_ ByclDtnTrlrLtSts 0 "Unknown" 1 "Not Attached" 2 "Attached" ;
VAL_TABLE_ ByclDtnFrgtnCyclLtWrnLvl 0 "No Indication" 1 "Off" 2 "Right Level 1" 3 "Left Level 1" 4 "Right Level 2" 5 "Left Level 2" 6 "Left and Right Level 1" 7 "Left and Right Level 2" ;
VAL_TABLE_ SBZALnChgAlrtLtWrnLvl 0 "No Information" 1 "Information" 2 "Warning" ;
VAL_TABLE_ SBZALnChgAlrtLtSts 0 "Off" 1 "Passive" 2 "Active" 3 "Error" ;
VAL_TABLE_ ByclDtnFrgtnCyclRtWrnLvl 0 "No Indication" 1 "Off" 2 "Right Level 1" 3 "Left Level 1" 4 "Right Level 2" 5 "Left Level 2" 6 "Left and Right Level 1" 7 "Left and Right Level 2" ;
VAL_TABLE_ RrCrsTrfcRtWrnLvl 0 "No Information" 1 "Information" 2 "Warning" 3 "Brake" ;
VAL_TABLE_ SBZALCARRActv 0 "FALSE" 1 "TRUE" ;
VAL_TABLE_ SBZALCARROprtlSts 0 "Normal Operation" 1 "Needs Service" 2 "Temporary Unavailable" ;
VAL_TABLE_ SBZALnChgAlrtRtSts 0 "Off" 1 "Passive" 2 "Active" 3 "Error" ;
VAL_TABLE_ RrCrsTrfcRtSts 0 "Off" 1 "Passive" 2 "Active" 3 "Error" ;
VAL_TABLE_ ByclDtnTrlrRtSts 0 "Unknown" 1 "Not Attached" 2 "Attached" ;
VAL_TABLE_ SBZALnChgAlrtRtWrnLvl 0 "No Information" 1 "Information" 2 "Warning" ;
VAL_TABLE_ ByclDtnOvrallStsReqd 0 "FALSE" 1 "TRUE" ;
VAL_TABLE_ SBZALCAOvrllSts 0 "FALSE" 1 "TRUE" ;
VAL_TABLE_ RCTAOvrllSts 0 "FALSE" 1 "TRUE" ;
VAL_TABLE_ RrCrsTrfcBrkgAutoBrkgReqdRt 0 "FALSE" 1 "TRUE" ;
VAL_TABLE_ ByclDtnRtLvl2ChmEvntStat 0 "No Action" 1 "Active" 2 "Cancel Chime" ;
VAL_TABLE_ ByclDtnRtLvl1ChmEvntStat 0 "No Action" 1 "Active" 2 "Cancel Chime" ;
VAL_TABLE_ ByclDtnRtIndStat 0 "No Indication" 1 "Off" 2 "Right Level 1" 3 "Left Level 1" 4 "Right Level 2" 5 "Left Level 2" 6 "Left and Right Level 1" 7 "Left and Right Level 2" ;
VAL_TABLE_ ByclDtnRtStsReqd 0 "FALSE" 1 "TRUE" ;
VAL_TABLE_ SBZALCARtSts 0 "FALSE" 1 "TRUE" ;
VAL_TABLE_ RCTARtSts 0 "FALSE" 1 "TRUE" ;
VAL_TABLE_ SBZALCAROpStat 0 "NORMAL OPERATION" 1 "NEEDS SERVICE" 2 "TEMPORARY UNAVAILABLE" ;
VAL_TABLE_ FrwdVsnRdTyp 0 "TOWN" 1 "COUNTRY ROAD" 2 "MOTORWAY" 3 "RESERVED1" 4 "RESERVED2" 5 "RESERVED3" 6 "RESERVED 4" 7 "UNDEFINED" ;
VAL_TABLE_ FrwdVsnBlkgSts 0 "UNKNOWN" 1 "NOT BLOCKED" 2 "FULL BLOCKAGE" 3 "PARTIAL BLOCKAGE" 4 "RESERVED3" 5 "RESERVED4" 6 "RESERVED5" 7 "RESERVED6" ;
VAL_TABLE_ FrwdVsnAdvWthrSts 0 "CLEAR WEATHER" 1 "LIGHT FOG" 2 "MEDIUM FOG" 3 "HEAVY FOG" 4 "LIGHT SNOW" 5 "MEDIUM SNOW" 6 "HEAVY SNOW" 7 "LIGHT RAIN" 8 "MEDIUM RAIN" 9 "HEAVY RAIN" ;
VAL_TABLE_ GlrFrHiBmSts 0 "OFF" 1 "AHBA" 2 "GFHB" ;
VAL_TABLE_ FrwdVsnEnvIllum 0 "UNKNOWN" 1 "LIT ENVIRONMENT DURING NIGHT" 2 "UNLIT ENVIRONMENT DURING NIGHT" 3 "DAYLIGHT" ;
VAL_TABLE_ CruzCtlActvAuth 0 "FALSE" 1 "TRUE" ;
VAL_TABLE_ BrkPdlDrvAppPrsDetcdAuth 0 "FALSE" 1 "TRUE" ;
VAL_TABLE_ BGI3P_BrkPedInitTrvlAchAuth 0 "FALSE" 1 "TRUE" ;
VAL_TABLE_ DrSeltdSpdLmtrSetTypActvAuth 0 "Off" 1 "Manual" 2 "Auto" 3 "Reserved" ;
VAL_TABLE_ HMII1P_ACCSetTypAuth 0 "Manual" 1 "Auto" ;
VAL_TABLE_ FCATgtObjSeltnDispSnsrCnfd 0 "None" 1 "Low" 2 "Medium" 3 "High" ;
VAL_TABLE_ CIBAutoBrkTyp 0 "None" 1 "Brake Per Requested Decel" 2 "Hold" ;
VAL_TABLE_ CIBAutoBrkReqActv 0 "FALSE" 1 "TRUE" ;
VAL_TABLE_ RrCrsTrfcBrkgEnbld 0 "FALSE" 1 "TRUE" ;
VAL_TABLE_ TrfcSgnMemCstSetAval 0 "FALSE" 1 "TRUE" ;
VAL_TABLE_ TrfcSgnMemCstAvlFlg7 0 "FALSE" 1 "TRUE" ;
VAL_TABLE_ TrfcSgnMemCstAvlFlg6 0 "FALSE" 1 "TRUE" ;
VAL_TABLE_ TrfcSgnMemCstAvlFlg5 0 "FALSE" 1 "TRUE" ;
VAL_TABLE_ TrfcSgnMemCstAvlFlg4 0 "FALSE" 1 "TRUE" ;
VAL_TABLE_ TrfcSgnMemCstAvlFlg3 0 "FALSE" 1 "TRUE" ;
VAL_TABLE_ TrfcSgnMemCstAvlFlg2 0 "FALSE" 1 "TRUE" ;
VAL_TABLE_ TrfcSgnMemCstAvlFlg1 0 "FALSE" 1 "TRUE" ;
VAL_TABLE_ TrfcSgnMemOvrspdChmCstAvlFlg7 0 "FALSE" 1 "TRUE" ;
VAL_TABLE_ TrfcSgnMemOvrspdChmCstAvlFlg6 0 "FALSE" 1 "TRUE" ;
VAL_TABLE_ TrfcSgnMemOvrspdChmCstAvlFlg5 0 "FALSE" 1 "TRUE" ;
VAL_TABLE_ TrfcSgnMemOvrspdChmCstAvlFlg4 0 "FALSE" 1 "TRUE" ;
VAL_TABLE_ TrfcSgnMemOvrspdChmCstAvlFlg3 0 "FALSE" 1 "TRUE" ;
VAL_TABLE_ TrfcSgnMemOvrspdChmCstAvlFlg2 0 "FALSE" 1 "TRUE" ;
VAL_TABLE_ TrfcSgnMemOvrspdChmCstAvlFlg1 0 "FALSE" 1 "TRUE" ;
VAL_TABLE_ TrfcSgnMemOfstEnbld 0 "FALSE" 1 "TRUE" ;
VAL_TABLE_ TrfcSgnMemSpdLmChgChmCstAvlFlg7 0 "FALSE" 1 "TRUE" ;
VAL_TABLE_ TrfcSgnMemSpdLmChgChmCstAvlFlg6 0 "FALSE" 1 "TRUE" ;
VAL_TABLE_ TrfcSgnMemSpdLmChgChmCstAvlFlg5 0 "FALSE" 1 "TRUE" ;
VAL_TABLE_ TrfcSgnMemSpdLmChgChmCstAvlFlg4 0 "FALSE" 1 "TRUE" ;
VAL_TABLE_ TrfcSgnMemSpdLmChgChmCstAvlFlg3 0 "FALSE" 1 "TRUE" ;
VAL_TABLE_ TrfcSgnMemSpdLmChgChmCstAvlFlg2 0 "FALSE" 1 "TRUE" ;
VAL_TABLE_ TrfcSgnMemSpdLmChgChmCstAvlFlg1 0 "FALSE" 1 "TRUE" ;
VAL_TABLE_ TrfcSgnMemOvrspdChmCstSetAval 0 "FALSE" 1 "TRUE" ;
VAL_TABLE_ TrfcSgnMemSpdLmChgChmCstSetAval 0 "FALSE" 1 "TRUE" ;
VAL_TABLE_ TrfcSgnMemOvrspdChmCstChgSetReq 0 "No Action" 1 "Off" 2 "On" ;
VAL_TABLE_ TrfcSgnMemCstChgSetReq 0 "No Action" 1 "Off" 2 "On" ;
VAL_TABLE_ TrfSgnMemSpdLmChgChmCstChgSetRq 0 "No Action" 1 "Off" 2 "On" ;
VAL_TABLE_ TrfcSgnMemSgnChgChmEvntStat 0 "No Action" 1 "Active" 2 "Cancel Chime" ;
VAL_TABLE_ TrfcSgnMemOvrspdChmEvntStat 0 "No Action" 1 "Active" 2 "Cancel Chime" ;
VAL_TABLE_ TrfcSgnMemCstCurrSetVal 0 "Setting Unknown" 1 "Off" 2 "On" ;
VAL_TABLE_ TrfSgnMemSpdLmChgChmCstCurSetVl 0 "Setting Unknown" 1 "Off" 2 "On" ;
VAL_TABLE_ TrfSgnMemOvrspdChmCstCurrSetVal 0 "Setting Unknown" 1 "Off" 2 "On" ;
VAL_TABLE_ TrfcSgnMemOvrspdWrnOffIndOn 0 "FALSE" 1 "TRUE" ;
VAL_TABLE_ TrfcSgnMemDsbldIndOn 0 "FALSE" 1 "TRUE" ;
VAL_TABLE_ AdpLgtHstLnLtTyp 0 "Undecided" 1 "Solid" 2 "Dashed" 3 "Road Edge" 4 "Double Line" 5 "Botts Dots" 6 "Virtual" 7 "Triple Line" ;
VAL_TABLE_ AdpLgtHstLnRtQlty 0 "Very Low Quality" 1 "Low Quality" 2 "Prediction" 3 "High Quality" ;
VAL_TABLE_ AdpLgtHstLnLtQlty 0 "Very Low Quality" 1 "Low Quality" 2 "Prediction" 3 "High Quality" ;
VAL_TABLE_ AdpLgtHstLnRtTyp 0 "Undecided" 1 "Solid" 2 "Dashed" 3 "Road Edge" 4 "Double Line" 5 "Botts Dots" 6 "Virtual" 7 "Triple Line" ;
VAL_TABLE_ ALOI3_TypTk11 0 "UNKNOWN" 1 "4 WHEEL VEHICLE" 2 "LARGE VEHICLE" 3 "MOTORCYCLE/BICYCLE" 4 "PEDESTRIAN" 5 "FIXED OVERHEAD OBJECT" 6 "FIXED ROADSIDE OBJECT" 7 "NO OBJECT PRESENT" 8 "PEDESTRIAN STANDING OUTSIDE DANGER ZONE" 9 "PEDESTRIAN MOVING OUT OF DANGER ZONE" 10 "PEDESTRIAN MOVING INTO DANGER ZONE" 11 "CHILD CLOSE TO DANGER ZONE" 12 "CLUSTER OBJECT" ;
VAL_TABLE_ ALOI3_TypTk10 0 "UNKNOWN" 1 "4 WHEEL VEHICLE" 2 "LARGE VEHICLE" 3 "MOTORCYCLE/BICYCLE" 4 "PEDESTRIAN" 5 "FIXED OVERHEAD OBJECT" 6 "FIXED ROADSIDE OBJECT" 7 "NO OBJECT PRESENT" 8 "PEDESTRIAN STANDING OUTSIDE DANGER ZONE" 9 "PEDESTRIAN MOVING OUT OF DANGER ZONE" 10 "PEDESTRIAN MOVING INTO DANGER ZONE" 11 "CHILD CLOSE TO DANGER ZONE" 12 "CLUSTER OBJECT" ;
VAL_TABLE_ ALOI3_TypTk9 0 "UNKNOWN" 1 "4 WHEEL VEHICLE" 2 "LARGE VEHICLE" 3 "MOTORCYCLE/BICYCLE" 4 "PEDESTRIAN" 5 "FIXED OVERHEAD OBJECT" 6 "FIXED ROADSIDE OBJECT" 7 "NO OBJECT PRESENT" 8 "PEDESTRIAN STANDING OUTSIDE DANGER ZONE" 9 "PEDESTRIAN MOVING OUT OF DANGER ZONE" 10 "PEDESTRIAN MOVING INTO DANGER ZONE" 11 "CHILD CLOSE TO DANGER ZONE" 12 "CLUSTER OBJECT" ;
VAL_TABLE_ ALOI3_TypTk12 0 "UNKNOWN" 1 "4 WHEEL VEHICLE" 2 "LARGE VEHICLE" 3 "MOTORCYCLE/BICYCLE" 4 "PEDESTRIAN" 5 "FIXED OVERHEAD OBJECT" 6 "FIXED ROADSIDE OBJECT" 7 "NO OBJECT PRESENT" 8 "PEDESTRIAN STANDING OUTSIDE DANGER ZONE" 9 "PEDESTRIAN MOVING OUT OF DANGER ZONE" 10 "PEDESTRIAN MOVING INTO DANGER ZONE" 11 "CHILD CLOSE TO DANGER ZONE" 12 "CLUSTER OBJECT" ;
VAL_TABLE_ ALOI3_DirTk11 0 "Following" 1 "Oncoming" 2 "Following Goup" 3 "Oncoming Group" 4 "Unknown" ;
VAL_TABLE_ ALOI3_DirTk10 0 "Following" 1 "Oncoming" 2 "Following Goup" 3 "Oncoming Group" 4 "Unknown" ;
VAL_TABLE_ ALOI3_DirTk9 0 "Following" 1 "Oncoming" 2 "Following Goup" 3 "Oncoming Group" 4 "Unknown" ;
VAL_TABLE_ ALOI3_DirTk12 0 "Following" 1 "Oncoming" 2 "Following Goup" 3 "Oncoming Group" 4 "Unknown" ;
VAL_TABLE_ ALOI3_CnfdTk9 0 "Highly Speculative" 1 "Speculative" 2 "Confident" 3 "Highly Confident" ;
VAL_TABLE_ ALOI3_CnfdTk12 0 "Highly Speculative" 1 "Speculative" 2 "Confident" 3 "Highly Confident" ;
VAL_TABLE_ ALOI3_CnfdTk11 0 "Highly Speculative" 1 "Speculative" 2 "Confident" 3 "Highly Confident" ;
VAL_TABLE_ ALOI3_CnfdTk10 0 "Highly Speculative" 1 "Speculative" 2 "Confident" 3 "Highly Confident" ;
VAL_TABLE_ ALOI3_MeasStsTk9 0 "No Object" 1 "New Object" 2 "Latent Track Not Detected This Cycle" 3 "Measured This Cycle" ;
VAL_TABLE_ ALOI3_MeasStsTk12 0 "No Object" 1 "New Object" 2 "Latent Track Not Detected This Cycle" 3 "Measured This Cycle" ;
VAL_TABLE_ ALOI3_MeasStsTk11 0 "No Object" 1 "New Object" 2 "Latent Track Not Detected This Cycle" 3 "Measured This Cycle" ;
VAL_TABLE_ ALOI3_MeasStsTk10 0 "No Object" 1 "New Object" 2 "Latent Track Not Detected This Cycle" 3 "Measured This Cycle" ;
VAL_TABLE_ ALOI3_RltvLnTk9 0 "Unknown" 1 "Host Lane" 2 "Right Lane" 3 "Left Lane" ;
VAL_TABLE_ ALOI3_RltvLnTk12 0 "Unknown" 1 "Host Lane" 2 "Right Lane" 3 "Left Lane" ;
VAL_TABLE_ ALOI3_RltvLnTk11 0 "Unknown" 1 "Host Lane" 2 "Right Lane" 3 "Left Lane" ;
VAL_TABLE_ ALOI3_RltvLnTk10 0 "Unknown" 1 "Host Lane" 2 "Right Lane" 3 "Left Lane" ;
VAL_TABLE_ TrfcSgnMemFtrSts 0 "OFF" 1 "ACTIVE" 2 "FAILED" ;
VAL_TABLE_ ALOI3_RngTk9_Inv 0 "FALSE" 1 "TRUE" ;
VAL_TABLE_ ALOI3_RngTk12_Inv 0 "FALSE" 1 "TRUE" ;
VAL_TABLE_ ALOI3_RngTk11_Inv 0 "FALSE" 1 "TRUE" ;
VAL_TABLE_ ALOI3_RngTk10_Inv 0 "FALSE" 1 "TRUE" ;
VAL_TABLE_ ALOI3_AcqTmStm_Inv 0 "FALSE" 1 "TRUE" ;
VAL_TABLE_ NodeStsADIMb_CAN_9_LcFA 0 "FALSE" 1 "TRUE" ;
VAL_TABLE_ NodeStsADIMb_CAN_3_LcFA 0 "FALSE" 1 "TRUE" ;
VAL_TABLE_ NodeStsADIMb_CAN_2_LcFA 0 "FALSE" 1 "TRUE" ;
VAL_TABLE_ NodeStsADIMb_CAN_10_LcFA 0 "FALSE" 1 "TRUE" ;
VAL_TABLE_ NodeStsADIMa_CAN_9_LcFA 0 "FALSE" 1 "TRUE" ;
VAL_TABLE_ NodeStsADIMa_CAN_3_LcFA 0 "FALSE" 1 "TRUE" ;
VAL_TABLE_ NodeStsADIMa_CAN_2_LcFA 0 "FALSE" 1 "TRUE" ;
VAL_TABLE_ NodeStsADIMa_CAN_10_LcFA 0 "FALSE" 1 "TRUE" ;
VAL_TABLE_ NodeStsAPA_CAN_1_LcFA 0 "FALSE" 1 "TRUE" ;
VAL_TABLE_ NodeStsAOS_LcFA 0 "FALSE" 1 "TRUE" ;
VAL_TABLE_ NodeStsAMP_LcFA 0 "FALSE" 1 "TRUE" ;
VAL_TABLE_ NodeStsALC_LcFA 0 "FALSE" 1 "TRUE" ;
VAL_TABLE_ NodeStsAHS_LcFA 0 "FALSE" 1 "TRUE" ;
VAL_TABLE_ NodeStsAHL_AFL_CAN_2_LcFA 0 "FALSE" 1 "TRUE" ;
VAL_TABLE_ NodeStsBSM_MH_LcFA 0 "FALSE" 1 "TRUE" ;
VAL_TABLE_ NodeStsBSM_CAN_3_LcFA 0 "FALSE" 1 "TRUE" ;
VAL_TABLE_ NodeStsBSM_CAN_2_LcFA 0 "FALSE" 1 "TRUE" ;
VAL_TABLE_ NodeStsBCM_LcFA 0 "FALSE" 1 "TRUE" ;
VAL_TABLE_ NodeStsARS_LcFA 0 "FALSE" 1 "TRUE" ;
VAL_TABLE_ NodeStsARB_LcFA 0 "FALSE" 1 "TRUE" ;
VAL_TABLE_ NodeStsAPA_CAN_2_LcFA 0 "FALSE" 1 "TRUE" ;
VAL_TABLE_ NodeStsEBCM_AV_CAN_2_LcFA 0 "FALSE" 1 "TRUE" ;
VAL_TABLE_ NodeStsDMS_LcFA 0 "FALSE" 1 "TRUE" ;
VAL_TABLE_ NodeStsDEFC_LcFA 0 "FALSE" 1 "TRUE" ;
VAL_TABLE_ NodeStsDCM_LcFA 0 "FALSE" 1 "TRUE" ;
VAL_TABLE_ NodeStsCSM_CAN_5_LcFA 0 "FALSE" 1 "TRUE" ;
VAL_TABLE_ NodeStsECP_E_CAN_9_LcFA 0 "FALSE" 1 "TRUE" ;
VAL_TABLE_ NodeStsECP_E_CAN_2_LcFA 0 "FALSE" 1 "TRUE" ;
VAL_TABLE_ NodeStsECM_CAN_3_LcFA 0 "FALSE" 1 "TRUE" ;
VAL_TABLE_ NodeStsECM_CAN_2_LcFA 0 "FALSE" 1 "TRUE" ;
VAL_TABLE_ NodeStsEBCM_CAN_3_LcFA 0 "FALSE" 1 "TRUE" ;
VAL_TABLE_ NodeStsEBCM_CAN_2_LcFA 0 "FALSE" 1 "TRUE" ;
VAL_TABLE_ NodeStsEBCM_AV_CAN_3_LcFA 0 "FALSE" 1 "TRUE" ;
VAL_TABLE_ NodeStsEOCM_CAN_3_LcFA 0 "FALSE" 1 "TRUE" ;
VAL_TABLE_ NodeStsEOCM_CAN_2_LcFA 0 "FALSE" 1 "TRUE" ;
VAL_TABLE_ NodeStsELM_LcFA 0 "FALSE" 1 "TRUE" ;
VAL_TABLE_ NodeStsECP_X1_CAN_3_LcFA 0 "FALSE" 1 "TRUE" ;
VAL_TABLE_ NodeStsECP_X1_CAN_2_LcFA 0 "FALSE" 1 "TRUE" ;
VAL_TABLE_ NodeStsECP_S_CAN_9_LcFA 0 "FALSE" 1 "TRUE" ;
VAL_TABLE_ NodeStsECP_S_CAN_2_LcFA 0 "FALSE" 1 "TRUE" ;
VAL_TABLE_ NodeStsECP_MC_LcFA 0 "FALSE" 1 "TRUE" ;
VAL_TABLE_ NodeStsEPSRAa_LcFA 0 "FALSE" 1 "TRUE" ;
VAL_TABLE_ NodeStsEPS_LcFA 0 "FALSE" 1 "TRUE" ;
VAL_TABLE_ NodeStsEPS_1_LcFA 0 "FALSE" 1 "TRUE" ;
VAL_TABLE_ NodeStsEOCM_HCP2_LcFA 0 "FALSE" 1 "TRUE" ;
VAL_TABLE_ NodeStsEOCM_HCP1_CAN_8_LcFA 0 "FALSE" 1 "TRUE" ;
VAL_TABLE_ NodeStsEOCM_HCP1_CAN_3_LcFA 0 "FALSE" 1 "TRUE" ;
VAL_TABLE_ NodeStsEOCM_HCP1_CAN_2_LcFA 0 "FALSE" 1 "TRUE" ;
VAL_TABLE_ NodeStsEOCM_CAN_8_LcFA 0 "FALSE" 1 "TRUE" ;
VAL_TABLE_ NodeStsHVAC_FP_F_LcFA 0 "FALSE" 1 "TRUE" ;
VAL_TABLE_ NodeStsHUD_CAN_LcFA 0 "FALSE" 1 "TRUE" ;
VAL_TABLE_ NodeStsHDLM_LcFA 0 "FALSE" 1 "TRUE" ;
VAL_TABLE_ NodeStsFOPM_CAN_3_LcFA 0 "FALSE" 1 "TRUE" ;
VAL_TABLE_ NodeStsFOPM_CAN_2_LcFA 0 "FALSE" 1 "TRUE" ;
VAL_TABLE_ NodeStsFCM_LcFA 0 "FALSE" 1 "TRUE" ;
VAL_TABLE_ NodeStsFCM_LC_LcFA 0 "FALSE" 1 "TRUE" ;
VAL_TABLE_ NodeStsEPSRAb_LcFA 0 "FALSE" 1 "TRUE" ;
VAL_TABLE_ NodeStsMFC_LcFA 0 "FALSE" 1 "TRUE" ;
VAL_TABLE_ NodeStsLRR_LcFA 0 "FALSE" 1 "TRUE" ;
VAL_TABLE_ NodeStsLIB1_LcFA 0 "FALSE" 1 "TRUE" ;
VAL_TABLE_ NodeStsIPC_CAN_5_LcFA 0 "FALSE" 1 "TRUE" ;
VAL_TABLE_ NodeStsICS_Info_LcFA 0 "FALSE" 1 "TRUE" ;
VAL_TABLE_ NodeStsICCM_CAN_3_LcFA 0 "FALSE" 1 "TRUE" ;
VAL_TABLE_ NodeStsHVAC_FP_R_LcFA 0 "FALSE" 1 "TRUE" ;
VAL_TABLE_ NodeStsMSM_RR_LcFA 0 "FALSE" 1 "TRUE" ;
VAL_TABLE_ NodeStsMSM_P_LcFA 0 "FALSE" 1 "TRUE" ;
VAL_TABLE_ NodeStsMSM_LR_LcFA 0 "FALSE" 1 "TRUE" ;
VAL_TABLE_ NodeStsMSM_D_LcFA 0 "FALSE" 1 "TRUE" ;
VAL_TABLE_ NodeStsMSB2_LcFA 0 "FALSE" 1 "TRUE" ;
VAL_TABLE_ NodeStsMSB1_LcFA 0 "FALSE" 1 "TRUE" ;
VAL_TABLE_ NodeStsMRCM_R_LcFA 0 "FALSE" 1 "TRUE" ;
VAL_TABLE_ NodeStsMRCM_L_LcFA 0 "FALSE" 1 "TRUE" ;
VAL_TABLE_ NodeStsRDCM_LcFA 0 "FALSE" 1 "TRUE" ;
VAL_TABLE_ NodeStsRadioLow_LcFA 0 "FALSE" 1 "TRUE" ;
VAL_TABLE_ NodeStsPTM_LcFA 0 "FALSE" 1 "TRUE" ;
VAL_TABLE_ NodeStsPDR_LcFA 0 "FALSE" 1 "TRUE" ;
VAL_TABLE_ NodeStsPA_LcFA 0 "FALSE" 1 "TRUE" ;
VAL_TABLE_ NodeStsNVM_LcFA 0 "FALSE" 1 "TRUE" ;
VAL_TABLE_ NodeStsMTCM_R_LcFA 0 "FALSE" 1 "TRUE" ;
VAL_TABLE_ NodeStsMTCM_L_LcFA 0 "FALSE" 1 "TRUE" ;
VAL_TABLE_ NodeStsSBM_CAN_3_LcFA 0 "FALSE" 1 "TRUE" ;
VAL_TABLE_ NodeStsSAM_RR_LcFA 0 "FALSE" 1 "TRUE" ;
VAL_TABLE_ NodeStsSAM_RF_LcFA 0 "FALSE" 1 "TRUE" ;
VAL_TABLE_ NodeStsSAM_LR_LcFA 0 "FALSE" 1 "TRUE" ;
VAL_TABLE_ NodeStsSAM_LF_LcFA 0 "FALSE" 1 "TRUE" ;
VAL_TABLE_ NodeStsSADS_LcFA 0 "FALSE" 1 "TRUE" ;
VAL_TABLE_ NodeStsSRR_RF_LcFA 0 "FALSE" 1 "TRUE" ;
VAL_TABLE_ NodeStsSRR_LR_CR_LcFA 0 "FALSE" 1 "TRUE" ;
VAL_TABLE_ NodeStsSRR_LF_LcFA 0 "FALSE" 1 "TRUE" ;
VAL_TABLE_ NodeStsSIB_LcFA 0 "FALSE" 1 "TRUE" ;
VAL_TABLE_ NodeStsSDM_LcFA 0 "FALSE" 1 "TRUE" ;
VAL_TABLE_ NodeStsSCL_LcFA 0 "FALSE" 1 "TRUE" ;
VAL_TABLE_ NodeStsSBZA_R_LcFA 0 "FALSE" 1 "TRUE" ;
VAL_TABLE_ NodeStsSBZA_L_LcFA 0 "FALSE" 1 "TRUE" ;
VAL_TABLE_ NodeStsTCP_CAN_5_LcFA 0 "FALSE" 1 "TRUE" ;
VAL_TABLE_ NodeStsTCM_CAN_2_LcFA 0 "FALSE" 1 "TRUE" ;
VAL_TABLE_ NodeStsTCCM_LcFA 0 "FALSE" 1 "TRUE" ;
VAL_TABLE_ NodeStsSRR_SRR_LcFA 0 "FALSE" 1 "TRUE" ;
VAL_TABLE_ NodeStsSRR_SLR_LcFA 0 "FALSE" 1 "TRUE" ;
VAL_TABLE_ NodeStsSRR_RR_LcFA 0 "FALSE" 1 "TRUE" ;
VAL_TABLE_ NodeStsWCM_LcFA 0 "FALSE" 1 "TRUE" ;
VAL_TABLE_ NodeStsVPM_LcFA 0 "FALSE" 1 "TRUE" ;
VAL_TABLE_ NodeStsVLM_LcFA 0 "FALSE" 1 "TRUE" ;
VAL_TABLE_ NodeStsVKM_LcFA 0 "FALSE" 1 "TRUE" ;
VAL_TABLE_ NodeStsVICM_CAN_9_LcFA 0 "FALSE" 1 "TRUE" ;
VAL_TABLE_ NodeStsVICM_CAN_2_LcFA 0 "FALSE" 1 "TRUE" ;
VAL_TABLE_ NodeStsVCU_CAN_5_LcFA 0 "FALSE" 1 "TRUE" ;
VAL_TABLE_ NodeStsTIM_LcFA 0 "FALSE" 1 "TRUE" ;
VAL_TABLE_ NodeStsECP_S2_CAN_2_LcFA 0 "FALSE" 1 "TRUE" ;
VAL_TABLE_ NodeStsPFCM_LcFA 0 "FALSE" 1 "TRUE" ;
VAL_TABLE_ NodeStsVDM_CAN_2_LcFA 0 "FALSE" 1 "TRUE" ;
VAL_TABLE_ NodeStsPCM_CAN_3_LcFA 0 "FALSE" 1 "TRUE" ;
VAL_TABLE_ NodeStsPCM_CAN_2_LcFA 0 "FALSE" 1 "TRUE" ;
VAL_TABLE_ NodeStsSDM_AV_LcFA 0 "FALSE" 1 "TRUE" ;
VAL_TABLE_ NodeStsACP4_MCU_CAN_2_LcFA 0 "FALSE" 1 "TRUE" ;
VAL_TABLE_ NodeStsACP2_MCU_CAN_8_LcFA 0 "FALSE" 1 "TRUE" ;
VAL_TABLE_ NodeStsACP2_MCU_CAN_2_LcFA 0 "FALSE" 1 "TRUE" ;
VAL_TABLE_ NodeStsVECM_CAN_2_LcFA 0 "FALSE" 1 "TRUE" ;
VAL_TABLE_ NodeStsVDM_CAN_9_LcFA 0 "FALSE" 1 "TRUE" ;
VAL_TABLE_ NodeStsUVM_CAN_1_LcFA 0 "FALSE" 1 "TRUE" ;
VAL_TABLE_ NodeStsUPM_LcFA 0 "FALSE" 1 "TRUE" ;
VAL_TABLE_ NodeStsEPSb_LcFA 0 "FALSE" 1 "TRUE" ;
VAL_TABLE_ NodeStsSBM_CAN_10_LcFA 0 "FALSE" 1 "TRUE" ;
VAL_TABLE_ NodeStsVECM_CAN_9_LcFA 0 "FALSE" 1 "TRUE" ;
VAL_TABLE_ NodeStsECP_S2_CAN_9_LcFA 0 "FALSE" 1 "TRUE" ;
VAL_TABLE_ NodeStsCSM_AV_CAN_5_LcFA 0 "FALSE" 1 "TRUE" ;
VAL_TABLE_ NodeStsACP3_MCU_CAN_3_LcFA 0 "FALSE" 1 "TRUE" ;
VAL_TABLE_ NodeStsACP3_MCU_CAN_8_LcFA 0 "FALSE" 1 "TRUE" ;
VAL_TABLE_ NodeStsACP3_MCU_CAN_2_LcFA 0 "FALSE" 1 "TRUE" ;
VAL_TABLE_ NodeStsWCM4_LcFA 0 "FALSE" 1 "TRUE" ;
VAL_TABLE_ NodeStsWCM3_LcFA 0 "FALSE" 1 "TRUE" ;
VAL_TABLE_ NodeStsWCM2_LcFA 0 "FALSE" 1 "TRUE" ;
VAL_TABLE_ NodeStsRSI_CAN_5_LcFA 0 "FALSE" 1 "TRUE" ;
VAL_TABLE_ NodeStsLIB_48V_LcFA 0 "FALSE" 1 "TRUE" ;
VAL_TABLE_ NodeStsFPI_CAN_5_LcFA 0 "FALSE" 1 "TRUE" ;
VAL_TABLE_ NodeStsACP4_MCU_CAN_3_LcFA 0 "FALSE" 1 "TRUE" ;
VAL_TABLE_ NodeStsACP4_MCU_CAN_8_LcFA 0 "FALSE" 1 "TRUE" ;
VAL_TABLE_ NodeStsBSM_HEV_CAN_2_LcFA 0 "FALSE" 1 "TRUE" ;
VAL_TABLE_ NodeStsECP_H3_CAN_2_LcFA 0 "FALSE" 1 "TRUE" ;
VAL_TABLE_ NodeStsECP_H2_CAN_2_LcFA 0 "FALSE" 1 "TRUE" ;
VAL_TABLE_ NodeStsECP_H2_CAN_9_LcFA 0 "FALSE" 1 "TRUE" ;
VAL_TABLE_ NodeStsECP_H1_CAN_9_LcFA 0 "FALSE" 1 "TRUE" ;
VAL_TABLE_ NodeStsECP_H1_CAN_2_LcFA 0 "FALSE" 1 "TRUE" ;
VAL_TABLE_ NodeStsBSM_HEV_CAN_9_LcFA 0 "FALSE" 1 "TRUE" ;
VAL_TABLE_ NodeStsECP_H3_CAN_9_LcFA 0 "FALSE" 1 "TRUE" ;
VAL_TABLE_ NodeStsSAM_BH_LcFA 0 "FALSE" 1 "TRUE" ;
VAL_TABLE_ NodeStsPLCM_LcFA 0 "FALSE" 1 "TRUE" ;
VAL_TABLE_ NodeStsODS_LcFA 0 "FALSE" 1 "TRUE" ;
VAL_TABLE_ NodeStsODS2_LcFA 0 "FALSE" 1 "TRUE" ;
VAL_TABLE_ NodeStsSRR_SRR_Prsnt 0 "FALSE" 1 "TRUE" ;
VAL_TABLE_ NodeStsEOCM_HCP2_Prsnt 0 "FALSE" 1 "TRUE" ;
VAL_TABLE_ NodeStsEOCM_HCP1_CAN_3_Prsnt 0 "FALSE" 1 "TRUE" ;
VAL_TABLE_ NodeStsFCM_Prsnt 0 "FALSE" 1 "TRUE" ;
VAL_TABLE_ NodeStsSBZA_L_Prsnt 0 "FALSE" 1 "TRUE" ;
VAL_TABLE_ NodeStsMSM_LR_Prsnt 0 "FALSE" 1 "TRUE" ;
VAL_TABLE_ NodeStsACP2_MCU_CAN_2_Prsnt 0 "FALSE" 1 "TRUE" ;
VAL_TABLE_ NodeStsMSM_P_Prsnt 0 "FALSE" 1 "TRUE" ;
VAL_TABLE_ NodeStsACP4_MCU_CAN_3_Prsnt 0 "FALSE" 1 "TRUE" ;
VAL_TABLE_ NodeStsACP3_MCU_CAN_3_Prsnt 0 "FALSE" 1 "TRUE" ;
VAL_TABLE_ NodeStsEOCM_CAN_2_Prsnt 0 "FALSE" 1 "TRUE" ;
VAL_TABLE_ NodeStsACP2_MCU_CAN_8_Prsnt 0 "FALSE" 1 "TRUE" ;
VAL_TABLE_ NodeStsFCM_LC_Prsnt 0 "FALSE" 1 "TRUE" ;
VAL_TABLE_ NodeStsEOCM_HCP1_CAN_2_Prsnt 0 "FALSE" 1 "TRUE" ;
VAL_TABLE_ NodeStsSRR_LF_Prsnt 0 "FALSE" 1 "TRUE" ;
VAL_TABLE_ NodeStsSRR_RF_Prsnt 0 "FALSE" 1 "TRUE" ;
VAL_TABLE_ NodeStsACP3_MCU_CAN_8_Prsnt 0 "FALSE" 1 "TRUE" ;
VAL_TABLE_ NodeStsSBZA_R_Prsnt 0 "FALSE" 1 "TRUE" ;
VAL_TABLE_ NodeStsSRR_LR_CR_Prsnt 0 "FALSE" 1 "TRUE" ;
VAL_TABLE_ NodeStsSRR_RR_Prsnt 0 "FALSE" 1 "TRUE" ;
VAL_TABLE_ NodeStsSRR_SLR_Prsnt 0 "FALSE" 1 "TRUE" ;
VAL_TABLE_ NodeStsEOCM_HCP1_CAN_8_Prsnt 0 "FALSE" 1 "TRUE" ;
VAL_TABLE_ NodeStsMSM_RR_Prsnt 0 "FALSE" 1 "TRUE" ;
VAL_TABLE_ NodeStsEOCM_CAN_8_Prsnt 0 "FALSE" 1 "TRUE" ;
VAL_TABLE_ NodeStsMSM_D_Prsnt 0 "FALSE" 1 "TRUE" ;
VAL_TABLE_ NodeStsACP3_MCU_CAN_2_Prsnt 0 "FALSE" 1 "TRUE" ;
VAL_TABLE_ NodeStsACP4_MCU_CAN_2_Prsnt 0 "FALSE" 1 "TRUE" ;
VAL_TABLE_ NodeStsEOCM_CAN_3_Prsnt 0 "FALSE" 1 "TRUE" ;
VAL_TABLE_ NodeStsACP4_MCU_CAN_8_Prsnt 0 "FALSE" 1 "TRUE" ;
VAL_TABLE_ FrtPsngrAirbagDsblVisIndCmd 0 "On" 1 "Off" 2 "Flash" ;
VAL_TABLE_ ORIP_EnvModPrsntRsp1Auth 0 "FALSE" 1 "TRUE" ;
VAL_TABLE_ ORIP_DrvrStBltStsAuth_Inv 0 "FALSE" 1 "TRUE" ;
VAL_TABLE_ ORIP_DrvrStBltStsAuth 0 "Unknown" 1 "UnFastened" 2 "Fastened" ;
VAL_TABLE_ RstrntSysFltPrsnt 0 "FALSE" 1 "TRUE" ;
VAL_TABLE_ FrtPsngrAirbagEnblVisIndCmd 0 "On" 1 "Off" 2 "Flash" ;
VAL_TABLE_ PCIP_HzrdLgtsOnReqdAuth 0 "FALSE" 1 "TRUE" ;
VAL_TABLE_ PCIP_HybVehHiVltgDsblReqdAuth 0 "FALSE" 1 "TRUE" ;
VAL_TABLE_ PCIP_HVCrshImpSnsSysDsbldAuth 0 "FALSE" 1 "TRUE" ;
VAL_TABLE_ PCIP_HVACBlwDsblReqdAuth 0 "FALSE" 1 "TRUE" ;
VAL_TABLE_ PCIP_FuelCutOffReqdAuth 0 "FALSE" 1 "TRUE" ;
VAL_TABLE_ PCIP_DrUnlckReqdAuth 0 "FALSE" 1 "TRUE" ;
VAL_TABLE_ PCIP_CruzCtlDsblReqdAuth 0 "FALSE" 1 "TRUE" ;
VAL_TABLE_ PCIP_BrkActReqdAuth 0 "FALSE" 1 "TRUE" ;
VAL_TABLE_ PCIP_NftnFrtImpPrtnsrSevAchAuth 0 "FALSE" 1 "TRUE" ;
VAL_TABLE_ PCIP_MemStRclDsblReqdAuth 0 "FALSE" 1 "TRUE" ;
VAL_TABLE_ PCIP_IntrLgtOnReqdAuth 0 "FALSE" 1 "TRUE" ;
VAL_TABLE_ PCIP_NtfnLtSdSevAchvdAuth 0 "FALSE" 1 "TRUE" ;
VAL_TABLE_ PCIP_NtfnFrtImpStg2SevAchvdAuth 0 "FALSE" 1 "TRUE" ;
VAL_TABLE_ PCIP_NtfnFrtImpStg1SevAchvdAuth 0 "FALSE" 1 "TRUE" ;
VAL_TABLE_ PCIP_NtfnEvntStsAuth 0 "No Event" 1 "Near Deploy Event" 2 "Deployment Event" ;
VAL_TABLE_ PCIP_eCallReqdAuth 0 "FALSE" 1 "TRUE" ;
VAL_TABLE_ PCIP_NtfnRtSdSevAchvdAuth 0 "FALSE" 1 "TRUE" ;
VAL_TABLE_ PCIP_NtfnRrImpSevAchvdAuth 0 "FALSE" 1 "TRUE" ;
VAL_TABLE_ PCIP_NtfnRlOvrSevAchvdAuth 0 "FALSE" 1 "TRUE" ;
VAL_TABLE_ PCIP_NtfnPedtrnPrtctnSevAchAuth 0 "FALSE" 1 "TRUE" ;
VAL_TABLE_ RtSdObjDtdAdjTrlr 0 "FALSE" 1 "TRUE" ;
VAL_TABLE_ SRRLFODPB2P_POTk3DynPrpAuth 0 "Has Never Moved" 1 "Has Moved But Currently Stopped" 2 "Moving In Same Direction As Host" 3 "Moving In Opposite Direction As Host" 4 "Crossing Path" ;
VAL_TABLE_ SRRLFODPB2P_POTk3CnfdStsAuth 0 "Highly Speculative" 1 "Speculative" 2 "Confident" 3 "Highly Confident" ;
VAL_TABLE_ SRRLFODPB2P_POTk3MStsAuth 0 "No Object" 1 "New Object" 2 "Latent Track Not Detected this Cycle" 3 "Measured this Cycle" ;
VAL_TABLE_ SRRLFODPB2P_POTk3TypCnfdAuth 0 "Highly Speculative" 1 "Speculative" 2 "Confident" 3 "Highly Confident" ;
VAL_TABLE_ SRRLFODPB2P_POTk3TypAuth 0 "Unknown" 1 "Pedestrian" 2 "Bicycle" ;
VAL_TABLE_ SRRLFODPB2P_VOTk2DynPrpStsAuth 0 "Stopped" 1 "Not Stopped" ;
VAL_TABLE_ SRRLFODPB2P_VOTk2DynPrpAuth 0 "Has Never Moved" 1 "Moving In Same Direction As Host" 2 "Moving In Opposite Direction As Host" 3 "Crossing From Left To Right" 4 "Crossing From Right To Left" ;
VAL_TABLE_ SRRLFODPB2P_VOTk2CnfdStsAuth 0 "Highly Speculative" 1 "Speculative" 2 "Confident" 3 "Highly Confident" ;
VAL_TABLE_ SRRLFODPB2P_VOTk2MStsAuth 0 "No Object" 1 "New Object" 2 "Latent Track Not Detected this Cycle" 3 "Measured this Cycle" ;
VAL_TABLE_ SRRLFODPB2P_VOTk2TypCnfdAuth 0 "Highly Speculative" 1 "Speculative" 2 "Confident" 3 "Highly Confident" ;
VAL_TABLE_ SRRLFODPB2P_VOTk3CnfdStsAuth 0 "Highly Speculative" 1 "Speculative" 2 "Confident" 3 "Highly Confident" ;
VAL_TABLE_ SRRLFODPB2P_VOTk3DynPrpStsAuth 0 "Stopped" 1 "Not Stopped" ;
VAL_TABLE_ SRRLFODPB2P_VOTk3DynPrpAuth 0 "Has Never Moved" 1 "Moving In Same Direction As Host" 2 "Moving In Opposite Direction As Host" 3 "Crossing From Left To Right" 4 "Crossing From Right To Left" ;
VAL_TABLE_ SRRLFODPB2P_VOTk3MStsAuth 0 "No Object" 1 "New Object" 2 "Latent Track Not Detected this Cycle" 3 "Measured this Cycle" ;
VAL_TABLE_ SRRLFODPB2P_VOTk3TypCnfdAuth 0 "Highly Speculative" 1 "Speculative" 2 "Confident" 3 "Highly Confident" ;
VAL_TABLE_ SRRLFODPB2P_VOTk4DynPrpStsAuth 0 "Stopped" 1 "Not Stopped" ;
VAL_TABLE_ SRRLFODPB2P_VOTk4DynPrpAuth 0 "Has Never Moved" 1 "Moving In Same Direction As Host" 2 "Moving In Opposite Direction As Host" 3 "Crossing From Left To Right" 4 "Crossing From Right To Left" ;
VAL_TABLE_ SRRLFODPB2P_VOTk4CnfdStsAuth 0 "Highly Speculative" 1 "Speculative" 2 "Confident" 3 "Highly Confident" ;
VAL_TABLE_ SRRLFODPB2P_VOTk4MStsAuth 0 "No Object" 1 "New Object" 2 "Latent Track Not Detected this Cycle" 3 "Measured this Cycle" ;
VAL_TABLE_ SRRLFODPB2P_VOTk4TypCnfdAuth 0 "Highly Speculative" 1 "Speculative" 2 "Confident" 3 "Highly Confident" ;
VAL_TABLE_ SRRLFODPB3P_POTk4DynPrpAuth 0 "Has Never Moved" 1 "Has Moved But Currently Stopped" 2 "Moving In Same Direction As Host" 3 "Moving In Opposite Direction As Host" 4 "Crossing Path" ;
VAL_TABLE_ SRRLFODPB3P_POTk4CnfdStsAuth 0 "Highly Speculative" 1 "Speculative" 2 "Confident" 3 "Highly Confident" ;
VAL_TABLE_ SRRLFODPB3P_POTk4MStsAuth 0 "No Object" 1 "New Object" 2 "Latent Track Not Detected this Cycle" 3 "Measured this Cycle" ;
VAL_TABLE_ SRRLFODPB3P_POTk4TypCnfdAuth 0 "Highly Speculative" 1 "Speculative" 2 "Confident" 3 "Highly Confident" ;
VAL_TABLE_ SRRLFODPB3P_POTk4TypAuth 0 "Unknown" 1 "Pedestrian" 2 "Bicycle" ;
VAL_TABLE_ SRRLFODPB3P_VOTk5DynPrpStsAuth 0 "Stopped" 1 "Not Stopped" ;
VAL_TABLE_ SRRLFODPB3P_VOTk5DynPrpAuth 0 "Has Never Moved" 1 "Moving In Same Direction As Host" 2 "Moving In Opposite Direction As Host" 3 "Crossing From Left To Right" 4 "Crossing From Right To Left" ;
VAL_TABLE_ SRRLFODPB3P_VOTk5CnfdStsAuth 0 "Highly Speculative" 1 "Speculative" 2 "Confident" 3 "Highly Confident" ;
VAL_TABLE_ SRRLFODPB3P_VOTk5MStsAuth 0 "No Object" 1 "New Object" 2 "Latent Track Not Detected this Cycle" 3 "Measured this Cycle" ;
VAL_TABLE_ SRRLFODPB3P_VOTk5TypCnfdAuth 0 "Highly Speculative" 1 "Speculative" 2 "Confident" 3 "Highly Confident" ;
VAL_TABLE_ SRRLFODPB3P_VOTk6CnfdStsAuth 0 "Highly Speculative" 1 "Speculative" 2 "Confident" 3 "Highly Confident" ;
VAL_TABLE_ SRRLFODPB3P_VOTk6DynPrpStsAuth 0 "Stopped" 1 "Not Stopped" ;
VAL_TABLE_ SRRLFODPB3P_VOTk6DynPrpAuth 0 "Has Never Moved" 1 "Moving In Same Direction As Host" 2 "Moving In Opposite Direction As Host" 3 "Crossing From Left To Right" 4 "Crossing From Right To Left" ;
VAL_TABLE_ SRRLFODPB3P_VOTk6MStsAuth 0 "No Object" 1 "New Object" 2 "Latent Track Not Detected this Cycle" 3 "Measured this Cycle" ;
VAL_TABLE_ SRRLFODPB3P_VOTk6TypCnfdAuth 0 "Highly Speculative" 1 "Speculative" 2 "Confident" 3 "Highly Confident" ;
VAL_TABLE_ SRRLFODPB3P_VOTk7DynPrpStsAuth 0 "Stopped" 1 "Not Stopped" ;
VAL_TABLE_ SRRLFODPB3P_VOTk7DynPrpAuth 0 "Has Never Moved" 1 "Moving In Same Direction As Host" 2 "Moving In Opposite Direction As Host" 3 "Crossing From Left To Right" 4 "Crossing From Right To Left" ;
VAL_TABLE_ SRRLFODPB3P_VOTk7CnfdStsAuth 0 "Highly Speculative" 1 "Speculative" 2 "Confident" 3 "Highly Confident" ;
VAL_TABLE_ SRRLFODPB3P_VOTk7MStsAuth 0 "No Object" 1 "New Object" 2 "Latent Track Not Detected this Cycle" 3 "Measured this Cycle" ;
VAL_TABLE_ SRRLFODPB3P_VOTk7TypCnfdAuth 0 "Highly Speculative" 1 "Speculative" 2 "Confident" 3 "Highly Confident" ;
VAL_TABLE_ SRRLFODPB4P_POTk5DynPrpAuth 0 "Has Never Moved" 1 "Has Moved But Currently Stopped" 2 "Moving In Same Direction As Host" 3 "Moving In Opposite Direction As Host" 4 "Crossing Path" ;
VAL_TABLE_ SRRLFODPB4P_POTk5CnfdStsAuth 0 "Highly Speculative" 1 "Speculative" 2 "Confident" 3 "Highly Confident" ;
VAL_TABLE_ SRRLFODPB4P_POTk5MStsAuth 0 "No Object" 1 "New Object" 2 "Latent Track Not Detected this Cycle" 3 "Measured this Cycle" ;
VAL_TABLE_ SRRLFODPB4P_POTk5TypCnfdAuth 0 "Highly Speculative" 1 "Speculative" 2 "Confident" 3 "Highly Confident" ;
VAL_TABLE_ SRRLFODPB4P_POTk5TypAuth 0 "Unknown" 1 "Pedestrian" 2 "Bicycle" ;
VAL_TABLE_ SRRLFODPB4P_VOTk10DynPrpStsAuth 0 "Stopped" 1 "Not Stopped" ;
VAL_TABLE_ SRRLFODPB4P_VOTk10DynPrpAuth 0 "Has Never Moved" 1 "Moving In Same Direction As Host" 2 "Moving In Opposite Direction As Host" 3 "Crossing From Left To Right" 4 "Crossing From Right To Left" ;
VAL_TABLE_ SRRLFODPB4P_VOTk10CnfdStsAuth 0 "Highly Speculative" 1 "Speculative" 2 "Confident" 3 "Highly Confident" ;
VAL_TABLE_ SRRLFODPB4P_VOTk10MStsAuth 0 "No Object" 1 "New Object" 2 "Latent Track Not Detected this Cycle" 3 "Measured this Cycle" ;
VAL_TABLE_ SRRLFODPB4P_VOTk10TypCnfdAuth 0 "Highly Speculative" 1 "Speculative" 2 "Confident" 3 "Highly Confident" ;
VAL_TABLE_ SRRLFODPB4P_VOTk8CnfdStsAuth 0 "Highly Speculative" 1 "Speculative" 2 "Confident" 3 "Highly Confident" ;
VAL_TABLE_ SRRLFODPB4P_VOTk8DynPrpStsAuth 0 "Stopped" 1 "Not Stopped" ;
VAL_TABLE_ SRRLFODPB4P_VOTk8DynPrpAuth 0 "Has Never Moved" 1 "Moving In Same Direction As Host" 2 "Moving In Opposite Direction As Host" 3 "Crossing From Left To Right" 4 "Crossing From Right To Left" ;
VAL_TABLE_ SRRLFODPB4P_VOTk8MStsAuth 0 "No Object" 1 "New Object" 2 "Latent Track Not Detected this Cycle" 3 "Measured this Cycle" ;
VAL_TABLE_ SRRLFODPB4P_VOTk8TypCnfdAuth 0 "Highly Speculative" 1 "Speculative" 2 "Confident" 3 "Highly Confident" ;
VAL_TABLE_ SRRLFODPB4P_VOTk9DynPrpStsAuth 0 "Stopped" 1 "Not Stopped" ;
VAL_TABLE_ SRRLFODPB4P_VOTk9DynPrpAuth 0 "Has Never Moved" 1 "Moving In Same Direction As Host" 2 "Moving In Opposite Direction As Host" 3 "Crossing From Left To Right" 4 "Crossing From Right To Left" ;
VAL_TABLE_ SRRLFODPB4P_VOTk9CnfdStsAuth 0 "Highly Speculative" 1 "Speculative" 2 "Confident" 3 "Highly Confident" ;
VAL_TABLE_ SRRLFODPB4P_VOTk9MStsAuth 0 "No Object" 1 "New Object" 2 "Latent Track Not Detected this Cycle" 3 "Measured this Cycle" ;
VAL_TABLE_ SRRLFODPB4P_VOTk9TypCnfdAuth 0 "Highly Speculative" 1 "Speculative" 2 "Confident" 3 "Highly Confident" ;
VAL_TABLE_ SRRLFODPB5P_IOTk10ElvtnAuth 0 "Not Elevated" 1 "Elevation Speculative" 2 "Elevation Confident" 3 "Elevation Very Confident" ;
VAL_TABLE_ SRRLFODPB5P_IOTk10CnfdStsAuth 0 "Highly Speculative" 1 "Speculative" 2 "Confident" 3 "Highly Confident" ;
VAL_TABLE_ SRRLFODPB5P_IOTk10MStsAuth 0 "No Object" 1 "New Object" 2 "Latent Track Not Detected this Cycle" 3 "Measured this Cycle" ;
VAL_TABLE_ SRRLFODPB5P_IOTk1CnfdStsAuth 0 "Highly Speculative" 1 "Speculative" 2 "Confident" 3 "Highly Confident" ;
VAL_TABLE_ SRRLFODPB5P_IOTk10TypCnfdAuth 0 "Highly Speculative" 1 "Speculative" 2 "Confident" 3 "Highly Confident" ;
VAL_TABLE_ SRRLFODPB5P_IOTk10TypAuth 0 "Unknown" 1 "Guard Rail" 2 "Tunnel" 3 "Traffic Sign" 4 "Bridge" 5 "Pole" ;
VAL_TABLE_ SRRLFODPB5P_IOTk1ElvtnAuth 0 "Not Elevated" 1 "Elevation Speculative" 2 "Elevation Confident" 3 "Elevation Very Confident" ;
VAL_TABLE_ SRRLFODPB5P_IOTk1MStsAuth 0 "No Object" 1 "New Object" 2 "Latent Track Not Detected this Cycle" 3 "Measured this Cycle" ;
VAL_TABLE_ SRRLFODPB5P_IOTk1TypAuth 0 "Unknown" 1 "Guard Rail" 2 "Tunnel" 3 "Traffic Sign" 4 "Bridge" 5 "Pole" ;
VAL_TABLE_ SRRLFODPB5P_IOTk2ElvtnAuth 0 "Not Elevated" 1 "Elevation Speculative" 2 "Elevation Confident" 3 "Elevation Very Confident" ;
VAL_TABLE_ SRRLFODPB5P_IOTk2CnfdStsAuth 0 "Highly Speculative" 1 "Speculative" 2 "Confident" 3 "Highly Confident" ;
VAL_TABLE_ SRRLFODPB5P_IOTk1TypCnfdAuth 0 "Highly Speculative" 1 "Speculative" 2 "Confident" 3 "Highly Confident" ;
VAL_TABLE_ SRRLFODPB5P_IOTk2MStsAuth 0 "No Object" 1 "New Object" 2 "Latent Track Not Detected this Cycle" 3 "Measured this Cycle" ;
VAL_TABLE_ SRRLFODPB5P_IOTk2TypCnfdAuth 0 "Highly Speculative" 1 "Speculative" 2 "Confident" 3 "Highly Confident" ;
VAL_TABLE_ SRRLFODPB5P_IOTk2TypAuth 0 "Unknown" 1 "Guard Rail" 2 "Tunnel" 3 "Traffic Sign" 4 "Bridge" 5 "Pole" ;
VAL_TABLE_ SRRLFODPB5P_IOTk3ElvtnAuth 0 "Not Elevated" 1 "Elevation Speculative" 2 "Elevation Confident" 3 "Elevation Very Confident" ;
VAL_TABLE_ SRRLFODPB5P_IOTk3CnfdStsAuth 0 "Highly Speculative" 1 "Speculative" 2 "Confident" 3 "Highly Confident" ;
VAL_TABLE_ SRRLFODPB5P_IOTk3MStsAuth 0 "No Object" 1 "New Object" 2 "Latent Track Not Detected this Cycle" 3 "Measured this Cycle" ;
VAL_TABLE_ SRRLFODPB5P_IOTk4CnfdStsAuth 0 "Highly Speculative" 1 "Speculative" 2 "Confident" 3 "Highly Confident" ;
VAL_TABLE_ SRRLFODPB5P_IOTk3TypCnfdAuth 0 "Highly Speculative" 1 "Speculative" 2 "Confident" 3 "Highly Confident" ;
VAL_TABLE_ SRRLFODPB5P_IOTk3TypAuth 0 "Unknown" 1 "Guard Rail" 2 "Tunnel" 3 "Traffic Sign" 4 "Bridge" 5 "Pole" ;
VAL_TABLE_ SRRLFODPB5P_IOTk4ElvtnAuth 0 "Not Elevated" 1 "Elevation Speculative" 2 "Elevation Confident" 3 "Elevation Very Confident" ;
VAL_TABLE_ SRRLFODPB5P_IOTk4MStsAuth 0 "No Object" 1 "New Object" 2 "Latent Track Not Detected this Cycle" 3 "Measured this Cycle" ;
VAL_TABLE_ SRRLFODPB5P_IOTk4TypAuth 0 "Unknown" 1 "Guard Rail" 2 "Tunnel" 3 "Traffic Sign" 4 "Bridge" 5 "Pole" ;
VAL_TABLE_ SRRLFODPB5P_IOTk5ElvtnAuth 0 "Not Elevated" 1 "Elevation Speculative" 2 "Elevation Confident" 3 "Elevation Very Confident" ;
VAL_TABLE_ SRRLFODPB5P_IOTk5CnfdStsAuth 0 "Highly Speculative" 1 "Speculative" 2 "Confident" 3 "Highly Confident" ;
VAL_TABLE_ SRRLFODPB5P_IOTk4TypCnfdAuth 0 "Highly Speculative" 1 "Speculative" 2 "Confident" 3 "Highly Confident" ;
VAL_TABLE_ SRRLFODPB5P_IOTk5MStsAuth 0 "No Object" 1 "New Object" 2 "Latent Track Not Detected this Cycle" 3 "Measured this Cycle" ;
VAL_TABLE_ SRRLFODPB5P_IOTk5TypCnfdAuth 0 "Highly Speculative" 1 "Speculative" 2 "Confident" 3 "Highly Confident" ;
VAL_TABLE_ SRRLFODPB5P_IOTk5TypAuth 0 "Unknown" 1 "Guard Rail" 2 "Tunnel" 3 "Traffic Sign" 4 "Bridge" 5 "Pole" ;
VAL_TABLE_ SRRLFODPB5P_IOTk6ElvtnAuth 0 "Not Elevated" 1 "Elevation Speculative" 2 "Elevation Confident" 3 "Elevation Very Confident" ;
VAL_TABLE_ SRRLFODPB5P_IOTk6CnfdStsAuth 0 "Highly Speculative" 1 "Speculative" 2 "Confident" 3 "Highly Confident" ;
VAL_TABLE_ SRRLFODPB5P_IOTk6MStsAuth 0 "No Object" 1 "New Object" 2 "Latent Track Not Detected this Cycle" 3 "Measured this Cycle" ;
VAL_TABLE_ SRRLFODPB5P_IOTk7ElvtnAuth 0 "Not Elevated" 1 "Elevation Speculative" 2 "Elevation Confident" 3 "Elevation Very Confident" ;
VAL_TABLE_ SRRLFODPB5P_IOTk7CnfdStsAuth 0 "Highly Speculative" 1 "Speculative" 2 "Confident" 3 "Highly Confident" ;
VAL_TABLE_ SRRLFODPB5P_IOTk6TypCnfdAuth 0 "Highly Speculative" 1 "Speculative" 2 "Confident" 3 "Highly Confident" ;
VAL_TABLE_ SRRLFODPB5P_IOTk6TypAuth 0 "Unknown" 1 "Guard Rail" 2 "Tunnel" 3 "Traffic Sign" 4 "Bridge" 5 "Pole" ;
VAL_TABLE_ SRRLFODPB5P_IOTk7MStsAuth 0 "No Object" 1 "New Object" 2 "Latent Track Not Detected this Cycle" 3 "Measured this Cycle" ;
VAL_TABLE_ SRRLFODPB5P_IOTk7TypAuth 0 "Unknown" 1 "Guard Rail" 2 "Tunnel" 3 "Traffic Sign" 4 "Bridge" 5 "Pole" ;
VAL_TABLE_ SRRLFODPB5P_IOTk8ElvtnAuth 0 "Not Elevated" 1 "Elevation Speculative" 2 "Elevation Confident" 3 "Elevation Very Confident" ;
VAL_TABLE_ SRRLFODPB5P_IOTk8CnfdStsAuth 0 "Highly Speculative" 1 "Speculative" 2 "Confident" 3 "Highly Confident" ;
VAL_TABLE_ SRRLFODPB5P_IOTk7TypCnfdAuth 0 "Highly Speculative" 1 "Speculative" 2 "Confident" 3 "Highly Confident" ;
VAL_TABLE_ SRRLFODPB5P_IOTk8MStsAuth 0 "No Object" 1 "New Object" 2 "Latent Track Not Detected this Cycle" 3 "Measured this Cycle" ;
VAL_TABLE_ SRRLFODPB5P_IOTk9CnfdStsAuth 0 "Highly Speculative" 1 "Speculative" 2 "Confident" 3 "Highly Confident" ;
VAL_TABLE_ SRRLFODPB5P_IOTk8TypCnfdAuth 0 "Highly Speculative" 1 "Speculative" 2 "Confident" 3 "Highly Confident" ;
VAL_TABLE_ SRRLFODPB5P_IOTk8TypAuth 0 "Unknown" 1 "Guard Rail" 2 "Tunnel" 3 "Traffic Sign" 4 "Bridge" 5 "Pole" ;
VAL_TABLE_ SRRLFODPB5P_IOTk9ElvtnAuth 0 "Not Elevated" 1 "Elevation Speculative" 2 "Elevation Confident" 3 "Elevation Very Confident" ;
VAL_TABLE_ SRRLFODPB5P_IOTk9MStsAuth 0 "No Object" 1 "New Object" 2 "Latent Track Not Detected this Cycle" 3 "Measured this Cycle" ;
VAL_TABLE_ SRRLFODPB5P_IOTk9TypAuth 0 "Unknown" 1 "Guard Rail" 2 "Tunnel" 3 "Traffic Sign" 4 "Bridge" 5 "Pole" ;
VAL_TABLE_ SRRLFODPB5P_IOTk9TypCnfdAuth 0 "Highly Speculative" 1 "Speculative" 2 "Confident" 3 "Highly Confident" ;
VAL_TABLE_ SRRLFODPB1P_ConstrArDtnCnfdAuth 0 "Highly Speculative" 1 "Speculative" 2 "Confident" 3 "Highly Confident" ;
VAL_TABLE_ SRRLFODPB1P_AcqTmStmAuth_Inv 0 "FALSE" 1 "TRUE" ;
VAL_TABLE_ SRRLFODPB1P_POTk1DynPrpAuth 0 "Has Never Moved" 1 "Has Moved But Currently Stopped" 2 "Moving In Same Direction As Host" 3 "Moving In Opposite Direction As Host" 4 "Crossing Path" ;
VAL_TABLE_ SRRLFODPB1P_POTk1CnfdStsAuth 0 "Highly Speculative" 1 "Speculative" 2 "Confident" 3 "Highly Confident" ;
VAL_TABLE_ SRRLFODPB1P_MdCmdStsAuth 0 "Not Radiating" 1 "Reporting Object Data" 2 "Not Reporting Object Data" ;
VAL_TABLE_ SRRLFODPB1P_ConstrArDtnStsAuth 0 "Not Detected" 1 "Detected" 2 "Unknown" ;
VAL_TABLE_ SRRLFODPB1P_POTk1MStsAuth 0 "No Object" 1 "New Object" 2 "Latent Track Not Detected this Cycle" 3 "Measured this Cycle" ;
VAL_TABLE_ SRRLFODPB1P_POTk2CnfdStsAuth 0 "Highly Speculative" 1 "Speculative" 2 "Confident" 3 "Highly Confident" ;
VAL_TABLE_ SRRLFODPB1P_POTk1TypCnfdAuth 0 "Highly Speculative" 1 "Speculative" 2 "Confident" 3 "Highly Confident" ;
VAL_TABLE_ SRRLFODPB1P_POTk1TypAuth 0 "Unknown" 1 "Pedestrian" 2 "Bicycle" ;
VAL_TABLE_ SRRLFODPB1P_POTk2DynPrpAuth 0 "Has Never Moved" 1 "Has Moved But Currently Stopped" 2 "Moving In Same Direction As Host" 3 "Moving In Opposite Direction As Host" 4 "Crossing Path" ;
VAL_TABLE_ SRRLFODPB1P_POTk2MStsAuth 0 "No Object" 1 "New Object" 2 "Latent Track Not Detected this Cycle" 3 "Measured this Cycle" ;
VAL_TABLE_ SRRLFODPB1P_POTk2TypCnfdAuth 0 "Highly Speculative" 1 "Speculative" 2 "Confident" 3 "Highly Confident" ;
VAL_TABLE_ SRRLFODPB1P_POTk2TypAuth 0 "Unknown" 1 "Pedestrian" 2 "Bicycle" ;
VAL_TABLE_ SRRLFODPB1P_SnsrUnvAuth 0 "FALSE" 1 "TRUE" ;
VAL_TABLE_ SRRLFODPB1P_SnsrBlckdAuth 0 "FALSE" 1 "TRUE" ;
VAL_TABLE_ SRRLFODPB1P_ServRqrdAuth 0 "FALSE" 1 "TRUE" ;
VAL_TABLE_ SRRLFODPB1P_RdTypCnfdAuth 0 "Highly Speculative" 1 "Speculative" 2 "Confident" 3 "Highly Confident" ;
VAL_TABLE_ SRRLFODPB1P_RdTypAuth 0 "Unknown" 1 "City" 2 "Secondary Road" 3 "Highway" 4 "Construction Zone Entry" 5 "Construction Zone Exit" ;
VAL_TABLE_ SRRLFODPB1P_SwpBndwdthStsAuth 0 "Mode A" 1 "Mode B" 2 "Mode C" 3 "Mode D" ;
VAL_TABLE_ SRRLFODPB1P_VOTk1DynPrpStsAuth 0 "Stopped" 1 "Not Stopped" ;
VAL_TABLE_ SRRLFODPB1P_VOTk1DynPrpAuth 0 "Has Never Moved" 1 "Moving In Same Direction As Host" 2 "Moving In Opposite Direction As Host" 3 "Crossing From Left To Right" 4 "Crossing From Right To Left" ;
VAL_TABLE_ SRRLFODPB1P_VOTk1CnfdStsAuth 0 "Highly Speculative" 1 "Speculative" 2 "Confident" 3 "Highly Confident" ;
VAL_TABLE_ SRRLFODPB1P_VOTk1MStsAuth 0 "No Object" 1 "New Object" 2 "Latent Track Not Detected this Cycle" 3 "Measured this Cycle" ;
VAL_TABLE_ SRRLFODPB1P_VOTk1TypCnfdAuth 0 "Highly Speculative" 1 "Speculative" 2 "Confident" 3 "Highly Confident" ;
VAL_TABLE_ SRRLFODPB6P_REOTk1CnfdStsAuth 0 "Highly Speculative" 1 "Speculative" 2 "Confident" 3 "Highly Confident" ;
VAL_TABLE_ SRRLFODPB6P_REOTk2CnfdStsAuth 0 "Highly Speculative" 1 "Speculative" 2 "Confident" 3 "Highly Confident" ;
VAL_TABLE_ SRRLFODPB6P_REOTk1TypCnfdAuth 0 "Highly Speculative" 1 "Speculative" 2 "Confident" 3 "Highly Confident" ;
VAL_TABLE_ SRRLFODPB6P_REOTk1TypAuth 0 "Unknown" 1 "Barriers" 2 "Guard Rails" 3 "Bridge Abutments" 4 "Edge of Road" 5 "Open Area" ;
VAL_TABLE_ SRRLFODPB6P_REOTk3CnfdStsAuth 0 "Highly Speculative" 1 "Speculative" 2 "Confident" 3 "Highly Confident" ;
VAL_TABLE_ SRRLFODPB6P_REOTk2TypCnfdAuth 0 "Highly Speculative" 1 "Speculative" 2 "Confident" 3 "Highly Confident" ;
VAL_TABLE_ SRRLFODPB6P_REOTk2TypAuth 0 "Unknown" 1 "Barriers" 2 "Guard Rails" 3 "Bridge Abutments" 4 "Edge of Road" 5 "Open Area" ;
VAL_TABLE_ SRRLFODPB6P_REOTk3TypCnfdAuth 0 "Highly Speculative" 1 "Speculative" 2 "Confident" 3 "Highly Confident" ;
VAL_TABLE_ SRRLFODPB6P_REOTk3TypAuth 0 "Unknown" 1 "Barriers" 2 "Guard Rails" 3 "Bridge Abutments" 4 "Edge of Road" 5 "Open Area" ;
VAL_TABLE_ SRRLRCODPB2P_POTk3DynPrpAuth 0 "Has Never Moved" 1 "Has Moved But Currently Stopped" 2 "Moving In Same Direction As Host" 3 "Moving In Opposite Direction As Host" 4 "Crossing Path" ;
VAL_TABLE_ SRRLRCODPB2P_POTk3CnfdStsAuth 0 "Highly Speculative" 1 "Speculative" 2 "Confident" 3 "Highly Confident" ;
VAL_TABLE_ SRRLRCODPB2P_POTk3MStsAuth 0 "No Object" 1 "New Object" 2 "Latent Track Not Detected this Cycle" 3 "Measured this Cycle" ;
VAL_TABLE_ SRRLRCODPB2P_POTk3TypCnfdAuth 0 "Highly Speculative" 1 "Speculative" 2 "Confident" 3 "Highly Confident" ;
VAL_TABLE_ SRRLRCODPB2P_POTk3TypAuth 0 "Unknown" 1 "Pedestrian" 2 "Bicycle" ;
VAL_TABLE_ SRRLRCODPB2P_VOTk2DynPrpStsAuth 0 "Stopped" 1 "Not Stopped" ;
VAL_TABLE_ SRRLRCODPB2P_VOTk2DynPrpAuth 0 "Has Never Moved" 1 "Moving In Same Direction As Host" 2 "Moving In Opposite Direction As Host" 3 "Crossing From Left To Right" 4 "Crossing From Right To Left" ;
VAL_TABLE_ SRRLRCODPB2P_VOTk2CnfdStsAuth 0 "Highly Speculative" 1 "Speculative" 2 "Confident" 3 "Highly Confident" ;
VAL_TABLE_ SRRLRCODPB2P_VOTk2MStsAuth 0 "No Object" 1 "New Object" 2 "Latent Track Not Detected this Cycle" 3 "Measured this Cycle" ;
VAL_TABLE_ SRRLRCODPB2P_VOTk2TypCnfdAuth 0 "Highly Speculative" 1 "Speculative" 2 "Confident" 3 "Highly Confident" ;
VAL_TABLE_ SRRLRCODPB2P_VOTk3CnfdStsAuth 0 "Highly Speculative" 1 "Speculative" 2 "Confident" 3 "Highly Confident" ;
VAL_TABLE_ SRRLRCODPB2P_VOTk3DynPrpStsAuth 0 "Stopped" 1 "Not Stopped" ;
VAL_TABLE_ SRRLRCODPB2P_VOTk3DynPrpAuth 0 "Has Never Moved" 1 "Moving In Same Direction As Host" 2 "Moving In Opposite Direction As Host" 3 "Crossing From Left To Right" 4 "Crossing From Right To Left" ;
VAL_TABLE_ SRRLRCODPB2P_VOTk3MStsAuth 0 "No Object" 1 "New Object" 2 "Latent Track Not Detected this Cycle" 3 "Measured this Cycle" ;
VAL_TABLE_ SRRLRCODPB2P_VOTk3TypCnfdAuth 0 "Highly Speculative" 1 "Speculative" 2 "Confident" 3 "Highly Confident" ;
VAL_TABLE_ SRRLRCODPB2P_VOTk4DynPrpStsAuth 0 "Stopped" 1 "Not Stopped" ;
VAL_TABLE_ SRRLRCODPB2P_VOTk4DynPrpAuth 0 "Has Never Moved" 1 "Moving In Same Direction As Host" 2 "Moving In Opposite Direction As Host" 3 "Crossing From Left To Right" 4 "Crossing From Right To Left" ;
VAL_TABLE_ SRRLRCODPB2P_VOTk4CnfdStsAuth 0 "Highly Speculative" 1 "Speculative" 2 "Confident" 3 "Highly Confident" ;
VAL_TABLE_ SRRLRCODPB2P_VOTk4MStsAuth 0 "No Object" 1 "New Object" 2 "Latent Track Not Detected this Cycle" 3 "Measured this Cycle" ;
VAL_TABLE_ SRRLRCODPB2P_VOTk4TypCnfdAuth 0 "Highly Speculative" 1 "Speculative" 2 "Confident" 3 "Highly Confident" ;
VAL_TABLE_ SRRLRCODPB3P_POTk4DynPrpAuth 0 "Has Never Moved" 1 "Has Moved But Currently Stopped" 2 "Moving In Same Direction As Host" 3 "Moving In Opposite Direction As Host" 4 "Crossing Path" ;
VAL_TABLE_ SRRLRCODPB3P_POTk4CnfdStsAuth 0 "Highly Speculative" 1 "Speculative" 2 "Confident" 3 "Highly Confident" ;
VAL_TABLE_ SRRLRCODPB3P_POTk4MStsAuth 0 "No Object" 1 "New Object" 2 "Latent Track Not Detected this Cycle" 3 "Measured this Cycle" ;
VAL_TABLE_ SRRLRCODPB3P_POTk4TypCnfdAuth 0 "Highly Speculative" 1 "Speculative" 2 "Confident" 3 "Highly Confident" ;
VAL_TABLE_ SRRLRCODPB3P_POTk4TypAuth 0 "Unknown" 1 "Pedestrian" 2 "Bicycle" ;
VAL_TABLE_ SRRLRCODPB3P_VOTk5DynPrpStsAuth 0 "Stopped" 1 "Not Stopped" ;
VAL_TABLE_ SRRLRCODPB3P_VOTk5DynPrpAuth 0 "Has Never Moved" 1 "Moving In Same Direction As Host" 2 "Moving In Opposite Direction As Host" 3 "Crossing From Left To Right" 4 "Crossing From Right To Left" ;
VAL_TABLE_ SRRLRCODPB3P_VOTk5CnfdStsAuth 0 "Highly Speculative" 1 "Speculative" 2 "Confident" 3 "Highly Confident" ;
VAL_TABLE_ SRRLRCODPB3P_VOTk5MStsAuth 0 "No Object" 1 "New Object" 2 "Latent Track Not Detected this Cycle" 3 "Measured this Cycle" ;
VAL_TABLE_ SRRLRCODPB3P_VOTk5TypCnfdAuth 0 "Highly Speculative" 1 "Speculative" 2 "Confident" 3 "Highly Confident" ;
VAL_TABLE_ SRRLRCODPB3P_VOTk6CnfdStsAuth 0 "Highly Speculative" 1 "Speculative" 2 "Confident" 3 "Highly Confident" ;
VAL_TABLE_ SRRLRCODPB3P_VOTk6DynPrpStsAuth 0 "Stopped" 1 "Not Stopped" ;
VAL_TABLE_ SRRLRCODPB3P_VOTk6DynPrpAuth 0 "Has Never Moved" 1 "Moving In Same Direction As Host" 2 "Moving In Opposite Direction As Host" 3 "Crossing From Left To Right" 4 "Crossing From Right To Left" ;
VAL_TABLE_ SRRLRCODPB3P_VOTk6MStsAuth 0 "No Object" 1 "New Object" 2 "Latent Track Not Detected this Cycle" 3 "Measured this Cycle" ;
VAL_TABLE_ SRRLRCODPB3P_VOTk6TypCnfdAuth 0 "Highly Speculative" 1 "Speculative" 2 "Confident" 3 "Highly Confident" ;
VAL_TABLE_ SRRLRCODPB3P_VOTk7DynPrpStsAuth 0 "Stopped" 1 "Not Stopped" ;
VAL_TABLE_ SRRLRCODPB3P_VOTk7DynPrpAuth 0 "Has Never Moved" 1 "Moving In Same Direction As Host" 2 "Moving In Opposite Direction As Host" 3 "Crossing From Left To Right" 4 "Crossing From Right To Left" ;
VAL_TABLE_ SRRLRCODPB3P_VOTk7CnfdStsAuth 0 "Highly Speculative" 1 "Speculative" 2 "Confident" 3 "Highly Confident" ;
VAL_TABLE_ SRRLRCODPB3P_VOTk7MStsAuth 0 "No Object" 1 "New Object" 2 "Latent Track Not Detected this Cycle" 3 "Measured this Cycle" ;
VAL_TABLE_ SRRLRCODPB3P_VOTk7TypCnfdAuth 0 "Highly Speculative" 1 "Speculative" 2 "Confident" 3 "Highly Confident" ;
VAL_TABLE_ SRRLRCODPB4P_POTk5DynPrpAuth 0 "Has Never Moved" 1 "Has Moved But Currently Stopped" 2 "Moving In Same Direction As Host" 3 "Moving In Opposite Direction As Host" 4 "Crossing Path" ;
VAL_TABLE_ SRRLRCODPB4P_POTk5CnfdStsAuth 0 "Highly Speculative" 1 "Speculative" 2 "Confident" 3 "Highly Confident" ;
VAL_TABLE_ SRRLRCODPB4P_POTk5MStsAuth 0 "No Object" 1 "New Object" 2 "Latent Track Not Detected this Cycle" 3 "Measured this Cycle" ;
VAL_TABLE_ SRRLRCODPB4P_POTk5TypCnfdAuth 0 "Highly Speculative" 1 "Speculative" 2 "Confident" 3 "Highly Confident" ;
VAL_TABLE_ SRRLRCODPB4P_POTk5TypAuth 0 "Unknown" 1 "Pedestrian" 2 "Bicycle" ;
VAL_TABLE_ SRRLRCODPB4P_VOTk10DynPrpStsAuth 0 "Stopped" 1 "Not Stopped" ;
VAL_TABLE_ SRRLRCODPB4P_VOTk10DynPrpAuth 0 "Has Never Moved" 1 "Moving In Same Direction As Host" 2 "Moving In Opposite Direction As Host" 3 "Crossing From Left To Right" 4 "Crossing From Right To Left" ;
VAL_TABLE_ SRRLRCODPB4P_VOTk10CnfdStsAuth 0 "Highly Speculative" 1 "Speculative" 2 "Confident" 3 "Highly Confident" ;
VAL_TABLE_ SRRLRCODPB4P_VOTk10MStsAuth 0 "No Object" 1 "New Object" 2 "Latent Track Not Detected this Cycle" 3 "Measured this Cycle" ;
VAL_TABLE_ SRRLRCODPB4P_VOTk10TypCnfdAuth 0 "Highly Speculative" 1 "Speculative" 2 "Confident" 3 "Highly Confident" ;
VAL_TABLE_ SRRLRCODPB4P_VOTk8CnfdStsAuth 0 "Highly Speculative" 1 "Speculative" 2 "Confident" 3 "Highly Confident" ;
VAL_TABLE_ SRRLRCODPB4P_VOTk8DynPrpStsAuth 0 "Stopped" 1 "Not Stopped" ;
VAL_TABLE_ SRRLRCODPB4P_VOTk8DynPrpAuth 0 "Has Never Moved" 1 "Moving In Same Direction As Host" 2 "Moving In Opposite Direction As Host" 3 "Crossing From Left To Right" 4 "Crossing From Right To Left" ;
VAL_TABLE_ SRRLRCODPB4P_VOTk8MStsAuth 0 "No Object" 1 "New Object" 2 "Latent Track Not Detected this Cycle" 3 "Measured this Cycle" ;
VAL_TABLE_ SRRLRCODPB4P_VOTk8TypCnfdAuth 0 "Highly Speculative" 1 "Speculative" 2 "Confident" 3 "Highly Confident" ;
VAL_TABLE_ SRRLRCODPB4P_VOTk9DynPrpStsAuth 0 "Stopped" 1 "Not Stopped" ;
VAL_TABLE_ SRRLRCODPB4P_VOTk9DynPrpAuth 0 "Has Never Moved" 1 "Moving In Same Direction As Host" 2 "Moving In Opposite Direction As Host" 3 "Crossing From Left To Right" 4 "Crossing From Right To Left" ;
VAL_TABLE_ SRRLRCODPB4P_VOTk9CnfdStsAuth 0 "Highly Speculative" 1 "Speculative" 2 "Confident" 3 "Highly Confident" ;
VAL_TABLE_ SRRLRCODPB4P_VOTk9MStsAuth 0 "No Object" 1 "New Object" 2 "Latent Track Not Detected this Cycle" 3 "Measured this Cycle" ;
VAL_TABLE_ SRRLRCODPB4P_VOTk9TypCnfdAuth 0 "Highly Speculative" 1 "Speculative" 2 "Confident" 3 "Highly Confident" ;
VAL_TABLE_ SRRLRCODPB5P_IOTk10ElvtnAuth 0 "Not Elevated" 1 "Elevation Speculative" 2 "Elevation Confident" 3 "Elevation Very Confident" ;
VAL_TABLE_ SRRLRCODPB5P_IOTk10CnfdStsAuth 0 "Highly Speculative" 1 "Speculative" 2 "Confident" 3 "Highly Confident" ;
VAL_TABLE_ SRRLRCODPB5P_IOTk10MStsAuth 0 "No Object" 1 "New Object" 2 "Latent Track Not Detected this Cycle" 3 "Measured this Cycle" ;
VAL_TABLE_ SRRLRCODPB5P_IOTk1CnfdStsAuth 0 "Highly Speculative" 1 "Speculative" 2 "Confident" 3 "Highly Confident" ;
VAL_TABLE_ SRRLRCODPB5P_IOTk10TypCnfdAuth 0 "Highly Speculative" 1 "Speculative" 2 "Confident" 3 "Highly Confident" ;
VAL_TABLE_ SRRLRCODPB5P_IOTk10TypAuth 0 "Unknown" 1 "Guard Rail" 2 "Tunnel" 3 "Traffic Sign" 4 "Bridge" 5 "Pole" ;
VAL_TABLE_ SRRLRCODPB5P_IOTk1ElvtnAuth 0 "Not Elevated" 1 "Elevation Speculative" 2 "Elevation Confident" 3 "Elevation Very Confident" ;
VAL_TABLE_ SRRLRCODPB5P_IOTk1MStsAuth 0 "No Object" 1 "New Object" 2 "Latent Track Not Detected this Cycle" 3 "Measured this Cycle" ;
VAL_TABLE_ SRRLRCODPB5P_IOTk1TypAuth 0 "Unknown" 1 "Guard Rail" 2 "Tunnel" 3 "Traffic Sign" 4 "Bridge" 5 "Pole" ;
VAL_TABLE_ SRRLRCODPB5P_IOTk2ElvtnAuth 0 "Not Elevated" 1 "Elevation Speculative" 2 "Elevation Confident" 3 "Elevation Very Confident" ;
VAL_TABLE_ SRRLRCODPB5P_IOTk2CnfdStsAuth 0 "Highly Speculative" 1 "Speculative" 2 "Confident" 3 "Highly Confident" ;
VAL_TABLE_ SRRLRCODPB5P_IOTk1TypCnfdAuth 0 "Highly Speculative" 1 "Speculative" 2 "Confident" 3 "Highly Confident" ;
VAL_TABLE_ SRRLRCODPB5P_IOTk2MStsAuth 0 "No Object" 1 "New Object" 2 "Latent Track Not Detected this Cycle" 3 "Measured this Cycle" ;
VAL_TABLE_ SRRLRCODPB5P_IOTk2TypCnfdAuth 0 "Highly Speculative" 1 "Speculative" 2 "Confident" 3 "Highly Confident" ;
VAL_TABLE_ SRRLRCODPB5P_IOTk2TypAuth 0 "Unknown" 1 "Guard Rail" 2 "Tunnel" 3 "Traffic Sign" 4 "Bridge" 5 "Pole" ;
VAL_TABLE_ SRRLRCODPB5P_IOTk3ElvtnAuth 0 "Not Elevated" 1 "Elevation Speculative" 2 "Elevation Confident" 3 "Elevation Very Confident" ;
VAL_TABLE_ SRRLRCODPB5P_IOTk3CnfdStsAuth 0 "Highly Speculative" 1 "Speculative" 2 "Confident" 3 "Highly Confident" ;
VAL_TABLE_ SRRLRCODPB5P_IOTk3MStsAuth 0 "No Object" 1 "New Object" 2 "Latent Track Not Detected this Cycle" 3 "Measured this Cycle" ;
VAL_TABLE_ SRRLRCODPB5P_IOTk4CnfdStsAuth 0 "Highly Speculative" 1 "Speculative" 2 "Confident" 3 "Highly Confident" ;
VAL_TABLE_ SRRLRCODPB5P_IOTk3TypCnfdAuth 0 "Highly Speculative" 1 "Speculative" 2 "Confident" 3 "Highly Confident" ;
VAL_TABLE_ SRRLRCODPB5P_IOTk3TypAuth 0 "Unknown" 1 "Guard Rail" 2 "Tunnel" 3 "Traffic Sign" 4 "Bridge" 5 "Pole" ;
VAL_TABLE_ SRRLRCODPB5P_IOTk4ElvtnAuth 0 "Not Elevated" 1 "Elevation Speculative" 2 "Elevation Confident" 3 "Elevation Very Confident" ;
VAL_TABLE_ SRRLRCODPB5P_IOTk4MStsAuth 0 "No Object" 1 "New Object" 2 "Latent Track Not Detected this Cycle" 3 "Measured this Cycle" ;
VAL_TABLE_ SRRLRCODPB5P_IOTk4TypAuth 0 "Unknown" 1 "Guard Rail" 2 "Tunnel" 3 "Traffic Sign" 4 "Bridge" 5 "Pole" ;
VAL_TABLE_ SRRLRCODPB5P_IOTk5ElvtnAuth 0 "Not Elevated" 1 "Elevation Speculative" 2 "Elevation Confident" 3 "Elevation Very Confident" ;
VAL_TABLE_ SRRLRCODPB5P_IOTk5CnfdStsAuth 0 "Highly Speculative" 1 "Speculative" 2 "Confident" 3 "Highly Confident" ;
VAL_TABLE_ SRRLRCODPB5P_IOTk4TypCnfdAuth 0 "Highly Speculative" 1 "Speculative" 2 "Confident" 3 "Highly Confident" ;
VAL_TABLE_ SRRLRCODPB5P_IOTk5MStsAuth 0 "No Object" 1 "New Object" 2 "Latent Track Not Detected this Cycle" 3 "Measured this Cycle" ;
VAL_TABLE_ SRRLRCODPB5P_IOTk5TypCnfdAuth 0 "Highly Speculative" 1 "Speculative" 2 "Confident" 3 "Highly Confident" ;
VAL_TABLE_ SRRLRCODPB5P_IOTk5TypAuth 0 "Unknown" 1 "Guard Rail" 2 "Tunnel" 3 "Traffic Sign" 4 "Bridge" 5 "Pole" ;
VAL_TABLE_ SRRLRCODPB5P_IOTk6ElvtnAuth 0 "Not Elevated" 1 "Elevation Speculative" 2 "Elevation Confident" 3 "Elevation Very Confident" ;
VAL_TABLE_ SRRLRCODPB5P_IOTk6CnfdStsAuth 0 "Highly Speculative" 1 "Speculative" 2 "Confident" 3 "Highly Confident" ;
VAL_TABLE_ SRRLRCODPB5P_IOTk6MStsAuth 0 "No Object" 1 "New Object" 2 "Latent Track Not Detected this Cycle" 3 "Measured this Cycle" ;
VAL_TABLE_ SRRLRCODPB5P_IOTk7ElvtnAuth 0 "Not Elevated" 1 "Elevation Speculative" 2 "Elevation Confident" 3 "Elevation Very Confident" ;
VAL_TABLE_ SRRLRCODPB5P_IOTk7CnfdStsAuth 0 "Highly Speculative" 1 "Speculative" 2 "Confident" 3 "Highly Confident" ;
VAL_TABLE_ SRRLRCODPB5P_IOTk6TypCnfdAuth 0 "Highly Speculative" 1 "Speculative" 2 "Confident" 3 "Highly Confident" ;
VAL_TABLE_ SRRLRCODPB5P_IOTk6TypAuth 0 "Unknown" 1 "Guard Rail" 2 "Tunnel" 3 "Traffic Sign" 4 "Bridge" 5 "Pole" ;
VAL_TABLE_ SRRLRCODPB5P_IOTk7MStsAuth 0 "No Object" 1 "New Object" 2 "Latent Track Not Detected this Cycle" 3 "Measured this Cycle" ;
VAL_TABLE_ SRRLRCODPB5P_IOTk7TypAuth 0 "Unknown" 1 "Guard Rail" 2 "Tunnel" 3 "Traffic Sign" 4 "Bridge" 5 "Pole" ;
VAL_TABLE_ SRRLRCODPB5P_IOTk8ElvtnAuth 0 "Not Elevated" 1 "Elevation Speculative" 2 "Elevation Confident" 3 "Elevation Very Confident" ;
VAL_TABLE_ SRRLRCODPB5P_IOTk8CnfdStsAuth 0 "Highly Speculative" 1 "Speculative" 2 "Confident" 3 "Highly Confident" ;
VAL_TABLE_ SRRLRCODPB5P_IOTk7TypCnfdAuth 0 "Highly Speculative" 1 "Speculative" 2 "Confident" 3 "Highly Confident" ;
VAL_TABLE_ SRRLRCODPB5P_IOTk8MStsAuth 0 "No Object" 1 "New Object" 2 "Latent Track Not Detected this Cycle" 3 "Measured this Cycle" ;
VAL_TABLE_ SRRLRCODPB5P_IOTk9CnfdStsAuth 0 "Highly Speculative" 1 "Speculative" 2 "Confident" 3 "Highly Confident" ;
VAL_TABLE_ SRRLRCODPB5P_IOTk8TypCnfdAuth 0 "Highly Speculative" 1 "Speculative" 2 "Confident" 3 "Highly Confident" ;
VAL_TABLE_ SRRLRCODPB5P_IOTk8TypAuth 0 "Unknown" 1 "Guard Rail" 2 "Tunnel" 3 "Traffic Sign" 4 "Bridge" 5 "Pole" ;
VAL_TABLE_ SRRLRCODPB5P_IOTk9ElvtnAuth 0 "Not Elevated" 1 "Elevation Speculative" 2 "Elevation Confident" 3 "Elevation Very Confident" ;
VAL_TABLE_ SRRLRCODPB5P_IOTk9MStsAuth 0 "No Object" 1 "New Object" 2 "Latent Track Not Detected this Cycle" 3 "Measured this Cycle" ;
VAL_TABLE_ SRRLRCODPB5P_IOTk9TypAuth 0 "Unknown" 1 "Guard Rail" 2 "Tunnel" 3 "Traffic Sign" 4 "Bridge" 5 "Pole" ;
VAL_TABLE_ SRRLRCODPB5P_IOTk9TypCnfdAuth 0 "Highly Speculative" 1 "Speculative" 2 "Confident" 3 "Highly Confident" ;
VAL_TABLE_ SRRLRCODPB1P_ConstrArDtnCnfdAuth 0 "Highly Speculative" 1 "Speculative" 2 "Confident" 3 "Highly Confident" ;
VAL_TABLE_ SRRLRCODPB1P_AcqTmStmAuth_Inv 0 "FALSE" 1 "TRUE" ;
VAL_TABLE_ SRRLRCODPB1P_POTk1DynPrpAuth 0 "Has Never Moved" 1 "Has Moved But Currently Stopped" 2 "Moving In Same Direction As Host" 3 "Moving In Opposite Direction As Host" 4 "Crossing Path" ;
VAL_TABLE_ SRRLRCODPB1P_POTk1CnfdStsAuth 0 "Highly Speculative" 1 "Speculative" 2 "Confident" 3 "Highly Confident" ;
VAL_TABLE_ SRRLRCODPB1P_MdCmdStsAuth 0 "Not Radiating" 1 "Reporting Object Data" 2 "Not Reporting Object Data" ;
VAL_TABLE_ SRRLRCODPB1P_ConstrArDtnStsAuth 0 "Not Detected" 1 "Detected" 2 "Unknown" ;
VAL_TABLE_ SRRLRCODPB1P_POTk1MStsAuth 0 "No Object" 1 "New Object" 2 "Latent Track Not Detected this Cycle" 3 "Measured this Cycle" ;
VAL_TABLE_ SRRLRCODPB1P_POTk2CnfdStsAuth 0 "Highly Speculative" 1 "Speculative" 2 "Confident" 3 "Highly Confident" ;
VAL_TABLE_ SRRLRCODPB1P_POTk1TypCnfdAuth 0 "Highly Speculative" 1 "Speculative" 2 "Confident" 3 "Highly Confident" ;
VAL_TABLE_ SRRLRCODPB1P_POTk1TypAuth 0 "Unknown" 1 "Pedestrian" 2 "Bicycle" ;
VAL_TABLE_ SRRLRCODPB1P_POTk2DynPrpAuth 0 "Has Never Moved" 1 "Has Moved But Currently Stopped" 2 "Moving In Same Direction As Host" 3 "Moving In Opposite Direction As Host" 4 "Crossing Path" ;
VAL_TABLE_ SRRLRCODPB1P_POTk2MStsAuth 0 "No Object" 1 "New Object" 2 "Latent Track Not Detected this Cycle" 3 "Measured this Cycle" ;
VAL_TABLE_ SRRLRCODPB1P_POTk2TypCnfdAuth 0 "Highly Speculative" 1 "Speculative" 2 "Confident" 3 "Highly Confident" ;
VAL_TABLE_ SRRLRCODPB1P_POTk2TypAuth 0 "Unknown" 1 "Pedestrian" 2 "Bicycle" ;
VAL_TABLE_ SRRLRCODPB1P_SnsrUnvAuth 0 "FALSE" 1 "TRUE" ;
VAL_TABLE_ SRRLRCODPB1P_SnsrBlckdAuth 0 "FALSE" 1 "TRUE" ;
VAL_TABLE_ SRRLRCODPB1P_ServRqrdAuth 0 "FALSE" 1 "TRUE" ;
VAL_TABLE_ SRRLRCODPB1P_RdTypCnfdAuth 0 "Highly Speculative" 1 "Speculative" 2 "Confident" 3 "Highly Confident" ;
VAL_TABLE_ SRRLRCODPB1P_RdTypAuth 0 "Unknown" 1 "City" 2 "Secondary Road" 3 "Highway" 4 "Construction Zone Entry" 5 "Construction Zone Exit" ;
VAL_TABLE_ SRRLRCODPB1P_SwpBndwdthStsAuth 0 "Mode A" 1 "Mode B" 2 "Mode C" 3 "Mode D" ;
VAL_TABLE_ SRRLRCODPB1P_VOTk1DynPrpStsAuth 0 "Stopped" 1 "Not Stopped" ;
VAL_TABLE_ SRRLRCODPB1P_VOTk1DynPrpAuth 0 "Has Never Moved" 1 "Moving In Same Direction As Host" 2 "Moving In Opposite Direction As Host" 3 "Crossing From Left To Right" 4 "Crossing From Right To Left" ;
VAL_TABLE_ SRRLRCODPB1P_VOTk1CnfdStsAuth 0 "Highly Speculative" 1 "Speculative" 2 "Confident" 3 "Highly Confident" ;
VAL_TABLE_ SRRLRCODPB1P_VOTk1MStsAuth 0 "No Object" 1 "New Object" 2 "Latent Track Not Detected this Cycle" 3 "Measured this Cycle" ;
VAL_TABLE_ SRRLRCODPB1P_VOTk1TypCnfdAuth 0 "Highly Speculative" 1 "Speculative" 2 "Confident" 3 "Highly Confident" ;
VAL_TABLE_ SRRLRCODPB6P_REOTk1CnfdStsAuth 0 "Highly Speculative" 1 "Speculative" 2 "Confident" 3 "Highly Confident" ;
VAL_TABLE_ SRRLRCODPB6P_REOTk2CnfdStsAuth 0 "Highly Speculative" 1 "Speculative" 2 "Confident" 3 "Highly Confident" ;
VAL_TABLE_ SRRLRCODPB6P_REOTk1TypCnfdAuth 0 "Highly Speculative" 1 "Speculative" 2 "Confident" 3 "Highly Confident" ;
VAL_TABLE_ SRRLRCODPB6P_REOTk1TypAuth 0 "Unknown" 1 "Barriers" 2 "Guard Rails" 3 "Bridge Abutments" 4 "Edge of Road" 5 "Open Area" ;
VAL_TABLE_ SRRLRCODPB6P_REOTk3CnfdStsAuth 0 "Highly Speculative" 1 "Speculative" 2 "Confident" 3 "Highly Confident" ;
VAL_TABLE_ SRRLRCODPB6P_REOTk2TypCnfdAuth 0 "Highly Speculative" 1 "Speculative" 2 "Confident" 3 "Highly Confident" ;
VAL_TABLE_ SRRLRCODPB6P_REOTk2TypAuth 0 "Unknown" 1 "Barriers" 2 "Guard Rails" 3 "Bridge Abutments" 4 "Edge of Road" 5 "Open Area" ;
VAL_TABLE_ SRRLRCODPB6P_REOTk3TypCnfdAuth 0 "Highly Speculative" 1 "Speculative" 2 "Confident" 3 "Highly Confident" ;
VAL_TABLE_ SRRLRCODPB6P_REOTk3TypAuth 0 "Unknown" 1 "Barriers" 2 "Guard Rails" 3 "Bridge Abutments" 4 "Edge of Road" 5 "Open Area" ;
VAL_TABLE_ SRRRFODPB2P_POTk3DynPrpAuth 0 "Has Never Moved" 1 "Has Moved But Currently Stopped" 2 "Moving In Same Direction As Host" 3 "Moving In Opposite Direction As Host" 4 "Crossing Path" ;
VAL_TABLE_ SRRRFODPB2P_POTk3CnfdStsAuth 0 "Highly Speculative" 1 "Speculative" 2 "Confident" 3 "Highly Confident" ;
VAL_TABLE_ SRRRFODPB2P_POTk3MStsAuth 0 "No Object" 1 "New Object" 2 "Latent Track Not Detected this Cycle" 3 "Measured this Cycle" ;
VAL_TABLE_ SRRRFODPB2P_POTk3TypCnfdAuth 0 "Highly Speculative" 1 "Speculative" 2 "Confident" 3 "Highly Confident" ;
VAL_TABLE_ SRRRFODPB2P_POTk3TypAuth 0 "Unknown" 1 "Pedestrian" 2 "Bicycle" ;
VAL_TABLE_ SRRRFODPB2P_VOTk2DynPrpStsAuth 0 "Stopped" 1 "Not Stopped" ;
VAL_TABLE_ SRRRFODPB2P_VOTk2DynPrpAuth 0 "Has Never Moved" 1 "Moving In Same Direction As Host" 2 "Moving In Opposite Direction As Host" 3 "Crossing From Left To Right" 4 "Crossing From Right To Left" ;
VAL_TABLE_ SRRRFODPB2P_VOTk2CnfdStsAuth 0 "Highly Speculative" 1 "Speculative" 2 "Confident" 3 "Highly Confident" ;
VAL_TABLE_ SRRRFODPB2P_VOTk2MStsAuth 0 "No Object" 1 "New Object" 2 "Latent Track Not Detected this Cycle" 3 "Measured this Cycle" ;
VAL_TABLE_ SRRRFODPB2P_VOTk2TypCnfdAuth 0 "Highly Speculative" 1 "Speculative" 2 "Confident" 3 "Highly Confident" ;
VAL_TABLE_ SRRRFODPB2P_VOTk3CnfdStsAuth 0 "Highly Speculative" 1 "Speculative" 2 "Confident" 3 "Highly Confident" ;
VAL_TABLE_ SRRRFODPB2P_VOTk3DynPrpStsAuth 0 "Stopped" 1 "Not Stopped" ;
VAL_TABLE_ SRRRFODPB2P_VOTk3DynPrpAuth 0 "Has Never Moved" 1 "Moving In Same Direction As Host" 2 "Moving In Opposite Direction As Host" 3 "Crossing From Left To Right" 4 "Crossing From Right To Left" ;
VAL_TABLE_ SRRRFODPB2P_VOTk3MStsAuth 0 "No Object" 1 "New Object" 2 "Latent Track Not Detected this Cycle" 3 "Measured this Cycle" ;
VAL_TABLE_ SRRRFODPB2P_VOTk3TypCnfdAuth 0 "Highly Speculative" 1 "Speculative" 2 "Confident" 3 "Highly Confident" ;
VAL_TABLE_ SRRRFODPB2P_VOTk4DynPrpStsAuth 0 "Stopped" 1 "Not Stopped" ;
VAL_TABLE_ SRRRFODPB2P_VOTk4DynPrpAuth 0 "Has Never Moved" 1 "Moving In Same Direction As Host" 2 "Moving In Opposite Direction As Host" 3 "Crossing From Left To Right" 4 "Crossing From Right To Left" ;
VAL_TABLE_ SRRRFODPB2P_VOTk4CnfdStsAuth 0 "Highly Speculative" 1 "Speculative" 2 "Confident" 3 "Highly Confident" ;
VAL_TABLE_ SRRRFODPB2P_VOTk4MStsAuth 0 "No Object" 1 "New Object" 2 "Latent Track Not Detected this Cycle" 3 "Measured this Cycle" ;
VAL_TABLE_ SRRRFODPB2P_VOTk4TypCnfdAuth 0 "Highly Speculative" 1 "Speculative" 2 "Confident" 3 "Highly Confident" ;
VAL_TABLE_ SRRRFODPB3P_POTk4DynPrpAuth 0 "Has Never Moved" 1 "Has Moved But Currently Stopped" 2 "Moving In Same Direction As Host" 3 "Moving In Opposite Direction As Host" 4 "Crossing Path" ;
VAL_TABLE_ SRRRFODPB3P_POTk4CnfdStsAuth 0 "Highly Speculative" 1 "Speculative" 2 "Confident" 3 "Highly Confident" ;
VAL_TABLE_ SRRRFODPB3P_POTk4MStsAuth 0 "No Object" 1 "New Object" 2 "Latent Track Not Detected this Cycle" 3 "Measured this Cycle" ;
VAL_TABLE_ SRRRFODPB3P_POTk4TypCnfdAuth 0 "Highly Speculative" 1 "Speculative" 2 "Confident" 3 "Highly Confident" ;
VAL_TABLE_ SRRRFODPB3P_POTk4TypAuth 0 "Unknown" 1 "Pedestrian" 2 "Bicycle" ;
VAL_TABLE_ SRRRFODPB3P_VOTk5DynPrpStsAuth 0 "Stopped" 1 "Not Stopped" ;
VAL_TABLE_ SRRRFODPB3P_VOTk5DynPrpAuth 0 "Has Never Moved" 1 "Moving In Same Direction As Host" 2 "Moving In Opposite Direction As Host" 3 "Crossing From Left To Right" 4 "Crossing From Right To Left" ;
VAL_TABLE_ SRRRFODPB3P_VOTk5CnfdStsAuth 0 "Highly Speculative" 1 "Speculative" 2 "Confident" 3 "Highly Confident" ;
VAL_TABLE_ SRRRFODPB3P_VOTk5MStsAuth 0 "No Object" 1 "New Object" 2 "Latent Track Not Detected this Cycle" 3 "Measured this Cycle" ;
VAL_TABLE_ SRRRFODPB3P_VOTk5TypCnfdAuth 0 "Highly Speculative" 1 "Speculative" 2 "Confident" 3 "Highly Confident" ;
VAL_TABLE_ SRRRFODPB3P_VOTk6CnfdStsAuth 0 "Highly Speculative" 1 "Speculative" 2 "Confident" 3 "Highly Confident" ;
VAL_TABLE_ SRRRFODPB3P_VOTk6DynPrpStsAuth 0 "Stopped" 1 "Not Stopped" ;
VAL_TABLE_ SRRRFODPB3P_VOTk6DynPrpAuth 0 "Has Never Moved" 1 "Moving In Same Direction As Host" 2 "Moving In Opposite Direction As Host" 3 "Crossing From Left To Right" 4 "Crossing From Right To Left" ;
VAL_TABLE_ SRRRFODPB3P_VOTk6MStsAuth 0 "No Object" 1 "New Object" 2 "Latent Track Not Detected this Cycle" 3 "Measured this Cycle" ;
VAL_TABLE_ SRRRFODPB3P_VOTk6TypCnfdAuth 0 "Highly Speculative" 1 "Speculative" 2 "Confident" 3 "Highly Confident" ;
VAL_TABLE_ SRRRFODPB3P_VOTk7DynPrpStsAuth 0 "Stopped" 1 "Not Stopped" ;
VAL_TABLE_ SRRRFODPB3P_VOTk7DynPrpAuth 0 "Has Never Moved" 1 "Moving In Same Direction As Host" 2 "Moving In Opposite Direction As Host" 3 "Crossing From Left To Right" 4 "Crossing From Right To Left" ;
VAL_TABLE_ SRRRFODPB3P_VOTk7CnfdStsAuth 0 "Highly Speculative" 1 "Speculative" 2 "Confident" 3 "Highly Confident" ;
VAL_TABLE_ SRRRFODPB3P_VOTk7MStsAuth 0 "No Object" 1 "New Object" 2 "Latent Track Not Detected this Cycle" 3 "Measured this Cycle" ;
VAL_TABLE_ SRRRFODPB3P_VOTk7TypCnfdAuth 0 "Highly Speculative" 1 "Speculative" 2 "Confident" 3 "Highly Confident" ;
VAL_TABLE_ SRRRFODPB4P_POTk5DynPrpAuth 0 "Has Never Moved" 1 "Has Moved But Currently Stopped" 2 "Moving In Same Direction As Host" 3 "Moving In Opposite Direction As Host" 4 "Crossing Path" ;
VAL_TABLE_ SRRRFODPB4P_POTk5CnfdStsAuth 0 "Highly Speculative" 1 "Speculative" 2 "Confident" 3 "Highly Confident" ;
VAL_TABLE_ SRRRFODPB4P_POTk5MStsAuth 0 "No Object" 1 "New Object" 2 "Latent Track Not Detected this Cycle" 3 "Measured this Cycle" ;
VAL_TABLE_ SRRRFODPB4P_POTk5TypCnfdAuth 0 "Highly Speculative" 1 "Speculative" 2 "Confident" 3 "Highly Confident" ;
VAL_TABLE_ SRRRFODPB4P_POTk5TypAuth 0 "Unknown" 1 "Pedestrian" 2 "Bicycle" ;
VAL_TABLE_ SRRRFODPB4P_VOTk10DynPrpStsAuth 0 "Stopped" 1 "Not Stopped" ;
VAL_TABLE_ SRRRFODPB4P_VOTk10DynPrpAuth 0 "Has Never Moved" 1 "Moving In Same Direction As Host" 2 "Moving In Opposite Direction As Host" 3 "Crossing From Left To Right" 4 "Crossing From Right To Left" ;
VAL_TABLE_ SRRRFODPB4P_VOTk10CnfdStsAuth 0 "Highly Speculative" 1 "Speculative" 2 "Confident" 3 "Highly Confident" ;
VAL_TABLE_ SRRRFODPB4P_VOTk10MStsAuth 0 "No Object" 1 "New Object" 2 "Latent Track Not Detected this Cycle" 3 "Measured this Cycle" ;
VAL_TABLE_ SRRRFODPB4P_VOTk10TypCnfdAuth 0 "Highly Speculative" 1 "Speculative" 2 "Confident" 3 "Highly Confident" ;

BA_DEF_ SG_  "SignalType" STRING ;
BA_DEF_ SG_  "SignalLongName" STRING ;
BA_DEF_ BO_  "GenMsgCycleTime" INT 0 10000;
BA_DEF_ BO_  "GenMsgSendType" ENUM "cyclicX","spontanX","cyclicIfActiveX","spontanWithDelay","cyclicAndSpontanX","cyclicAndSpontanWithDelay","spontanWithRepetition","cyclicIfActiveAndSpontanWD";
BA_DEF_ BO_  "VFrameFormat" ENUM  "StandardCAN","ExtendedCAN","reserved","reserved","reserved","reserved","reserved","reserved","reserved","reserved","reserved","reserved","reserved","reserved","StandardCAN_FD","ExtendedCAN_FD";
BA_DEF_DEF_  "SignalType" "";
BA_DEF_DEF_  "SignalLongName" "";
BA_DEF_DEF_  "GenMsgCycleTime" 0;
BA_DEF_DEF_  "GenMsgSendType" "cyclicX";
BA_DEF_DEF_  "VFrameFormat" "StandardCAN";
